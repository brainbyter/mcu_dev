/* @@@@ File written by CANAPE_VERSION 9 0 30 @@@@ */
ASAP2_VERSION 1 60
/begin PROJECT Project_AU_C ""
/begin MODULE CPP ""
/begin MOD_COMMON "" BYTE_ORDER MSB_LAST ALIGNMENT_BYTE 1 ALIGNMENT_WORD 1 ALIGNMENT_LONG 1 ALIGNMENT_INT64 1 ALIGNMENT_FLOAT32_IEEE 1 ALIGNMENT_FLOAT64_IEEE 1 /end MOD_COMMON
/begin IF_DATA XCP
 /begin PROTOCOL_LAYER 0x0100 0x03E8 0x2710 0 0 0 0 0 8 /* 0xFF */ 128 /* 0x00FA */ BYTE_ORDER_MSB_LAST ADDRESS_GRANULARITY_BYTE OPTIONAL_CMD PROGRAM_PREPARE OPTIONAL_CMD PROGRAM_RESET OPTIONAL_CMD PROGRAM OPTIONAL_CMD PROGRAM_CLEAR OPTIONAL_CMD PROGRAM_START OPTIONAL_CMD ALLOC_ODT_ENTRY OPTIONAL_CMD ALLOC_ODT OPTIONAL_CMD ALLOC_DAQ OPTIONAL_CMD FREE_DAQ OPTIONAL_CMD GET_DAQ_RESOLUTION_INFO OPTIONAL_CMD GET_DAQ_PROCESSOR_INFO OPTIONAL_CMD GET_DAQ_CLOCK OPTIONAL_CMD START_STOP_SYNCH OPTIONAL_CMD START_STOP_DAQ_LIST OPTIONAL_CMD GET_DAQ_LIST_MODE OPTIONAL_CMD SET_DAQ_LIST_MODE OPTIONAL_CMD WRITE_DAQ OPTIONAL_CMD SET_DAQ_PTR OPTIONAL_CMD CLEAR_DAQ_LIST OPTIONAL_CMD COPY_CAL_PAGE OPTIONAL_CMD GET_CAL_PAGE OPTIONAL_CMD SET_CAL_PAGE OPTIONAL_CMD SHORT_DOWNLOAD OPTIONAL_CMD DOWNLOAD_MAX OPTIONAL_CMD DOWNLOAD OPTIONAL_CMD BUILD_CHECKSUM OPTIONAL_CMD SHORT_UPLOAD OPTIONAL_CMD UPLOAD OPTIONAL_CMD SET_MTA OPTIONAL_CMD GET_COMM_MODE_INFO /end PROTOCOL_LAYER
 /begin DAQ DYNAMIC 0x0000 0x0004 0x00 OPTIMISATION_TYPE_DEFAULT ADDRESS_EXTENSION_FREE IDENTIFICATION_FIELD_TYPE_RELATIVE_BYTE GRANULARITY_ODT_ENTRY_SIZE_DAQ_BYTE 0xF8 OVERLOAD_INDICATION_PID /begin STIM GRANULARITY_ODT_ENTRY_SIZE_STIM_BYTE 0xF8 /end STIM /begin TIMESTAMP_SUPPORTED 0x002D NO_TIME_STAMP UNIT_1US /end TIMESTAMP_SUPPORTED /begin EVENT "Task_10ms" "Task_10ms" 0x0000 DAQ 0xFF 0x0A 0x06 0x00 /end EVENT /begin EVENT "Task_100ms" "Task_100m" 0x0001 DAQ 0xFF 0x64 0x06 0x00 /end EVENT /begin EVENT "synch" "synch" 0x0002 DAQ 0xFF 0x00 0x00 0x01 /end EVENT /begin EVENT "Bypass_STIM" "Bypass_ST" 0x0003 STIM 0xFF 0x01 0x07 0xFF /end EVENT /end DAQ
 /begin PAG 0x01 /end PAG
 /begin PGM PGM_MODE_ABSOLUTE 0x14 0x00 /begin SECTOR "Sector" 0x0 0xA0000000 0x20000 0x0 0x0 0x0 /end SECTOR /begin SECTOR "Sector" 0x1 0xA0020000 0x20000 0x0 0x0 0x0 /end SECTOR /begin SECTOR "Sector" 0x2 0xA0040000 0x40000 0x0 0x0 0x0 /end SECTOR /begin SECTOR "Sector" 0x3 0xA0080000 0x40000 0x0 0x0 0x0 /end SECTOR /begin SECTOR "Sector" 0x4 0xA00C0000 0x40000 0x0 0x0 0x0 /end SECTOR /begin SECTOR "Sector" 0x5 0xA0100000 0x40000 0x0 0x0 0x0 /end SECTOR /begin SECTOR "Sector" 0x6 0xA0140000 0x40000 0x0 0x0 0x0 /end SECTOR /begin SECTOR "Sector" 0x7 0xA0180000 0x40000 0x0 0x0 0x0 /end SECTOR /begin SECTOR "Sector" 0x8 0xA01C0000 0x40000 0x0 0x0 0x0 /end SECTOR /begin SECTOR "Sector" 0x9 0xA01C0000 0x40000 0x0 0x0 0x0 /end SECTOR /begin SECTOR "Sector" 0xA 0xA0200000 0x10000 0x0 0x0 0x0 /end SECTOR /begin SECTOR "Sector" 0xB 0xA0210000 0x10000 0x0 0x0 0x0 /end SECTOR /begin SECTOR "Sector" 0xC 0xA0220000 0x20000 0x0 0x0 0x0 /end SECTOR /begin SECTOR "Sector" 0xD 0xA0240000 0x40000 0x0 0x0 0x0 /end SECTOR /begin SECTOR "Sector" 0xE 0xA0280000 0x40000 0x0 0x0 0x0 /end SECTOR /begin SECTOR "Sector" 0xF 0xA02C0000 0x40000 0x0 0x0 0x0 /end SECTOR /begin SECTOR "Sector" 0x10 0xA0300000 0x40000 0x0 0x0 0x0 /end SECTOR /begin SECTOR "Sector" 0x11 0xA0340000 0x40000 0x0 0x0 0x0 /end SECTOR /begin SECTOR "Sector" 0x12 0xA0380000 0x40000 0x0 0x0 0x0 /end SECTOR /begin SECTOR "Sector" 0x13 0xA03C0000 0x40000 0x0 0x0 0x0 /end SECTOR /end PGM
 /begin XCP_ON_TCP_IP 0x0101 50000 ADDRESS "192.168.1.3" /end XCP_ON_TCP_IP
 /begin XCP_ON_UDP_IP 0x0100 52100 ADDRESS "192.168.1.3" /end XCP_ON_UDP_IP
 /begin XCP_ON_CAN 0x0100 CAN_ID_MASTER 0x0782 CAN_ID_SLAVE 0x0792 BAUDRATE 0x0F4240 SAMPLE_POINT 0x4B SAMPLE_RATE SINGLE BTL_CYCLES 0x08 SJW 0x02 SYNC_EDGE SINGLE /end XCP_ON_CAN
/end IF_DATA
/begin MEASUREMENT CAN_Debug "" UBYTE NO_COMPU_METHOD 0 0 0 255 ECU_ADDRESS 0x00000000 /end MEASUREMENT
/begin GROUP OutputVars "OutputVars" ROOT /begin REF_MEASUREMENT CAN_Debug /end REF_MEASUREMENT /end GROUP
/begin MEASUREMENT CrashEveDetd "" UBYTE NO_COMPU_METHOD 0 0 0 255 ECU_ADDRESS 0x00000000 /end MEASUREMENT
/begin MEASUREMENT SeatBeltStatus "" UBYTE NO_COMPU_METHOD 0 0 0 255 ECU_ADDRESS 0x00000000 /end MEASUREMENT
/begin MEASUREMENT RainDetd "" UBYTE NO_COMPU_METHOD 0 0 0 255 ECU_ADDRESS 0x00000000 /end MEASUREMENT
/begin MEASUREMENT RainDens "" UBYTE NO_COMPU_METHOD 0 0 0 255 ECU_ADDRESS 0x00000000 /end MEASUREMENT
/begin MEASUREMENT WindscreenHum "" FLOAT32_IEEE NO_COMPU_METHOD 0 0 -3.40282346639E+38 3.40282346639E+38 ECU_ADDRESS 0x00000000 /end MEASUREMENT
/begin MEASUREMENT WindscreenTemp "" FLOAT32_IEEE NO_COMPU_METHOD 0 0 -3.40282346639E+38 3.40282346639E+38 ECU_ADDRESS 0x00000000 /end MEASUREMENT
/begin MEASUREMENT WindscreenHeat "" UBYTE NO_COMPU_METHOD 0 0 0 255 ECU_ADDRESS 0x00000000 /end MEASUREMENT
/begin MEASUREMENT SolarSnsrRiVal "" FLOAT32_IEEE NO_COMPU_METHOD 0 0 -3.40282346639E+38 3.40282346639E+38 ECU_ADDRESS 0x00000000 /end MEASUREMENT
/begin MEASUREMENT SolarSnsrLeVal "" FLOAT32_IEEE NO_COMPU_METHOD 0 0 -3.40282346639E+38 3.40282346639E+38 ECU_ADDRESS 0x00000000 /end MEASUREMENT
/begin MEASUREMENT WiprSt "" UBYTE NO_COMPU_METHOD 0 0 0 255 ECU_ADDRESS 0x00000000 /end MEASUREMENT
/begin MEASUREMENT TurnLeftSt "" UBYTE NO_COMPU_METHOD 0 0 0 255 ECU_ADDRESS 0x00000000 /end MEASUREMENT
/begin MEASUREMENT TurnRightSt "" UBYTE NO_COMPU_METHOD 0 0 0 255 ECU_ADDRESS 0x00000000 /end MEASUREMENT
/begin MEASUREMENT HighBeamReq "" UBYTE NO_COMPU_METHOD 0 0 0 255 ECU_ADDRESS 0x00000000 /end MEASUREMENT
/begin MEASUREMENT MliaStartReq "" UBYTE NO_COMPU_METHOD 0 0 0 255 ECU_ADDRESS 0x00000000 /end MEASUREMENT
/begin MEASUREMENT TargetLvlALS "" UBYTE NO_COMPU_METHOD 0 0 0 255 ECU_ADDRESS 0x00000000 /end MEASUREMENT
/begin MEASUREMENT ProjAnimationStat "" UBYTE NO_COMPU_METHOD 0 0 0 255 ECU_ADDRESS 0x00000000 /end MEASUREMENT
/begin MEASUREMENT WashFluidLvl "" UBYTE NO_COMPU_METHOD 0 0 0 255 ECU_ADDRESS 0x00000000 /end MEASUREMENT
/begin MEASUREMENT LockSt "" UBYTE NO_COMPU_METHOD 0 0 0 255 ECU_ADDRESS 0x00000000 /end MEASUREMENT
/begin MEASUREMENT LightSwReason_Val "" UBYTE NO_COMPU_METHOD 0 0 0 255 ECU_ADDRESS 0x00000000 /end MEASUREMENT
/begin MEASUREMENT LightAmbient_Val "" FLOAT32_IEEE NO_COMPU_METHOD 0 0 -3.40282346639E+38 3.40282346639E+38 ECU_ADDRESS 0x00000000 /end MEASUREMENT
/begin MEASUREMENT LightFront_Val "" FLOAT32_IEEE NO_COMPU_METHOD 0 0 -3.40282346639E+38 3.40282346639E+38 ECU_ADDRESS 0x00000000 /end MEASUREMENT
/begin MEASUREMENT VehBody "" UBYTE NO_COMPU_METHOD 0 0 0 255 ECU_ADDRESS 0x00000000 /end MEASUREMENT
/begin MEASUREMENT IgnSt "" UBYTE NO_COMPU_METHOD 0 0 0 255 ECU_ADDRESS 0x00000000 /end MEASUREMENT
/begin MEASUREMENT VehicleMode "" UBYTE NO_COMPU_METHOD 0 0 0 255 ECU_ADDRESS 0x00000000 /end MEASUREMENT
/begin MEASUREMENT SensTermSt "" UBYTE NO_COMPU_METHOD 0 0 0 255 ECU_ADDRESS 0x00000000 /end MEASUREMENT
/begin MEASUREMENT VehicleType "" UBYTE NO_COMPU_METHOD 0 0 0 255 ECU_ADDRESS 0x00000000 /end MEASUREMENT
/begin MEASUREMENT LdwBt "" UBYTE NO_COMPU_METHOD 0 0 0 255 ECU_ADDRESS 0x00000000 /end MEASUREMENT
/begin MEASUREMENT LccBt "" UBYTE NO_COMPU_METHOD 0 0 0 255 ECU_ADDRESS 0x00000000 /end MEASUREMENT
/begin MEASUREMENT AdasSensCleanSt "" UBYTE NO_COMPU_METHOD 0 0 0 255 ECU_ADDRESS 0x00000000 /end MEASUREMENT
/begin MEASUREMENT AmbTemp "" FLOAT32_IEEE NO_COMPU_METHOD 0 0 -3.40282346639E+38 3.40282346639E+38 ECU_ADDRESS 0x00000000 /end MEASUREMENT
/begin MEASUREMENT FanSpeed "" UBYTE NO_COMPU_METHOD 0 0 0 255 ECU_ADDRESS 0x00000000 /end MEASUREMENT
/begin MEASUREMENT DoorFrontLeftSt "" UBYTE NO_COMPU_METHOD 0 0 0 255 ECU_ADDRESS 0x00000000 /end MEASUREMENT
/begin MEASUREMENT DoorFrontLeftHandleReq "" UBYTE NO_COMPU_METHOD 0 0 0 255 ECU_ADDRESS 0x00000000 /end MEASUREMENT
/begin MEASUREMENT DoorFrontRightSt "" UBYTE NO_COMPU_METHOD 0 0 0 255 ECU_ADDRESS 0x00000000 /end MEASUREMENT
/begin MEASUREMENT DoorFrontRightHandleReq "" UBYTE NO_COMPU_METHOD 0 0 0 255 ECU_ADDRESS 0x00000000 /end MEASUREMENT
/begin MEASUREMENT DoorRearLeftSt "" UBYTE NO_COMPU_METHOD 0 0 0 255 ECU_ADDRESS 0x00000000 /end MEASUREMENT
/begin MEASUREMENT DoorRearLeftHandleReq "" UBYTE NO_COMPU_METHOD 0 0 0 255 ECU_ADDRESS 0x00000000 /end MEASUREMENT
/begin MEASUREMENT DoorRearRightSt "" UBYTE NO_COMPU_METHOD 0 0 0 255 ECU_ADDRESS 0x00000000 /end MEASUREMENT
/begin MEASUREMENT DoorRearRightHandleReq "" UBYTE NO_COMPU_METHOD 0 0 0 255 ECU_ADDRESS 0x00000000 /end MEASUREMENT
/begin MEASUREMENT DriveOperMode "" UBYTE NO_COMPU_METHOD 0 0 0 255 ECU_ADDRESS 0x00000000 /end MEASUREMENT
/begin MEASUREMENT TrqClutch "" FLOAT32_IEEE NO_COMPU_METHOD 0 0 -3.40282346639E+38 3.40282346639E+38 ECU_ADDRESS 0x00000000 /end MEASUREMENT
/begin MEASUREMENT DragTrq "" FLOAT32_IEEE NO_COMPU_METHOD 0 0 -3.40282346639E+38 3.40282346639E+38 ECU_ADDRESS 0x00000000 /end MEASUREMENT
/begin MEASUREMENT KickDownSt "" UBYTE NO_COMPU_METHOD 0 0 0 255 ECU_ADDRESS 0x00000000 /end MEASUREMENT
/begin MEASUREMENT AccelPedalPos "" FLOAT32_IEEE NO_COMPU_METHOD 0 0 -3.40282346639E+38 3.40282346639E+38 ECU_ADDRESS 0x00000000 /end MEASUREMENT
/begin MEASUREMENT DriverTorqueDmd "" FLOAT32_IEEE NO_COMPU_METHOD 0 0 -3.40282346639E+38 3.40282346639E+38 ECU_ADDRESS 0x00000000 /end MEASUREMENT
/begin MEASUREMENT EngineSpeed "" FLOAT32_IEEE NO_COMPU_METHOD 0 0 -3.40282346639E+38 3.40282346639E+38 ECU_ADDRESS 0x00000000 /end MEASUREMENT
/begin MEASUREMENT DynamicEmergActive "" UBYTE NO_COMPU_METHOD 0 0 0 255 ECU_ADDRESS 0x00000000 /end MEASUREMENT
/begin MEASUREMENT EpbSt "" UBYTE NO_COMPU_METHOD 0 0 0 255 ECU_ADDRESS 0x00000000 /end MEASUREMENT
/begin MEASUREMENT WheelSpdFrontLeft "" FLOAT32_IEEE NO_COMPU_METHOD 0 0 -3.40282346639E+38 3.40282346639E+38 ECU_ADDRESS 0x00000000 /end MEASUREMENT
/begin MEASUREMENT WheelSpdFrontRight "" FLOAT32_IEEE NO_COMPU_METHOD 0 0 -3.40282346639E+38 3.40282346639E+38 ECU_ADDRESS 0x00000000 /end MEASUREMENT
/begin MEASUREMENT WheelDirectionFL "" UBYTE NO_COMPU_METHOD 0 0 0 255 ECU_ADDRESS 0x00000000 /end MEASUREMENT
/begin MEASUREMENT WheelDirectionFR "" UBYTE NO_COMPU_METHOD 0 0 0 255 ECU_ADDRESS 0x00000000 /end MEASUREMENT
/begin MEASUREMENT WheelSpeedValueErrorFL "" UBYTE NO_COMPU_METHOD 0 0 0 255 ECU_ADDRESS 0x00000000 /end MEASUREMENT
/begin MEASUREMENT WheelSpeedValueErrorFR "" UBYTE NO_COMPU_METHOD 0 0 0 255 ECU_ADDRESS 0x00000000 /end MEASUREMENT
/begin MEASUREMENT WheelSpdRearLeft "" FLOAT32_IEEE NO_COMPU_METHOD 0 0 -3.40282346639E+38 3.40282346639E+38 ECU_ADDRESS 0x00000000 /end MEASUREMENT
/begin MEASUREMENT WheelSpdRearRight "" FLOAT32_IEEE NO_COMPU_METHOD 0 0 -3.40282346639E+38 3.40282346639E+38 ECU_ADDRESS 0x00000000 /end MEASUREMENT
/begin MEASUREMENT WheelSpeedValueErrorRL "" UBYTE NO_COMPU_METHOD 0 0 0 255 ECU_ADDRESS 0x00000000 /end MEASUREMENT
/begin MEASUREMENT WheelSpeedValueErrorRR "" UBYTE NO_COMPU_METHOD 0 0 0 255 ECU_ADDRESS 0x00000000 /end MEASUREMENT
/begin MEASUREMENT AbsActive "" UBYTE NO_COMPU_METHOD 0 0 0 255 ECU_ADDRESS 0x00000000 /end MEASUREMENT
/begin MEASUREMENT TcsActive "" UBYTE NO_COMPU_METHOD 0 0 0 255 ECU_ADDRESS 0x00000000 /end MEASUREMENT
/begin MEASUREMENT BlsActive "" UBYTE NO_COMPU_METHOD 0 0 0 255 ECU_ADDRESS 0x00000000 /end MEASUREMENT
/begin MEASUREMENT BlaActive "" UBYTE NO_COMPU_METHOD 0 0 0 255 ECU_ADDRESS 0x00000000 /end MEASUREMENT
/begin MEASUREMENT HdcActive "" UBYTE NO_COMPU_METHOD 0 0 0 255 ECU_ADDRESS 0x00000000 /end MEASUREMENT
/begin MEASUREMENT VdcActive "" UBYTE NO_COMPU_METHOD 0 0 0 255 ECU_ADDRESS 0x00000000 /end MEASUREMENT
/begin MEASUREMENT VehicleSpd "" FLOAT32_IEEE NO_COMPU_METHOD 0 0 -3.40282346639E+38 3.40282346639E+38 ECU_ADDRESS 0x00000000 /end MEASUREMENT
/begin MEASUREMENT VehicleSpdValueError "" UBYTE NO_COMPU_METHOD 0 0 0 255 ECU_ADDRESS 0x00000000 /end MEASUREMENT
/begin MEASUREMENT EbdActive "" UBYTE NO_COMPU_METHOD 0 0 0 255 ECU_ADDRESS 0x00000000 /end MEASUREMENT
/begin MEASUREMENT WheelBrakePressureFrontRight "" FLOAT32_IEEE NO_COMPU_METHOD 0 0 -3.40282346639E+38 3.40282346639E+38 ECU_ADDRESS 0x00000000 /end MEASUREMENT
/begin MEASUREMENT WheelBrakePressureFrontLeft "" FLOAT32_IEEE NO_COMPU_METHOD 0 0 -3.40282346639E+38 3.40282346639E+38 ECU_ADDRESS 0x00000000 /end MEASUREMENT
/begin MEASUREMENT WheelBrakePressureRearLeft "" FLOAT32_IEEE NO_COMPU_METHOD 0 0 -3.40282346639E+38 3.40282346639E+38 ECU_ADDRESS 0x00000000 /end MEASUREMENT
/begin MEASUREMENT WheelBrakePressureRearRight "" FLOAT32_IEEE NO_COMPU_METHOD 0 0 -3.40282346639E+38 3.40282346639E+38 ECU_ADDRESS 0x00000000 /end MEASUREMENT
/begin MEASUREMENT McBrakePressure "" FLOAT32_IEEE NO_COMPU_METHOD 0 0 -3.40282346639E+38 3.40282346639E+38 ECU_ADDRESS 0x00000000 /end MEASUREMENT
/begin MEASUREMENT CddSkiddingDetd "" UBYTE NO_COMPU_METHOD 0 0 0 255 ECU_ADDRESS 0x00000000 /end MEASUREMENT
/begin MEASUREMENT CddTempSwitchOff "" UBYTE NO_COMPU_METHOD 0 0 0 255 ECU_ADDRESS 0x00000000 /end MEASUREMENT
/begin MEASUREMENT CddAvl "" UBYTE NO_COMPU_METHOD 0 0 0 255 ECU_ADDRESS 0x00000000 /end MEASUREMENT
/begin MEASUREMENT CddActv "" UBYTE NO_COMPU_METHOD 0 0 0 255 ECU_ADDRESS 0x00000000 /end MEASUREMENT
/begin MEASUREMENT AebAvl "" UBYTE NO_COMPU_METHOD 0 0 0 255 ECU_ADDRESS 0x00000000 /end MEASUREMENT
/begin MEASUREMENT CddStandstillSt "" UBYTE NO_COMPU_METHOD 0 0 0 255 ECU_ADDRESS 0x00000000 /end MEASUREMENT
/begin MEASUREMENT LateralAccel "" FLOAT32_IEEE NO_COMPU_METHOD 0 0 -3.40282346639E+38 3.40282346639E+38 ECU_ADDRESS 0x00000000 /end MEASUREMENT
/begin MEASUREMENT AYStat "" UBYTE NO_COMPU_METHOD 0 0 0 255 ECU_ADDRESS 0x00000000 /end MEASUREMENT
/begin MEASUREMENT YawRate "" FLOAT32_IEEE NO_COMPU_METHOD 0 0 -3.40282346639E+38 3.40282346639E+38 ECU_ADDRESS 0x00000000 /end MEASUREMENT
/begin MEASUREMENT YawRateValidSts "" UBYTE NO_COMPU_METHOD 0 0 0 255 ECU_ADDRESS 0x00000000 /end MEASUREMENT
/begin MEASUREMENT LongAccel "" FLOAT32_IEEE NO_COMPU_METHOD 0 0 -3.40282346639E+38 3.40282346639E+38 ECU_ADDRESS 0x00000000 /end MEASUREMENT
/begin MEASUREMENT AXStat "" UBYTE NO_COMPU_METHOD 0 0 0 255 ECU_ADDRESS 0x00000000 /end MEASUREMENT
/begin MEASUREMENT DmsFatiqueLvl "" UBYTE NO_COMPU_METHOD 0 0 0 255 ECU_ADDRESS 0x00000000 /end MEASUREMENT
/begin MEASUREMENT DmsDistractLvl "" UBYTE NO_COMPU_METHOD 0 0 0 255 ECU_ADDRESS 0x00000000 /end MEASUREMENT
/begin MEASUREMENT DmsCentrWindArea "" UBYTE NO_COMPU_METHOD 0 0 0 255 ECU_ADDRESS 0x00000000 /end MEASUREMENT
/begin MEASUREMENT DmsLeftWindArea "" UBYTE NO_COMPU_METHOD 0 0 0 255 ECU_ADDRESS 0x00000000 /end MEASUREMENT
/begin MEASUREMENT DmsRightWindArea "" UBYTE NO_COMPU_METHOD 0 0 0 255 ECU_ADDRESS 0x00000000 /end MEASUREMENT
/begin MEASUREMENT DmsRearMirrArea "" UBYTE NO_COMPU_METHOD 0 0 0 255 ECU_ADDRESS 0x00000000 /end MEASUREMENT
/begin MEASUREMENT DmsLeftMirrArea "" UBYTE NO_COMPU_METHOD 0 0 0 255 ECU_ADDRESS 0x00000000 /end MEASUREMENT
/begin MEASUREMENT DmsRightMirrArea "" UBYTE NO_COMPU_METHOD 0 0 0 255 ECU_ADDRESS 0x00000000 /end MEASUREMENT
/begin MEASUREMENT DmsCillArea "" UBYTE NO_COMPU_METHOD 0 0 0 255 ECU_ADDRESS 0x00000000 /end MEASUREMENT
/begin MEASUREMENT DmsDashArea "" UBYTE NO_COMPU_METHOD 0 0 0 255 ECU_ADDRESS 0x00000000 /end MEASUREMENT
/begin MEASUREMENT DmsMediaArea "" UBYTE NO_COMPU_METHOD 0 0 0 255 ECU_ADDRESS 0x00000000 /end MEASUREMENT
/begin MEASUREMENT DmsOtherArea "" UBYTE NO_COMPU_METHOD 0 0 0 255 ECU_ADDRESS 0x00000000 /end MEASUREMENT
/begin MEASUREMENT DmsReliability "" UBYTE NO_COMPU_METHOD 0 0 0 255 ECU_ADDRESS 0x00000000 /end MEASUREMENT
/begin MEASUREMENT DmsRecognition "" UBYTE NO_COMPU_METHOD 0 0 0 255 ECU_ADDRESS 0x00000000 /end MEASUREMENT
/begin MEASUREMENT NvActReq "" UBYTE NO_COMPU_METHOD 0 0 0 255 ECU_ADDRESS 0x00000000 /end MEASUREMENT
/begin MEASUREMENT VisualActReq "" UBYTE NO_COMPU_METHOD 0 0 0 255 ECU_ADDRESS 0x00000000 /end MEASUREMENT
/begin MEASUREMENT DistBarSt "" UBYTE NO_COMPU_METHOD 0 0 0 255 ECU_ADDRESS 0x00000000 /end MEASUREMENT
/begin MEASUREMENT SpdFromIc "" FLOAT32_IEEE NO_COMPU_METHOD 0 0 -3.40282346639E+38 3.40282346639E+38 ECU_ADDRESS 0x00000000 /end MEASUREMENT
/begin MEASUREMENT AbsoluteDateAndTime "" ULONG NO_COMPU_METHOD 0 0 0 4294967295 ECU_ADDRESS 0x00000000 /end MEASUREMENT
/begin MEASUREMENT MasDrivingSt "" UBYTE NO_COMPU_METHOD 0 0 0 255 ECU_ADDRESS 0x00000000 /end MEASUREMENT
/begin MEASUREMENT MasErrSt "" UBYTE NO_COMPU_METHOD 0 0 0 255 ECU_ADDRESS 0x00000000 /end MEASUREMENT
/begin MEASUREMENT MasActivReq "" UBYTE NO_COMPU_METHOD 0 0 0 255 ECU_ADDRESS 0x00000000 /end MEASUREMENT
/begin MEASUREMENT MasApaDistReq "" FLOAT32_IEEE NO_COMPU_METHOD 0 0 -3.40282346639E+38 3.40282346639E+38 ECU_ADDRESS 0x00000000 /end MEASUREMENT
/begin MEASUREMENT MasGearReq "" UBYTE NO_COMPU_METHOD 0 0 0 255 ECU_ADDRESS 0x00000000 /end MEASUREMENT
/begin MEASUREMENT MasParkSt "" UBYTE NO_COMPU_METHOD 0 0 0 255 ECU_ADDRESS 0x00000000 /end MEASUREMENT
/begin MEASUREMENT MasPosTrq "" FLOAT32_IEEE NO_COMPU_METHOD 0 0 -3.40282346639E+38 3.40282346639E+38 ECU_ADDRESS 0x00000000 /end MEASUREMENT
/begin MEASUREMENT MasNegTrq "" FLOAT32_IEEE NO_COMPU_METHOD 0 0 -3.40282346639E+38 3.40282346639E+38 ECU_ADDRESS 0x00000000 /end MEASUREMENT
/begin MEASUREMENT ParkDistFront1 "" UBYTE NO_COMPU_METHOD 0 0 0 255 ECU_ADDRESS 0x00000000 /end MEASUREMENT
/begin MEASUREMENT ParkDistFront2 "" UBYTE NO_COMPU_METHOD 0 0 0 255 ECU_ADDRESS 0x00000000 /end MEASUREMENT
/begin MEASUREMENT ParkDistFront3 "" UBYTE NO_COMPU_METHOD 0 0 0 255 ECU_ADDRESS 0x00000000 /end MEASUREMENT
/begin MEASUREMENT ParkDistFront4 "" UBYTE NO_COMPU_METHOD 0 0 0 255 ECU_ADDRESS 0x00000000 /end MEASUREMENT
/begin MEASUREMENT ParkDistRear1 "" UBYTE NO_COMPU_METHOD 0 0 0 255 ECU_ADDRESS 0x00000000 /end MEASUREMENT
/begin MEASUREMENT ParkDistRear2 "" UBYTE NO_COMPU_METHOD 0 0 0 255 ECU_ADDRESS 0x00000000 /end MEASUREMENT
/begin MEASUREMENT ParkDistRear3 "" UBYTE NO_COMPU_METHOD 0 0 0 255 ECU_ADDRESS 0x00000000 /end MEASUREMENT
/begin MEASUREMENT ParkDistRear4 "" UBYTE NO_COMPU_METHOD 0 0 0 255 ECU_ADDRESS 0x00000000 /end MEASUREMENT
/begin MEASUREMENT ParkDistFrontLeftSide "" FLOAT32_IEEE NO_COMPU_METHOD 0 0 -3.40282346639E+38 3.40282346639E+38 ECU_ADDRESS 0x00000000 /end MEASUREMENT
/begin MEASUREMENT ParkDistFrontRightSide "" FLOAT32_IEEE NO_COMPU_METHOD 0 0 -3.40282346639E+38 3.40282346639E+38 ECU_ADDRESS 0x00000000 /end MEASUREMENT
/begin MEASUREMENT ParkDistRearLeftSide "" FLOAT32_IEEE NO_COMPU_METHOD 0 0 -3.40282346639E+38 3.40282346639E+38 ECU_ADDRESS 0x00000000 /end MEASUREMENT
/begin MEASUREMENT ParkDistRearRightSide "" FLOAT32_IEEE NO_COMPU_METHOD 0 0 -3.40282346639E+38 3.40282346639E+38 ECU_ADDRESS 0x00000000 /end MEASUREMENT
/begin MEASUREMENT CorrectorActValLeft "" UBYTE NO_COMPU_METHOD 0 0 0 255 ECU_ADDRESS 0x00000000 /end MEASUREMENT
/begin MEASUREMENT CorrectorActValRight "" UBYTE NO_COMPU_METHOD 0 0 0 255 ECU_ADDRESS 0x00000000 /end MEASUREMENT
/begin MEASUREMENT SasAng "" FLOAT32_IEEE NO_COMPU_METHOD 0 0 -3.40282346639E+38 3.40282346639E+38 ECU_ADDRESS 0x00000000 /end MEASUREMENT
/begin MEASUREMENT SasSpd "" FLOAT32_IEEE NO_COMPU_METHOD 0 0 -3.40282346639E+38 3.40282346639E+38 ECU_ADDRESS 0x00000000 /end MEASUREMENT
/begin MEASUREMENT SasCalSt "" UBYTE NO_COMPU_METHOD 0 0 0 255 ECU_ADDRESS 0x00000000 /end MEASUREMENT
/begin MEASUREMENT SasOKSt "" UBYTE NO_COMPU_METHOD 0 0 0 255 ECU_ADDRESS 0x00000000 /end MEASUREMENT
/begin MEASUREMENT BtSpdDec "" UBYTE NO_COMPU_METHOD 0 0 0 255 ECU_ADDRESS 0x00000000 /end MEASUREMENT
/begin MEASUREMENT BtActivMode "" UBYTE NO_COMPU_METHOD 0 0 0 255 ECU_ADDRESS 0x00000000 /end MEASUREMENT
/begin MEASUREMENT BtDist "" UBYTE NO_COMPU_METHOD 0 0 0 255 ECU_ADDRESS 0x00000000 /end MEASUREMENT
/begin MEASUREMENT PosHandSt "" UBYTE NO_COMPU_METHOD 0 0 0 255 ECU_ADDRESS 0x00000000 /end MEASUREMENT
/begin MEASUREMENT BtSpdInc "" UBYTE NO_COMPU_METHOD 0 0 0 255 ECU_ADDRESS 0x00000000 /end MEASUREMENT
/begin MEASUREMENT BtCncl "" UBYTE NO_COMPU_METHOD 0 0 0 255 ECU_ADDRESS 0x00000000 /end MEASUREMENT
/begin MEASUREMENT BtRes "" UBYTE NO_COMPU_METHOD 0 0 0 255 ECU_ADDRESS 0x00000000 /end MEASUREMENT
/begin MEASUREMENT BtStar "" UBYTE NO_COMPU_METHOD 0 0 0 255 ECU_ADDRESS 0x00000000 /end MEASUREMENT
/begin MEASUREMENT BtSet "" UBYTE NO_COMPU_METHOD 0 0 0 255 ECU_ADDRESS 0x00000000 /end MEASUREMENT
/begin MEASUREMENT SCULFHeight "" UBYTE NO_COMPU_METHOD 0 0 0 255 ECU_ADDRESS 0x00000000 /end MEASUREMENT
/begin MEASUREMENT SCURFHeight "" UBYTE NO_COMPU_METHOD 0 0 0 255 ECU_ADDRESS 0x00000000 /end MEASUREMENT
/begin MEASUREMENT SCULRHeight "" UBYTE NO_COMPU_METHOD 0 0 0 255 ECU_ADDRESS 0x00000000 /end MEASUREMENT
/begin MEASUREMENT SCURRHeight "" UBYTE NO_COMPU_METHOD 0 0 0 255 ECU_ADDRESS 0x00000000 /end MEASUREMENT
/begin MEASUREMENT GearSt "" UBYTE NO_COMPU_METHOD 0 0 0 255 ECU_ADDRESS 0x00000000 /end MEASUREMENT
/begin MEASUREMENT GearManualModeSt "" UBYTE NO_COMPU_METHOD 0 0 0 255 ECU_ADDRESS 0x00000000 /end MEASUREMENT
/begin MEASUREMENT GearChange "" UBYTE NO_COMPU_METHOD 0 0 0 255 ECU_ADDRESS 0x00000000 /end MEASUREMENT
/begin MEASUREMENT GearEngNum "" UBYTE NO_COMPU_METHOD 0 0 0 255 ECU_ADDRESS 0x00000000 /end MEASUREMENT
/begin MEASUREMENT GearTargetNum "" UBYTE NO_COMPU_METHOD 0 0 0 255 ECU_ADDRESS 0x00000000 /end MEASUREMENT
/begin MEASUREMENT ISettStartSettReq "" UBYTE NO_COMPU_METHOD 0 0 0 255 ECU_ADDRESS 0x00000000 /end MEASUREMENT
/begin MEASUREMENT ISettCcTypeReq "" UBYTE NO_COMPU_METHOD 0 0 0 255 ECU_ADDRESS 0x00000000 /end MEASUREMENT
/begin MEASUREMENT ISettCcmodeReq "" UBYTE NO_COMPU_METHOD 0 0 0 255 ECU_ADDRESS 0x00000000 /end MEASUREMENT
/begin MEASUREMENT ISettCcAutoSpeedReq "" UBYTE NO_COMPU_METHOD 0 0 0 255 ECU_ADDRESS 0x00000000 /end MEASUREMENT
/begin MEASUREMENT ISettAslaActReq "" UBYTE NO_COMPU_METHOD 0 0 0 255 ECU_ADDRESS 0x00000000 /end MEASUREMENT
/begin MEASUREMENT ISettAslaDeltaReq "" FLOAT32_IEEE NO_COMPU_METHOD 0 0 -3.40282346639E+38 3.40282346639E+38 ECU_ADDRESS 0x00000000 /end MEASUREMENT
/begin MEASUREMENT ISettFcwActReq "" UBYTE NO_COMPU_METHOD 0 0 0 255 ECU_ADDRESS 0x00000000 /end MEASUREMENT
/begin MEASUREMENT ISettFcwModeReq "" UBYTE NO_COMPU_METHOD 0 0 0 255 ECU_ADDRESS 0x00000000 /end MEASUREMENT
/begin MEASUREMENT ISettFcwVibrWarnReq "" UBYTE NO_COMPU_METHOD 0 0 0 255 ECU_ADDRESS 0x00000000 /end MEASUREMENT
/begin MEASUREMENT ISettAebActReq "" UBYTE NO_COMPU_METHOD 0 0 0 255 ECU_ADDRESS 0x00000000 /end MEASUREMENT
/begin MEASUREMENT ISettAaActReq "" UBYTE NO_COMPU_METHOD 0 0 0 255 ECU_ADDRESS 0x00000000 /end MEASUREMENT
/begin MEASUREMENT ISettAaModeReq "" UBYTE NO_COMPU_METHOD 0 0 0 255 ECU_ADDRESS 0x00000000 /end MEASUREMENT
/begin MEASUREMENT ISettAfsActReq "" UBYTE NO_COMPU_METHOD 0 0 0 255 ECU_ADDRESS 0x00000000 /end MEASUREMENT
/begin MEASUREMENT ISettLccActReq "" UBYTE NO_COMPU_METHOD 0 0 0 255 ECU_ADDRESS 0x00000000 /end MEASUREMENT
/begin MEASUREMENT ISettLccVibrationWarnReq "" UBYTE NO_COMPU_METHOD 0 0 0 255 ECU_ADDRESS 0x00000000 /end MEASUREMENT
/begin MEASUREMENT ISettLccSoundAlertReq "" UBYTE NO_COMPU_METHOD 0 0 0 255 ECU_ADDRESS 0x00000000 /end MEASUREMENT
/begin MEASUREMENT ISettLccModeReq "" UBYTE NO_COMPU_METHOD 0 0 0 255 ECU_ADDRESS 0x00000000 /end MEASUREMENT
/begin MEASUREMENT ISettAlccActReq "" UBYTE NO_COMPU_METHOD 0 0 0 255 ECU_ADDRESS 0x00000000 /end MEASUREMENT
/begin MEASUREMENT ISettDowActReq "" UBYTE NO_COMPU_METHOD 0 0 0 255 ECU_ADDRESS 0x00000000 /end MEASUREMENT
/begin MEASUREMENT ISettDowSoundWarnReq "" UBYTE NO_COMPU_METHOD 0 0 0 255 ECU_ADDRESS 0x00000000 /end MEASUREMENT
/begin MEASUREMENT ISettLdwActReq "" UBYTE NO_COMPU_METHOD 0 0 0 255 ECU_ADDRESS 0x00000000 /end MEASUREMENT
/begin MEASUREMENT ISettLdwModeReq "" UBYTE NO_COMPU_METHOD 0 0 0 255 ECU_ADDRESS 0x00000000 /end MEASUREMENT
/begin MEASUREMENT ISettLdwVibrReq "" UBYTE NO_COMPU_METHOD 0 0 0 255 ECU_ADDRESS 0x00000000 /end MEASUREMENT
/begin MEASUREMENT ISettLdwSoundReq "" UBYTE NO_COMPU_METHOD 0 0 0 255 ECU_ADDRESS 0x00000000 /end MEASUREMENT
/begin MEASUREMENT ISettLdpActReq "" UBYTE NO_COMPU_METHOD 0 0 0 255 ECU_ADDRESS 0x00000000 /end MEASUREMENT
/begin MEASUREMENT ISettRecActReq "" UBYTE NO_COMPU_METHOD 0 0 0 255 ECU_ADDRESS 0x00000000 /end MEASUREMENT
/begin MEASUREMENT ISettLkaActReq "" UBYTE NO_COMPU_METHOD 0 0 0 255 ECU_ADDRESS 0x00000000 /end MEASUREMENT
/begin MEASUREMENT ISettTsrActReq "" UBYTE NO_COMPU_METHOD 0 0 0 255 ECU_ADDRESS 0x00000000 /end MEASUREMENT
/begin MEASUREMENT ISettRdaActReq "" UBYTE NO_COMPU_METHOD 0 0 0 255 ECU_ADDRESS 0x00000000 /end MEASUREMENT
/begin MEASUREMENT ISettRDAAutoBrake_Req "" UBYTE NO_COMPU_METHOD 0 0 0 255 ECU_ADDRESS 0x00000000 /end MEASUREMENT
/begin MEASUREMENT ISettRctcActReq "" UBYTE NO_COMPU_METHOD 0 0 0 255 ECU_ADDRESS 0x00000000 /end MEASUREMENT
/begin MEASUREMENT ISettCleanSensorReq "" UBYTE NO_COMPU_METHOD 0 0 0 255 ECU_ADDRESS 0x00000000 /end MEASUREMENT
/begin MEASUREMENT ISettRoadSignStsReq "" UBYTE NO_COMPU_METHOD 0 0 0 255 ECU_ADDRESS 0x00000000 /end MEASUREMENT
/begin MEASUREMENT ISettNavigStsReq "" UBYTE NO_COMPU_METHOD 0 0 0 255 ECU_ADDRESS 0x00000000 /end MEASUREMENT
/begin MEASUREMENT ISettOtherObjStsReq "" UBYTE NO_COMPU_METHOD 0 0 0 255 ECU_ADDRESS 0x00000000 /end MEASUREMENT
/begin MEASUREMENT ISettProjectionOnARoadReq "" UBYTE NO_COMPU_METHOD 0 0 0 255 ECU_ADDRESS 0x00000000 /end MEASUREMENT
/begin MEASUREMENT FanSpeedReq "" UBYTE NO_COMPU_METHOD 0 0 0 255 ECU_ADDRESS 0x00000000 /end MEASUREMENT
/begin GROUP SignalsRx "SignalsRx" ROOT
 /begin REF_MEASUREMENT CrashEveDetd SeatBeltStatus RainDetd RainDens WindscreenHum WindscreenTemp WindscreenHeat SolarSnsrRiVal SolarSnsrLeVal WiprSt TurnLeftSt TurnRightSt HighBeamReq MliaStartReq TargetLvlALS ProjAnimationStat WashFluidLvl LockSt LightSwReason_Val LightAmbient_Val LightFront_Val VehBody IgnSt VehicleMode SensTermSt VehicleType LdwBt LccBt AdasSensCleanSt AmbTemp FanSpeed DoorFrontLeftSt DoorFrontLeftHandleReq DoorFrontRightSt DoorFrontRightHandleReq DoorRearLeftSt DoorRearLeftHandleReq DoorRearRightSt DoorRearRightHandleReq DriveOperMode TrqClutch DragTrq KickDownSt AccelPedalPos DriverTorqueDmd EngineSpeed DynamicEmergActive EpbSt WheelSpdFrontLeft WheelSpdFrontRight WheelDirectionFL WheelDirectionFR WheelSpeedValueErrorFL WheelSpeedValueErrorFR WheelSpdRearLeft WheelSpdRearRight WheelSpeedValueErrorRL WheelSpeedValueErrorRR AbsActive TcsActive BlsActive BlaActive HdcActive VdcActive VehicleSpd VehicleSpdValueError EbdActive WheelBrakePressureFrontRight WheelBrakePressureFrontLeft WheelBrakePressureRearLeft WheelBrakePressureRearRight McBrakePressure CddSkiddingDetd CddTempSwitchOff CddAvl CddActv AebAvl CddStandstillSt LateralAccel AYStat YawRate YawRateValidSts LongAccel AXStat DmsFatiqueLvl DmsDistractLvl DmsCentrWindArea DmsLeftWindArea DmsRightWindArea DmsRearMirrArea DmsLeftMirrArea DmsRightMirrArea DmsCillArea DmsDashArea DmsMediaArea DmsOtherArea DmsReliability DmsRecognition NvActReq VisualActReq DistBarSt SpdFromIc AbsoluteDateAndTime MasDrivingSt MasErrSt MasActivReq MasApaDistReq MasGearReq MasParkSt MasPosTrq MasNegTrq ParkDistFront1 ParkDistFront2 ParkDistFront3 ParkDistFront4 ParkDistRear1 ParkDistRear2 ParkDistRear3 ParkDistRear4 ParkDistFrontLeftSide ParkDistFrontRightSide ParkDistRearLeftSide ParkDistRearRightSide CorrectorActValLeft CorrectorActValRight SasAng SasSpd SasCalSt SasOKSt BtSpdDec BtActivMode BtDist PosHandSt BtSpdInc BtCncl BtRes BtStar BtSet SCULFHeight SCURFHeight SCULRHeight SCURRHeight GearSt GearManualModeSt GearChange GearEngNum GearTargetNum ISettStartSettReq ISettCcTypeReq ISettCcmodeReq ISettCcAutoSpeedReq ISettAslaActReq ISettAslaDeltaReq ISettFcwActReq ISettFcwModeReq ISettFcwVibrWarnReq ISettAebActReq ISettAaActReq ISettAaModeReq ISettAfsActReq ISettLccActReq ISettLccVibrationWarnReq ISettLccSoundAlertReq ISettLccModeReq ISettAlccActReq ISettDowActReq ISettDowSoundWarnReq ISettLdwActReq ISettLdwModeReq ISettLdwVibrReq ISettLdwSoundReq ISettLdpActReq ISettRecActReq ISettLkaActReq ISettTsrActReq ISettRdaActReq ISettRDAAutoBrake_Req ISettRctcActReq ISettCleanSensorReq ISettRoadSignStsReq ISettNavigStsReq ISettOtherObjStsReq ISettProjectionOnARoadReq FanSpeedReq /end REF_MEASUREMENT
/end GROUP
/begin MEASUREMENT ComScl_ACU_01_Timeout "" UBYTE NO_COMPU_METHOD 0 0 0 255 ECU_ADDRESS 0x00000000 /end MEASUREMENT
/begin MEASUREMENT ComScl_ACU_01_DataCorrupt "" UBYTE NO_COMPU_METHOD 0 0 0 255 ECU_ADDRESS 0x00000000 /end MEASUREMENT
/begin MEASUREMENT ComScl_ACU_01_ChksmError "" UBYTE NO_COMPU_METHOD 0 0 0 255 ECU_ADDRESS 0x00000000 /end MEASUREMENT
/begin MEASUREMENT ComScl_ACU_01_AlvCntError "" UBYTE NO_COMPU_METHOD 0 0 0 255 ECU_ADDRESS 0x00000000 /end MEASUREMENT
/begin MEASUREMENT ComScl_BCM_CLIMATIC_DATA_Timeout "" UBYTE NO_COMPU_METHOD 0 0 0 255 ECU_ADDRESS 0x00000000 /end MEASUREMENT
/begin MEASUREMENT ComScl_BCM_CLIMATIC_DATA_DataCorrupt "" UBYTE NO_COMPU_METHOD 0 0 0 255 ECU_ADDRESS 0x00000000 /end MEASUREMENT
/begin MEASUREMENT ComScl_BCM_EXT_LGT_Timeout "" UBYTE NO_COMPU_METHOD 0 0 0 255 ECU_ADDRESS 0x00000000 /end MEASUREMENT
/begin MEASUREMENT ComScl_BCM_EXT_LGT_DataCorrupt "" UBYTE NO_COMPU_METHOD 0 0 0 255 ECU_ADDRESS 0x00000000 /end MEASUREMENT
/begin MEASUREMENT ComScl_BCM_EXT_LGT_ChksmError "" UBYTE NO_COMPU_METHOD 0 0 0 255 ECU_ADDRESS 0x00000000 /end MEASUREMENT
/begin MEASUREMENT ComScl_BCM_EXT_LGT_AlvCntError "" UBYTE NO_COMPU_METHOD 0 0 0 255 ECU_ADDRESS 0x00000000 /end MEASUREMENT
/begin MEASUREMENT ComScl_BCM_IC_Info_Msg_Timeout "" UBYTE NO_COMPU_METHOD 0 0 0 255 ECU_ADDRESS 0x00000000 /end MEASUREMENT
/begin MEASUREMENT ComScl_BCM_IC_Info_Msg_DataCorrupt "" UBYTE NO_COMPU_METHOD 0 0 0 255 ECU_ADDRESS 0x00000000 /end MEASUREMENT
/begin MEASUREMENT ComScl_BCM_Lock_CTR_Timeout "" UBYTE NO_COMPU_METHOD 0 0 0 255 ECU_ADDRESS 0x00000000 /end MEASUREMENT
/begin MEASUREMENT ComScl_BCM_Lock_CTR_DataCorrupt "" UBYTE NO_COMPU_METHOD 0 0 0 255 ECU_ADDRESS 0x00000000 /end MEASUREMENT
/begin MEASUREMENT ComScl_BCM_RLS_Stat_Timeout "" UBYTE NO_COMPU_METHOD 0 0 0 255 ECU_ADDRESS 0x00000000 /end MEASUREMENT
/begin MEASUREMENT ComScl_BCM_RLS_Stat_DataCorrupt "" UBYTE NO_COMPU_METHOD 0 0 0 255 ECU_ADDRESS 0x00000000 /end MEASUREMENT
/begin MEASUREMENT ComScl_BCM_VEH_STATE_Timeout "" UBYTE NO_COMPU_METHOD 0 0 0 255 ECU_ADDRESS 0x00000000 /end MEASUREMENT
/begin MEASUREMENT ComScl_BCM_VEH_STATE_DataCorrupt "" UBYTE NO_COMPU_METHOD 0 0 0 255 ECU_ADDRESS 0x00000000 /end MEASUREMENT
/begin MEASUREMENT ComScl_BCM_Veh_State2_Timeout "" UBYTE NO_COMPU_METHOD 0 0 0 255 ECU_ADDRESS 0x00000000 /end MEASUREMENT
/begin MEASUREMENT ComScl_BCM_Veh_State2_DataCorrupt "" UBYTE NO_COMPU_METHOD 0 0 0 255 ECU_ADDRESS 0x00000000 /end MEASUREMENT
/begin MEASUREMENT ComScl_CCU_Stat1_Timeout "" UBYTE NO_COMPU_METHOD 0 0 0 255 ECU_ADDRESS 0x00000000 /end MEASUREMENT
/begin MEASUREMENT ComScl_CCU_Stat1_DataCorrupt "" UBYTE NO_COMPU_METHOD 0 0 0 255 ECU_ADDRESS 0x00000000 /end MEASUREMENT
/begin MEASUREMENT ComScl_DMFL_Msg1_Timeout "" UBYTE NO_COMPU_METHOD 0 0 0 255 ECU_ADDRESS 0x00000000 /end MEASUREMENT
/begin MEASUREMENT ComScl_DMFL_Msg1_DataCorrupt "" UBYTE NO_COMPU_METHOD 0 0 0 255 ECU_ADDRESS 0x00000000 /end MEASUREMENT
/begin MEASUREMENT ComScl_DMFR_Msg1_Timeout "" UBYTE NO_COMPU_METHOD 0 0 0 255 ECU_ADDRESS 0x00000000 /end MEASUREMENT
/begin MEASUREMENT ComScl_DMFR_Msg1_DataCorrupt "" UBYTE NO_COMPU_METHOD 0 0 0 255 ECU_ADDRESS 0x00000000 /end MEASUREMENT
/begin MEASUREMENT ComScl_DMRL_Msg1_Timeout "" UBYTE NO_COMPU_METHOD 0 0 0 255 ECU_ADDRESS 0x00000000 /end MEASUREMENT
/begin MEASUREMENT ComScl_DMRL_Msg1_DataCorrupt "" UBYTE NO_COMPU_METHOD 0 0 0 255 ECU_ADDRESS 0x00000000 /end MEASUREMENT
/begin MEASUREMENT ComScl_DMRR_Msg1_Timeout "" UBYTE NO_COMPU_METHOD 0 0 0 255 ECU_ADDRESS 0x00000000 /end MEASUREMENT
/begin MEASUREMENT ComScl_DMRR_Msg1_DataCorrupt "" UBYTE NO_COMPU_METHOD 0 0 0 255 ECU_ADDRESS 0x00000000 /end MEASUREMENT
/begin MEASUREMENT ComScl_BCM_DMS_01_Timeout "" UBYTE NO_COMPU_METHOD 0 0 0 255 ECU_ADDRESS 0x00000000 /end MEASUREMENT
/begin MEASUREMENT ComScl_BCM_DMS_01_DataCorrupt "" UBYTE NO_COMPU_METHOD 0 0 0 255 ECU_ADDRESS 0x00000000 /end MEASUREMENT
/begin MEASUREMENT ComScl_BCM_DMS_01_ChksmError "" UBYTE NO_COMPU_METHOD 0 0 0 255 ECU_ADDRESS 0x00000000 /end MEASUREMENT
/begin MEASUREMENT ComScl_BCM_DMS_01_AlvCntError "" UBYTE NO_COMPU_METHOD 0 0 0 255 ECU_ADDRESS 0x00000000 /end MEASUREMENT
/begin MEASUREMENT ComScl_EMS_14_Timeout "" UBYTE NO_COMPU_METHOD 0 0 0 255 ECU_ADDRESS 0x00000000 /end MEASUREMENT
/begin MEASUREMENT ComScl_EMS_14_DataCorrupt "" UBYTE NO_COMPU_METHOD 0 0 0 255 ECU_ADDRESS 0x00000000 /end MEASUREMENT
/begin MEASUREMENT ComScl_EMS_14_ChksmError "" UBYTE NO_COMPU_METHOD 0 0 0 255 ECU_ADDRESS 0x00000000 /end MEASUREMENT
/begin MEASUREMENT ComScl_EMS_14_AlvCntError "" UBYTE NO_COMPU_METHOD 0 0 0 255 ECU_ADDRESS 0x00000000 /end MEASUREMENT
/begin MEASUREMENT ComScl_EMS_3_Timeout "" UBYTE NO_COMPU_METHOD 0 0 0 255 ECU_ADDRESS 0x00000000 /end MEASUREMENT
/begin MEASUREMENT ComScl_EMS_3_DataCorrupt "" UBYTE NO_COMPU_METHOD 0 0 0 255 ECU_ADDRESS 0x00000000 /end MEASUREMENT
/begin MEASUREMENT ComScl_EMS_4_Timeout "" UBYTE NO_COMPU_METHOD 0 0 0 255 ECU_ADDRESS 0x00000000 /end MEASUREMENT
/begin MEASUREMENT ComScl_EMS_4_DataCorrupt "" UBYTE NO_COMPU_METHOD 0 0 0 255 ECU_ADDRESS 0x00000000 /end MEASUREMENT
/begin MEASUREMENT ComScl_EPB_Status_Timeout "" UBYTE NO_COMPU_METHOD 0 0 0 255 ECU_ADDRESS 0x00000000 /end MEASUREMENT
/begin MEASUREMENT ComScl_EPB_Status_DataCorrupt "" UBYTE NO_COMPU_METHOD 0 0 0 255 ECU_ADDRESS 0x00000000 /end MEASUREMENT
/begin MEASUREMENT ComScl_EPB_Status_ChksmError "" UBYTE NO_COMPU_METHOD 0 0 0 255 ECU_ADDRESS 0x00000000 /end MEASUREMENT
/begin MEASUREMENT ComScl_EPB_Status_AlvCntError "" UBYTE NO_COMPU_METHOD 0 0 0 255 ECU_ADDRESS 0x00000000 /end MEASUREMENT
/begin MEASUREMENT ComScl_ESC_02_Timeout "" UBYTE NO_COMPU_METHOD 0 0 0 255 ECU_ADDRESS 0x00000000 /end MEASUREMENT
/begin MEASUREMENT ComScl_ESC_02_DataCorrupt "" UBYTE NO_COMPU_METHOD 0 0 0 255 ECU_ADDRESS 0x00000000 /end MEASUREMENT
/begin MEASUREMENT ComScl_ESC_02_ChksmError "" UBYTE NO_COMPU_METHOD 0 0 0 255 ECU_ADDRESS 0x00000000 /end MEASUREMENT
/begin MEASUREMENT ComScl_ESC_02_AlvCntError "" UBYTE NO_COMPU_METHOD 0 0 0 255 ECU_ADDRESS 0x00000000 /end MEASUREMENT
/begin MEASUREMENT ComScl_ESC_03_Timeout "" UBYTE NO_COMPU_METHOD 0 0 0 255 ECU_ADDRESS 0x00000000 /end MEASUREMENT
/begin MEASUREMENT ComScl_ESC_03_DataCorrupt "" UBYTE NO_COMPU_METHOD 0 0 0 255 ECU_ADDRESS 0x00000000 /end MEASUREMENT
/begin MEASUREMENT ComScl_ESC_03_ChksmError "" UBYTE NO_COMPU_METHOD 0 0 0 255 ECU_ADDRESS 0x00000000 /end MEASUREMENT
/begin MEASUREMENT ComScl_ESC_03_AlvCntError "" UBYTE NO_COMPU_METHOD 0 0 0 255 ECU_ADDRESS 0x00000000 /end MEASUREMENT
/begin MEASUREMENT ComScl_ESC_04_Timeout "" UBYTE NO_COMPU_METHOD 0 0 0 255 ECU_ADDRESS 0x00000000 /end MEASUREMENT
/begin MEASUREMENT ComScl_ESC_04_DataCorrupt "" UBYTE NO_COMPU_METHOD 0 0 0 255 ECU_ADDRESS 0x00000000 /end MEASUREMENT
/begin MEASUREMENT ComScl_ESC_04_ChksmError "" UBYTE NO_COMPU_METHOD 0 0 0 255 ECU_ADDRESS 0x00000000 /end MEASUREMENT
/begin MEASUREMENT ComScl_ESC_04_AlvCntError "" UBYTE NO_COMPU_METHOD 0 0 0 255 ECU_ADDRESS 0x00000000 /end MEASUREMENT
/begin MEASUREMENT ComScl_ESC_06_Timeout "" UBYTE NO_COMPU_METHOD 0 0 0 255 ECU_ADDRESS 0x00000000 /end MEASUREMENT
/begin MEASUREMENT ComScl_ESC_06_DataCorrupt "" UBYTE NO_COMPU_METHOD 0 0 0 255 ECU_ADDRESS 0x00000000 /end MEASUREMENT
/begin MEASUREMENT ComScl_ESC_06_ChksmError "" UBYTE NO_COMPU_METHOD 0 0 0 255 ECU_ADDRESS 0x00000000 /end MEASUREMENT
/begin MEASUREMENT ComScl_ESC_06_AlvCntError "" UBYTE NO_COMPU_METHOD 0 0 0 255 ECU_ADDRESS 0x00000000 /end MEASUREMENT
/begin MEASUREMENT ComScl_ESC_07_Timeout "" UBYTE NO_COMPU_METHOD 0 0 0 255 ECU_ADDRESS 0x00000000 /end MEASUREMENT
/begin MEASUREMENT ComScl_ESC_07_DataCorrupt "" UBYTE NO_COMPU_METHOD 0 0 0 255 ECU_ADDRESS 0x00000000 /end MEASUREMENT
/begin MEASUREMENT ComScl_ESC_07_ChksmError "" UBYTE NO_COMPU_METHOD 0 0 0 255 ECU_ADDRESS 0x00000000 /end MEASUREMENT
/begin MEASUREMENT ComScl_ESC_07_AlvCntError "" UBYTE NO_COMPU_METHOD 0 0 0 255 ECU_ADDRESS 0x00000000 /end MEASUREMENT
/begin MEASUREMENT ComScl_ESC_09_Timeout "" UBYTE NO_COMPU_METHOD 0 0 0 255 ECU_ADDRESS 0x00000000 /end MEASUREMENT
/begin MEASUREMENT ComScl_ESC_09_DataCorrupt "" UBYTE NO_COMPU_METHOD 0 0 0 255 ECU_ADDRESS 0x00000000 /end MEASUREMENT
/begin MEASUREMENT ComScl_ESC_09_ChksmError "" UBYTE NO_COMPU_METHOD 0 0 0 255 ECU_ADDRESS 0x00000000 /end MEASUREMENT
/begin MEASUREMENT ComScl_ESC_09_AlvCntError "" UBYTE NO_COMPU_METHOD 0 0 0 255 ECU_ADDRESS 0x00000000 /end MEASUREMENT
/begin MEASUREMENT ComScl_ESC_10_Timeout "" UBYTE NO_COMPU_METHOD 0 0 0 255 ECU_ADDRESS 0x00000000 /end MEASUREMENT
/begin MEASUREMENT ComScl_ESC_10_DataCorrupt "" UBYTE NO_COMPU_METHOD 0 0 0 255 ECU_ADDRESS 0x00000000 /end MEASUREMENT
/begin MEASUREMENT ComScl_ESC_10_ChksmError "" UBYTE NO_COMPU_METHOD 0 0 0 255 ECU_ADDRESS 0x00000000 /end MEASUREMENT
/begin MEASUREMENT ComScl_ESC_10_AlvCntError "" UBYTE NO_COMPU_METHOD 0 0 0 255 ECU_ADDRESS 0x00000000 /end MEASUREMENT
/begin MEASUREMENT ComScl_ESC_YRS_01_Timeout "" UBYTE NO_COMPU_METHOD 0 0 0 255 ECU_ADDRESS 0x00000000 /end MEASUREMENT
/begin MEASUREMENT ComScl_ESC_YRS_01_DataCorrupt "" UBYTE NO_COMPU_METHOD 0 0 0 255 ECU_ADDRESS 0x00000000 /end MEASUREMENT
/begin MEASUREMENT ComScl_ESC_YRS_01_ChksmError "" UBYTE NO_COMPU_METHOD 0 0 0 255 ECU_ADDRESS 0x00000000 /end MEASUREMENT
/begin MEASUREMENT ComScl_ESC_YRS_01_AlvCntError "" UBYTE NO_COMPU_METHOD 0 0 0 255 ECU_ADDRESS 0x00000000 /end MEASUREMENT
/begin MEASUREMENT ComScl_ESC_YRS_02_Timeout "" UBYTE NO_COMPU_METHOD 0 0 0 255 ECU_ADDRESS 0x00000000 /end MEASUREMENT
/begin MEASUREMENT ComScl_ESC_YRS_02_DataCorrupt "" UBYTE NO_COMPU_METHOD 0 0 0 255 ECU_ADDRESS 0x00000000 /end MEASUREMENT
/begin MEASUREMENT ComScl_ESC_YRS_02_ChksmError "" UBYTE NO_COMPU_METHOD 0 0 0 255 ECU_ADDRESS 0x00000000 /end MEASUREMENT
/begin MEASUREMENT ComScl_ESC_YRS_02_AlvCntError "" UBYTE NO_COMPU_METHOD 0 0 0 255 ECU_ADDRESS 0x00000000 /end MEASUREMENT
/begin MEASUREMENT ComScl_IC_DMS_Timeout "" UBYTE NO_COMPU_METHOD 0 0 0 255 ECU_ADDRESS 0x00000000 /end MEASUREMENT
/begin MEASUREMENT ComScl_IC_DMS_DataCorrupt "" UBYTE NO_COMPU_METHOD 0 0 0 255 ECU_ADDRESS 0x00000000 /end MEASUREMENT
/begin MEASUREMENT ComScl_IC_ADAS_REST_Timeout "" UBYTE NO_COMPU_METHOD 0 0 0 255 ECU_ADDRESS 0x00000000 /end MEASUREMENT
/begin MEASUREMENT ComScl_IC_ADAS_REST_DataCorrupt "" UBYTE NO_COMPU_METHOD 0 0 0 255 ECU_ADDRESS 0x00000000 /end MEASUREMENT
/begin MEASUREMENT ComScl_IC_HUD_01_Timeout "" UBYTE NO_COMPU_METHOD 0 0 0 255 ECU_ADDRESS 0x00000000 /end MEASUREMENT
/begin MEASUREMENT ComScl_IC_HUD_01_DataCorrupt "" UBYTE NO_COMPU_METHOD 0 0 0 255 ECU_ADDRESS 0x00000000 /end MEASUREMENT
/begin MEASUREMENT ComScl_IC_ABSOLUTE_CLOCK_Timeout "" UBYTE NO_COMPU_METHOD 0 0 0 255 ECU_ADDRESS 0x00000000 /end MEASUREMENT
/begin MEASUREMENT ComScl_IC_ABSOLUTE_CLOCK_DataCorrupt "" UBYTE NO_COMPU_METHOD 0 0 0 255 ECU_ADDRESS 0x00000000 /end MEASUREMENT
/begin MEASUREMENT ComScl_IC_ABSOLUTE_CLOCK_ChksmError "" UBYTE NO_COMPU_METHOD 0 0 0 255 ECU_ADDRESS 0x00000000 /end MEASUREMENT
/begin MEASUREMENT ComScl_IC_ABSOLUTE_CLOCK_AlvCntError "" UBYTE NO_COMPU_METHOD 0 0 0 255 ECU_ADDRESS 0x00000000 /end MEASUREMENT
/begin MEASUREMENT ComScl_MAS_Status_Timeout "" UBYTE NO_COMPU_METHOD 0 0 0 255 ECU_ADDRESS 0x00000000 /end MEASUREMENT
/begin MEASUREMENT ComScl_MAS_Status_DataCorrupt "" UBYTE NO_COMPU_METHOD 0 0 0 255 ECU_ADDRESS 0x00000000 /end MEASUREMENT
/begin MEASUREMENT ComScl_MAS_Status_ChksmError "" UBYTE NO_COMPU_METHOD 0 0 0 255 ECU_ADDRESS 0x00000000 /end MEASUREMENT
/begin MEASUREMENT ComScl_MAS_Status_AlvCntError "" UBYTE NO_COMPU_METHOD 0 0 0 255 ECU_ADDRESS 0x00000000 /end MEASUREMENT
/begin MEASUREMENT ComScl_MAS_FrontUSS_Timeout "" UBYTE NO_COMPU_METHOD 0 0 0 255 ECU_ADDRESS 0x00000000 /end MEASUREMENT
/begin MEASUREMENT ComScl_MAS_FrontUSS_DataCorrupt "" UBYTE NO_COMPU_METHOD 0 0 0 255 ECU_ADDRESS 0x00000000 /end MEASUREMENT
/begin MEASUREMENT ComScl_MAS_FrontUSS_ChksmError "" UBYTE NO_COMPU_METHOD 0 0 0 255 ECU_ADDRESS 0x00000000 /end MEASUREMENT
/begin MEASUREMENT ComScl_MAS_FrontUSS_AlvCntError "" UBYTE NO_COMPU_METHOD 0 0 0 255 ECU_ADDRESS 0x00000000 /end MEASUREMENT
/begin MEASUREMENT ComScl_MAS_RearUSS_Timeout "" UBYTE NO_COMPU_METHOD 0 0 0 255 ECU_ADDRESS 0x00000000 /end MEASUREMENT
/begin MEASUREMENT ComScl_MAS_RearUSS_DataCorrupt "" UBYTE NO_COMPU_METHOD 0 0 0 255 ECU_ADDRESS 0x00000000 /end MEASUREMENT
/begin MEASUREMENT ComScl_MAS_RearUSS_ChksmError "" UBYTE NO_COMPU_METHOD 0 0 0 255 ECU_ADDRESS 0x00000000 /end MEASUREMENT
/begin MEASUREMENT ComScl_MAS_RearUSS_AlvCntError "" UBYTE NO_COMPU_METHOD 0 0 0 255 ECU_ADDRESS 0x00000000 /end MEASUREMENT
/begin MEASUREMENT ComScl_MAS_SideUSS_Timeout "" UBYTE NO_COMPU_METHOD 0 0 0 255 ECU_ADDRESS 0x00000000 /end MEASUREMENT
/begin MEASUREMENT ComScl_MAS_SideUSS_DataCorrupt "" UBYTE NO_COMPU_METHOD 0 0 0 255 ECU_ADDRESS 0x00000000 /end MEASUREMENT
/begin MEASUREMENT ComScl_MAS_SideUSS_ChksmError "" UBYTE NO_COMPU_METHOD 0 0 0 255 ECU_ADDRESS 0x00000000 /end MEASUREMENT
/begin MEASUREMENT ComScl_MAS_SideUSS_AlvCntError "" UBYTE NO_COMPU_METHOD 0 0 0 255 ECU_ADDRESS 0x00000000 /end MEASUREMENT
/begin MEASUREMENT ComScl_HLL_STATE_Timeout "" UBYTE NO_COMPU_METHOD 0 0 0 255 ECU_ADDRESS 0x00000000 /end MEASUREMENT
/begin MEASUREMENT ComScl_HLL_STATE_DataCorrupt "" UBYTE NO_COMPU_METHOD 0 0 0 255 ECU_ADDRESS 0x00000000 /end MEASUREMENT
/begin MEASUREMENT ComScl_HLR_STATE_Timeout "" UBYTE NO_COMPU_METHOD 0 0 0 255 ECU_ADDRESS 0x00000000 /end MEASUREMENT
/begin MEASUREMENT ComScl_HLR_STATE_DataCorrupt "" UBYTE NO_COMPU_METHOD 0 0 0 255 ECU_ADDRESS 0x00000000 /end MEASUREMENT
/begin MEASUREMENT ComScl_SAS_Standard_Timeout "" UBYTE NO_COMPU_METHOD 0 0 0 255 ECU_ADDRESS 0x00000000 /end MEASUREMENT
/begin MEASUREMENT ComScl_SAS_Standard_DataCorrupt "" UBYTE NO_COMPU_METHOD 0 0 0 255 ECU_ADDRESS 0x00000000 /end MEASUREMENT
/begin MEASUREMENT ComScl_SAS_Standard_ChksmError "" UBYTE NO_COMPU_METHOD 0 0 0 255 ECU_ADDRESS 0x00000000 /end MEASUREMENT
/begin MEASUREMENT ComScl_SAS_Standard_AlvCntError "" UBYTE NO_COMPU_METHOD 0 0 0 255 ECU_ADDRESS 0x00000000 /end MEASUREMENT
/begin MEASUREMENT ComScl_SWM_ContrlsState_Old_Timeout "" UBYTE NO_COMPU_METHOD 0 0 0 255 ECU_ADDRESS 0x00000000 /end MEASUREMENT
/begin MEASUREMENT ComScl_SWM_ContrlsState_Old_DataCorrupt "" UBYTE NO_COMPU_METHOD 0 0 0 255 ECU_ADDRESS 0x00000000 /end MEASUREMENT
/begin MEASUREMENT ComScl_SWM_ContrlsState_Old_ChksmError "" UBYTE NO_COMPU_METHOD 0 0 0 255 ECU_ADDRESS 0x00000000 /end MEASUREMENT
/begin MEASUREMENT ComScl_SWM_ContrlsState_Old_AlvCntError "" UBYTE NO_COMPU_METHOD 0 0 0 255 ECU_ADDRESS 0x00000000 /end MEASUREMENT
/begin MEASUREMENT ComScl_SWM_ContrlsState_Timeout "" UBYTE NO_COMPU_METHOD 0 0 0 255 ECU_ADDRESS 0x00000000 /end MEASUREMENT
/begin MEASUREMENT ComScl_SWM_ContrlsState_DataCorrupt "" UBYTE NO_COMPU_METHOD 0 0 0 255 ECU_ADDRESS 0x00000000 /end MEASUREMENT
/begin MEASUREMENT ComScl_SWM_ContrlsState_ChksmError "" UBYTE NO_COMPU_METHOD 0 0 0 255 ECU_ADDRESS 0x00000000 /end MEASUREMENT
/begin MEASUREMENT ComScl_SWM_ContrlsState_AlvCntError "" UBYTE NO_COMPU_METHOD 0 0 0 255 ECU_ADDRESS 0x00000000 /end MEASUREMENT
/begin MEASUREMENT ComScl_SCU_02_Timeout "" UBYTE NO_COMPU_METHOD 0 0 0 255 ECU_ADDRESS 0x00000000 /end MEASUREMENT
/begin MEASUREMENT ComScl_SCU_02_DataCorrupt "" UBYTE NO_COMPU_METHOD 0 0 0 255 ECU_ADDRESS 0x00000000 /end MEASUREMENT
/begin MEASUREMENT ComScl_SCU_02_ChksmError "" UBYTE NO_COMPU_METHOD 0 0 0 255 ECU_ADDRESS 0x00000000 /end MEASUREMENT
/begin MEASUREMENT ComScl_SCU_02_AlvCntError "" UBYTE NO_COMPU_METHOD 0 0 0 255 ECU_ADDRESS 0x00000000 /end MEASUREMENT
/begin MEASUREMENT ComScl_TCU_R932_1_Timeout "" UBYTE NO_COMPU_METHOD 0 0 0 255 ECU_ADDRESS 0x00000000 /end MEASUREMENT
/begin MEASUREMENT ComScl_TCU_R932_1_DataCorrupt "" UBYTE NO_COMPU_METHOD 0 0 0 255 ECU_ADDRESS 0x00000000 /end MEASUREMENT
/begin MEASUREMENT ComScl_TCU_R932_1_ChksmError "" UBYTE NO_COMPU_METHOD 0 0 0 255 ECU_ADDRESS 0x00000000 /end MEASUREMENT
/begin MEASUREMENT ComScl_TCU_R932_1_AlvCntError "" UBYTE NO_COMPU_METHOD 0 0 0 255 ECU_ADDRESS 0x00000000 /end MEASUREMENT
/begin MEASUREMENT ComScl_FIU_ADAS_Config_Timeout "" UBYTE NO_COMPU_METHOD 0 0 0 255 ECU_ADDRESS 0x00000000 /end MEASUREMENT
/begin MEASUREMENT ComScl_FIU_ADAS_Config_DataCorrupt "" UBYTE NO_COMPU_METHOD 0 0 0 255 ECU_ADDRESS 0x00000000 /end MEASUREMENT
/begin MEASUREMENT ComScl_FIU_Msg3_Timeout "" UBYTE NO_COMPU_METHOD 0 0 0 255 ECU_ADDRESS 0x00000000 /end MEASUREMENT
/begin MEASUREMENT ComScl_FIU_Msg3_DataCorrupt "" UBYTE NO_COMPU_METHOD 0 0 0 255 ECU_ADDRESS 0x00000000 /end MEASUREMENT
/begin MEASUREMENT ComScl_VCU_ADAS_01_Timeout "" UBYTE NO_COMPU_METHOD 0 0 0 255 ECU_ADDRESS 0x00000000 /end MEASUREMENT
/begin MEASUREMENT ComScl_VCU_ADAS_01_DataCorrupt "" UBYTE NO_COMPU_METHOD 0 0 0 255 ECU_ADDRESS 0x00000000 /end MEASUREMENT
/begin MEASUREMENT ComScl_VCU_ADAS_01_ChksmError "" UBYTE NO_COMPU_METHOD 0 0 0 255 ECU_ADDRESS 0x00000000 /end MEASUREMENT
/begin MEASUREMENT ComScl_VCU_ADAS_01_AlvCntError "" UBYTE NO_COMPU_METHOD 0 0 0 255 ECU_ADDRESS 0x00000000 /end MEASUREMENT
/begin MEASUREMENT ComScl_Diag_From_ERAG_Timeout "" UBYTE NO_COMPU_METHOD 0 0 0 255 ECU_ADDRESS 0x00000000 /end MEASUREMENT
/begin MEASUREMENT ComScl_Diag_From_ERAG_DataCorrupt "" UBYTE NO_COMPU_METHOD 0 0 0 255 ECU_ADDRESS 0x00000000 /end MEASUREMENT
/begin MEASUREMENT ComScl_ERAG_NMEA1_Timeout "" UBYTE NO_COMPU_METHOD 0 0 0 255 ECU_ADDRESS 0x00000000 /end MEASUREMENT
/begin MEASUREMENT ComScl_ERAG_NMEA1_DataCorrupt "" UBYTE NO_COMPU_METHOD 0 0 0 255 ECU_ADDRESS 0x00000000 /end MEASUREMENT
/begin MEASUREMENT ComScl_ERAG_NMEA2_Timeout "" UBYTE NO_COMPU_METHOD 0 0 0 255 ECU_ADDRESS 0x00000000 /end MEASUREMENT
/begin MEASUREMENT ComScl_ERAG_NMEA2_DataCorrupt "" UBYTE NO_COMPU_METHOD 0 0 0 255 ECU_ADDRESS 0x00000000 /end MEASUREMENT
/begin MEASUREMENT ComScl_ERAG_NMEA3_Timeout "" UBYTE NO_COMPU_METHOD 0 0 0 255 ECU_ADDRESS 0x00000000 /end MEASUREMENT
/begin MEASUREMENT ComScl_ERAG_NMEA3_DataCorrupt "" UBYTE NO_COMPU_METHOD 0 0 0 255 ECU_ADDRESS 0x00000000 /end MEASUREMENT
/begin MEASUREMENT ComScl_ERAG_NMEA4_Timeout "" UBYTE NO_COMPU_METHOD 0 0 0 255 ECU_ADDRESS 0x00000000 /end MEASUREMENT
/begin MEASUREMENT ComScl_ERAG_NMEA4_DataCorrupt "" UBYTE NO_COMPU_METHOD 0 0 0 255 ECU_ADDRESS 0x00000000 /end MEASUREMENT
/begin MEASUREMENT ComScl_ERAG_NMEA5_Timeout "" UBYTE NO_COMPU_METHOD 0 0 0 255 ECU_ADDRESS 0x00000000 /end MEASUREMENT
/begin MEASUREMENT ComScl_ERAG_NMEA5_DataCorrupt "" UBYTE NO_COMPU_METHOD 0 0 0 255 ECU_ADDRESS 0x00000000 /end MEASUREMENT
/begin MEASUREMENT ComScl_ERAG_NMEA6_Timeout "" UBYTE NO_COMPU_METHOD 0 0 0 255 ECU_ADDRESS 0x00000000 /end MEASUREMENT
/begin MEASUREMENT ComScl_ERAG_NMEA6_DataCorrupt "" UBYTE NO_COMPU_METHOD 0 0 0 255 ECU_ADDRESS 0x00000000 /end MEASUREMENT
/begin MEASUREMENT ComScl_ERAG_DATA_MSG_Timeout "" UBYTE NO_COMPU_METHOD 0 0 0 255 ECU_ADDRESS 0x00000000 /end MEASUREMENT
/begin MEASUREMENT ComScl_ERAG_DATA_MSG_DataCorrupt "" UBYTE NO_COMPU_METHOD 0 0 0 255 ECU_ADDRESS 0x00000000 /end MEASUREMENT
/begin MEASUREMENT ComScl_ATC_TX_Timeout "" UBYTE NO_COMPU_METHOD 0 0 0 255 ECU_ADDRESS 0x00000000 /end MEASUREMENT
/begin MEASUREMENT ComScl_ATC_TX_DataCorrupt "" UBYTE NO_COMPU_METHOD 0 0 0 255 ECU_ADDRESS 0x00000000 /end MEASUREMENT
/begin MEASUREMENT ComScl_ATC_TX_ChksmError "" UBYTE NO_COMPU_METHOD 0 0 0 255 ECU_ADDRESS 0x00000000 /end MEASUREMENT
/begin MEASUREMENT ComScl_ATC_TX_AlvCntError "" UBYTE NO_COMPU_METHOD 0 0 0 255 ECU_ADDRESS 0x00000000 /end MEASUREMENT
/begin MEASUREMENT ComScl_Diag_Functional_Timeout "" UBYTE NO_COMPU_METHOD 0 0 0 255 ECU_ADDRESS 0x00000000 /end MEASUREMENT
/begin MEASUREMENT ComScl_Diag_Functional_DataCorrupt "" UBYTE NO_COMPU_METHOD 0 0 0 255 ECU_ADDRESS 0x00000000 /end MEASUREMENT
/begin MEASUREMENT ComScl_Diag_To_DASCU_Timeout "" UBYTE NO_COMPU_METHOD 0 0 0 255 ECU_ADDRESS 0x00000000 /end MEASUREMENT
/begin MEASUREMENT ComScl_Diag_To_DASCU_DataCorrupt "" UBYTE NO_COMPU_METHOD 0 0 0 255 ECU_ADDRESS 0x00000000 /end MEASUREMENT
/begin MEASUREMENT ComScl_EMS_03_Timeout "" UBYTE NO_COMPU_METHOD 0 0 0 255 ECU_ADDRESS 0x00000000 /end MEASUREMENT
/begin MEASUREMENT ComScl_EMS_03_DataCorrupt "" UBYTE NO_COMPU_METHOD 0 0 0 255 ECU_ADDRESS 0x00000000 /end MEASUREMENT
/begin MEASUREMENT ComScl_EMS_03_ChksmError "" UBYTE NO_COMPU_METHOD 0 0 0 255 ECU_ADDRESS 0x00000000 /end MEASUREMENT
/begin MEASUREMENT ComScl_EMS_03_AlvCntError "" UBYTE NO_COMPU_METHOD 0 0 0 255 ECU_ADDRESS 0x00000000 /end MEASUREMENT
/begin MEASUREMENT ComScl_EMS_04_Timeout "" UBYTE NO_COMPU_METHOD 0 0 0 255 ECU_ADDRESS 0x00000000 /end MEASUREMENT
/begin MEASUREMENT ComScl_EMS_04_DataCorrupt "" UBYTE NO_COMPU_METHOD 0 0 0 255 ECU_ADDRESS 0x00000000 /end MEASUREMENT
/begin MEASUREMENT ComScl_EMS_04_ChksmError "" UBYTE NO_COMPU_METHOD 0 0 0 255 ECU_ADDRESS 0x00000000 /end MEASUREMENT
/begin MEASUREMENT ComScl_EMS_04_AlvCntError "" UBYTE NO_COMPU_METHOD 0 0 0 255 ECU_ADDRESS 0x00000000 /end MEASUREMENT
/begin MEASUREMENT ComScl_EMS_16_Timeout "" UBYTE NO_COMPU_METHOD 0 0 0 255 ECU_ADDRESS 0x00000000 /end MEASUREMENT
/begin MEASUREMENT ComScl_EMS_16_DataCorrupt "" UBYTE NO_COMPU_METHOD 0 0 0 255 ECU_ADDRESS 0x00000000 /end MEASUREMENT
/begin MEASUREMENT ComScl_EMS_16_ChksmError "" UBYTE NO_COMPU_METHOD 0 0 0 255 ECU_ADDRESS 0x00000000 /end MEASUREMENT
/begin MEASUREMENT ComScl_EMS_16_AlvCntError "" UBYTE NO_COMPU_METHOD 0 0 0 255 ECU_ADDRESS 0x00000000 /end MEASUREMENT
/begin MEASUREMENT ComScl_mLEDL_STATE_Timeout "" UBYTE NO_COMPU_METHOD 0 0 0 255 ECU_ADDRESS 0x00000000 /end MEASUREMENT
/begin MEASUREMENT ComScl_mLEDL_STATE_DataCorrupt "" UBYTE NO_COMPU_METHOD 0 0 0 255 ECU_ADDRESS 0x00000000 /end MEASUREMENT
/begin MEASUREMENT ComScl_mLEDR_STATE_Timeout "" UBYTE NO_COMPU_METHOD 0 0 0 255 ECU_ADDRESS 0x00000000 /end MEASUREMENT
/begin MEASUREMENT ComScl_mLEDR_STATE_DataCorrupt "" UBYTE NO_COMPU_METHOD 0 0 0 255 ECU_ADDRESS 0x00000000 /end MEASUREMENT
/begin MEASUREMENT ComScl_RSA_Status_Timeout "" UBYTE NO_COMPU_METHOD 0 0 0 255 ECU_ADDRESS 0x00000000 /end MEASUREMENT
/begin MEASUREMENT ComScl_RSA_Status_DataCorrupt "" UBYTE NO_COMPU_METHOD 0 0 0 255 ECU_ADDRESS 0x00000000 /end MEASUREMENT
/begin MEASUREMENT ComScl_RSA_Status_ChksmError "" UBYTE NO_COMPU_METHOD 0 0 0 255 ECU_ADDRESS 0x00000000 /end MEASUREMENT
/begin MEASUREMENT ComScl_RSA_Status_AlvCntError "" UBYTE NO_COMPU_METHOD 0 0 0 255 ECU_ADDRESS 0x00000000 /end MEASUREMENT
/begin MEASUREMENT ComScl_TM_Stat_Timeout "" UBYTE NO_COMPU_METHOD 0 0 0 255 ECU_ADDRESS 0x00000000 /end MEASUREMENT
/begin MEASUREMENT ComScl_TM_Stat_DataCorrupt "" UBYTE NO_COMPU_METHOD 0 0 0 255 ECU_ADDRESS 0x00000000 /end MEASUREMENT
/begin MEASUREMENT ComScl_VCU_DriverDmd_Timeout "" UBYTE NO_COMPU_METHOD 0 0 0 255 ECU_ADDRESS 0x00000000 /end MEASUREMENT
/begin MEASUREMENT ComScl_VCU_DriverDmd_DataCorrupt "" UBYTE NO_COMPU_METHOD 0 0 0 255 ECU_ADDRESS 0x00000000 /end MEASUREMENT
/begin MEASUREMENT ComScl_VCU_DriverDmd_ChksmError "" UBYTE NO_COMPU_METHOD 0 0 0 255 ECU_ADDRESS 0x00000000 /end MEASUREMENT
/begin MEASUREMENT ComScl_VCU_DriverDmd_AlvCntError "" UBYTE NO_COMPU_METHOD 0 0 0 255 ECU_ADDRESS 0x00000000 /end MEASUREMENT
/begin MEASUREMENT ComScl_Emu_Spd_Timeout "" UBYTE NO_COMPU_METHOD 0 0 0 255 ECU_ADDRESS 0x00000000 /end MEASUREMENT
/begin MEASUREMENT ComScl_Emu_Spd_DataCorrupt "" UBYTE NO_COMPU_METHOD 0 0 0 255 ECU_ADDRESS 0x00000000 /end MEASUREMENT
/begin MEASUREMENT ComScl_NeuralNetwork_Switch_Timeout "" UBYTE NO_COMPU_METHOD 0 0 0 255 ECU_ADDRESS 0x00000000 /end MEASUREMENT
/begin MEASUREMENT ComScl_NeuralNetwork_Switch_DataCorrupt "" UBYTE NO_COMPU_METHOD 0 0 0 255 ECU_ADDRESS 0x00000000 /end MEASUREMENT
/begin MEASUREMENT ComScl_DiagGpuReq_Timeout "" UBYTE NO_COMPU_METHOD 0 0 0 255 ECU_ADDRESS 0x00000000 /end MEASUREMENT
/begin MEASUREMENT ComScl_DiagGpuReq_DataCorrupt "" UBYTE NO_COMPU_METHOD 0 0 0 255 ECU_ADDRESS 0x00000000 /end MEASUREMENT
/begin MEASUREMENT ComScl_DiagMrrDidReq_Timeout "" UBYTE NO_COMPU_METHOD 0 0 0 255 ECU_ADDRESS 0x00000000 /end MEASUREMENT
/begin MEASUREMENT ComScl_DiagMrrDidReq_DataCorrupt "" UBYTE NO_COMPU_METHOD 0 0 0 255 ECU_ADDRESS 0x00000000 /end MEASUREMENT
/begin MEASUREMENT ComScl_DiagPanelConn_Timeout "" UBYTE NO_COMPU_METHOD 0 0 0 255 ECU_ADDRESS 0x00000000 /end MEASUREMENT
/begin MEASUREMENT ComScl_DiagPanelConn_DataCorrupt "" UBYTE NO_COMPU_METHOD 0 0 0 255 ECU_ADDRESS 0x00000000 /end MEASUREMENT
/begin MEASUREMENT ComScl_DiagMrrCalibrationReq_Timeout "" UBYTE NO_COMPU_METHOD 0 0 0 255 ECU_ADDRESS 0x00000000 /end MEASUREMENT
/begin MEASUREMENT ComScl_DiagMrrCalibrationReq_DataCorrupt "" UBYTE NO_COMPU_METHOD 0 0 0 255 ECU_ADDRESS 0x00000000 /end MEASUREMENT
/begin MEASUREMENT ComScl_MainStart_Timeout "" UBYTE NO_COMPU_METHOD 0 0 0 255 ECU_ADDRESS 0x00000000 /end MEASUREMENT
/begin MEASUREMENT ComScl_MainStart_DataCorrupt "" UBYTE NO_COMPU_METHOD 0 0 0 255 ECU_ADDRESS 0x00000000 /end MEASUREMENT
/begin MEASUREMENT ComScl_DiagToolFake_Timeout "" UBYTE NO_COMPU_METHOD 0 0 0 255 ECU_ADDRESS 0x00000000 /end MEASUREMENT
/begin MEASUREMENT ComScl_DiagToolFake_DataCorrupt "" UBYTE NO_COMPU_METHOD 0 0 0 255 ECU_ADDRESS 0x00000000 /end MEASUREMENT
/begin MEASUREMENT ComScl_Emu_EMS_Timeout "" UBYTE NO_COMPU_METHOD 0 0 0 255 ECU_ADDRESS 0x00000000 /end MEASUREMENT
/begin MEASUREMENT ComScl_Emu_EMS_DataCorrupt "" UBYTE NO_COMPU_METHOD 0 0 0 255 ECU_ADDRESS 0x00000000 /end MEASUREMENT
/begin MEASUREMENT ComScl_Emu_MLIA_Xcp_Timeout "" UBYTE NO_COMPU_METHOD 0 0 0 255 ECU_ADDRESS 0x00000000 /end MEASUREMENT
/begin MEASUREMENT ComScl_Emu_MLIA_Xcp_DataCorrupt "" UBYTE NO_COMPU_METHOD 0 0 0 255 ECU_ADDRESS 0x00000000 /end MEASUREMENT
/begin MEASUREMENT ComScl_Emu_Blink_Xcp_Timeout "" UBYTE NO_COMPU_METHOD 0 0 0 255 ECU_ADDRESS 0x00000000 /end MEASUREMENT
/begin MEASUREMENT ComScl_Emu_Blink_Xcp_DataCorrupt "" UBYTE NO_COMPU_METHOD 0 0 0 255 ECU_ADDRESS 0x00000000 /end MEASUREMENT
/begin MEASUREMENT ComScl_TestData_SOS_Button_Timeout "" UBYTE NO_COMPU_METHOD 0 0 0 255 ECU_ADDRESS 0x00000000 /end MEASUREMENT
/begin MEASUREMENT ComScl_TestData_SOS_Button_DataCorrupt "" UBYTE NO_COMPU_METHOD 0 0 0 255 ECU_ADDRESS 0x00000000 /end MEASUREMENT
/begin MEASUREMENT ComScl_Emu_AfsExecuteReq_Timeout "" UBYTE NO_COMPU_METHOD 0 0 0 255 ECU_ADDRESS 0x00000000 /end MEASUREMENT
/begin MEASUREMENT ComScl_Emu_AfsExecuteReq_DataCorrupt "" UBYTE NO_COMPU_METHOD 0 0 0 255 ECU_ADDRESS 0x00000000 /end MEASUREMENT
/begin MEASUREMENT ComScl_PrepareToFirmware_Timeout "" UBYTE NO_COMPU_METHOD 0 0 0 255 ECU_ADDRESS 0x00000000 /end MEASUREMENT
/begin MEASUREMENT ComScl_PrepareToFirmware_DataCorrupt "" UBYTE NO_COMPU_METHOD 0 0 0 255 ECU_ADDRESS 0x00000000 /end MEASUREMENT
/begin MEASUREMENT ComScl_EmergOrinResetRequest_Timeout "" UBYTE NO_COMPU_METHOD 0 0 0 255 ECU_ADDRESS 0x00000000 /end MEASUREMENT
/begin MEASUREMENT ComScl_EmergOrinResetRequest_DataCorrupt "" UBYTE NO_COMPU_METHOD 0 0 0 255 ECU_ADDRESS 0x00000000 /end MEASUREMENT
/begin MEASUREMENT ComScl_TestJerkBrake_Timeout "" UBYTE NO_COMPU_METHOD 0 0 0 255 ECU_ADDRESS 0x00000000 /end MEASUREMENT
/begin MEASUREMENT ComScl_TestJerkBrake_DataCorrupt "" UBYTE NO_COMPU_METHOD 0 0 0 255 ECU_ADDRESS 0x00000000 /end MEASUREMENT
/begin MEASUREMENT ComScl_AA_SwitchTest_Timeout "" UBYTE NO_COMPU_METHOD 0 0 0 255 ECU_ADDRESS 0x00000000 /end MEASUREMENT
/begin MEASUREMENT ComScl_AA_SwitchTest_DataCorrupt "" UBYTE NO_COMPU_METHOD 0 0 0 255 ECU_ADDRESS 0x00000000 /end MEASUREMENT
/begin MEASUREMENT ComScl_Radar_Rear_ADAS_Timeout "" UBYTE NO_COMPU_METHOD 0 0 0 255 ECU_ADDRESS 0x00000000 /end MEASUREMENT
/begin MEASUREMENT ComScl_Radar_Rear_ADAS_DataCorrupt "" UBYTE NO_COMPU_METHOD 0 0 0 255 ECU_ADDRESS 0x00000000 /end MEASUREMENT
/begin MEASUREMENT ComScl_LeftRadarSynMessage_Timeout "" UBYTE NO_COMPU_METHOD 0 0 0 255 ECU_ADDRESS 0x00000000 /end MEASUREMENT
/begin MEASUREMENT ComScl_LeftRadarSynMessage_DataCorrupt "" UBYTE NO_COMPU_METHOD 0 0 0 255 ECU_ADDRESS 0x00000000 /end MEASUREMENT
/begin MEASUREMENT ComScl_Monitor_Time_L_1_Timeout "" UBYTE NO_COMPU_METHOD 0 0 0 255 ECU_ADDRESS 0x00000000 /end MEASUREMENT
/begin MEASUREMENT ComScl_Monitor_Time_L_1_DataCorrupt "" UBYTE NO_COMPU_METHOD 0 0 0 255 ECU_ADDRESS 0x00000000 /end MEASUREMENT
/begin MEASUREMENT ComScl_Monitor_Time_L_2_Timeout "" UBYTE NO_COMPU_METHOD 0 0 0 255 ECU_ADDRESS 0x00000000 /end MEASUREMENT
/begin MEASUREMENT ComScl_Monitor_Time_L_2_DataCorrupt "" UBYTE NO_COMPU_METHOD 0 0 0 255 ECU_ADDRESS 0x00000000 /end MEASUREMENT
/begin MEASUREMENT ComScl_Monitor_Time_R_1_Timeout "" UBYTE NO_COMPU_METHOD 0 0 0 255 ECU_ADDRESS 0x00000000 /end MEASUREMENT
/begin MEASUREMENT ComScl_Monitor_Time_R_1_DataCorrupt "" UBYTE NO_COMPU_METHOD 0 0 0 255 ECU_ADDRESS 0x00000000 /end MEASUREMENT
/begin MEASUREMENT ComScl_Monitor_Time_R_2_Timeout "" UBYTE NO_COMPU_METHOD 0 0 0 255 ECU_ADDRESS 0x00000000 /end MEASUREMENT
/begin MEASUREMENT ComScl_Monitor_Time_R_2_DataCorrupt "" UBYTE NO_COMPU_METHOD 0 0 0 255 ECU_ADDRESS 0x00000000 /end MEASUREMENT
/begin MEASUREMENT ComScl_Obj_0_Status_RL_Timeout "" UBYTE NO_COMPU_METHOD 0 0 0 255 ECU_ADDRESS 0x00000000 /end MEASUREMENT
/begin MEASUREMENT ComScl_Obj_0_Status_RL_DataCorrupt "" UBYTE NO_COMPU_METHOD 0 0 0 255 ECU_ADDRESS 0x00000000 /end MEASUREMENT
/begin MEASUREMENT ComScl_Obj_0_Status_RR_Timeout "" UBYTE NO_COMPU_METHOD 0 0 0 255 ECU_ADDRESS 0x00000000 /end MEASUREMENT
/begin MEASUREMENT ComScl_Obj_0_Status_RR_DataCorrupt "" UBYTE NO_COMPU_METHOD 0 0 0 255 ECU_ADDRESS 0x00000000 /end MEASUREMENT
/begin MEASUREMENT ComScl_Obj_Collision_Info_RL_Timeout "" UBYTE NO_COMPU_METHOD 0 0 0 255 ECU_ADDRESS 0x00000000 /end MEASUREMENT
/begin MEASUREMENT ComScl_Obj_Collision_Info_RL_DataCorrupt "" UBYTE NO_COMPU_METHOD 0 0 0 255 ECU_ADDRESS 0x00000000 /end MEASUREMENT
/begin MEASUREMENT ComScl_Obj_Collision_Info_RR_Timeout "" UBYTE NO_COMPU_METHOD 0 0 0 255 ECU_ADDRESS 0x00000000 /end MEASUREMENT
/begin MEASUREMENT ComScl_Obj_Collision_Info_RR_DataCorrupt "" UBYTE NO_COMPU_METHOD 0 0 0 255 ECU_ADDRESS 0x00000000 /end MEASUREMENT
/begin MEASUREMENT ComScl_Obj_End_Msg_RL_Timeout "" UBYTE NO_COMPU_METHOD 0 0 0 255 ECU_ADDRESS 0x00000000 /end MEASUREMENT
/begin MEASUREMENT ComScl_Obj_End_Msg_RL_DataCorrupt "" UBYTE NO_COMPU_METHOD 0 0 0 255 ECU_ADDRESS 0x00000000 /end MEASUREMENT
/begin MEASUREMENT ComScl_Obj_End_Msg_RR_Timeout "" UBYTE NO_COMPU_METHOD 0 0 0 255 ECU_ADDRESS 0x00000000 /end MEASUREMENT
/begin MEASUREMENT ComScl_Obj_End_Msg_RR_DataCorrupt "" UBYTE NO_COMPU_METHOD 0 0 0 255 ECU_ADDRESS 0x00000000 /end MEASUREMENT
/begin MEASUREMENT ComScl_Obj_Extended_Info_RL_Timeout "" UBYTE NO_COMPU_METHOD 0 0 0 255 ECU_ADDRESS 0x00000000 /end MEASUREMENT
/begin MEASUREMENT ComScl_Obj_Extended_Info_RL_DataCorrupt "" UBYTE NO_COMPU_METHOD 0 0 0 255 ECU_ADDRESS 0x00000000 /end MEASUREMENT
/begin MEASUREMENT ComScl_Obj_Extended_Info_RR_Timeout "" UBYTE NO_COMPU_METHOD 0 0 0 255 ECU_ADDRESS 0x00000000 /end MEASUREMENT
/begin MEASUREMENT ComScl_Obj_Extended_Info_RR_DataCorrupt "" UBYTE NO_COMPU_METHOD 0 0 0 255 ECU_ADDRESS 0x00000000 /end MEASUREMENT
/begin MEASUREMENT ComScl_Obj_General_Info_RL_Timeout "" UBYTE NO_COMPU_METHOD 0 0 0 255 ECU_ADDRESS 0x00000000 /end MEASUREMENT
/begin MEASUREMENT ComScl_Obj_General_Info_RL_DataCorrupt "" UBYTE NO_COMPU_METHOD 0 0 0 255 ECU_ADDRESS 0x00000000 /end MEASUREMENT
/begin MEASUREMENT ComScl_Obj_General_Info_RR_Timeout "" UBYTE NO_COMPU_METHOD 0 0 0 255 ECU_ADDRESS 0x00000000 /end MEASUREMENT
/begin MEASUREMENT ComScl_Obj_General_Info_RR_DataCorrupt "" UBYTE NO_COMPU_METHOD 0 0 0 255 ECU_ADDRESS 0x00000000 /end MEASUREMENT
/begin MEASUREMENT ComScl_Obj_Quality_Info_RL_Timeout "" UBYTE NO_COMPU_METHOD 0 0 0 255 ECU_ADDRESS 0x00000000 /end MEASUREMENT
/begin MEASUREMENT ComScl_Obj_Quality_Info_RL_DataCorrupt "" UBYTE NO_COMPU_METHOD 0 0 0 255 ECU_ADDRESS 0x00000000 /end MEASUREMENT
/begin MEASUREMENT ComScl_Obj_Quality_Info_RR_Timeout "" UBYTE NO_COMPU_METHOD 0 0 0 255 ECU_ADDRESS 0x00000000 /end MEASUREMENT
/begin MEASUREMENT ComScl_Obj_Quality_Info_RR_DataCorrupt "" UBYTE NO_COMPU_METHOD 0 0 0 255 ECU_ADDRESS 0x00000000 /end MEASUREMENT
/begin MEASUREMENT ComScl_RightRadarSynMessage_Timeout "" UBYTE NO_COMPU_METHOD 0 0 0 255 ECU_ADDRESS 0x00000000 /end MEASUREMENT
/begin MEASUREMENT ComScl_RightRadarSynMessage_DataCorrupt "" UBYTE NO_COMPU_METHOD 0 0 0 255 ECU_ADDRESS 0x00000000 /end MEASUREMENT
/begin MEASUREMENT ComScl_VehInfo_Left_Radar_Timeout "" UBYTE NO_COMPU_METHOD 0 0 0 255 ECU_ADDRESS 0x00000000 /end MEASUREMENT
/begin MEASUREMENT ComScl_VehInfo_Left_Radar_DataCorrupt "" UBYTE NO_COMPU_METHOD 0 0 0 255 ECU_ADDRESS 0x00000000 /end MEASUREMENT
/begin MEASUREMENT ComScl_VehInfo_Right_Radar_Timeout "" UBYTE NO_COMPU_METHOD 0 0 0 255 ECU_ADDRESS 0x00000000 /end MEASUREMENT
/begin MEASUREMENT ComScl_VehInfo_Right_Radar_DataCorrupt "" UBYTE NO_COMPU_METHOD 0 0 0 255 ECU_ADDRESS 0x00000000 /end MEASUREMENT
/begin MEASUREMENT ComScl_China_UDS_RL_Phy_Resp_Timeout "" UBYTE NO_COMPU_METHOD 0 0 0 255 ECU_ADDRESS 0x00000000 /end MEASUREMENT
/begin MEASUREMENT ComScl_China_UDS_RL_Phy_Resp_DataCorrupt "" UBYTE NO_COMPU_METHOD 0 0 0 255 ECU_ADDRESS 0x00000000 /end MEASUREMENT
/begin MEASUREMENT ComScl_China_UDS_RR_Phy_Resp_Timeout "" UBYTE NO_COMPU_METHOD 0 0 0 255 ECU_ADDRESS 0x00000000 /end MEASUREMENT
/begin MEASUREMENT ComScl_China_UDS_RR_Phy_Resp_DataCorrupt "" UBYTE NO_COMPU_METHOD 0 0 0 255 ECU_ADDRESS 0x00000000 /end MEASUREMENT
/begin MEASUREMENT ComScl_CSA1_Timeout "" UBYTE NO_COMPU_METHOD 0 0 0 255 ECU_ADDRESS 0x00000000 /end MEASUREMENT
/begin MEASUREMENT ComScl_CSA1_DataCorrupt "" UBYTE NO_COMPU_METHOD 0 0 0 255 ECU_ADDRESS 0x00000000 /end MEASUREMENT
/begin MEASUREMENT ComScl_CSA2_Timeout "" UBYTE NO_COMPU_METHOD 0 0 0 255 ECU_ADDRESS 0x00000000 /end MEASUREMENT
/begin MEASUREMENT ComScl_CSA2_DataCorrupt "" UBYTE NO_COMPU_METHOD 0 0 0 255 ECU_ADDRESS 0x00000000 /end MEASUREMENT
/begin MEASUREMENT ComScl_ABS1_Timeout "" UBYTE NO_COMPU_METHOD 0 0 0 255 ECU_ADDRESS 0x00000000 /end MEASUREMENT
/begin MEASUREMENT ComScl_ABS1_DataCorrupt "" UBYTE NO_COMPU_METHOD 0 0 0 255 ECU_ADDRESS 0x00000000 /end MEASUREMENT
/begin MEASUREMENT ComScl_ABS2_Timeout "" UBYTE NO_COMPU_METHOD 0 0 0 255 ECU_ADDRESS 0x00000000 /end MEASUREMENT
/begin MEASUREMENT ComScl_ABS2_DataCorrupt "" UBYTE NO_COMPU_METHOD 0 0 0 255 ECU_ADDRESS 0x00000000 /end MEASUREMENT
/begin MEASUREMENT ComScl_ABS3_Timeout "" UBYTE NO_COMPU_METHOD 0 0 0 255 ECU_ADDRESS 0x00000000 /end MEASUREMENT
/begin MEASUREMENT ComScl_ABS3_DataCorrupt "" UBYTE NO_COMPU_METHOD 0 0 0 255 ECU_ADDRESS 0x00000000 /end MEASUREMENT
/begin MEASUREMENT ComScl_ESP1_Timeout "" UBYTE NO_COMPU_METHOD 0 0 0 255 ECU_ADDRESS 0x00000000 /end MEASUREMENT
/begin MEASUREMENT ComScl_ESP1_DataCorrupt "" UBYTE NO_COMPU_METHOD 0 0 0 255 ECU_ADDRESS 0x00000000 /end MEASUREMENT
/begin MEASUREMENT ComScl_ABM1_Timeout "" UBYTE NO_COMPU_METHOD 0 0 0 255 ECU_ADDRESS 0x00000000 /end MEASUREMENT
/begin MEASUREMENT ComScl_ABM1_DataCorrupt "" UBYTE NO_COMPU_METHOD 0 0 0 255 ECU_ADDRESS 0x00000000 /end MEASUREMENT
/begin MEASUREMENT ComScl_ABM2_Timeout "" UBYTE NO_COMPU_METHOD 0 0 0 255 ECU_ADDRESS 0x00000000 /end MEASUREMENT
/begin MEASUREMENT ComScl_ABM2_DataCorrupt "" UBYTE NO_COMPU_METHOD 0 0 0 255 ECU_ADDRESS 0x00000000 /end MEASUREMENT
/begin MEASUREMENT ComScl_ACC_FD2_Timeout "" UBYTE NO_COMPU_METHOD 0 0 0 255 ECU_ADDRESS 0x00000000 /end MEASUREMENT
/begin MEASUREMENT ComScl_ACC_FD2_DataCorrupt "" UBYTE NO_COMPU_METHOD 0 0 0 255 ECU_ADDRESS 0x00000000 /end MEASUREMENT
/begin MEASUREMENT ComScl_AEB_FD1_Timeout "" UBYTE NO_COMPU_METHOD 0 0 0 255 ECU_ADDRESS 0x00000000 /end MEASUREMENT
/begin MEASUREMENT ComScl_AEB_FD1_DataCorrupt "" UBYTE NO_COMPU_METHOD 0 0 0 255 ECU_ADDRESS 0x00000000 /end MEASUREMENT
/begin MEASUREMENT ComScl_IFC_FD2_Timeout "" UBYTE NO_COMPU_METHOD 0 0 0 255 ECU_ADDRESS 0x00000000 /end MEASUREMENT
/begin MEASUREMENT ComScl_IFC_FD2_DataCorrupt "" UBYTE NO_COMPU_METHOD 0 0 0 255 ECU_ADDRESS 0x00000000 /end MEASUREMENT
/begin MEASUREMENT ComScl_XCP_CAN_RX_Timeout "" UBYTE NO_COMPU_METHOD 0 0 0 255 ECU_ADDRESS 0x00000000 /end MEASUREMENT
/begin MEASUREMENT ComScl_XCP_CAN_RX_DataCorrupt "" UBYTE NO_COMPU_METHOD 0 0 0 255 ECU_ADDRESS 0x00000000 /end MEASUREMENT
/begin GROUP CommunicationFaults "CommunicationFaults" ROOT
 /begin REF_MEASUREMENT ComScl_ACU_01_Timeout ComScl_ACU_01_DataCorrupt ComScl_ACU_01_ChksmError ComScl_ACU_01_AlvCntError ComScl_BCM_CLIMATIC_DATA_Timeout ComScl_BCM_CLIMATIC_DATA_DataCorrupt ComScl_BCM_CLIMATIC_DATA_ChksmError ComScl_BCM_CLIMATIC_DATA_AlvCntError ComScl_BCM_EXT_LGT_Timeout ComScl_BCM_EXT_LGT_DataCorrupt ComScl_BCM_EXT_LGT_ChksmError ComScl_BCM_EXT_LGT_AlvCntError ComScl_BCM_IC_Info_Msg_Timeout ComScl_BCM_IC_Info_Msg_DataCorrupt ComScl_BCM_IC_Info_Msg_ChksmError ComScl_BCM_IC_Info_Msg_AlvCntError ComScl_BCM_Lock_CTR_Timeout ComScl_BCM_Lock_CTR_DataCorrupt ComScl_BCM_Lock_CTR_ChksmError ComScl_BCM_Lock_CTR_AlvCntError ComScl_BCM_RLS_Stat_Timeout ComScl_BCM_RLS_Stat_DataCorrupt ComScl_BCM_RLS_Stat_ChksmError ComScl_BCM_RLS_Stat_AlvCntError ComScl_BCM_VEH_STATE_Timeout ComScl_BCM_VEH_STATE_DataCorrupt ComScl_BCM_VEH_STATE_ChksmError ComScl_BCM_VEH_STATE_AlvCntError ComScl_BCM_Veh_State2_Timeout ComScl_BCM_Veh_State2_DataCorrupt ComScl_BCM_Veh_State2_ChksmError ComScl_BCM_Veh_State2_AlvCntError ComScl_CCU_Stat1_Timeout ComScl_CCU_Stat1_DataCorrupt ComScl_CCU_Stat1_ChksmError ComScl_CCU_Stat1_AlvCntError ComScl_DMFL_Msg1_Timeout ComScl_DMFL_Msg1_DataCorrupt ComScl_DMFL_Msg1_ChksmError ComScl_DMFL_Msg1_AlvCntError ComScl_DMFR_Msg1_Timeout ComScl_DMFR_Msg1_DataCorrupt ComScl_DMFR_Msg1_ChksmError ComScl_DMFR_Msg1_AlvCntError ComScl_DMRL_Msg1_Timeout ComScl_DMRL_Msg1_DataCorrupt ComScl_DMRL_Msg1_ChksmError ComScl_DMRL_Msg1_AlvCntError ComScl_DMRR_Msg1_Timeout ComScl_DMRR_Msg1_DataCorrupt ComScl_DMRR_Msg1_ChksmError ComScl_DMRR_Msg1_AlvCntError ComScl_BCM_DMS_01_Timeout ComScl_BCM_DMS_01_DataCorrupt ComScl_BCM_DMS_01_ChksmError ComScl_BCM_DMS_01_AlvCntError ComScl_EMS_14_Timeout ComScl_EMS_14_DataCorrupt ComScl_EMS_14_ChksmError ComScl_EMS_14_AlvCntError ComScl_EMS_3_Timeout ComScl_EMS_3_DataCorrupt ComScl_EMS_3_ChksmError ComScl_EMS_3_AlvCntError ComScl_EMS_4_Timeout ComScl_EMS_4_DataCorrupt ComScl_EMS_4_ChksmError ComScl_EMS_4_AlvCntError ComScl_EPB_Status_Timeout ComScl_EPB_Status_DataCorrupt ComScl_EPB_Status_ChksmError ComScl_EPB_Status_AlvCntError ComScl_ESC_02_Timeout ComScl_ESC_02_DataCorrupt ComScl_ESC_02_ChksmError ComScl_ESC_02_AlvCntError ComScl_ESC_03_Timeout ComScl_ESC_03_DataCorrupt ComScl_ESC_03_ChksmError ComScl_ESC_03_AlvCntError ComScl_ESC_04_Timeout ComScl_ESC_04_DataCorrupt ComScl_ESC_04_ChksmError ComScl_ESC_04_AlvCntError ComScl_ESC_06_Timeout ComScl_ESC_06_DataCorrupt ComScl_ESC_06_ChksmError ComScl_ESC_06_AlvCntError ComScl_ESC_07_Timeout ComScl_ESC_07_DataCorrupt ComScl_ESC_07_ChksmError ComScl_ESC_07_AlvCntError ComScl_ESC_09_Timeout ComScl_ESC_09_DataCorrupt ComScl_ESC_09_ChksmError ComScl_ESC_09_AlvCntError ComScl_ESC_10_Timeout ComScl_ESC_10_DataCorrupt ComScl_ESC_10_ChksmError ComScl_ESC_10_AlvCntError ComScl_ESC_YRS_01_Timeout ComScl_ESC_YRS_01_DataCorrupt ComScl_ESC_YRS_01_ChksmError ComScl_ESC_YRS_01_AlvCntError ComScl_ESC_YRS_02_Timeout ComScl_ESC_YRS_02_DataCorrupt ComScl_ESC_YRS_02_ChksmError ComScl_ESC_YRS_02_AlvCntError ComScl_IC_DMS_Timeout ComScl_IC_DMS_DataCorrupt ComScl_IC_DMS_ChksmError ComScl_IC_DMS_AlvCntError ComScl_IC_ADAS_REST_Timeout ComScl_IC_ADAS_REST_DataCorrupt ComScl_IC_ADAS_REST_ChksmError ComScl_IC_ADAS_REST_AlvCntError ComScl_IC_HUD_01_Timeout ComScl_IC_HUD_01_DataCorrupt ComScl_IC_HUD_01_ChksmError ComScl_IC_HUD_01_AlvCntError ComScl_IC_ABSOLUTE_CLOCK_Timeout ComScl_IC_ABSOLUTE_CLOCK_DataCorrupt ComScl_IC_ABSOLUTE_CLOCK_ChksmError ComScl_IC_ABSOLUTE_CLOCK_AlvCntError ComScl_MAS_Status_Timeout ComScl_MAS_Status_DataCorrupt ComScl_MAS_Status_ChksmError ComScl_MAS_Status_AlvCntError ComScl_MAS_FrontUSS_Timeout ComScl_MAS_FrontUSS_DataCorrupt ComScl_MAS_FrontUSS_ChksmError ComScl_MAS_FrontUSS_AlvCntError ComScl_MAS_RearUSS_Timeout ComScl_MAS_RearUSS_DataCorrupt ComScl_MAS_RearUSS_ChksmError ComScl_MAS_RearUSS_AlvCntError ComScl_MAS_SideUSS_Timeout ComScl_MAS_SideUSS_DataCorrupt ComScl_MAS_SideUSS_ChksmError ComScl_MAS_SideUSS_AlvCntError ComScl_HLL_STATE_Timeout ComScl_HLL_STATE_DataCorrupt ComScl_HLL_STATE_ChksmError ComScl_HLL_STATE_AlvCntError ComScl_HLR_STATE_Timeout ComScl_HLR_STATE_DataCorrupt ComScl_HLR_STATE_ChksmError ComScl_HLR_STATE_AlvCntError ComScl_SAS_Standard_Timeout ComScl_SAS_Standard_DataCorrupt ComScl_SAS_Standard_ChksmError ComScl_SAS_Standard_AlvCntError ComScl_SWM_ContrlsState_Old_Timeout ComScl_SWM_ContrlsState_Old_DataCorrupt ComScl_SWM_ContrlsState_Old_ChksmError ComScl_SWM_ContrlsState_Old_AlvCntError ComScl_SWM_ContrlsState_Timeout ComScl_SWM_ContrlsState_DataCorrupt ComScl_SWM_ContrlsState_ChksmError ComScl_SWM_ContrlsState_AlvCntError ComScl_SCU_02_Timeout ComScl_SCU_02_DataCorrupt ComScl_SCU_02_ChksmError ComScl_SCU_02_AlvCntError ComScl_TCU_R932_1_Timeout ComScl_TCU_R932_1_DataCorrupt ComScl_TCU_R932_1_ChksmError ComScl_TCU_R932_1_AlvCntError ComScl_FIU_ADAS_Config_Timeout ComScl_FIU_ADAS_Config_DataCorrupt ComScl_FIU_ADAS_Config_ChksmError ComScl_FIU_ADAS_Config_AlvCntError ComScl_FIU_Msg3_Timeout ComScl_FIU_Msg3_DataCorrupt ComScl_FIU_Msg3_ChksmError ComScl_FIU_Msg3_AlvCntError ComScl_VCU_ADAS_01_Timeout ComScl_VCU_ADAS_01_DataCorrupt ComScl_VCU_ADAS_01_ChksmError ComScl_VCU_ADAS_01_AlvCntError ComScl_Diag_From_ERAG_Timeout ComScl_Diag_From_ERAG_DataCorrupt ComScl_Diag_From_ERAG_ChksmError ComScl_Diag_From_ERAG_AlvCntError ComScl_ERAG_NMEA1_Timeout ComScl_ERAG_NMEA1_DataCorrupt ComScl_ERAG_NMEA1_ChksmError ComScl_ERAG_NMEA1_AlvCntError ComScl_ERAG_NMEA2_Timeout ComScl_ERAG_NMEA2_DataCorrupt ComScl_ERAG_NMEA2_ChksmError ComScl_ERAG_NMEA2_AlvCntError ComScl_ERAG_NMEA3_Timeout ComScl_ERAG_NMEA3_DataCorrupt ComScl_ERAG_NMEA3_ChksmError ComScl_ERAG_NMEA3_AlvCntError ComScl_ERAG_NMEA4_Timeout ComScl_ERAG_NMEA4_DataCorrupt ComScl_ERAG_NMEA4_ChksmError ComScl_ERAG_NMEA4_AlvCntError ComScl_ERAG_NMEA5_Timeout ComScl_ERAG_NMEA5_DataCorrupt ComScl_ERAG_NMEA5_ChksmError ComScl_ERAG_NMEA5_AlvCntError ComScl_ERAG_NMEA6_Timeout ComScl_ERAG_NMEA6_DataCorrupt ComScl_ERAG_NMEA6_ChksmError ComScl_ERAG_NMEA6_AlvCntError ComScl_ERAG_DATA_MSG_Timeout ComScl_ERAG_DATA_MSG_DataCorrupt ComScl_ERAG_DATA_MSG_ChksmError ComScl_ERAG_DATA_MSG_AlvCntError ComScl_ATC_TX_Timeout ComScl_ATC_TX_DataCorrupt ComScl_ATC_TX_ChksmError ComScl_ATC_TX_AlvCntError ComScl_Diag_Functional_Timeout ComScl_Diag_Functional_DataCorrupt ComScl_Diag_Functional_ChksmError ComScl_Diag_Functional_AlvCntError ComScl_Diag_To_DASCU_Timeout ComScl_Diag_To_DASCU_DataCorrupt ComScl_Diag_To_DASCU_ChksmError ComScl_Diag_To_DASCU_AlvCntError ComScl_EMS_03_Timeout ComScl_EMS_03_DataCorrupt ComScl_EMS_03_ChksmError ComScl_EMS_03_AlvCntError ComScl_EMS_04_Timeout ComScl_EMS_04_DataCorrupt ComScl_EMS_04_ChksmError ComScl_EMS_04_AlvCntError ComScl_EMS_16_Timeout ComScl_EMS_16_DataCorrupt ComScl_EMS_16_ChksmError ComScl_EMS_16_AlvCntError ComScl_mLEDL_STATE_Timeout ComScl_mLEDL_STATE_DataCorrupt ComScl_mLEDL_STATE_ChksmError ComScl_mLEDL_STATE_AlvCntError ComScl_mLEDR_STATE_Timeout ComScl_mLEDR_STATE_DataCorrupt ComScl_mLEDR_STATE_ChksmError ComScl_mLEDR_STATE_AlvCntError ComScl_RSA_Status_Timeout ComScl_RSA_Status_DataCorrupt ComScl_RSA_Status_ChksmError ComScl_RSA_Status_AlvCntError ComScl_TM_Stat_Timeout ComScl_TM_Stat_DataCorrupt ComScl_TM_Stat_ChksmError ComScl_TM_Stat_AlvCntError ComScl_VCU_DriverDmd_Timeout ComScl_VCU_DriverDmd_DataCorrupt ComScl_VCU_DriverDmd_ChksmError ComScl_VCU_DriverDmd_AlvCntError ComScl_Emu_Spd_Timeout ComScl_Emu_Spd_DataCorrupt ComScl_Emu_Spd_ChksmError ComScl_Emu_Spd_AlvCntError ComScl_NeuralNetwork_Switch_Timeout ComScl_NeuralNetwork_Switch_DataCorrupt ComScl_NeuralNetwork_Switch_ChksmError ComScl_NeuralNetwork_Switch_AlvCntError ComScl_DiagGpuReq_Timeout ComScl_DiagGpuReq_DataCorrupt ComScl_DiagGpuReq_ChksmError ComScl_DiagGpuReq_AlvCntError ComScl_DiagMrrDidReq_Timeout ComScl_DiagMrrDidReq_DataCorrupt ComScl_DiagMrrDidReq_ChksmError ComScl_DiagMrrDidReq_AlvCntError ComScl_DiagPanelConn_Timeout ComScl_DiagPanelConn_DataCorrupt ComScl_DiagPanelConn_ChksmError ComScl_DiagPanelConn_AlvCntError ComScl_DiagMrrCalibrationReq_Timeout ComScl_DiagMrrCalibrationReq_DataCorrupt ComScl_DiagMrrCalibrationReq_ChksmError ComScl_DiagMrrCalibrationReq_AlvCntError ComScl_MainStart_Timeout ComScl_MainStart_DataCorrupt ComScl_MainStart_ChksmError ComScl_MainStart_AlvCntError ComScl_DiagToolFake_Timeout ComScl_DiagToolFake_DataCorrupt ComScl_DiagToolFake_ChksmError ComScl_DiagToolFake_AlvCntError ComScl_Emu_EMS_Timeout ComScl_Emu_EMS_DataCorrupt ComScl_Emu_EMS_ChksmError ComScl_Emu_EMS_AlvCntError ComScl_Emu_MLIA_Xcp_Timeout ComScl_Emu_MLIA_Xcp_DataCorrupt ComScl_Emu_MLIA_Xcp_ChksmError ComScl_Emu_MLIA_Xcp_AlvCntError ComScl_Emu_Blink_Xcp_Timeout ComScl_Emu_Blink_Xcp_DataCorrupt ComScl_Emu_Blink_Xcp_ChksmError ComScl_Emu_Blink_Xcp_AlvCntError ComScl_TestData_SOS_Button_Timeout ComScl_TestData_SOS_Button_DataCorrupt ComScl_TestData_SOS_Button_ChksmError ComScl_TestData_SOS_Button_AlvCntError ComScl_Emu_AfsExecuteReq_Timeout ComScl_Emu_AfsExecuteReq_DataCorrupt ComScl_Emu_AfsExecuteReq_ChksmError ComScl_Emu_AfsExecuteReq_AlvCntError ComScl_PrepareToFirmware_Timeout ComScl_PrepareToFirmware_DataCorrupt ComScl_PrepareToFirmware_ChksmError ComScl_PrepareToFirmware_AlvCntError ComScl_EmergOrinResetRequest_Timeout ComScl_EmergOrinResetRequest_DataCorrupt ComScl_EmergOrinResetRequest_ChksmError ComScl_EmergOrinResetRequest_AlvCntError ComScl_TestJerkBrake_Timeout ComScl_TestJerkBrake_DataCorrupt ComScl_TestJerkBrake_ChksmError ComScl_TestJerkBrake_AlvCntError ComScl_AA_SwitchTest_Timeout ComScl_AA_SwitchTest_DataCorrupt ComScl_AA_SwitchTest_ChksmError ComScl_AA_SwitchTest_AlvCntError ComScl_Radar_Rear_ADAS_Timeout ComScl_Radar_Rear_ADAS_DataCorrupt ComScl_Radar_Rear_ADAS_ChksmError ComScl_Radar_Rear_ADAS_AlvCntError ComScl_LeftRadarSynMessage_Timeout ComScl_LeftRadarSynMessage_DataCorrupt ComScl_LeftRadarSynMessage_ChksmError ComScl_LeftRadarSynMessage_AlvCntError ComScl_Monitor_Time_L_1_Timeout ComScl_Monitor_Time_L_1_DataCorrupt ComScl_Monitor_Time_L_1_ChksmError ComScl_Monitor_Time_L_1_AlvCntError ComScl_Monitor_Time_L_2_Timeout ComScl_Monitor_Time_L_2_DataCorrupt ComScl_Monitor_Time_L_2_ChksmError ComScl_Monitor_Time_L_2_AlvCntError ComScl_Monitor_Time_R_1_Timeout ComScl_Monitor_Time_R_1_DataCorrupt ComScl_Monitor_Time_R_1_ChksmError ComScl_Monitor_Time_R_1_AlvCntError ComScl_Monitor_Time_R_2_Timeout ComScl_Monitor_Time_R_2_DataCorrupt ComScl_Monitor_Time_R_2_ChksmError ComScl_Monitor_Time_R_2_AlvCntError ComScl_Obj_0_Status_RL_Timeout ComScl_Obj_0_Status_RL_DataCorrupt ComScl_Obj_0_Status_RL_ChksmError ComScl_Obj_0_Status_RL_AlvCntError ComScl_Obj_0_Status_RR_Timeout ComScl_Obj_0_Status_RR_DataCorrupt ComScl_Obj_0_Status_RR_ChksmError ComScl_Obj_0_Status_RR_AlvCntError ComScl_Obj_Collision_Info_RL_Timeout ComScl_Obj_Collision_Info_RL_DataCorrupt ComScl_Obj_Collision_Info_RL_ChksmError ComScl_Obj_Collision_Info_RL_AlvCntError ComScl_Obj_Collision_Info_RR_Timeout ComScl_Obj_Collision_Info_RR_DataCorrupt ComScl_Obj_Collision_Info_RR_ChksmError ComScl_Obj_Collision_Info_RR_AlvCntError ComScl_Obj_End_Msg_RL_Timeout ComScl_Obj_End_Msg_RL_DataCorrupt ComScl_Obj_End_Msg_RL_ChksmError ComScl_Obj_End_Msg_RL_AlvCntError ComScl_Obj_End_Msg_RR_Timeout ComScl_Obj_End_Msg_RR_DataCorrupt ComScl_Obj_End_Msg_RR_ChksmError ComScl_Obj_End_Msg_RR_AlvCntError ComScl_Obj_Extended_Info_RL_Timeout ComScl_Obj_Extended_Info_RL_DataCorrupt ComScl_Obj_Extended_Info_RL_ChksmError ComScl_Obj_Extended_Info_RL_AlvCntError ComScl_Obj_Extended_Info_RR_Timeout ComScl_Obj_Extended_Info_RR_DataCorrupt ComScl_Obj_Extended_Info_RR_ChksmError ComScl_Obj_Extended_Info_RR_AlvCntError ComScl_Obj_General_Info_RL_Timeout ComScl_Obj_General_Info_RL_DataCorrupt ComScl_Obj_General_Info_RL_ChksmError ComScl_Obj_General_Info_RL_AlvCntError ComScl_Obj_General_Info_RR_Timeout ComScl_Obj_General_Info_RR_DataCorrupt ComScl_Obj_General_Info_RR_ChksmError ComScl_Obj_General_Info_RR_AlvCntError ComScl_Obj_Quality_Info_RL_Timeout ComScl_Obj_Quality_Info_RL_DataCorrupt ComScl_Obj_Quality_Info_RL_ChksmError ComScl_Obj_Quality_Info_RL_AlvCntError ComScl_Obj_Quality_Info_RR_Timeout ComScl_Obj_Quality_Info_RR_DataCorrupt ComScl_Obj_Quality_Info_RR_ChksmError ComScl_Obj_Quality_Info_RR_AlvCntError ComScl_RightRadarSynMessage_Timeout ComScl_RightRadarSynMessage_DataCorrupt ComScl_RightRadarSynMessage_ChksmError ComScl_RightRadarSynMessage_AlvCntError ComScl_VehInfo_Left_Radar_Timeout ComScl_VehInfo_Left_Radar_DataCorrupt ComScl_VehInfo_Left_Radar_ChksmError ComScl_VehInfo_Left_Radar_AlvCntError ComScl_VehInfo_Right_Radar_Timeout ComScl_VehInfo_Right_Radar_DataCorrupt ComScl_VehInfo_Right_Radar_ChksmError ComScl_VehInfo_Right_Radar_AlvCntError ComScl_China_UDS_RL_Phy_Resp_Timeout ComScl_China_UDS_RL_Phy_Resp_DataCorrupt ComScl_China_UDS_RL_Phy_Resp_ChksmError ComScl_China_UDS_RL_Phy_Resp_AlvCntError ComScl_China_UDS_RR_Phy_Resp_Timeout ComScl_China_UDS_RR_Phy_Resp_DataCorrupt ComScl_China_UDS_RR_Phy_Resp_ChksmError ComScl_China_UDS_RR_Phy_Resp_AlvCntError ComScl_CSA1_Timeout ComScl_CSA1_DataCorrupt ComScl_CSA1_ChksmError ComScl_CSA1_AlvCntError ComScl_CSA2_Timeout ComScl_CSA2_DataCorrupt ComScl_CSA2_ChksmError ComScl_CSA2_AlvCntError ComScl_ABS1_Timeout ComScl_ABS1_DataCorrupt ComScl_ABS1_ChksmError ComScl_ABS1_AlvCntError ComScl_ABS2_Timeout ComScl_ABS2_DataCorrupt ComScl_ABS2_ChksmError ComScl_ABS2_AlvCntError ComScl_ABS3_Timeout ComScl_ABS3_DataCorrupt ComScl_ABS3_ChksmError ComScl_ABS3_AlvCntError ComScl_ESP1_Timeout ComScl_ESP1_DataCorrupt ComScl_ESP1_ChksmError ComScl_ESP1_AlvCntError ComScl_ABM1_Timeout ComScl_ABM1_DataCorrupt ComScl_ABM1_ChksmError ComScl_ABM1_AlvCntError ComScl_ABM2_Timeout ComScl_ABM2_DataCorrupt ComScl_ABM2_ChksmError ComScl_ABM2_AlvCntError ComScl_ACC_FD2_Timeout ComScl_ACC_FD2_DataCorrupt ComScl_ACC_FD2_ChksmError ComScl_ACC_FD2_AlvCntError ComScl_AEB_FD1_Timeout ComScl_AEB_FD1_DataCorrupt ComScl_AEB_FD1_ChksmError ComScl_AEB_FD1_AlvCntError ComScl_IFC_FD2_Timeout ComScl_IFC_FD2_DataCorrupt ComScl_IFC_FD2_ChksmError ComScl_IFC_FD2_AlvCntError ComScl_XCP_CAN_RX_Timeout ComScl_XCP_CAN_RX_DataCorrupt ComScl_XCP_CAN_RX_ChksmError ComScl_XCP_CAN_RX_AlvCntError /end REF_MEASUREMENT
/end GROUP
/begin GROUP InvalidRxValueFaults "InvalidRxValueFaults" ROOT /begin REF_MEASUREMENT /end REF_MEASUREMENT /end GROUP
/begin GROUP InvalidTxValueFaults "InvalidTxValueFaults" ROOT /begin REF_CHARACTERISTIC /end REF_CHARACTERISTIC /end GROUP
/begin GROUP SignalsTx "SignalsTx" ROOT
 /begin REF_CHARACTERISTIC ComScl_ACU_01_Timeout ComScl_ATC_TX_Timeout ComScl_BCM_CLIMATIC_DATA_Timeout ComScl_BCM_DMS_01_Timeout ComScl_BCM_EXT_LGT_Timeout ComScl_BCM_IC_Info_Msg_Timeout ComScl_BCM_Lock_CTR_Timeout ComScl_BCM_RLS_Stat_Timeout ComScl_BCM_VEH_STATE_Timeout ComScl_BCM_Veh_State2_Timeout ComScl_CCU_Stat1_Timeout ComScl_DMFL_Msg1_Timeout ComScl_DMFR_Msg1_Timeout ComScl_DMRL_Msg1_Timeout ComScl_DMRR_Msg1_Timeout ComScl_EMS_03_Timeout ComScl_EMS_04_Timeout ComScl_EMS_14_Timeout ComScl_EMS_16_Timeout ComScl_EMS_3_Timeout ComScl_EMS_4_Timeout ComScl_EPB_Status_Timeout ComScl_ERAG_DATA_MSG_Timeout ComScl_ERAG_NMEA1_Timeout ComScl_ERAG_NMEA2_Timeout ComScl_ERAG_NMEA3_Timeout ComScl_ERAG_NMEA4_Timeout ComScl_ERAG_NMEA5_Timeout ComScl_ERAG_NMEA6_Timeout ComScl_ESC_02_Timeout ComScl_ESC_03_Timeout ComScl_ESC_04_Timeout ComScl_ESC_06_Timeout ComScl_ESC_07_Timeout ComScl_ESC_09_Timeout ComScl_ESC_10_Timeout ComScl_ESC_YRS_01_Timeout ComScl_ESC_YRS_02_Timeout ComScl_HLL_STATE_Timeout ComScl_HLR_STATE_Timeout ComScl_IC_ABSOLUTE_CLOCK_Timeout ComScl_IC_ADAS_REST_Timeout ComScl_IC_DMS_Timeout ComScl_MAS_FrontUSS_Timeout ComScl_MAS_RearUSS_Timeout ComScl_MAS_SideUSS_Timeout ComScl_MAS_Status_Timeout ComScl_mLEDL_STATE_Timeout ComScl_mLEDR_STATE_Timeout ComScl_RSA_Status_Timeout ComScl_SAS_Standard_Timeout ComScl_SCU_02_Timeout ComScl_SWM_ContrlsState_Old_Timeout ComScl_SWM_ContrlsState_Timeout ComScl_TCU_R932_1_Timeout ComScl_TM_Stat_Timeout ComScl_VCU_ADAS_01_Timeout ComScl_VCU_DriverDmd_Timeout /end REF_CHARACTERISTIC
/end GROUP
/end MODULE
/end PROJECT
