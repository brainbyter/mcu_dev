ASAP2_VERSION 1 60
/begin PROJECT Project_AU_C ""
/begin MODULE CPP ""
/begin MOD_COMMON "" BYTE_ORDER MSB_LAST ALIGNMENT_BYTE 1 ALIGNMENT_WORD 1 ALIGNMENT_LONG 1 ALIGNMENT_INT64 1 ALIGNMENT_FLOAT32_IEEE 1 ALIGNMENT_FLOAT64_IEEE 1 /end MOD_COMMON
/begin RECORD_LAYOUT __FLOAT32_IEEE_Z FNC_VALUES 1 FLOAT32_IEEE ROW_DIR DIRECT /end RECORD_LAYOUT
/begin RECORD_LAYOUT __SBYTE_Z FNC_VALUES 1 SBYTE ROW_DIR DIRECT /end RECORD_LAYOUT
/begin RECORD_LAYOUT __UBYTE_Z FNC_VALUES 1 UBYTE ROW_DIR DIRECT /end RECORD_LAYOUT
/begin CHARACTERISTIC CcBrakeLightReq "" VALUE 0x00000000 __UBYTE_Z 0 NO_COMPU_METHOD 0 255 /end CHARACTERISTIC
/begin CHARACTERISTIC CcAfsDecelReq "" VALUE 0x00000000 __FLOAT32_IEEE_Z 0 NO_COMPU_METHOD -3.40282346639E+38 3.40282346639E+38 /end CHARACTERISTIC
/begin CHARACTERISTIC AebPreCrash "" VALUE 0x00000000 __UBYTE_Z 0 NO_COMPU_METHOD 0 255 /end CHARACTERISTIC
/begin CHARACTERISTIC AebDecelReq "" VALUE 0x00000000 __FLOAT32_IEEE_Z 0 NO_COMPU_METHOD -3.40282346639E+38 3.40282346639E+38 /end CHARACTERISTIC
/begin CHARACTERISTIC AebBoostReq "" VALUE 0x00000000 __UBYTE_Z 0 NO_COMPU_METHOD 0 255 /end CHARACTERISTIC
/begin CHARACTERISTIC AebPrefillReq "" VALUE 0x00000000 __UBYTE_Z 0 NO_COMPU_METHOD 0 255 /end CHARACTERISTIC
/begin CHARACTERISTIC DAS_AccFuncError_Stat "" VALUE 0x00000000 __UBYTE_Z 0 NO_COMPU_METHOD 0 255 /end CHARACTERISTIC
/begin CHARACTERISTIC LkaMode "" VALUE 0x00000000 __UBYTE_Z 0 NO_COMPU_METHOD 0 255 /end CHARACTERISTIC
/begin CHARACTERISTIC LkaAngleReq "" VALUE 0x00000000 __FLOAT32_IEEE_Z 0 NO_COMPU_METHOD -3.40282346639E+38 3.40282346639E+38 /end CHARACTERISTIC
/begin CHARACTERISTIC LkaAngleReqFlag "" VALUE 0x00000000 __UBYTE_Z 0 NO_COMPU_METHOD 0 255 /end CHARACTERISTIC
/begin CHARACTERISTIC RsaAngleDirect "" VALUE 0x00000000 __UBYTE_Z 0 NO_COMPU_METHOD 0 255 /end CHARACTERISTIC
/begin CHARACTERISTIC LkaFuncError "" VALUE 0x00000000 __UBYTE_Z 0 NO_COMPU_METHOD 0 255 /end CHARACTERISTIC
/begin CHARACTERISTIC AfsMode "" VALUE 0x00000000 __UBYTE_Z 0 NO_COMPU_METHOD 0 255 /end CHARACTERISTIC
/begin CHARACTERISTIC AfsDoorUnlookReq "" VALUE 0x00000000 __UBYTE_Z 0 NO_COMPU_METHOD 0 255 /end CHARACTERISTIC
/begin CHARACTERISTIC AfsSosReq "" VALUE 0x00000000 __UBYTE_Z 0 NO_COMPU_METHOD 0 255 /end CHARACTERISTIC
/begin CHARACTERISTIC AfsDecelReqFlag "" VALUE 0x00000000 __UBYTE_Z 0 NO_COMPU_METHOD 0 255 /end CHARACTERISTIC
/begin CHARACTERISTIC AfsNotifError "" VALUE 0x00000000 __UBYTE_Z 0 NO_COMPU_METHOD 0 255 /end CHARACTERISTIC
/begin CHARACTERISTIC AfsFuncError "" VALUE 0x00000000 __UBYTE_Z 0 NO_COMPU_METHOD 0 255 /end CHARACTERISTIC
/begin CHARACTERISTIC LdpMode "" VALUE 0x00000000 __UBYTE_Z 0 NO_COMPU_METHOD 0 255 /end CHARACTERISTIC
/begin CHARACTERISTIC LdpAngleReqFlag "" VALUE 0x00000000 __UBYTE_Z 0 NO_COMPU_METHOD 0 255 /end CHARACTERISTIC
/begin CHARACTERISTIC LdwFuncError "" VALUE 0x00000000 __UBYTE_Z 0 NO_COMPU_METHOD 0 255 /end CHARACTERISTIC
/begin CHARACTERISTIC ALccMode "" VALUE 0x00000000 __UBYTE_Z 0 NO_COMPU_METHOD 0 255 /end CHARACTERISTIC
/begin CHARACTERISTIC AlccAngleReqFlag "" VALUE 0x00000000 __UBYTE_Z 0 NO_COMPU_METHOD 0 255 /end CHARACTERISTIC
/begin CHARACTERISTIC LccFuncError "" VALUE 0x00000000 __UBYTE_Z 0 NO_COMPU_METHOD 0 255 /end CHARACTERISTIC
/begin CHARACTERISTIC RdaMode "" VALUE 0x00000000 __UBYTE_Z 0 NO_COMPU_METHOD 0 255 /end CHARACTERISTIC
/begin CHARACTERISTIC RctcMode "" VALUE 0x00000000 __UBYTE_Z 0 NO_COMPU_METHOD 0 255 /end CHARACTERISTIC
/begin CHARACTERISTIC RdaDecelReqFalg "" VALUE 0x00000000 __UBYTE_Z 0 NO_COMPU_METHOD 0 255 /end CHARACTERISTIC
/begin CHARACTERISTIC RctcDecelReqFalg "" VALUE 0x00000000 __UBYTE_Z 0 NO_COMPU_METHOD 0 255 /end CHARACTERISTIC
/begin CHARACTERISTIC RdaFuncError "" VALUE 0x00000000 __UBYTE_Z 0 NO_COMPU_METHOD 0 255 /end CHARACTERISTIC
/begin CHARACTERISTIC RctcFuncError "" VALUE 0x00000000 __UBYTE_Z 0 NO_COMPU_METHOD 0 255 /end CHARACTERISTIC
/begin CHARACTERISTIC RctcNotifError "" VALUE 0x00000000 __UBYTE_Z 0 NO_COMPU_METHOD 0 255 /end CHARACTERISTIC
/begin CHARACTERISTIC CcType "" VALUE 0x00000000 __UBYTE_Z 0 NO_COMPU_METHOD 0 255 /end CHARACTERISTIC
/begin CHARACTERISTIC CcSetSpeed "" VALUE 0x00000000 __UBYTE_Z 0 NO_COMPU_METHOD 0 255 /end CHARACTERISTIC
/begin CHARACTERISTIC CcSetDist "" VALUE 0x00000000 __UBYTE_Z 0 NO_COMPU_METHOD 0 255 /end CHARACTERISTIC
/begin CHARACTERISTIC CcReject "" VALUE 0x00000000 __UBYTE_Z 0 NO_COMPU_METHOD 0 255 /end CHARACTERISTIC
/begin CHARACTERISTIC CcTargetId "" VALUE 0x00000000 __UBYTE_Z 0 NO_COMPU_METHOD 0 255 /end CHARACTERISTIC
/begin CHARACTERISTIC CcSleepSt "" VALUE 0x00000000 __UBYTE_Z 0 NO_COMPU_METHOD 0 255 /end CHARACTERISTIC
/begin CHARACTERISTIC DAS_LimNotifError_Req "" VALUE 0x00000000 __UBYTE_Z 0 NO_COMPU_METHOD 0 255 /end CHARACTERISTIC
/begin CHARACTERISTIC DAS_AccToCc_Req "" VALUE 0x00000000 __UBYTE_Z 0 NO_COMPU_METHOD 0 255 /end CHARACTERISTIC
/begin CHARACTERISTIC DAS_AccNotifError_Req "" VALUE 0x00000000 __UBYTE_Z 0 NO_COMPU_METHOD 0 255 /end CHARACTERISTIC
/begin CHARACTERISTIC CcNotifError "" VALUE 0x00000000 __UBYTE_Z 0 NO_COMPU_METHOD 0 255 /end CHARACTERISTIC
/begin CHARACTERISTIC AslaMode "" VALUE 0x00000000 __UBYTE_Z 0 NO_COMPU_METHOD 0 255 /end CHARACTERISTIC
/begin CHARACTERISTIC AslaChSpdReq "" VALUE 0x00000000 __UBYTE_Z 0 NO_COMPU_METHOD 0 255 /end CHARACTERISTIC
/begin CHARACTERISTIC FcwMode "" VALUE 0x00000000 __UBYTE_Z 0 NO_COMPU_METHOD 0 255 /end CHARACTERISTIC
/begin CHARACTERISTIC AebDeactivNotif "" VALUE 0x00000000 __UBYTE_Z 0 NO_COMPU_METHOD 0 255 /end CHARACTERISTIC
/begin CHARACTERISTIC FcwActivNotif "" VALUE 0x00000000 __UBYTE_Z 0 NO_COMPU_METHOD 0 255 /end CHARACTERISTIC
/begin CHARACTERISTIC AebUnAvaliable "" VALUE 0x00000000 __UBYTE_Z 0 NO_COMPU_METHOD 0 255 /end CHARACTERISTIC
/begin CHARACTERISTIC FcwSoundWarnReq "" VALUE 0x00000000 __UBYTE_Z 0 NO_COMPU_METHOD 0 255 /end CHARACTERISTIC
/begin CHARACTERISTIC AebNotifError "" VALUE 0x00000000 __UBYTE_Z 0 NO_COMPU_METHOD 0 255 /end CHARACTERISTIC
/begin CHARACTERISTIC FcwNotifError "" VALUE 0x00000000 __UBYTE_Z 0 NO_COMPU_METHOD 0 255 /end CHARACTERISTIC
/begin CHARACTERISTIC LkaShootdownNotifReq "" VALUE 0x00000000 __UBYTE_Z 0 NO_COMPU_METHOD 0 255 /end CHARACTERISTIC
/begin CHARACTERISTIC MliaMode "" VALUE 0x00000000 __UBYTE_Z 0 NO_COMPU_METHOD 0 255 /end CHARACTERISTIC
/begin CHARACTERISTIC MliaStreetLightStat "" VALUE 0x00000000 __UBYTE_Z 0 NO_COMPU_METHOD 0 255 /end CHARACTERISTIC
/begin CHARACTERISTIC MliaFuncError "" VALUE 0x00000000 __UBYTE_Z 0 NO_COMPU_METHOD 0 255 /end CHARACTERISTIC
/begin CHARACTERISTIC CcMode "" VALUE 0x00000000 __UBYTE_Z 0 NO_COMPU_METHOD 0 255 /end CHARACTERISTIC
/begin CHARACTERISTIC CcBrakeStandStReq "" VALUE 0x00000000 __UBYTE_Z 0 NO_COMPU_METHOD 0 255 /end CHARACTERISTIC
/begin CHARACTERISTIC CcBrakeReleaseReq "" VALUE 0x00000000 __UBYTE_Z 0 NO_COMPU_METHOD 0 255 /end CHARACTERISTIC
/begin CHARACTERISTIC CcDecelReqFlag "" VALUE 0x00000000 __UBYTE_Z 0 NO_COMPU_METHOD 0 255 /end CHARACTERISTIC
/begin CHARACTERISTIC CcFuncError "" VALUE 0x00000000 __UBYTE_Z 0 NO_COMPU_METHOD 0 255 /end CHARACTERISTIC
/begin CHARACTERISTIC AebMode "" VALUE 0x00000000 __UBYTE_Z 0 NO_COMPU_METHOD 0 255 /end CHARACTERISTIC
/begin CHARACTERISTIC AebDecelReqFlag "" VALUE 0x00000000 __UBYTE_Z 0 NO_COMPU_METHOD 0 255 /end CHARACTERISTIC
/begin CHARACTERISTIC AebRdaStandReq "" VALUE 0x00000000 __UBYTE_Z 0 NO_COMPU_METHOD 0 255 /end CHARACTERISTIC
/begin CHARACTERISTIC AebFuncError "" VALUE 0x00000000 __UBYTE_Z 0 NO_COMPU_METHOD 0 255 /end CHARACTERISTIC
/begin CHARACTERISTIC AfsBrakeJerkLevel "" VALUE 0x00000000 __UBYTE_Z 0 NO_COMPU_METHOD 0 255 /end CHARACTERISTIC
/begin CHARACTERISTIC AfsBrakeJerkEn "" VALUE 0x00000000 __UBYTE_Z 0 NO_COMPU_METHOD 0 255 /end CHARACTERISTIC
/begin CHARACTERISTIC AfsBrakeJerkReq "" VALUE 0x00000000 __UBYTE_Z 0 NO_COMPU_METHOD 0 255 /end CHARACTERISTIC
/begin CHARACTERISTIC LkaWarnSoundReq "" VALUE 0x00000000 __UBYTE_Z 0 NO_COMPU_METHOD 0 255 /end CHARACTERISTIC
/begin CHARACTERISTIC LkaShotdownSoundReq "" VALUE 0x00000000 __UBYTE_Z 0 NO_COMPU_METHOD 0 255 /end CHARACTERISTIC
/begin CHARACTERISTIC LkaWarnNotifReq "" VALUE 0x00000000 __UBYTE_Z 0 NO_COMPU_METHOD 0 255 /end CHARACTERISTIC
/begin CHARACTERISTIC LkaNotifError "" VALUE 0x00000000 __UBYTE_Z 0 NO_COMPU_METHOD 0 255 /end CHARACTERISTIC
/begin CHARACTERISTIC LdwMode "" VALUE 0x00000000 __UBYTE_Z 0 NO_COMPU_METHOD 0 255 /end CHARACTERISTIC
/begin CHARACTERISTIC LdwLeftLaneWarnReq "" VALUE 0x00000000 __UBYTE_Z 0 NO_COMPU_METHOD 0 255 /end CHARACTERISTIC
/begin CHARACTERISTIC LdwRightLaneWarnReq "" VALUE 0x00000000 __UBYTE_Z 0 NO_COMPU_METHOD 0 255 /end CHARACTERISTIC
/begin CHARACTERISTIC LdpLeftLaneWarnReq "" VALUE 0x00000000 __UBYTE_Z 0 NO_COMPU_METHOD 0 255 /end CHARACTERISTIC
/begin CHARACTERISTIC LdpRightLaneWarnReq "" VALUE 0x00000000 __UBYTE_Z 0 NO_COMPU_METHOD 0 255 /end CHARACTERISTIC
/begin CHARACTERISTIC LdwSoundReq "" VALUE 0x00000000 __UBYTE_Z 0 NO_COMPU_METHOD 0 255 /end CHARACTERISTIC
/begin CHARACTERISTIC LdpNotifError "" VALUE 0x00000000 __UBYTE_Z 0 NO_COMPU_METHOD 0 255 /end CHARACTERISTIC
/begin CHARACTERISTIC LdwNotifError "" VALUE 0x00000000 __UBYTE_Z 0 NO_COMPU_METHOD 0 255 /end CHARACTERISTIC
/begin CHARACTERISTIC LccMode "" VALUE 0x00000000 __UBYTE_Z 0 NO_COMPU_METHOD 0 255 /end CHARACTERISTIC
/begin CHARACTERISTIC DowMode "" VALUE 0x00000000 __UBYTE_Z 0 NO_COMPU_METHOD 0 255 /end CHARACTERISTIC
/begin CHARACTERISTIC LccLeftLedReq "" VALUE 0x00000000 __UBYTE_Z 0 NO_COMPU_METHOD 0 255 /end CHARACTERISTIC
/begin CHARACTERISTIC LccRightLedReq "" VALUE 0x00000000 __UBYTE_Z 0 NO_COMPU_METHOD 0 255 /end CHARACTERISTIC
/begin CHARACTERISTIC LccLeftWarnReq "" VALUE 0x00000000 __UBYTE_Z 0 NO_COMPU_METHOD 0 255 /end CHARACTERISTIC
/begin CHARACTERISTIC LccRightWarnReq "" VALUE 0x00000000 __UBYTE_Z 0 NO_COMPU_METHOD 0 255 /end CHARACTERISTIC
/begin CHARACTERISTIC LccSoundReq "" VALUE 0x00000000 __UBYTE_Z 0 NO_COMPU_METHOD 0 255 /end CHARACTERISTIC
/begin CHARACTERISTIC ALccNotifError "" VALUE 0x00000000 __UBYTE_Z 0 NO_COMPU_METHOD 0 255 /end CHARACTERISTIC
/begin CHARACTERISTIC LccNotifError "" VALUE 0x00000000 __UBYTE_Z 0 NO_COMPU_METHOD 0 255 /end CHARACTERISTIC
/begin CHARACTERISTIC DowNotifError "" VALUE 0x00000000 __UBYTE_Z 0 NO_COMPU_METHOD 0 255 /end CHARACTERISTIC
/begin CHARACTERISTIC RdaWarnReq "" VALUE 0x00000000 __UBYTE_Z 0 NO_COMPU_METHOD 0 255 /end CHARACTERISTIC
/begin CHARACTERISTIC RctcWarnReq "" VALUE 0x00000000 __UBYTE_Z 0 NO_COMPU_METHOD 0 255 /end CHARACTERISTIC
/begin CHARACTERISTIC RdaNotifError "" VALUE 0x00000000 __UBYTE_Z 0 NO_COMPU_METHOD 0 255 /end CHARACTERISTIC
/begin CHARACTERISTIC TsrMode "" VALUE 0x00000000 __UBYTE_Z 0 NO_COMPU_METHOD 0 255 /end CHARACTERISTIC
/begin CHARACTERISTIC TsrSignSpeed "" VALUE 0x00000000 __UBYTE_Z 0 NO_COMPU_METHOD 0 255 /end CHARACTERISTIC
/begin CHARACTERISTIC TsrSignOverTaking "" VALUE 0x00000000 __UBYTE_Z 0 NO_COMPU_METHOD 0 255 /end CHARACTERISTIC
/begin CHARACTERISTIC TsrSignError "" VALUE 0x00000000 __UBYTE_Z 0 NO_COMPU_METHOD 0 255 /end CHARACTERISTIC
/begin CHARACTERISTIC TsrSignNotifError "" VALUE 0x00000000 __UBYTE_Z 0 NO_COMPU_METHOD 0 255 /end CHARACTERISTIC
/begin CHARACTERISTIC AaMode "" VALUE 0x00000000 __UBYTE_Z 0 NO_COMPU_METHOD 0 255 /end CHARACTERISTIC
/begin CHARACTERISTIC AaWarnNotifReq "" VALUE 0x00000000 __UBYTE_Z 0 NO_COMPU_METHOD 0 255 /end CHARACTERISTIC
/begin CHARACTERISTIC NvMode "" VALUE 0x00000000 __UBYTE_Z 0 NO_COMPU_METHOD 0 255 /end CHARACTERISTIC
/begin CHARACTERISTIC NvFuncError "" VALUE 0x00000000 __UBYTE_Z 0 NO_COMPU_METHOD 0 255 /end CHARACTERISTIC
/begin CHARACTERISTIC RcwMode "" VALUE 0x00000000 __UBYTE_Z 0 NO_COMPU_METHOD 0 255 /end CHARACTERISTIC
/begin CHARACTERISTIC RcwWarnReq "" VALUE 0x00000000 __UBYTE_Z 0 NO_COMPU_METHOD 0 255 /end CHARACTERISTIC
/begin CHARACTERISTIC RecMode "" VALUE 0x00000000 __UBYTE_Z 0 NO_COMPU_METHOD 0 255 /end CHARACTERISTIC
/begin CHARACTERISTIC DfDiagCcAvail "" VALUE 0x00000000 __UBYTE_Z 0 NO_COMPU_METHOD 0 255 /end CHARACTERISTIC
/begin CHARACTERISTIC DfDiagAccAvail "" VALUE 0x00000000 __UBYTE_Z 0 NO_COMPU_METHOD 0 255 /end CHARACTERISTIC
/begin CHARACTERISTIC DfDiagLimAvail "" VALUE 0x00000000 __UBYTE_Z 0 NO_COMPU_METHOD 0 255 /end CHARACTERISTIC
/begin CHARACTERISTIC DfDiagAslaAvail "" VALUE 0x00000000 __UBYTE_Z 0 NO_COMPU_METHOD 0 255 /end CHARACTERISTIC
/begin CHARACTERISTIC DfDiagLkaAvail "" VALUE 0x00000000 __UBYTE_Z 0 NO_COMPU_METHOD 0 255 /end CHARACTERISTIC
/begin CHARACTERISTIC DfDiagFcwAvail "" VALUE 0x00000000 __UBYTE_Z 0 NO_COMPU_METHOD 0 255 /end CHARACTERISTIC
/begin CHARACTERISTIC DfDiagAebAvail "" VALUE 0x00000000 __UBYTE_Z 0 NO_COMPU_METHOD 0 255 /end CHARACTERISTIC
/begin CHARACTERISTIC DfDiagLccAvail "" VALUE 0x00000000 __UBYTE_Z 0 NO_COMPU_METHOD 0 255 /end CHARACTERISTIC
/begin CHARACTERISTIC DfDiagAlccAvail "" VALUE 0x00000000 __UBYTE_Z 0 NO_COMPU_METHOD 0 255 /end CHARACTERISTIC
/begin CHARACTERISTIC DfDiagDowAvail "" VALUE 0x00000000 __UBYTE_Z 0 NO_COMPU_METHOD 0 255 /end CHARACTERISTIC
/begin CHARACTERISTIC DfDiagLdwAvail "" VALUE 0x00000000 __UBYTE_Z 0 NO_COMPU_METHOD 0 255 /end CHARACTERISTIC
/begin CHARACTERISTIC DfDiagLdpAvail "" VALUE 0x00000000 __UBYTE_Z 0 NO_COMPU_METHOD 0 255 /end CHARACTERISTIC
/begin CHARACTERISTIC DfDiagTsrAvail "" VALUE 0x00000000 __UBYTE_Z 0 NO_COMPU_METHOD 0 255 /end CHARACTERISTIC
/begin CHARACTERISTIC DfDiagAaAvail "" VALUE 0x00000000 __UBYTE_Z 0 NO_COMPU_METHOD 0 255 /end CHARACTERISTIC
/begin CHARACTERISTIC DfDiagAfsAvail "" VALUE 0x00000000 __UBYTE_Z 0 NO_COMPU_METHOD 0 255 /end CHARACTERISTIC
/begin CHARACTERISTIC DfDiagRdaAvail "" VALUE 0x00000000 __UBYTE_Z 0 NO_COMPU_METHOD 0 255 /end CHARACTERISTIC
/begin CHARACTERISTIC DfDiagRctcAvail "" VALUE 0x00000000 __UBYTE_Z 0 NO_COMPU_METHOD 0 255 /end CHARACTERISTIC
/begin CHARACTERISTIC DfDiagRcwAvail "" VALUE 0x00000000 __UBYTE_Z 0 NO_COMPU_METHOD 0 255 /end CHARACTERISTIC
/begin CHARACTERISTIC DfDiagRecAvail "" VALUE 0x00000000 __UBYTE_Z 0 NO_COMPU_METHOD 0 255 /end CHARACTERISTIC
/begin CHARACTERISTIC DfDiagNvAvail "" VALUE 0x00000000 __UBYTE_Z 0 NO_COMPU_METHOD 0 255 /end CHARACTERISTIC
/begin CHARACTERISTIC DfDiagVisualAvail "" VALUE 0x00000000 __UBYTE_Z 0 NO_COMPU_METHOD 0 255 /end CHARACTERISTIC
/begin CHARACTERISTIC CcEmsMotIncFlag "" VALUE 0x00000000 __UBYTE_Z 0 NO_COMPU_METHOD 0 255 /end CHARACTERISTIC
/begin CHARACTERISTIC CcEmsMotInc "" VALUE 0x00000000 __FLOAT32_IEEE_Z 0 NO_COMPU_METHOD -3.40282346639E+38 3.40282346639E+38 /end CHARACTERISTIC
/begin CHARACTERISTIC CcEmsEngagement_Stat "" VALUE 0x00000000 __UBYTE_Z 0 NO_COMPU_METHOD 0 255 /end CHARACTERISTIC
/begin CHARACTERISTIC CcEmsState_Stat "" VALUE 0x00000000 __UBYTE_Z 0 NO_COMPU_METHOD 0 255 /end CHARACTERISTIC
/begin CHARACTERISTIC OSettCcTypeSts "" VALUE 0x00000000 __UBYTE_Z 0 NO_COMPU_METHOD 0 255 /end CHARACTERISTIC
/begin CHARACTERISTIC OSettCcModeSts "" VALUE 0x00000000 __UBYTE_Z 0 NO_COMPU_METHOD 0 255 /end CHARACTERISTIC
/begin CHARACTERISTIC OSettCcSpdCorrectSts "" VALUE 0x00000000 __UBYTE_Z 0 NO_COMPU_METHOD 0 255 /end CHARACTERISTIC
/begin CHARACTERISTIC OSettAslaSts "" VALUE 0x00000000 __UBYTE_Z 0 NO_COMPU_METHOD 0 255 /end CHARACTERISTIC
/begin CHARACTERISTIC OSettAslaOverCmd "" VALUE 0x00000000 __UBYTE_Z 0 NO_COMPU_METHOD 0 255 /end CHARACTERISTIC
/begin CHARACTERISTIC OSettLkaSts "" VALUE 0x00000000 __UBYTE_Z 0 NO_COMPU_METHOD 0 255 /end CHARACTERISTIC
/begin CHARACTERISTIC OSettFcwSts "" VALUE 0x00000000 __UBYTE_Z 0 NO_COMPU_METHOD 0 255 /end CHARACTERISTIC
/begin CHARACTERISTIC OSettFcwModeSts "" VALUE 0x00000000 __UBYTE_Z 0 NO_COMPU_METHOD 0 255 /end CHARACTERISTIC
/begin CHARACTERISTIC OSettFcwVibrationSts "" VALUE 0x00000000 __UBYTE_Z 0 NO_COMPU_METHOD 0 255 /end CHARACTERISTIC
/begin CHARACTERISTIC OSettAebSts "" VALUE 0x00000000 __UBYTE_Z 0 NO_COMPU_METHOD 0 255 /end CHARACTERISTIC
/begin CHARACTERISTIC OSettLccSts "" VALUE 0x00000000 __UBYTE_Z 0 NO_COMPU_METHOD 0 255 /end CHARACTERISTIC
/begin CHARACTERISTIC OSettLccModeSts "" VALUE 0x00000000 __UBYTE_Z 0 NO_COMPU_METHOD 0 255 /end CHARACTERISTIC
/begin CHARACTERISTIC OSettLccVibrationSts "" VALUE 0x00000000 __UBYTE_Z 0 NO_COMPU_METHOD 0 255 /end CHARACTERISTIC
/begin CHARACTERISTIC OSettLccSoundSts "" VALUE 0x00000000 __UBYTE_Z 0 NO_COMPU_METHOD 0 255 /end CHARACTERISTIC
/begin CHARACTERISTIC OSettAlccSts "" VALUE 0x00000000 __UBYTE_Z 0 NO_COMPU_METHOD 0 255 /end CHARACTERISTIC
/begin CHARACTERISTIC OSettDowSts "" VALUE 0x00000000 __UBYTE_Z 0 NO_COMPU_METHOD 0 255 /end CHARACTERISTIC
/begin CHARACTERISTIC OSettDowSoundSts "" VALUE 0x00000000 __UBYTE_Z 0 NO_COMPU_METHOD 0 255 /end CHARACTERISTIC
/begin CHARACTERISTIC OSettLdwSts "" VALUE 0x00000000 __UBYTE_Z 0 NO_COMPU_METHOD 0 255 /end CHARACTERISTIC
/begin CHARACTERISTIC OSettLdwModeSts "" VALUE 0x00000000 __UBYTE_Z 0 NO_COMPU_METHOD 0 255 /end CHARACTERISTIC
/begin CHARACTERISTIC OSettLdwVibrationSts "" VALUE 0x00000000 __UBYTE_Z 0 NO_COMPU_METHOD 0 255 /end CHARACTERISTIC
/begin CHARACTERISTIC OSettLdwSoundSts "" VALUE 0x00000000 __UBYTE_Z 0 NO_COMPU_METHOD 0 255 /end CHARACTERISTIC
/begin CHARACTERISTIC OSettLdpSts "" VALUE 0x00000000 __UBYTE_Z 0 NO_COMPU_METHOD 0 255 /end CHARACTERISTIC
/begin CHARACTERISTIC OSettTsrSts "" VALUE 0x00000000 __UBYTE_Z 0 NO_COMPU_METHOD 0 255 /end CHARACTERISTIC
/begin CHARACTERISTIC OSettAaSts "" VALUE 0x00000000 __UBYTE_Z 0 NO_COMPU_METHOD 0 255 /end CHARACTERISTIC
/begin CHARACTERISTIC OSettAaModeSts "" VALUE 0x00000000 __UBYTE_Z 0 NO_COMPU_METHOD 0 255 /end CHARACTERISTIC
/begin CHARACTERISTIC OSettAfsSts "" VALUE 0x00000000 __UBYTE_Z 0 NO_COMPU_METHOD 0 255 /end CHARACTERISTIC
/begin CHARACTERISTIC OSettRdaSts "" VALUE 0x00000000 __UBYTE_Z 0 NO_COMPU_METHOD 0 255 /end CHARACTERISTIC
/begin CHARACTERISTIC OSettRdaAutoBrakeSts "" VALUE 0x00000000 __UBYTE_Z 0 NO_COMPU_METHOD 0 255 /end CHARACTERISTIC
/begin CHARACTERISTIC OSettRctcSts "" VALUE 0x00000000 __UBYTE_Z 0 NO_COMPU_METHOD 0 255 /end CHARACTERISTIC
/begin CHARACTERISTIC OSettRecSts "" VALUE 0x00000000 __UBYTE_Z 0 NO_COMPU_METHOD 0 255 /end CHARACTERISTIC
/begin CHARACTERISTIC OSettSensCleanSts "" VALUE 0x00000000 __UBYTE_Z 0 NO_COMPU_METHOD 0 255 /end CHARACTERISTIC
/begin CHARACTERISTIC OSettRoadSignSts "" VALUE 0x00000000 __UBYTE_Z 0 NO_COMPU_METHOD 0 255 /end CHARACTERISTIC
/begin CHARACTERISTIC OSettNavigSts "" VALUE 0x00000000 __UBYTE_Z 0 NO_COMPU_METHOD 0 255 /end CHARACTERISTIC
/begin CHARACTERISTIC OSettOtherObjSts "" VALUE 0x00000000 __UBYTE_Z 0 NO_COMPU_METHOD 0 255 /end CHARACTERISTIC
/begin CHARACTERISTIC OSettProjectionOnARoadSts "" VALUE 0x00000000 __UBYTE_Z 0 NO_COMPU_METHOD 0 255 /end CHARACTERISTIC
/begin CHARACTERISTIC DAS_ACCResDistance_Stat "" VALUE 0x00000000 __UBYTE_Z 0 NO_COMPU_METHOD 0 255 /end CHARACTERISTIC
/begin CHARACTERISTIC CcHudSetDist "" VALUE 0x00000000 __UBYTE_Z 0 NO_COMPU_METHOD 0 255 /end CHARACTERISTIC
/begin CHARACTERISTIC DAS_ACCResSpeed_Val "" VALUE 0x00000000 __UBYTE_Z 0 NO_COMPU_METHOD 0 255 /end CHARACTERISTIC
/begin CHARACTERISTIC CcHudSetSpeed "" VALUE 0x00000000 __UBYTE_Z 0 NO_COMPU_METHOD 0 255 /end CHARACTERISTIC
/begin CHARACTERISTIC CcHudTargDetect "" VALUE 0x00000000 __UBYTE_Z 0 NO_COMPU_METHOD 0 255 /end CHARACTERISTIC
/begin CHARACTERISTIC TsrHudMultiSign "" VALUE 0x00000000 __UBYTE_Z 0 NO_COMPU_METHOD 0 255 /end CHARACTERISTIC
/begin CHARACTERISTIC DAS_SPLimRoadSignInf2_Stat "" VALUE 0x00000000 __UBYTE_Z 0 NO_COMPU_METHOD 0 255 /end CHARACTERISTIC
/begin CHARACTERISTIC DAS_SPLimRoadSignInf3_Stat "" VALUE 0x00000000 __UBYTE_Z 0 NO_COMPU_METHOD 0 255 /end CHARACTERISTIC
/begin CHARACTERISTIC TsrHudMultSignAddres "" VALUE 0x00000000 __UBYTE_Z 0 NO_COMPU_METHOD 0 255 /end CHARACTERISTIC
/begin CHARACTERISTIC DAS_SPLimRoadSignCurrSpeed_Stat "" VALUE 0x00000000 __UBYTE_Z 0 NO_COMPU_METHOD 0 255 /end CHARACTERISTIC
/begin CHARACTERISTIC LdwHudMultiLaneWarnReq "" VALUE 0x00000000 __UBYTE_Z 0 NO_COMPU_METHOD 0 255 /end CHARACTERISTIC
/begin CHARACTERISTIC DAS_RightLaneLDWWarning_Req "" VALUE 0x00000000 __UBYTE_Z 0 NO_COMPU_METHOD 0 255 /end CHARACTERISTIC
/begin CHARACTERISTIC LdwHudMultiLaneAddres "" VALUE 0x00000000 __UBYTE_Z 0 NO_COMPU_METHOD 0 255 /end CHARACTERISTIC
/begin CHARACTERISTIC USSFrontReq "" VALUE 0x00000000 __UBYTE_Z 0 NO_COMPU_METHOD 0 255 /end CHARACTERISTIC
/begin CHARACTERISTIC USSRearReq "" VALUE 0x00000000 __UBYTE_Z 0 NO_COMPU_METHOD 0 255 /end CHARACTERISTIC
/begin CHARACTERISTIC USSSideReq "" VALUE 0x00000000 __UBYTE_Z 0 NO_COMPU_METHOD 0 255 /end CHARACTERISTIC
/begin CHARACTERISTIC AdasAvailMode "" VALUE 0x00000000 __UBYTE_Z 0 NO_COMPU_METHOD 0 255 /end CHARACTERISTIC
/begin CHARACTERISTIC SensAllDirty_Stat "" VALUE 0x00000000 __UBYTE_Z 0 NO_COMPU_METHOD 0 255 /end CHARACTERISTIC
/begin CHARACTERISTIC SensTicuDirty_Stat "" VALUE 0x00000000 __UBYTE_Z 0 NO_COMPU_METHOD 0 255 /end CHARACTERISTIC
/begin CHARACTERISTIC SensLidarDirty_Stat "" VALUE 0x00000000 __UBYTE_Z 0 NO_COMPU_METHOD 0 255 /end CHARACTERISTIC
/begin CHARACTERISTIC SensMrrxDirty_Stat "" VALUE 0x00000000 __UBYTE_Z 0 NO_COMPU_METHOD 0 255 /end CHARACTERISTIC
/begin CHARACTERISTIC SensFrcuDirty_Stat "" VALUE 0x00000000 __UBYTE_Z 0 NO_COMPU_METHOD 0 255 /end CHARACTERISTIC
/begin CHARACTERISTIC SensClearReq "" VALUE 0x00000000 __UBYTE_Z 0 NO_COMPU_METHOD 0 255 /end CHARACTERISTIC
/begin CHARACTERISTIC SensWSHeatReq "" VALUE 0x00000000 __UBYTE_Z 0 NO_COMPU_METHOD 0 255 /end CHARACTERISTIC
/begin CHARACTERISTIC SensSteerWhVibrReq "" VALUE 0x00000000 __UBYTE_Z 0 NO_COMPU_METHOD 0 255 /end CHARACTERISTIC
/begin CHARACTERISTIC SensSteerWhLvl "" VALUE 0x00000000 __UBYTE_Z 0 NO_COMPU_METHOD 0 255 /end CHARACTERISTIC
/begin CHARACTERISTIC CcVcuMotIncFlag "" VALUE 0x00000000 __UBYTE_Z 0 NO_COMPU_METHOD 0 255 /end CHARACTERISTIC
/begin CHARACTERISTIC CcVcuMotInc "" VALUE 0x00000000 __FLOAT32_IEEE_Z 0 NO_COMPU_METHOD -3.40282346639E+38 3.40282346639E+38 /end CHARACTERISTIC
/begin CHARACTERISTIC CcVcuEngagement_Stat "" VALUE 0x00000000 __UBYTE_Z 0 NO_COMPU_METHOD 0 255 /end CHARACTERISTIC
/begin CHARACTERISTIC CcVcuState_Stat "" VALUE 0x00000000 __UBYTE_Z 0 NO_COMPU_METHOD 0 255 /end CHARACTERISTIC
/begin CHARACTERISTIC DAS_TmissionChange_Req "" VALUE 0x00000000 __UBYTE_Z 0 NO_COMPU_METHOD 0 255 /end CHARACTERISTIC
/begin CHARACTERISTIC MliaLADBLED1Req "" VALUE 0x00000000 __UBYTE_Z 0 NO_COMPU_METHOD 0 255 /end CHARACTERISTIC
/begin CHARACTERISTIC MliaLADBLED2Req "" VALUE 0x00000000 __UBYTE_Z 0 NO_COMPU_METHOD 0 255 /end CHARACTERISTIC
/begin CHARACTERISTIC MliaLADBLED3Req "" VALUE 0x00000000 __UBYTE_Z 0 NO_COMPU_METHOD 0 255 /end CHARACTERISTIC
/begin CHARACTERISTIC MliaLADBLED4Req "" VALUE 0x00000000 __UBYTE_Z 0 NO_COMPU_METHOD 0 255 /end CHARACTERISTIC
/begin CHARACTERISTIC MliaLADBLED5Req "" VALUE 0x00000000 __UBYTE_Z 0 NO_COMPU_METHOD 0 255 /end CHARACTERISTIC
/begin CHARACTERISTIC MliaLADBLED6Req "" VALUE 0x00000000 __UBYTE_Z 0 NO_COMPU_METHOD 0 255 /end CHARACTERISTIC
/begin CHARACTERISTIC MliaLADBLED7Req "" VALUE 0x00000000 __UBYTE_Z 0 NO_COMPU_METHOD 0 255 /end CHARACTERISTIC
/begin CHARACTERISTIC MliaLADBLED8Req "" VALUE 0x00000000 __UBYTE_Z 0 NO_COMPU_METHOD 0 255 /end CHARACTERISTIC
/begin CHARACTERISTIC MliaLADBLED9Req "" VALUE 0x00000000 __UBYTE_Z 0 NO_COMPU_METHOD 0 255 /end CHARACTERISTIC
/begin CHARACTERISTIC MliaLADBLED10Req "" VALUE 0x00000000 __UBYTE_Z 0 NO_COMPU_METHOD 0 255 /end CHARACTERISTIC
/begin CHARACTERISTIC MliaLADBLED11Req "" VALUE 0x00000000 __UBYTE_Z 0 NO_COMPU_METHOD 0 255 /end CHARACTERISTIC
/begin CHARACTERISTIC MliaLADBLED12Req "" VALUE 0x00000000 __UBYTE_Z 0 NO_COMPU_METHOD 0 255 /end CHARACTERISTIC
/begin CHARACTERISTIC MliaLADBLED13Req "" VALUE 0x00000000 __UBYTE_Z 0 NO_COMPU_METHOD 0 255 /end CHARACTERISTIC
/begin CHARACTERISTIC MliaLADBLED14Req "" VALUE 0x00000000 __UBYTE_Z 0 NO_COMPU_METHOD 0 255 /end CHARACTERISTIC
/begin CHARACTERISTIC MliaLADBLED15Req "" VALUE 0x00000000 __UBYTE_Z 0 NO_COMPU_METHOD 0 255 /end CHARACTERISTIC
/begin CHARACTERISTIC MliaLADBLED16Req "" VALUE 0x00000000 __UBYTE_Z 0 NO_COMPU_METHOD 0 255 /end CHARACTERISTIC
/begin CHARACTERISTIC MliaLADBLED17Req "" VALUE 0x00000000 __UBYTE_Z 0 NO_COMPU_METHOD 0 255 /end CHARACTERISTIC
/begin CHARACTERISTIC MliaLADBLED18Req "" VALUE 0x00000000 __UBYTE_Z 0 NO_COMPU_METHOD 0 255 /end CHARACTERISTIC
/begin CHARACTERISTIC MliaLeftObj1Y1Val "" VALUE 0x00000000 __FLOAT32_IEEE_Z 0 NO_COMPU_METHOD -3.40282346639E+38 3.40282346639E+38 /end CHARACTERISTIC
/begin CHARACTERISTIC MliaLeftObj1Z1Val "" VALUE 0x00000000 __UBYTE_Z 0 NO_COMPU_METHOD 0 255 /end CHARACTERISTIC
/begin CHARACTERISTIC MliaLeftObj1Y2Val "" VALUE 0x00000000 __FLOAT32_IEEE_Z 0 NO_COMPU_METHOD -3.40282346639E+38 3.40282346639E+38 /end CHARACTERISTIC
/begin CHARACTERISTIC MliaLeftObj1Z2Val "" VALUE 0x00000000 __UBYTE_Z 0 NO_COMPU_METHOD 0 255 /end CHARACTERISTIC
/begin CHARACTERISTIC MliaLeftObj2Y1Val "" VALUE 0x00000000 __FLOAT32_IEEE_Z 0 NO_COMPU_METHOD -3.40282346639E+38 3.40282346639E+38 /end CHARACTERISTIC
/begin CHARACTERISTIC MliaLeftObj2Z1Val "" VALUE 0x00000000 __UBYTE_Z 0 NO_COMPU_METHOD 0 255 /end CHARACTERISTIC
/begin CHARACTERISTIC MliaLeftObj2Y2Val "" VALUE 0x00000000 __FLOAT32_IEEE_Z 0 NO_COMPU_METHOD -3.40282346639E+38 3.40282346639E+38 /end CHARACTERISTIC
/begin CHARACTERISTIC MliaLeftObj2Z2Val "" VALUE 0x00000000 __UBYTE_Z 0 NO_COMPU_METHOD 0 255 /end CHARACTERISTIC
/begin CHARACTERISTIC MliaLeftObj3Y1Val "" VALUE 0x00000000 __FLOAT32_IEEE_Z 0 NO_COMPU_METHOD -3.40282346639E+38 3.40282346639E+38 /end CHARACTERISTIC
/begin CHARACTERISTIC MliaLeftObj3Z1Val "" VALUE 0x00000000 __UBYTE_Z 0 NO_COMPU_METHOD 0 255 /end CHARACTERISTIC
/begin CHARACTERISTIC MliaLeftObj3Y2Val "" VALUE 0x00000000 __FLOAT32_IEEE_Z 0 NO_COMPU_METHOD -3.40282346639E+38 3.40282346639E+38 /end CHARACTERISTIC
/begin CHARACTERISTIC MliaLeftObj3Z2Val "" VALUE 0x00000000 __UBYTE_Z 0 NO_COMPU_METHOD 0 255 /end CHARACTERISTIC
/begin CHARACTERISTIC MliaLeftObj4Y1Val "" VALUE 0x00000000 __FLOAT32_IEEE_Z 0 NO_COMPU_METHOD -3.40282346639E+38 3.40282346639E+38 /end CHARACTERISTIC
/begin CHARACTERISTIC MliaLeftObj4Z1Val "" VALUE 0x00000000 __UBYTE_Z 0 NO_COMPU_METHOD 0 255 /end CHARACTERISTIC
/begin CHARACTERISTIC MliaLeftObj4Y2Val "" VALUE 0x00000000 __FLOAT32_IEEE_Z 0 NO_COMPU_METHOD -3.40282346639E+38 3.40282346639E+38 /end CHARACTERISTIC
/begin CHARACTERISTIC MliaLeftObj4Z2Val "" VALUE 0x00000000 __UBYTE_Z 0 NO_COMPU_METHOD 0 255 /end CHARACTERISTIC
/begin CHARACTERISTIC MliaLeftObj5Y1Val "" VALUE 0x00000000 __FLOAT32_IEEE_Z 0 NO_COMPU_METHOD -3.40282346639E+38 3.40282346639E+38 /end CHARACTERISTIC
/begin CHARACTERISTIC MliaLeftObj5Z1Val "" VALUE 0x00000000 __UBYTE_Z 0 NO_COMPU_METHOD 0 255 /end CHARACTERISTIC
/begin CHARACTERISTIC MliaLeftObj5Y2Val "" VALUE 0x00000000 __FLOAT32_IEEE_Z 0 NO_COMPU_METHOD -3.40282346639E+38 3.40282346639E+38 /end CHARACTERISTIC
/begin CHARACTERISTIC MliaLeftObj5Z2Val "" VALUE 0x00000000 __UBYTE_Z 0 NO_COMPU_METHOD 0 255 /end CHARACTERISTIC
/begin CHARACTERISTIC MliaLeftObj6Y1Val "" VALUE 0x00000000 __FLOAT32_IEEE_Z 0 NO_COMPU_METHOD -3.40282346639E+38 3.40282346639E+38 /end CHARACTERISTIC
/begin CHARACTERISTIC MliaLeftObj6Z1Val "" VALUE 0x00000000 __UBYTE_Z 0 NO_COMPU_METHOD 0 255 /end CHARACTERISTIC
/begin CHARACTERISTIC MliaLeftObj6Y2Val "" VALUE 0x00000000 __FLOAT32_IEEE_Z 0 NO_COMPU_METHOD -3.40282346639E+38 3.40282346639E+38 /end CHARACTERISTIC
/begin CHARACTERISTIC MliaLeftObj6Z2Val "" VALUE 0x00000000 __UBYTE_Z 0 NO_COMPU_METHOD 0 255 /end CHARACTERISTIC
/begin CHARACTERISTIC MliaLeftObj7Y1Val "" VALUE 0x00000000 __FLOAT32_IEEE_Z 0 NO_COMPU_METHOD -3.40282346639E+38 3.40282346639E+38 /end CHARACTERISTIC
/begin CHARACTERISTIC MliaLeftObj7Z1Val "" VALUE 0x00000000 __UBYTE_Z 0 NO_COMPU_METHOD 0 255 /end CHARACTERISTIC
/begin CHARACTERISTIC MliaLeftObj7Y2Val "" VALUE 0x00000000 __FLOAT32_IEEE_Z 0 NO_COMPU_METHOD -3.40282346639E+38 3.40282346639E+38 /end CHARACTERISTIC
/begin CHARACTERISTIC MliaLeftObj7Z2Val "" VALUE 0x00000000 __UBYTE_Z 0 NO_COMPU_METHOD 0 255 /end CHARACTERISTIC
/begin CHARACTERISTIC MliaLeftObj8Y1Val "" VALUE 0x00000000 __FLOAT32_IEEE_Z 0 NO_COMPU_METHOD -3.40282346639E+38 3.40282346639E+38 /end CHARACTERISTIC
/begin CHARACTERISTIC MliaLeftObj8Z1Val "" VALUE 0x00000000 __UBYTE_Z 0 NO_COMPU_METHOD 0 255 /end CHARACTERISTIC
/begin CHARACTERISTIC MliaLeftObj8Y2Val "" VALUE 0x00000000 __FLOAT32_IEEE_Z 0 NO_COMPU_METHOD -3.40282346639E+38 3.40282346639E+38 /end CHARACTERISTIC
/begin CHARACTERISTIC MliaLeftObj8Z2Val "" VALUE 0x00000000 __UBYTE_Z 0 NO_COMPU_METHOD 0 255 /end CHARACTERISTIC
/begin CHARACTERISTIC MliaLeftObj9Y1Val "" VALUE 0x00000000 __FLOAT32_IEEE_Z 0 NO_COMPU_METHOD -3.40282346639E+38 3.40282346639E+38 /end CHARACTERISTIC
/begin CHARACTERISTIC MliaLeftObj9Z1Val "" VALUE 0x00000000 __UBYTE_Z 0 NO_COMPU_METHOD 0 255 /end CHARACTERISTIC
/begin CHARACTERISTIC MliaLeftObj9Y2Val "" VALUE 0x00000000 __FLOAT32_IEEE_Z 0 NO_COMPU_METHOD -3.40282346639E+38 3.40282346639E+38 /end CHARACTERISTIC
/begin CHARACTERISTIC MliaLeftObj9Z2Val "" VALUE 0x00000000 __UBYTE_Z 0 NO_COMPU_METHOD 0 255 /end CHARACTERISTIC
/begin CHARACTERISTIC MliaLeftObj10Y1Val "" VALUE 0x00000000 __FLOAT32_IEEE_Z 0 NO_COMPU_METHOD -3.40282346639E+38 3.40282346639E+38 /end CHARACTERISTIC
/begin CHARACTERISTIC MliaLeftObj10Z1Val "" VALUE 0x00000000 __UBYTE_Z 0 NO_COMPU_METHOD 0 255 /end CHARACTERISTIC
/begin CHARACTERISTIC MliaLeftObj10Y2Val "" VALUE 0x00000000 __FLOAT32_IEEE_Z 0 NO_COMPU_METHOD -3.40282346639E+38 3.40282346639E+38 /end CHARACTERISTIC
/begin CHARACTERISTIC MliaLeftObj10Z2Val "" VALUE 0x00000000 __UBYTE_Z 0 NO_COMPU_METHOD 0 255 /end CHARACTERISTIC
/begin CHARACTERISTIC MliaRADBLED1Req "" VALUE 0x00000000 __UBYTE_Z 0 NO_COMPU_METHOD 0 255 /end CHARACTERISTIC
/begin CHARACTERISTIC MliaRADBLED2Req "" VALUE 0x00000000 __UBYTE_Z 0 NO_COMPU_METHOD 0 255 /end CHARACTERISTIC
/begin CHARACTERISTIC MliaRADBLED3Req "" VALUE 0x00000000 __UBYTE_Z 0 NO_COMPU_METHOD 0 255 /end CHARACTERISTIC
/begin CHARACTERISTIC MliaRADBLED4Req "" VALUE 0x00000000 __UBYTE_Z 0 NO_COMPU_METHOD 0 255 /end CHARACTERISTIC
/begin CHARACTERISTIC MliaRADBLED5Req "" VALUE 0x00000000 __UBYTE_Z 0 NO_COMPU_METHOD 0 255 /end CHARACTERISTIC
/begin CHARACTERISTIC MliaRADBLED6Req "" VALUE 0x00000000 __UBYTE_Z 0 NO_COMPU_METHOD 0 255 /end CHARACTERISTIC
/begin CHARACTERISTIC MliaRADBLED7Req "" VALUE 0x00000000 __UBYTE_Z 0 NO_COMPU_METHOD 0 255 /end CHARACTERISTIC
/begin CHARACTERISTIC MliaRADBLED8Req "" VALUE 0x00000000 __UBYTE_Z 0 NO_COMPU_METHOD 0 255 /end CHARACTERISTIC
/begin CHARACTERISTIC MliaRADBLED9Req "" VALUE 0x00000000 __UBYTE_Z 0 NO_COMPU_METHOD 0 255 /end CHARACTERISTIC
/begin CHARACTERISTIC MliaRADBLED10Req "" VALUE 0x00000000 __UBYTE_Z 0 NO_COMPU_METHOD 0 255 /end CHARACTERISTIC
/begin CHARACTERISTIC MliaRADBLED11Req "" VALUE 0x00000000 __UBYTE_Z 0 NO_COMPU_METHOD 0 255 /end CHARACTERISTIC
/begin CHARACTERISTIC MliaRADBLED12Req "" VALUE 0x00000000 __UBYTE_Z 0 NO_COMPU_METHOD 0 255 /end CHARACTERISTIC
/begin CHARACTERISTIC MliaRADBLED13Req "" VALUE 0x00000000 __UBYTE_Z 0 NO_COMPU_METHOD 0 255 /end CHARACTERISTIC
/begin CHARACTERISTIC MliaRADBLED14Req "" VALUE 0x00000000 __UBYTE_Z 0 NO_COMPU_METHOD 0 255 /end CHARACTERISTIC
/begin CHARACTERISTIC MliaRADBLED15Req "" VALUE 0x00000000 __UBYTE_Z 0 NO_COMPU_METHOD 0 255 /end CHARACTERISTIC
/begin CHARACTERISTIC MliaRADBLED16Req "" VALUE 0x00000000 __UBYTE_Z 0 NO_COMPU_METHOD 0 255 /end CHARACTERISTIC
/begin CHARACTERISTIC MliaRADBLED17Req "" VALUE 0x00000000 __UBYTE_Z 0 NO_COMPU_METHOD 0 255 /end CHARACTERISTIC
/begin CHARACTERISTIC MliaRADBLED18Req "" VALUE 0x00000000 __UBYTE_Z 0 NO_COMPU_METHOD 0 255 /end CHARACTERISTIC
/begin CHARACTERISTIC MliaRightObj1Y1Val "" VALUE 0x00000000 __FLOAT32_IEEE_Z 0 NO_COMPU_METHOD -3.40282346639E+38 3.40282346639E+38 /end CHARACTERISTIC
/begin CHARACTERISTIC MliaRightObj1Z1Val "" VALUE 0x00000000 __UBYTE_Z 0 NO_COMPU_METHOD 0 255 /end CHARACTERISTIC
/begin CHARACTERISTIC MliaRightObj1Y2Val "" VALUE 0x00000000 __FLOAT32_IEEE_Z 0 NO_COMPU_METHOD -3.40282346639E+38 3.40282346639E+38 /end CHARACTERISTIC
/begin CHARACTERISTIC MliaRightObj1Z2Val "" VALUE 0x00000000 __UBYTE_Z 0 NO_COMPU_METHOD 0 255 /end CHARACTERISTIC
/begin CHARACTERISTIC MliaRightObj2Y1Val "" VALUE 0x00000000 __FLOAT32_IEEE_Z 0 NO_COMPU_METHOD -3.40282346639E+38 3.40282346639E+38 /end CHARACTERISTIC
/begin CHARACTERISTIC MliaRightObj2Z1Val "" VALUE 0x00000000 __UBYTE_Z 0 NO_COMPU_METHOD 0 255 /end CHARACTERISTIC
/begin CHARACTERISTIC MliaRightObj2Y2Val "" VALUE 0x00000000 __FLOAT32_IEEE_Z 0 NO_COMPU_METHOD -3.40282346639E+38 3.40282346639E+38 /end CHARACTERISTIC
/begin CHARACTERISTIC MliaRightObj2Z2Val "" VALUE 0x00000000 __UBYTE_Z 0 NO_COMPU_METHOD 0 255 /end CHARACTERISTIC
/begin CHARACTERISTIC MliaRightObj3Y1Val "" VALUE 0x00000000 __FLOAT32_IEEE_Z 0 NO_COMPU_METHOD -3.40282346639E+38 3.40282346639E+38 /end CHARACTERISTIC
/begin CHARACTERISTIC MliaRightObj3Z1Val "" VALUE 0x00000000 __UBYTE_Z 0 NO_COMPU_METHOD 0 255 /end CHARACTERISTIC
/begin CHARACTERISTIC MliaRightObj3Y2Val "" VALUE 0x00000000 __FLOAT32_IEEE_Z 0 NO_COMPU_METHOD -3.40282346639E+38 3.40282346639E+38 /end CHARACTERISTIC
/begin CHARACTERISTIC MliaRightObj3Z2Val "" VALUE 0x00000000 __UBYTE_Z 0 NO_COMPU_METHOD 0 255 /end CHARACTERISTIC
/begin CHARACTERISTIC MliaRightObj4Y1Val "" VALUE 0x00000000 __FLOAT32_IEEE_Z 0 NO_COMPU_METHOD -3.40282346639E+38 3.40282346639E+38 /end CHARACTERISTIC
/begin CHARACTERISTIC MliaRightObj4Z1Val "" VALUE 0x00000000 __UBYTE_Z 0 NO_COMPU_METHOD 0 255 /end CHARACTERISTIC
/begin CHARACTERISTIC MliaRightObj4Y2Val "" VALUE 0x00000000 __FLOAT32_IEEE_Z 0 NO_COMPU_METHOD -3.40282346639E+38 3.40282346639E+38 /end CHARACTERISTIC
/begin CHARACTERISTIC MliaRightObj4Z2Val "" VALUE 0x00000000 __UBYTE_Z 0 NO_COMPU_METHOD 0 255 /end CHARACTERISTIC
/begin CHARACTERISTIC MliaRightObj5Y1Val "" VALUE 0x00000000 __FLOAT32_IEEE_Z 0 NO_COMPU_METHOD -3.40282346639E+38 3.40282346639E+38 /end CHARACTERISTIC
/begin CHARACTERISTIC MliaRightObj5Z1Val "" VALUE 0x00000000 __UBYTE_Z 0 NO_COMPU_METHOD 0 255 /end CHARACTERISTIC
/begin CHARACTERISTIC MliaRightObj5Y2Val "" VALUE 0x00000000 __FLOAT32_IEEE_Z 0 NO_COMPU_METHOD -3.40282346639E+38 3.40282346639E+38 /end CHARACTERISTIC
/begin CHARACTERISTIC MliaRightObj5Z2Val "" VALUE 0x00000000 __UBYTE_Z 0 NO_COMPU_METHOD 0 255 /end CHARACTERISTIC
/begin CHARACTERISTIC MliaRightObj6Y1Val "" VALUE 0x00000000 __FLOAT32_IEEE_Z 0 NO_COMPU_METHOD -3.40282346639E+38 3.40282346639E+38 /end CHARACTERISTIC
/begin CHARACTERISTIC MliaRightObj6Z1Val "" VALUE 0x00000000 __UBYTE_Z 0 NO_COMPU_METHOD 0 255 /end CHARACTERISTIC
/begin CHARACTERISTIC MliaRightObj6Y2Val "" VALUE 0x00000000 __FLOAT32_IEEE_Z 0 NO_COMPU_METHOD -3.40282346639E+38 3.40282346639E+38 /end CHARACTERISTIC
/begin CHARACTERISTIC MliaRightObj6Z2Val "" VALUE 0x00000000 __UBYTE_Z 0 NO_COMPU_METHOD 0 255 /end CHARACTERISTIC
/begin CHARACTERISTIC MliaRightObj7Y1Val "" VALUE 0x00000000 __FLOAT32_IEEE_Z 0 NO_COMPU_METHOD -3.40282346639E+38 3.40282346639E+38 /end CHARACTERISTIC
/begin CHARACTERISTIC MliaRightObj7Z1Val "" VALUE 0x00000000 __UBYTE_Z 0 NO_COMPU_METHOD 0 255 /end CHARACTERISTIC
/begin CHARACTERISTIC MliaRightObj7Y2Val "" VALUE 0x00000000 __FLOAT32_IEEE_Z 0 NO_COMPU_METHOD -3.40282346639E+38 3.40282346639E+38 /end CHARACTERISTIC
/begin CHARACTERISTIC MliaRightObj7Z2Val "" VALUE 0x00000000 __UBYTE_Z 0 NO_COMPU_METHOD 0 255 /end CHARACTERISTIC
/begin CHARACTERISTIC MliaRightObj8Y1Val "" VALUE 0x00000000 __FLOAT32_IEEE_Z 0 NO_COMPU_METHOD -3.40282346639E+38 3.40282346639E+38 /end CHARACTERISTIC
/begin CHARACTERISTIC MliaRightObj8Z1Val "" VALUE 0x00000000 __UBYTE_Z 0 NO_COMPU_METHOD 0 255 /end CHARACTERISTIC
/begin CHARACTERISTIC MliaRightObj8Y2Val "" VALUE 0x00000000 __FLOAT32_IEEE_Z 0 NO_COMPU_METHOD -3.40282346639E+38 3.40282346639E+38 /end CHARACTERISTIC
/begin CHARACTERISTIC MliaRightObj8Z2Val "" VALUE 0x00000000 __UBYTE_Z 0 NO_COMPU_METHOD 0 255 /end CHARACTERISTIC
/begin CHARACTERISTIC MliaRightObj9Y1Val "" VALUE 0x00000000 __FLOAT32_IEEE_Z 0 NO_COMPU_METHOD -3.40282346639E+38 3.40282346639E+38 /end CHARACTERISTIC
/begin CHARACTERISTIC MliaRightObj9Z1Val "" VALUE 0x00000000 __UBYTE_Z 0 NO_COMPU_METHOD 0 255 /end CHARACTERISTIC
/begin CHARACTERISTIC MliaRightObj9Y2Val "" VALUE 0x00000000 __FLOAT32_IEEE_Z 0 NO_COMPU_METHOD -3.40282346639E+38 3.40282346639E+38 /end CHARACTERISTIC
/begin CHARACTERISTIC MliaRightObj9Z2Val "" VALUE 0x00000000 __UBYTE_Z 0 NO_COMPU_METHOD 0 255 /end CHARACTERISTIC
/begin CHARACTERISTIC MliaRightObj10Y1Val "" VALUE 0x00000000 __FLOAT32_IEEE_Z 0 NO_COMPU_METHOD -3.40282346639E+38 3.40282346639E+38 /end CHARACTERISTIC
/begin CHARACTERISTIC MliaRightObj10Z1Val "" VALUE 0x00000000 __UBYTE_Z 0 NO_COMPU_METHOD 0 255 /end CHARACTERISTIC
/begin CHARACTERISTIC MliaRightObj10Y2Val "" VALUE 0x00000000 __FLOAT32_IEEE_Z 0 NO_COMPU_METHOD -3.40282346639E+38 3.40282346639E+38 /end CHARACTERISTIC
/begin CHARACTERISTIC MliaRightObj10Z2Val "" VALUE 0x00000000 __UBYTE_Z 0 NO_COMPU_METHOD 0 255 /end CHARACTERISTIC
/begin CHARACTERISTIC MliaRightProjSlot1Req "" VALUE 0x00000000 __UBYTE_Z 0 NO_COMPU_METHOD 0 255 /end CHARACTERISTIC
/begin CHARACTERISTIC MliaRightProjBrightSlot1Req "" VALUE 0x00000000 __UBYTE_Z 0 NO_COMPU_METHOD 0 255 /end CHARACTERISTIC
/begin CHARACTERISTIC MliaRightProjSlot2Req "" VALUE 0x00000000 __UBYTE_Z 0 NO_COMPU_METHOD 0 255 /end CHARACTERISTIC
/begin CHARACTERISTIC MliaRightProjBrightSlot2Req "" VALUE 0x00000000 __UBYTE_Z 0 NO_COMPU_METHOD 0 255 /end CHARACTERISTIC
/begin CHARACTERISTIC MliaRightProjSlot3Req "" VALUE 0x00000000 __UBYTE_Z 0 NO_COMPU_METHOD 0 255 /end CHARACTERISTIC
/begin CHARACTERISTIC MliaRightProjBrightSlot3Req "" VALUE 0x00000000 __UBYTE_Z 0 NO_COMPU_METHOD 0 255 /end CHARACTERISTIC
/begin CHARACTERISTIC MliaRightProjSlot4Req "" VALUE 0x00000000 __UBYTE_Z 0 NO_COMPU_METHOD 0 255 /end CHARACTERISTIC
/begin CHARACTERISTIC MliaRightProjBrightSlot4Req "" VALUE 0x00000000 __UBYTE_Z 0 NO_COMPU_METHOD 0 255 /end CHARACTERISTIC
/begin CHARACTERISTIC MliaLeftProjSlot1Req "" VALUE 0x00000000 __UBYTE_Z 0 NO_COMPU_METHOD 0 255 /end CHARACTERISTIC
/begin CHARACTERISTIC MliaLeftProjBrightSlot1Req "" VALUE 0x00000000 __UBYTE_Z 0 NO_COMPU_METHOD 0 255 /end CHARACTERISTIC
/begin CHARACTERISTIC MliaLeftProjSlot2Req "" VALUE 0x00000000 __UBYTE_Z 0 NO_COMPU_METHOD 0 255 /end CHARACTERISTIC
/begin CHARACTERISTIC MliaLeftProjBrightSlot2Req "" VALUE 0x00000000 __UBYTE_Z 0 NO_COMPU_METHOD 0 255 /end CHARACTERISTIC
/begin CHARACTERISTIC MliaLeftProjSlot3Req "" VALUE 0x00000000 __UBYTE_Z 0 NO_COMPU_METHOD 0 255 /end CHARACTERISTIC
/begin CHARACTERISTIC MliaLeftProjBrightSlot3Req "" VALUE 0x00000000 __UBYTE_Z 0 NO_COMPU_METHOD 0 255 /end CHARACTERISTIC
/begin CHARACTERISTIC MliaLeftProjSlot4Req "" VALUE 0x00000000 __UBYTE_Z 0 NO_COMPU_METHOD 0 255 /end CHARACTERISTIC
/begin CHARACTERISTIC MliaLeftProjBrightSlot4Req "" VALUE 0x00000000 __UBYTE_Z 0 NO_COMPU_METHOD 0 255 /end CHARACTERISTIC
/begin CHARACTERISTIC DtLogAccTargetDetect "" VALUE 0x00000000 __UBYTE_Z 0 NO_COMPU_METHOD 0 255 /end CHARACTERISTIC
/begin CHARACTERISTIC DtLogAccDistSetm "" VALUE 0x00000000 __FLOAT32_IEEE_Z 0 NO_COMPU_METHOD -3.40282346639E+38 3.40282346639E+38 /end CHARACTERISTIC
/begin CHARACTERISTIC DtLogAccDistRealm "" VALUE 0x00000000 __FLOAT32_IEEE_Z 0 NO_COMPU_METHOD -3.40282346639E+38 3.40282346639E+38 /end CHARACTERISTIC
/begin CHARACTERISTIC DtLogAccLeadSpeedReal_kmh "" VALUE 0x00000000 __FLOAT32_IEEE_Z 0 NO_COMPU_METHOD -3.40282346639E+38 3.40282346639E+38 /end CHARACTERISTIC
/begin CHARACTERISTIC DtLogAccLeadAccelReal "" VALUE 0x00000000 __FLOAT32_IEEE_Z 0 NO_COMPU_METHOD -3.40282346639E+38 3.40282346639E+38 /end CHARACTERISTIC
/begin CHARACTERISTIC DtLogAccLogicTrans "" VALUE 0x00000000 __UBYTE_Z 0 NO_COMPU_METHOD 0 255 /end CHARACTERISTIC
/begin CHARACTERISTIC DtLogAccSolverTrans "" VALUE 0x00000000 __UBYTE_Z 0 NO_COMPU_METHOD 0 255 /end CHARACTERISTIC
/begin CHARACTERISTIC DtLogAccVlcTrans "" VALUE 0x00000000 __UBYTE_Z 0 NO_COMPU_METHOD 0 255 /end CHARACTERISTIC
/begin CHARACTERISTIC DtLogAccErrFlag "" VALUE 0x00000000 __UBYTE_Z 0 NO_COMPU_METHOD 0 255 /end CHARACTERISTIC
/begin CHARACTERISTIC DtLogAccErrCode "" VALUE 0x00000000 __UBYTE_Z 0 NO_COMPU_METHOD 0 255 /end CHARACTERISTIC
/begin CHARACTERISTIC DtLogAebTargetDetect "" VALUE 0x00000000 __UBYTE_Z 0 NO_COMPU_METHOD 0 255 /end CHARACTERISTIC
/begin CHARACTERISTIC DtLogAebDistRealm "" VALUE 0x00000000 __FLOAT32_IEEE_Z 0 NO_COMPU_METHOD -3.40282346639E+38 3.40282346639E+38 /end CHARACTERISTIC
/begin CHARACTERISTIC DtLogAebLeadSpeedRealKmh "" VALUE 0x00000000 __FLOAT32_IEEE_Z 0 NO_COMPU_METHOD -3.40282346639E+38 3.40282346639E+38 /end CHARACTERISTIC
/begin CHARACTERISTIC DtLogAebLeadAccelReal "" VALUE 0x00000000 __FLOAT32_IEEE_Z 0 NO_COMPU_METHOD -3.40282346639E+38 3.40282346639E+38 /end CHARACTERISTIC
/begin CHARACTERISTIC DtLogAebLogicTrans "" VALUE 0x00000000 __UBYTE_Z 0 NO_COMPU_METHOD 0 255 /end CHARACTERISTIC
/begin CHARACTERISTIC DtLogAebSolverTrans "" VALUE 0x00000000 __UBYTE_Z 0 NO_COMPU_METHOD 0 255 /end CHARACTERISTIC
/begin CHARACTERISTIC DtLogAebErrFlag "" VALUE 0x00000000 __UBYTE_Z 0 NO_COMPU_METHOD 0 255 /end CHARACTERISTIC
/begin CHARACTERISTIC DtLogAebErrCode "" VALUE 0x00000000 __UBYTE_Z 0 NO_COMPU_METHOD 0 255 /end CHARACTERISTIC
/begin CHARACTERISTIC DtLogFiuLogicTrans "" VALUE 0x00000000 __UBYTE_Z 0 NO_COMPU_METHOD 0 255 /end CHARACTERISTIC
/begin CHARACTERISTIC DtLogFiuSolverTrans "" VALUE 0x00000000 __UBYTE_Z 0 NO_COMPU_METHOD 0 255 /end CHARACTERISTIC
/begin CHARACTERISTIC DtLogLkaTargetAngle "" VALUE 0x00000000 __FLOAT32_IEEE_Z 0 NO_COMPU_METHOD -3.40282346639E+38 3.40282346639E+38 /end CHARACTERISTIC
/begin CHARACTERISTIC DtLogLkaLogicTrans "" VALUE 0x00000000 __UBYTE_Z 0 NO_COMPU_METHOD 0 255 /end CHARACTERISTIC
/begin CHARACTERISTIC DtLogLkaSolverTrans "" VALUE 0x00000000 __UBYTE_Z 0 NO_COMPU_METHOD 0 255 /end CHARACTERISTIC
/begin CHARACTERISTIC DtLogLkaErrFlag "" VALUE 0x00000000 __UBYTE_Z 0 NO_COMPU_METHOD 0 255 /end CHARACTERISTIC
/begin CHARACTERISTIC DtLogLkaErrCode "" VALUE 0x00000000 __UBYTE_Z 0 NO_COMPU_METHOD 0 255 /end CHARACTERISTIC
/begin CHARACTERISTIC DtLogLdwLogicTrans "" VALUE 0x00000000 __UBYTE_Z 0 NO_COMPU_METHOD 0 255 /end CHARACTERISTIC
/begin CHARACTERISTIC DtLogLdwSolverTransLeft "" VALUE 0x00000000 __UBYTE_Z 0 NO_COMPU_METHOD 0 255 /end CHARACTERISTIC
/begin CHARACTERISTIC DtLogLdwWarnBlockTransLeft "" VALUE 0x00000000 __UBYTE_Z 0 NO_COMPU_METHOD 0 255 /end CHARACTERISTIC
/begin CHARACTERISTIC DtLogLdwTTLCTransLeft "" VALUE 0x00000000 __UBYTE_Z 0 NO_COMPU_METHOD 0 255 /end CHARACTERISTIC
/begin CHARACTERISTIC DtLogLdwTurnRadiusLeft "" VALUE 0x00000000 __FLOAT32_IEEE_Z 0 NO_COMPU_METHOD -3.40282346639E+38 3.40282346639E+38 /end CHARACTERISTIC
/begin CHARACTERISTIC DtLogLdwYawRate_dtLeft "" VALUE 0x00000000 __FLOAT32_IEEE_Z 0 NO_COMPU_METHOD -3.40282346639E+38 3.40282346639E+38 /end CHARACTERISTIC
/begin CHARACTERISTIC DtLogLdwVdepartureLeft "" VALUE 0x00000000 __FLOAT32_IEEE_Z 0 NO_COMPU_METHOD -3.40282346639E+38 3.40282346639E+38 /end CHARACTERISTIC
/begin CHARACTERISTIC DtLogLdwTTLCLeft "" VALUE 0x00000000 __FLOAT32_IEEE_Z 0 NO_COMPU_METHOD -3.40282346639E+38 3.40282346639E+38 /end CHARACTERISTIC
/begin CHARACTERISTIC DtLogLdwWarnDistLeft "" VALUE 0x00000000 __UBYTE_Z 0 NO_COMPU_METHOD 0 255 /end CHARACTERISTIC
/begin CHARACTERISTIC DtLogLdwWarnTimeLeft "" VALUE 0x00000000 __UBYTE_Z 0 NO_COMPU_METHOD 0 255 /end CHARACTERISTIC
/begin CHARACTERISTIC DtLogLdwWarnPredictLeft "" VALUE 0x00000000 __UBYTE_Z 0 NO_COMPU_METHOD 0 255 /end CHARACTERISTIC
/begin CHARACTERISTIC DtLogLdwSolverTransRight "" VALUE 0x00000000 __UBYTE_Z 0 NO_COMPU_METHOD 0 255 /end CHARACTERISTIC
/begin CHARACTERISTIC DtLogLdwWarnDistRight "" VALUE 0x00000000 __UBYTE_Z 0 NO_COMPU_METHOD 0 255 /end CHARACTERISTIC
/begin CHARACTERISTIC DtLogLdwWarnTimeRight "" VALUE 0x00000000 __UBYTE_Z 0 NO_COMPU_METHOD 0 255 /end CHARACTERISTIC
/begin CHARACTERISTIC DtLogLdwWarnPredictRight "" VALUE 0x00000000 __UBYTE_Z 0 NO_COMPU_METHOD 0 255 /end CHARACTERISTIC
/begin CHARACTERISTIC DtLogLccLogicTrans "" VALUE 0x00000000 __UBYTE_Z 0 NO_COMPU_METHOD 0 255 /end CHARACTERISTIC
/begin CHARACTERISTIC DtLogLccWarnReqTransLeft "" VALUE 0x00000000 __UBYTE_Z 0 NO_COMPU_METHOD 0 255 /end CHARACTERISTIC
/begin CHARACTERISTIC DtLogLccWarnReqTransRight "" VALUE 0x00000000 __UBYTE_Z 0 NO_COMPU_METHOD 0 255 /end CHARACTERISTIC
/begin CHARACTERISTIC DtLogLccIsObjInLeftCvwZone "" VALUE 0x00000000 __UBYTE_Z 0 NO_COMPU_METHOD 0 255 /end CHARACTERISTIC
/begin CHARACTERISTIC DtLogLccIsObjInRightCvwZone "" VALUE 0x00000000 __UBYTE_Z 0 NO_COMPU_METHOD 0 255 /end CHARACTERISTIC
/begin CHARACTERISTIC DtLogLccEnaSts "" VALUE 0x00000000 __UBYTE_Z 0 NO_COMPU_METHOD 0 255 /end CHARACTERISTIC
/begin CHARACTERISTIC DtLogLccSetSound "" VALUE 0x00000000 __UBYTE_Z 0 NO_COMPU_METHOD 0 255 /end CHARACTERISTIC
/begin CHARACTERISTIC DtLogLccSetVibration "" VALUE 0x00000000 __UBYTE_Z 0 NO_COMPU_METHOD 0 255 /end CHARACTERISTIC
/begin CHARACTERISTIC DtLogLccSetMode "" VALUE 0x00000000 __UBYTE_Z 0 NO_COMPU_METHOD 0 255 /end CHARACTERISTIC
/begin CHARACTERISTIC DtLogLccErrFlag "" VALUE 0x00000000 __UBYTE_Z 0 NO_COMPU_METHOD 0 255 /end CHARACTERISTIC
/begin CHARACTERISTIC DtLogLccErrCode "" VALUE 0x00000000 __UBYTE_Z 0 NO_COMPU_METHOD 0 255 /end CHARACTERISTIC
/begin CHARACTERISTIC DtLogAlccEnaSts "" VALUE 0x00000000 __UBYTE_Z 0 NO_COMPU_METHOD 0 255 /end CHARACTERISTIC
/begin CHARACTERISTIC DtLogDowLogicTrans "" VALUE 0x00000000 __UBYTE_Z 0 NO_COMPU_METHOD 0 255 /end CHARACTERISTIC
/begin CHARACTERISTIC DtLogDowWarnReqTransLeft "" VALUE 0x00000000 __UBYTE_Z 0 NO_COMPU_METHOD 0 255 /end CHARACTERISTIC
/begin CHARACTERISTIC DtLogDowWarnReqTransRight "" VALUE 0x00000000 __UBYTE_Z 0 NO_COMPU_METHOD 0 255 /end CHARACTERISTIC
/begin CHARACTERISTIC DtLogDowIsObjInLeftZone "" VALUE 0x00000000 __UBYTE_Z 0 NO_COMPU_METHOD 0 255 /end CHARACTERISTIC
/begin CHARACTERISTIC DtLogDowIsObjInRightZone "" VALUE 0x00000000 __UBYTE_Z 0 NO_COMPU_METHOD 0 255 /end CHARACTERISTIC
/begin CHARACTERISTIC DtLogRcwDistToObjRear "" VALUE 0x00000000 __FLOAT32_IEEE_Z 0 NO_COMPU_METHOD -3.40282346639E+38 3.40282346639E+38 /end CHARACTERISTIC
/begin CHARACTERISTIC DtLogRcwLogicTrans "" VALUE 0x00000000 __UBYTE_Z 0 NO_COMPU_METHOD 0 255 /end CHARACTERISTIC
/begin CHARACTERISTIC DtLogRcwLatObj "" VALUE 0x00000000 __FLOAT32_IEEE_Z 0 NO_COMPU_METHOD -3.40282346639E+38 3.40282346639E+38 /end CHARACTERISTIC
/begin CHARACTERISTIC DtLogRcwTimeCrash "" VALUE 0x00000000 __FLOAT32_IEEE_Z 0 NO_COMPU_METHOD -3.40282346639E+38 3.40282346639E+38 /end CHARACTERISTIC
/begin CHARACTERISTIC DtLogRcwVelRel "" VALUE 0x00000000 __UBYTE_Z 0 NO_COMPU_METHOD 0 255 /end CHARACTERISTIC
/begin CHARACTERISTIC DtLogRcwDimanWh "" VALUE 0x00000000 __FLOAT32_IEEE_Z 0 NO_COMPU_METHOD -3.40282346639E+38 3.40282346639E+38 /end CHARACTERISTIC
/begin CHARACTERISTIC DtLogRdaDistToObjRear "" VALUE 0x00000000 __FLOAT32_IEEE_Z 0 NO_COMPU_METHOD -3.40282346639E+38 3.40282346639E+38 /end CHARACTERISTIC
/begin CHARACTERISTIC DtLogRdaLogicTrans "" VALUE 0x00000000 __UBYTE_Z 0 NO_COMPU_METHOD 0 255 /end CHARACTERISTIC
/begin CHARACTERISTIC DtLogRdaSolverTrans "" VALUE 0x00000000 __UBYTE_Z 0 NO_COMPU_METHOD 0 255 /end CHARACTERISTIC
/begin CHARACTERISTIC DtLogRdaErrFlag "" VALUE 0x00000000 __UBYTE_Z 0 NO_COMPU_METHOD 0 255 /end CHARACTERISTIC
/begin CHARACTERISTIC DtLogRdaErrCode "" VALUE 0x00000000 __UBYTE_Z 0 NO_COMPU_METHOD 0 255 /end CHARACTERISTIC
/begin CHARACTERISTIC DtLogMliaDistToObj1 "" VALUE 0x00000000 __UBYTE_Z 0 NO_COMPU_METHOD 0 255 /end CHARACTERISTIC
/begin CHARACTERISTIC DtLogMliaDistToObj2 "" VALUE 0x00000000 __UBYTE_Z 0 NO_COMPU_METHOD 0 255 /end CHARACTERISTIC
/begin CHARACTERISTIC DtLogMliaDistToObj3 "" VALUE 0x00000000 __UBYTE_Z 0 NO_COMPU_METHOD 0 255 /end CHARACTERISTIC
/begin CHARACTERISTIC DtLogMliaDistToObj4 "" VALUE 0x00000000 __UBYTE_Z 0 NO_COMPU_METHOD 0 255 /end CHARACTERISTIC
/begin CHARACTERISTIC DtLogMliaLogicTrans "" VALUE 0x00000000 __UBYTE_Z 0 NO_COMPU_METHOD 0 255 /end CHARACTERISTIC
/begin CHARACTERISTIC DtLogMliaSolverTrans "" VALUE 0x00000000 __UBYTE_Z 0 NO_COMPU_METHOD 0 255 /end CHARACTERISTIC
/begin CHARACTERISTIC DtLogMliaErrFlag "" VALUE 0x00000000 __UBYTE_Z 0 NO_COMPU_METHOD 0 255 /end CHARACTERISTIC
/begin CHARACTERISTIC DtLogMliaErrCode "" VALUE 0x00000000 __UBYTE_Z 0 NO_COMPU_METHOD 0 255 /end CHARACTERISTIC
/begin CHARACTERISTIC DtLogVisualLogicTrans "" VALUE 0x00000000 __UBYTE_Z 0 NO_COMPU_METHOD 0 255 /end CHARACTERISTIC
/begin CHARACTERISTIC DtLogVisualSolverTrans "" VALUE 0x00000000 __UBYTE_Z 0 NO_COMPU_METHOD 0 255 /end CHARACTERISTIC
/begin CHARACTERISTIC DtLogVisualErrFlag "" VALUE 0x00000000 __UBYTE_Z 0 NO_COMPU_METHOD 0 255 /end CHARACTERISTIC
/begin CHARACTERISTIC DtLogVisualErrCode "" VALUE 0x00000000 __UBYTE_Z 0 NO_COMPU_METHOD 0 255 /end CHARACTERISTIC
/begin CHARACTERISTIC VisAccSetDist "" VALUE 0x00000000 __UBYTE_Z 0 NO_COMPU_METHOD 0 255 /end CHARACTERISTIC
/begin CHARACTERISTIC VisAccTargetObj "" VALUE 0x00000000 __UBYTE_Z 0 NO_COMPU_METHOD 0 255 /end CHARACTERISTIC
/begin CHARACTERISTIC VisAebTargetObj "" VALUE 0x00000000 __UBYTE_Z 0 NO_COMPU_METHOD 0 255 /end CHARACTERISTIC
/begin CHARACTERISTIC VisEgoZone "" VALUE 0x00000000 __UBYTE_Z 0 NO_COMPU_METHOD 0 255 /end CHARACTERISTIC
/begin CHARACTERISTIC VisFcwTargetObj "" VALUE 0x00000000 __UBYTE_Z 0 NO_COMPU_METHOD 0 255 /end CHARACTERISTIC
/begin CHARACTERISTIC VisLaneLLType "" VALUE 0x00000000 __UBYTE_Z 0 NO_COMPU_METHOD 0 255 /end CHARACTERISTIC
/begin CHARACTERISTIC VisLaneLType "" VALUE 0x00000000 __UBYTE_Z 0 NO_COMPU_METHOD 0 255 /end CHARACTERISTIC
/begin CHARACTERISTIC VisLaneRRType "" VALUE 0x00000000 __UBYTE_Z 0 NO_COMPU_METHOD 0 255 /end CHARACTERISTIC
/begin CHARACTERISTIC VisLaneRType "" VALUE 0x00000000 __UBYTE_Z 0 NO_COMPU_METHOD 0 255 /end CHARACTERISTIC
/begin CHARACTERISTIC VisLccLeftLane "" VALUE 0x00000000 __UBYTE_Z 0 NO_COMPU_METHOD 0 255 /end CHARACTERISTIC
/begin CHARACTERISTIC VisLccRightLane "" VALUE 0x00000000 __UBYTE_Z 0 NO_COMPU_METHOD 0 255 /end CHARACTERISTIC
/begin CHARACTERISTIC VisLdpLeftLine "" VALUE 0x00000000 __UBYTE_Z 0 NO_COMPU_METHOD 0 255 /end CHARACTERISTIC
/begin CHARACTERISTIC VisLdpRightLine "" VALUE 0x00000000 __UBYTE_Z 0 NO_COMPU_METHOD 0 255 /end CHARACTERISTIC
/begin CHARACTERISTIC VisLdwLeftLine "" VALUE 0x00000000 __UBYTE_Z 0 NO_COMPU_METHOD 0 255 /end CHARACTERISTIC
/begin CHARACTERISTIC VisLdwRightLine "" VALUE 0x00000000 __UBYTE_Z 0 NO_COMPU_METHOD 0 255 /end CHARACTERISTIC
/begin CHARACTERISTIC VisLkaAct "" VALUE 0x00000000 __UBYTE_Z 0 NO_COMPU_METHOD 0 255 /end CHARACTERISTIC
/begin CHARACTERISTIC VisObj1_Type "" VALUE 0x00000000 __UBYTE_Z 0 NO_COMPU_METHOD 0 255 /end CHARACTERISTIC
/begin CHARACTERISTIC VisObj1DistLong "" VALUE 0x00000000 __FLOAT32_IEEE_Z 0 NO_COMPU_METHOD -3.40282346639E+38 3.40282346639E+38 /end CHARACTERISTIC
/begin CHARACTERISTIC VisObj1Orient "" VALUE 0x00000000 __UBYTE_Z 0 NO_COMPU_METHOD 0 255 /end CHARACTERISTIC
/begin CHARACTERISTIC VisObj1Zone "" VALUE 0x00000000 __UBYTE_Z 0 NO_COMPU_METHOD 0 255 /end CHARACTERISTIC
/begin CHARACTERISTIC VisObj2_Type "" VALUE 0x00000000 __UBYTE_Z 0 NO_COMPU_METHOD 0 255 /end CHARACTERISTIC
/begin CHARACTERISTIC VisObj2DistLong "" VALUE 0x00000000 __FLOAT32_IEEE_Z 0 NO_COMPU_METHOD -3.40282346639E+38 3.40282346639E+38 /end CHARACTERISTIC
/begin CHARACTERISTIC VisObj2Orient "" VALUE 0x00000000 __UBYTE_Z 0 NO_COMPU_METHOD 0 255 /end CHARACTERISTIC
/begin CHARACTERISTIC VisObj2Zone "" VALUE 0x00000000 __UBYTE_Z 0 NO_COMPU_METHOD 0 255 /end CHARACTERISTIC
/begin CHARACTERISTIC VisObj3_Type "" VALUE 0x00000000 __UBYTE_Z 0 NO_COMPU_METHOD 0 255 /end CHARACTERISTIC
/begin CHARACTERISTIC VisObj3DistLong "" VALUE 0x00000000 __FLOAT32_IEEE_Z 0 NO_COMPU_METHOD -3.40282346639E+38 3.40282346639E+38 /end CHARACTERISTIC
/begin CHARACTERISTIC VisObj3Orient "" VALUE 0x00000000 __UBYTE_Z 0 NO_COMPU_METHOD 0 255 /end CHARACTERISTIC
/begin CHARACTERISTIC VisObj3Zone "" VALUE 0x00000000 __UBYTE_Z 0 NO_COMPU_METHOD 0 255 /end CHARACTERISTIC
/begin CHARACTERISTIC VisObj4_Type "" VALUE 0x00000000 __UBYTE_Z 0 NO_COMPU_METHOD 0 255 /end CHARACTERISTIC
/begin CHARACTERISTIC VisObj4DistLong "" VALUE 0x00000000 __FLOAT32_IEEE_Z 0 NO_COMPU_METHOD -3.40282346639E+38 3.40282346639E+38 /end CHARACTERISTIC
/begin CHARACTERISTIC VisObj4Orient "" VALUE 0x00000000 __UBYTE_Z 0 NO_COMPU_METHOD 0 255 /end CHARACTERISTIC
/begin CHARACTERISTIC VisObj4Zone "" VALUE 0x00000000 __UBYTE_Z 0 NO_COMPU_METHOD 0 255 /end CHARACTERISTIC
/begin CHARACTERISTIC VisObj5_Type "" VALUE 0x00000000 __UBYTE_Z 0 NO_COMPU_METHOD 0 255 /end CHARACTERISTIC
/begin CHARACTERISTIC VisObj5DistLong "" VALUE 0x00000000 __FLOAT32_IEEE_Z 0 NO_COMPU_METHOD -3.40282346639E+38 3.40282346639E+38 /end CHARACTERISTIC
/begin CHARACTERISTIC VisObj5Orient "" VALUE 0x00000000 __UBYTE_Z 0 NO_COMPU_METHOD 0 255 /end CHARACTERISTIC
/begin CHARACTERISTIC VisObj5Zone "" VALUE 0x00000000 __UBYTE_Z 0 NO_COMPU_METHOD 0 255 /end CHARACTERISTIC
/begin CHARACTERISTIC VisObj6_Type "" VALUE 0x00000000 __UBYTE_Z 0 NO_COMPU_METHOD 0 255 /end CHARACTERISTIC
/begin CHARACTERISTIC VisObj6DistLong "" VALUE 0x00000000 __FLOAT32_IEEE_Z 0 NO_COMPU_METHOD -3.40282346639E+38 3.40282346639E+38 /end CHARACTERISTIC
/begin CHARACTERISTIC VisObj6Orient "" VALUE 0x00000000 __UBYTE_Z 0 NO_COMPU_METHOD 0 255 /end CHARACTERISTIC
/begin CHARACTERISTIC VisObj6Zone "" VALUE 0x00000000 __UBYTE_Z 0 NO_COMPU_METHOD 0 255 /end CHARACTERISTIC
/begin CHARACTERISTIC VisObj7_Type "" VALUE 0x00000000 __UBYTE_Z 0 NO_COMPU_METHOD 0 255 /end CHARACTERISTIC
/begin CHARACTERISTIC VisObj7DistLong "" VALUE 0x00000000 __FLOAT32_IEEE_Z 0 NO_COMPU_METHOD -3.40282346639E+38 3.40282346639E+38 /end CHARACTERISTIC
/begin CHARACTERISTIC VisObj7Orient "" VALUE 0x00000000 __UBYTE_Z 0 NO_COMPU_METHOD 0 255 /end CHARACTERISTIC
/begin CHARACTERISTIC VisObj7Zone "" VALUE 0x00000000 __UBYTE_Z 0 NO_COMPU_METHOD 0 255 /end CHARACTERISTIC
/begin CHARACTERISTIC VisObj8_Type "" VALUE 0x00000000 __UBYTE_Z 0 NO_COMPU_METHOD 0 255 /end CHARACTERISTIC
/begin CHARACTERISTIC VisObj8DistLong "" VALUE 0x00000000 __FLOAT32_IEEE_Z 0 NO_COMPU_METHOD -3.40282346639E+38 3.40282346639E+38 /end CHARACTERISTIC
/begin CHARACTERISTIC VisObj8Orient "" VALUE 0x00000000 __UBYTE_Z 0 NO_COMPU_METHOD 0 255 /end CHARACTERISTIC
/begin CHARACTERISTIC VisObj8Zone "" VALUE 0x00000000 __UBYTE_Z 0 NO_COMPU_METHOD 0 255 /end CHARACTERISTIC
/begin CHARACTERISTIC VisObj9_Type "" VALUE 0x00000000 __UBYTE_Z 0 NO_COMPU_METHOD 0 255 /end CHARACTERISTIC
/begin CHARACTERISTIC VisObj9DistLong "" VALUE 0x00000000 __FLOAT32_IEEE_Z 0 NO_COMPU_METHOD -3.40282346639E+38 3.40282346639E+38 /end CHARACTERISTIC
/begin CHARACTERISTIC VisObj9Orient "" VALUE 0x00000000 __UBYTE_Z 0 NO_COMPU_METHOD 0 255 /end CHARACTERISTIC
/begin CHARACTERISTIC VisObj9Zone "" VALUE 0x00000000 __UBYTE_Z 0 NO_COMPU_METHOD 0 255 /end CHARACTERISTIC
/begin CHARACTERISTIC VisObjDynam1ID "" VALUE 0x00000000 __UBYTE_Z 0 NO_COMPU_METHOD 0 255 /end CHARACTERISTIC
/begin CHARACTERISTIC VisObjDynam2ID "" VALUE 0x00000000 __UBYTE_Z 0 NO_COMPU_METHOD 0 255 /end CHARACTERISTIC
/begin CHARACTERISTIC VisObjDynam3ID "" VALUE 0x00000000 __UBYTE_Z 0 NO_COMPU_METHOD 0 255 /end CHARACTERISTIC
/begin CHARACTERISTIC VisObjDynam4ID "" VALUE 0x00000000 __UBYTE_Z 0 NO_COMPU_METHOD 0 255 /end CHARACTERISTIC
/begin CHARACTERISTIC VisObjDynam5ID "" VALUE 0x00000000 __UBYTE_Z 0 NO_COMPU_METHOD 0 255 /end CHARACTERISTIC
/begin CHARACTERISTIC VisObjDynam6ID "" VALUE 0x00000000 __UBYTE_Z 0 NO_COMPU_METHOD 0 255 /end CHARACTERISTIC
/begin CHARACTERISTIC VisObjDynam7ID "" VALUE 0x00000000 __UBYTE_Z 0 NO_COMPU_METHOD 0 255 /end CHARACTERISTIC
/begin CHARACTERISTIC VisObjDynam8ID "" VALUE 0x00000000 __UBYTE_Z 0 NO_COMPU_METHOD 0 255 /end CHARACTERISTIC
/begin CHARACTERISTIC VisObjDynam9ID "" VALUE 0x00000000 __UBYTE_Z 0 NO_COMPU_METHOD 0 255 /end CHARACTERISTIC
/begin CHARACTERISTIC VisRoadAngleLvl "" VALUE 0x00000000 __UBYTE_Z 0 NO_COMPU_METHOD 0 255 /end CHARACTERISTIC
/begin CHARACTERISTIC DfPercFcuDirtSts "" VALUE 0x00000000 __UBYTE_Z 0 NO_COMPU_METHOD 0 255 /end CHARACTERISTIC
/begin CHARACTERISTIC DfPercFrcuDirtSts "" VALUE 0x00000000 __UBYTE_Z 0 NO_COMPU_METHOD 0 255 /end CHARACTERISTIC
/begin CHARACTERISTIC DfPercTicuDirtSts "" VALUE 0x00000000 __UBYTE_Z 0 NO_COMPU_METHOD 0 255 /end CHARACTERISTIC
/begin CHARACTERISTIC DfPercMrrxDirtSts "" VALUE 0x00000000 __UBYTE_Z 0 NO_COMPU_METHOD 0 255 /end CHARACTERISTIC
/begin CHARACTERISTIC DfPercLidarDirtSts "" VALUE 0x00000000 __UBYTE_Z 0 NO_COMPU_METHOD 0 255 /end CHARACTERISTIC
/begin CHARACTERISTIC DfPercValidDataFront "" VALUE 0x00000000 __UBYTE_Z 0 NO_COMPU_METHOD 0 255 /end CHARACTERISTIC
/begin CHARACTERISTIC DfPercValidDataRear "" VALUE 0x00000000 __UBYTE_Z 0 NO_COMPU_METHOD 0 255 /end CHARACTERISTIC
/begin CHARACTERISTIC DfPercValidDataLane "" VALUE 0x00000000 __UBYTE_Z 0 NO_COMPU_METHOD 0 255 /end CHARACTERISTIC
/begin CHARACTERISTIC DfPercValidDataSign "" VALUE 0x00000000 __UBYTE_Z 0 NO_COMPU_METHOD 0 255 /end CHARACTERISTIC
/begin CHARACTERISTIC DfPercValidDataMlia "" VALUE 0x00000000 __UBYTE_Z 0 NO_COMPU_METHOD 0 255 /end CHARACTERISTIC
/begin CHARACTERISTIC DfFPObj1detect "" VALUE 0x00000000 __UBYTE_Z 0 NO_COMPU_METHOD 0 255 /end CHARACTERISTIC
/begin CHARACTERISTIC DfFPObj1Sx1 "" VALUE 0x00000000 __FLOAT32_IEEE_Z 0 NO_COMPU_METHOD -3.40282346639E+38 3.40282346639E+38 /end CHARACTERISTIC
/begin CHARACTERISTIC DfFPObj1Sy1 "" VALUE 0x00000000 __FLOAT32_IEEE_Z 0 NO_COMPU_METHOD -3.40282346639E+38 3.40282346639E+38 /end CHARACTERISTIC
/begin CHARACTERISTIC DfFPObj1Sx2 "" VALUE 0x00000000 __FLOAT32_IEEE_Z 0 NO_COMPU_METHOD -3.40282346639E+38 3.40282346639E+38 /end CHARACTERISTIC
/begin CHARACTERISTIC DfFPObj1Sy2 "" VALUE 0x00000000 __FLOAT32_IEEE_Z 0 NO_COMPU_METHOD -3.40282346639E+38 3.40282346639E+38 /end CHARACTERISTIC
/begin CHARACTERISTIC DfFPObj1Vx "" VALUE 0x00000000 __FLOAT32_IEEE_Z 0 NO_COMPU_METHOD -3.40282346639E+38 3.40282346639E+38 /end CHARACTERISTIC
/begin CHARACTERISTIC DfFPObj1Vy "" VALUE 0x00000000 __FLOAT32_IEEE_Z 0 NO_COMPU_METHOD -3.40282346639E+38 3.40282346639E+38 /end CHARACTERISTIC
/begin CHARACTERISTIC DfFPObj1type "" VALUE 0x00000000 __UBYTE_Z 0 NO_COMPU_METHOD 0 255 /end CHARACTERISTIC
/begin CHARACTERISTIC DfFPObj1Orient "" VALUE 0x00000000 __FLOAT32_IEEE_Z 0 NO_COMPU_METHOD -3.40282346639E+38 3.40282346639E+38 /end CHARACTERISTIC
/begin CHARACTERISTIC DfFPObj1DynamID "" VALUE 0x00000000 __UBYTE_Z 0 NO_COMPU_METHOD 0 255 /end CHARACTERISTIC
/begin CHARACTERISTIC DfFPObj1Probabil "" VALUE 0x00000000 __UBYTE_Z 0 NO_COMPU_METHOD 0 255 /end CHARACTERISTIC
/begin CHARACTERISTIC DfFPObj2detect "" VALUE 0x00000000 __UBYTE_Z 0 NO_COMPU_METHOD 0 255 /end CHARACTERISTIC
/begin CHARACTERISTIC DfFPObj2Sx1 "" VALUE 0x00000000 __FLOAT32_IEEE_Z 0 NO_COMPU_METHOD -3.40282346639E+38 3.40282346639E+38 /end CHARACTERISTIC
/begin CHARACTERISTIC DfFPObj2Sy1 "" VALUE 0x00000000 __FLOAT32_IEEE_Z 0 NO_COMPU_METHOD -3.40282346639E+38 3.40282346639E+38 /end CHARACTERISTIC
/begin CHARACTERISTIC DfFPObj2Sx2 "" VALUE 0x00000000 __FLOAT32_IEEE_Z 0 NO_COMPU_METHOD -3.40282346639E+38 3.40282346639E+38 /end CHARACTERISTIC
/begin CHARACTERISTIC DfFPObj2Sy2 "" VALUE 0x00000000 __FLOAT32_IEEE_Z 0 NO_COMPU_METHOD -3.40282346639E+38 3.40282346639E+38 /end CHARACTERISTIC
/begin CHARACTERISTIC DfFPObj2Vx "" VALUE 0x00000000 __FLOAT32_IEEE_Z 0 NO_COMPU_METHOD -3.40282346639E+38 3.40282346639E+38 /end CHARACTERISTIC
/begin CHARACTERISTIC DfFPObj2Vy "" VALUE 0x00000000 __FLOAT32_IEEE_Z 0 NO_COMPU_METHOD -3.40282346639E+38 3.40282346639E+38 /end CHARACTERISTIC
/begin CHARACTERISTIC DfFPObj2type "" VALUE 0x00000000 __UBYTE_Z 0 NO_COMPU_METHOD 0 255 /end CHARACTERISTIC
/begin CHARACTERISTIC DfFPObj2Orient "" VALUE 0x00000000 __FLOAT32_IEEE_Z 0 NO_COMPU_METHOD -3.40282346639E+38 3.40282346639E+38 /end CHARACTERISTIC
/begin CHARACTERISTIC DfFPObj2DynamID "" VALUE 0x00000000 __UBYTE_Z 0 NO_COMPU_METHOD 0 255 /end CHARACTERISTIC
/begin CHARACTERISTIC DfFPObj2Probabil "" VALUE 0x00000000 __UBYTE_Z 0 NO_COMPU_METHOD 0 255 /end CHARACTERISTIC
/begin CHARACTERISTIC DfFPObj3detect "" VALUE 0x00000000 __UBYTE_Z 0 NO_COMPU_METHOD 0 255 /end CHARACTERISTIC
/begin CHARACTERISTIC DfFPObj3Sx1 "" VALUE 0x00000000 __FLOAT32_IEEE_Z 0 NO_COMPU_METHOD -3.40282346639E+38 3.40282346639E+38 /end CHARACTERISTIC
/begin CHARACTERISTIC DfFPObj3Sy1 "" VALUE 0x00000000 __FLOAT32_IEEE_Z 0 NO_COMPU_METHOD -3.40282346639E+38 3.40282346639E+38 /end CHARACTERISTIC
/begin CHARACTERISTIC DfFPObj3Sx2 "" VALUE 0x00000000 __FLOAT32_IEEE_Z 0 NO_COMPU_METHOD -3.40282346639E+38 3.40282346639E+38 /end CHARACTERISTIC
/begin CHARACTERISTIC DfFPObj3Sy2 "" VALUE 0x00000000 __FLOAT32_IEEE_Z 0 NO_COMPU_METHOD -3.40282346639E+38 3.40282346639E+38 /end CHARACTERISTIC
/begin CHARACTERISTIC DfFPObj3Vx "" VALUE 0x00000000 __FLOAT32_IEEE_Z 0 NO_COMPU_METHOD -3.40282346639E+38 3.40282346639E+38 /end CHARACTERISTIC
/begin CHARACTERISTIC DfFPObj3Vy "" VALUE 0x00000000 __FLOAT32_IEEE_Z 0 NO_COMPU_METHOD -3.40282346639E+38 3.40282346639E+38 /end CHARACTERISTIC
/begin CHARACTERISTIC DfFPObj3type "" VALUE 0x00000000 __UBYTE_Z 0 NO_COMPU_METHOD 0 255 /end CHARACTERISTIC
/begin CHARACTERISTIC DfFPObj3Orient "" VALUE 0x00000000 __FLOAT32_IEEE_Z 0 NO_COMPU_METHOD -3.40282346639E+38 3.40282346639E+38 /end CHARACTERISTIC
/begin CHARACTERISTIC DfFPObj3DynamID "" VALUE 0x00000000 __UBYTE_Z 0 NO_COMPU_METHOD 0 255 /end CHARACTERISTIC
/begin CHARACTERISTIC DfFPObj3Probabil "" VALUE 0x00000000 __UBYTE_Z 0 NO_COMPU_METHOD 0 255 /end CHARACTERISTIC
/begin CHARACTERISTIC DfFPObj4detect "" VALUE 0x00000000 __UBYTE_Z 0 NO_COMPU_METHOD 0 255 /end CHARACTERISTIC
/begin CHARACTERISTIC DfFPObj4Sx1 "" VALUE 0x00000000 __FLOAT32_IEEE_Z 0 NO_COMPU_METHOD -3.40282346639E+38 3.40282346639E+38 /end CHARACTERISTIC
/begin CHARACTERISTIC DfFPObj4Sy1 "" VALUE 0x00000000 __FLOAT32_IEEE_Z 0 NO_COMPU_METHOD -3.40282346639E+38 3.40282346639E+38 /end CHARACTERISTIC
/begin CHARACTERISTIC DfFPObj4Sx2 "" VALUE 0x00000000 __FLOAT32_IEEE_Z 0 NO_COMPU_METHOD -3.40282346639E+38 3.40282346639E+38 /end CHARACTERISTIC
/begin CHARACTERISTIC DfFPObj4Sy2 "" VALUE 0x00000000 __FLOAT32_IEEE_Z 0 NO_COMPU_METHOD -3.40282346639E+38 3.40282346639E+38 /end CHARACTERISTIC
/begin CHARACTERISTIC DfFPObj4Vx "" VALUE 0x00000000 __FLOAT32_IEEE_Z 0 NO_COMPU_METHOD -3.40282346639E+38 3.40282346639E+38 /end CHARACTERISTIC
/begin CHARACTERISTIC DfFPObj4Vy "" VALUE 0x00000000 __FLOAT32_IEEE_Z 0 NO_COMPU_METHOD -3.40282346639E+38 3.40282346639E+38 /end CHARACTERISTIC
/begin CHARACTERISTIC DfFPObj4type "" VALUE 0x00000000 __UBYTE_Z 0 NO_COMPU_METHOD 0 255 /end CHARACTERISTIC
/begin CHARACTERISTIC DfFPObj4Orient "" VALUE 0x00000000 __FLOAT32_IEEE_Z 0 NO_COMPU_METHOD -3.40282346639E+38 3.40282346639E+38 /end CHARACTERISTIC
/begin CHARACTERISTIC DfFPObj4DynamID "" VALUE 0x00000000 __UBYTE_Z 0 NO_COMPU_METHOD 0 255 /end CHARACTERISTIC
/begin CHARACTERISTIC DfFPObj4Probabil "" VALUE 0x00000000 __UBYTE_Z 0 NO_COMPU_METHOD 0 255 /end CHARACTERISTIC
/begin CHARACTERISTIC DfFPObj5detect "" VALUE 0x00000000 __UBYTE_Z 0 NO_COMPU_METHOD 0 255 /end CHARACTERISTIC
/begin CHARACTERISTIC DfFPObj5Sx1 "" VALUE 0x00000000 __FLOAT32_IEEE_Z 0 NO_COMPU_METHOD -3.40282346639E+38 3.40282346639E+38 /end CHARACTERISTIC
/begin CHARACTERISTIC DfFPObj5Sy1 "" VALUE 0x00000000 __FLOAT32_IEEE_Z 0 NO_COMPU_METHOD -3.40282346639E+38 3.40282346639E+38 /end CHARACTERISTIC
/begin CHARACTERISTIC DfFPObj5Sx2 "" VALUE 0x00000000 __FLOAT32_IEEE_Z 0 NO_COMPU_METHOD -3.40282346639E+38 3.40282346639E+38 /end CHARACTERISTIC
/begin CHARACTERISTIC DfFPObj5Sy2 "" VALUE 0x00000000 __FLOAT32_IEEE_Z 0 NO_COMPU_METHOD -3.40282346639E+38 3.40282346639E+38 /end CHARACTERISTIC
/begin CHARACTERISTIC DfFPObj5Vx "" VALUE 0x00000000 __FLOAT32_IEEE_Z 0 NO_COMPU_METHOD -3.40282346639E+38 3.40282346639E+38 /end CHARACTERISTIC
/begin CHARACTERISTIC DfFPObj5Vy "" VALUE 0x00000000 __FLOAT32_IEEE_Z 0 NO_COMPU_METHOD -3.40282346639E+38 3.40282346639E+38 /end CHARACTERISTIC
/begin CHARACTERISTIC DfFPObj5type "" VALUE 0x00000000 __UBYTE_Z 0 NO_COMPU_METHOD 0 255 /end CHARACTERISTIC
/begin CHARACTERISTIC DfFPObj5Orient "" VALUE 0x00000000 __FLOAT32_IEEE_Z 0 NO_COMPU_METHOD -3.40282346639E+38 3.40282346639E+38 /end CHARACTERISTIC
/begin CHARACTERISTIC DfFPObj5DynamID "" VALUE 0x00000000 __UBYTE_Z 0 NO_COMPU_METHOD 0 255 /end CHARACTERISTIC
/begin CHARACTERISTIC DfFPObj5Probabil "" VALUE 0x00000000 __UBYTE_Z 0 NO_COMPU_METHOD 0 255 /end CHARACTERISTIC
/begin CHARACTERISTIC DfFPObj6detect "" VALUE 0x00000000 __UBYTE_Z 0 NO_COMPU_METHOD 0 255 /end CHARACTERISTIC
/begin CHARACTERISTIC DfFPObj6Sx1 "" VALUE 0x00000000 __FLOAT32_IEEE_Z 0 NO_COMPU_METHOD -3.40282346639E+38 3.40282346639E+38 /end CHARACTERISTIC
/begin CHARACTERISTIC DfFPObj6Sy1 "" VALUE 0x00000000 __FLOAT32_IEEE_Z 0 NO_COMPU_METHOD -3.40282346639E+38 3.40282346639E+38 /end CHARACTERISTIC
/begin CHARACTERISTIC DfFPObj6Sx2 "" VALUE 0x00000000 __FLOAT32_IEEE_Z 0 NO_COMPU_METHOD -3.40282346639E+38 3.40282346639E+38 /end CHARACTERISTIC
/begin CHARACTERISTIC DfFPObj6Sy2 "" VALUE 0x00000000 __FLOAT32_IEEE_Z 0 NO_COMPU_METHOD -3.40282346639E+38 3.40282346639E+38 /end CHARACTERISTIC
/begin CHARACTERISTIC DfFPObj6Vx "" VALUE 0x00000000 __FLOAT32_IEEE_Z 0 NO_COMPU_METHOD -3.40282346639E+38 3.40282346639E+38 /end CHARACTERISTIC
/begin CHARACTERISTIC DfFPObj6Vy "" VALUE 0x00000000 __FLOAT32_IEEE_Z 0 NO_COMPU_METHOD -3.40282346639E+38 3.40282346639E+38 /end CHARACTERISTIC
/begin CHARACTERISTIC DfFPObj6type "" VALUE 0x00000000 __UBYTE_Z 0 NO_COMPU_METHOD 0 255 /end CHARACTERISTIC
/begin CHARACTERISTIC DfFPObj6Orient "" VALUE 0x00000000 __FLOAT32_IEEE_Z 0 NO_COMPU_METHOD -3.40282346639E+38 3.40282346639E+38 /end CHARACTERISTIC
/begin CHARACTERISTIC DfFPObj6DynamID "" VALUE 0x00000000 __UBYTE_Z 0 NO_COMPU_METHOD 0 255 /end CHARACTERISTIC
/begin CHARACTERISTIC DfFPObj6Probabil "" VALUE 0x00000000 __UBYTE_Z 0 NO_COMPU_METHOD 0 255 /end CHARACTERISTIC
/begin CHARACTERISTIC DfFPObj7detect "" VALUE 0x00000000 __UBYTE_Z 0 NO_COMPU_METHOD 0 255 /end CHARACTERISTIC
/begin CHARACTERISTIC DfFPObj7Sx1 "" VALUE 0x00000000 __FLOAT32_IEEE_Z 0 NO_COMPU_METHOD -3.40282346639E+38 3.40282346639E+38 /end CHARACTERISTIC
/begin CHARACTERISTIC DfFPObj7Sy1 "" VALUE 0x00000000 __FLOAT32_IEEE_Z 0 NO_COMPU_METHOD -3.40282346639E+38 3.40282346639E+38 /end CHARACTERISTIC
/begin CHARACTERISTIC DfFPObj7Sx2 "" VALUE 0x00000000 __FLOAT32_IEEE_Z 0 NO_COMPU_METHOD -3.40282346639E+38 3.40282346639E+38 /end CHARACTERISTIC
/begin CHARACTERISTIC DfFPObj7Sy2 "" VALUE 0x00000000 __FLOAT32_IEEE_Z 0 NO_COMPU_METHOD -3.40282346639E+38 3.40282346639E+38 /end CHARACTERISTIC
/begin CHARACTERISTIC DfFPObj7Vx "" VALUE 0x00000000 __FLOAT32_IEEE_Z 0 NO_COMPU_METHOD -3.40282346639E+38 3.40282346639E+38 /end CHARACTERISTIC
/begin CHARACTERISTIC DfFPObj7Vy "" VALUE 0x00000000 __FLOAT32_IEEE_Z 0 NO_COMPU_METHOD -3.40282346639E+38 3.40282346639E+38 /end CHARACTERISTIC
/begin CHARACTERISTIC DfFPObj7type "" VALUE 0x00000000 __UBYTE_Z 0 NO_COMPU_METHOD 0 255 /end CHARACTERISTIC
/begin CHARACTERISTIC DfFPObj7Orient "" VALUE 0x00000000 __FLOAT32_IEEE_Z 0 NO_COMPU_METHOD -3.40282346639E+38 3.40282346639E+38 /end CHARACTERISTIC
/begin CHARACTERISTIC DfFPObj7DynamID "" VALUE 0x00000000 __UBYTE_Z 0 NO_COMPU_METHOD 0 255 /end CHARACTERISTIC
/begin CHARACTERISTIC DfFPObj7Probabil "" VALUE 0x00000000 __UBYTE_Z 0 NO_COMPU_METHOD 0 255 /end CHARACTERISTIC
/begin CHARACTERISTIC DfFPObj8detect "" VALUE 0x00000000 __UBYTE_Z 0 NO_COMPU_METHOD 0 255 /end CHARACTERISTIC
/begin CHARACTERISTIC DfFPObj8Sx1 "" VALUE 0x00000000 __FLOAT32_IEEE_Z 0 NO_COMPU_METHOD -3.40282346639E+38 3.40282346639E+38 /end CHARACTERISTIC
/begin CHARACTERISTIC DfFPObj8Sy1 "" VALUE 0x00000000 __FLOAT32_IEEE_Z 0 NO_COMPU_METHOD -3.40282346639E+38 3.40282346639E+38 /end CHARACTERISTIC
/begin CHARACTERISTIC DfFPObj8Sx2 "" VALUE 0x00000000 __FLOAT32_IEEE_Z 0 NO_COMPU_METHOD -3.40282346639E+38 3.40282346639E+38 /end CHARACTERISTIC
/begin CHARACTERISTIC DfFPObj8Sy2 "" VALUE 0x00000000 __FLOAT32_IEEE_Z 0 NO_COMPU_METHOD -3.40282346639E+38 3.40282346639E+38 /end CHARACTERISTIC
/begin CHARACTERISTIC DfFPObj8Vx "" VALUE 0x00000000 __FLOAT32_IEEE_Z 0 NO_COMPU_METHOD -3.40282346639E+38 3.40282346639E+38 /end CHARACTERISTIC
/begin CHARACTERISTIC DfFPObj8Vy "" VALUE 0x00000000 __FLOAT32_IEEE_Z 0 NO_COMPU_METHOD -3.40282346639E+38 3.40282346639E+38 /end CHARACTERISTIC
/begin CHARACTERISTIC DfFPObj8type "" VALUE 0x00000000 __UBYTE_Z 0 NO_COMPU_METHOD 0 255 /end CHARACTERISTIC
/begin CHARACTERISTIC DfFPObj8Orient "" VALUE 0x00000000 __FLOAT32_IEEE_Z 0 NO_COMPU_METHOD -3.40282346639E+38 3.40282346639E+38 /end CHARACTERISTIC
/begin CHARACTERISTIC DfFPObj8DynamID "" VALUE 0x00000000 __UBYTE_Z 0 NO_COMPU_METHOD 0 255 /end CHARACTERISTIC
/begin CHARACTERISTIC DfFPObj8Probabil "" VALUE 0x00000000 __UBYTE_Z 0 NO_COMPU_METHOD 0 255 /end CHARACTERISTIC
/begin CHARACTERISTIC DfFPObj9detect "" VALUE 0x00000000 __UBYTE_Z 0 NO_COMPU_METHOD 0 255 /end CHARACTERISTIC
/begin CHARACTERISTIC DfFPObj9Sx1 "" VALUE 0x00000000 __FLOAT32_IEEE_Z 0 NO_COMPU_METHOD -3.40282346639E+38 3.40282346639E+38 /end CHARACTERISTIC
/begin CHARACTERISTIC DfFPObj9Sy1 "" VALUE 0x00000000 __FLOAT32_IEEE_Z 0 NO_COMPU_METHOD -3.40282346639E+38 3.40282346639E+38 /end CHARACTERISTIC
/begin CHARACTERISTIC DfFPObj9Sx2 "" VALUE 0x00000000 __FLOAT32_IEEE_Z 0 NO_COMPU_METHOD -3.40282346639E+38 3.40282346639E+38 /end CHARACTERISTIC
/begin CHARACTERISTIC DfFPObj9Sy2 "" VALUE 0x00000000 __FLOAT32_IEEE_Z 0 NO_COMPU_METHOD -3.40282346639E+38 3.40282346639E+38 /end CHARACTERISTIC
/begin CHARACTERISTIC DfFPObj9Vx "" VALUE 0x00000000 __FLOAT32_IEEE_Z 0 NO_COMPU_METHOD -3.40282346639E+38 3.40282346639E+38 /end CHARACTERISTIC
/begin CHARACTERISTIC DfFPObj9Vy "" VALUE 0x00000000 __FLOAT32_IEEE_Z 0 NO_COMPU_METHOD -3.40282346639E+38 3.40282346639E+38 /end CHARACTERISTIC
/begin CHARACTERISTIC DfFPObj9type "" VALUE 0x00000000 __UBYTE_Z 0 NO_COMPU_METHOD 0 255 /end CHARACTERISTIC
/begin CHARACTERISTIC DfFPObj9Orient "" VALUE 0x00000000 __FLOAT32_IEEE_Z 0 NO_COMPU_METHOD -3.40282346639E+38 3.40282346639E+38 /end CHARACTERISTIC
/begin CHARACTERISTIC DfFPObj9DynamID "" VALUE 0x00000000 __UBYTE_Z 0 NO_COMPU_METHOD 0 255 /end CHARACTERISTIC
/begin CHARACTERISTIC DfFPObj9Probabil "" VALUE 0x00000000 __UBYTE_Z 0 NO_COMPU_METHOD 0 255 /end CHARACTERISTIC
/begin CHARACTERISTIC DfFPObj10detect "" VALUE 0x00000000 __UBYTE_Z 0 NO_COMPU_METHOD 0 255 /end CHARACTERISTIC
/begin CHARACTERISTIC DfFPObj10Sx1 "" VALUE 0x00000000 __FLOAT32_IEEE_Z 0 NO_COMPU_METHOD -3.40282346639E+38 3.40282346639E+38 /end CHARACTERISTIC
/begin CHARACTERISTIC DfFPObj10Sy1 "" VALUE 0x00000000 __FLOAT32_IEEE_Z 0 NO_COMPU_METHOD -3.40282346639E+38 3.40282346639E+38 /end CHARACTERISTIC
/begin CHARACTERISTIC DfFPObj10Sx2 "" VALUE 0x00000000 __FLOAT32_IEEE_Z 0 NO_COMPU_METHOD -3.40282346639E+38 3.40282346639E+38 /end CHARACTERISTIC
/begin CHARACTERISTIC DfFPObj10Sy2 "" VALUE 0x00000000 __FLOAT32_IEEE_Z 0 NO_COMPU_METHOD -3.40282346639E+38 3.40282346639E+38 /end CHARACTERISTIC
/begin CHARACTERISTIC DfFPObj10Vx "" VALUE 0x00000000 __FLOAT32_IEEE_Z 0 NO_COMPU_METHOD -3.40282346639E+38 3.40282346639E+38 /end CHARACTERISTIC
/begin CHARACTERISTIC DfFPObj10Vy "" VALUE 0x00000000 __FLOAT32_IEEE_Z 0 NO_COMPU_METHOD -3.40282346639E+38 3.40282346639E+38 /end CHARACTERISTIC
/begin CHARACTERISTIC DfFPObj10type "" VALUE 0x00000000 __UBYTE_Z 0 NO_COMPU_METHOD 0 255 /end CHARACTERISTIC
/begin CHARACTERISTIC DfFPObj10Orient "" VALUE 0x00000000 __FLOAT32_IEEE_Z 0 NO_COMPU_METHOD -3.40282346639E+38 3.40282346639E+38 /end CHARACTERISTIC
/begin CHARACTERISTIC DfFPObj10DynamID "" VALUE 0x00000000 __UBYTE_Z 0 NO_COMPU_METHOD 0 255 /end CHARACTERISTIC
/begin CHARACTERISTIC DfFPObj10Probabil "" VALUE 0x00000000 __UBYTE_Z 0 NO_COMPU_METHOD 0 255 /end CHARACTERISTIC
/begin CHARACTERISTIC DfFPObj11detect "" VALUE 0x00000000 __UBYTE_Z 0 NO_COMPU_METHOD 0 255 /end CHARACTERISTIC
/begin CHARACTERISTIC DfFPObj11Sx1 "" VALUE 0x00000000 __FLOAT32_IEEE_Z 0 NO_COMPU_METHOD -3.40282346639E+38 3.40282346639E+38 /end CHARACTERISTIC
/begin CHARACTERISTIC DfFPObj11Sy1 "" VALUE 0x00000000 __FLOAT32_IEEE_Z 0 NO_COMPU_METHOD -3.40282346639E+38 3.40282346639E+38 /end CHARACTERISTIC
/begin CHARACTERISTIC DfFPObj11Sx2 "" VALUE 0x00000000 __FLOAT32_IEEE_Z 0 NO_COMPU_METHOD -3.40282346639E+38 3.40282346639E+38 /end CHARACTERISTIC
/begin CHARACTERISTIC DfFPObj11Sy2 "" VALUE 0x00000000 __FLOAT32_IEEE_Z 0 NO_COMPU_METHOD -3.40282346639E+38 3.40282346639E+38 /end CHARACTERISTIC
/begin CHARACTERISTIC DfFPObj11Vx "" VALUE 0x00000000 __FLOAT32_IEEE_Z 0 NO_COMPU_METHOD -3.40282346639E+38 3.40282346639E+38 /end CHARACTERISTIC
/begin CHARACTERISTIC DfFPObj11Vy "" VALUE 0x00000000 __FLOAT32_IEEE_Z 0 NO_COMPU_METHOD -3.40282346639E+38 3.40282346639E+38 /end CHARACTERISTIC
/begin CHARACTERISTIC DfFPObj11type "" VALUE 0x00000000 __UBYTE_Z 0 NO_COMPU_METHOD 0 255 /end CHARACTERISTIC
/begin CHARACTERISTIC DfFPObj11Orient "" VALUE 0x00000000 __FLOAT32_IEEE_Z 0 NO_COMPU_METHOD -3.40282346639E+38 3.40282346639E+38 /end CHARACTERISTIC
/begin CHARACTERISTIC DfFPObj11DynamID "" VALUE 0x00000000 __UBYTE_Z 0 NO_COMPU_METHOD 0 255 /end CHARACTERISTIC
/begin CHARACTERISTIC DfFPObj11Probabil "" VALUE 0x00000000 __UBYTE_Z 0 NO_COMPU_METHOD 0 255 /end CHARACTERISTIC
/begin CHARACTERISTIC DfRPObj12detect "" VALUE 0x00000000 __UBYTE_Z 0 NO_COMPU_METHOD 0 255 /end CHARACTERISTIC
/begin CHARACTERISTIC DfRPObj12Sx1 "" VALUE 0x00000000 __FLOAT32_IEEE_Z 0 NO_COMPU_METHOD -3.40282346639E+38 3.40282346639E+38 /end CHARACTERISTIC
/begin CHARACTERISTIC DfRPObj12Sy1 "" VALUE 0x00000000 __FLOAT32_IEEE_Z 0 NO_COMPU_METHOD -3.40282346639E+38 3.40282346639E+38 /end CHARACTERISTIC
/begin CHARACTERISTIC DfRPObj12Sx2 "" VALUE 0x00000000 __FLOAT32_IEEE_Z 0 NO_COMPU_METHOD -3.40282346639E+38 3.40282346639E+38 /end CHARACTERISTIC
/begin CHARACTERISTIC DfRPObj12Sy2 "" VALUE 0x00000000 __FLOAT32_IEEE_Z 0 NO_COMPU_METHOD -3.40282346639E+38 3.40282346639E+38 /end CHARACTERISTIC
/begin CHARACTERISTIC DfRPObj12Vx "" VALUE 0x00000000 __FLOAT32_IEEE_Z 0 NO_COMPU_METHOD -3.40282346639E+38 3.40282346639E+38 /end CHARACTERISTIC
/begin CHARACTERISTIC DfRPObj12Vy "" VALUE 0x00000000 __FLOAT32_IEEE_Z 0 NO_COMPU_METHOD -3.40282346639E+38 3.40282346639E+38 /end CHARACTERISTIC
/begin CHARACTERISTIC DfRPObj12Probabil "" VALUE 0x00000000 __UBYTE_Z 0 NO_COMPU_METHOD 0 255 /end CHARACTERISTIC
/begin CHARACTERISTIC DfRPObj13detect "" VALUE 0x00000000 __UBYTE_Z 0 NO_COMPU_METHOD 0 255 /end CHARACTERISTIC
/begin CHARACTERISTIC DfRPObj13Sx1 "" VALUE 0x00000000 __FLOAT32_IEEE_Z 0 NO_COMPU_METHOD -3.40282346639E+38 3.40282346639E+38 /end CHARACTERISTIC
/begin CHARACTERISTIC DfRPObj13Sy1 "" VALUE 0x00000000 __FLOAT32_IEEE_Z 0 NO_COMPU_METHOD -3.40282346639E+38 3.40282346639E+38 /end CHARACTERISTIC
/begin CHARACTERISTIC DfRPObj13Sx2 "" VALUE 0x00000000 __FLOAT32_IEEE_Z 0 NO_COMPU_METHOD -3.40282346639E+38 3.40282346639E+38 /end CHARACTERISTIC
/begin CHARACTERISTIC DfRPObj13Sy2 "" VALUE 0x00000000 __FLOAT32_IEEE_Z 0 NO_COMPU_METHOD -3.40282346639E+38 3.40282346639E+38 /end CHARACTERISTIC
/begin CHARACTERISTIC DfRPObj13Vx "" VALUE 0x00000000 __FLOAT32_IEEE_Z 0 NO_COMPU_METHOD -3.40282346639E+38 3.40282346639E+38 /end CHARACTERISTIC
/begin CHARACTERISTIC DfRPObj13Vy "" VALUE 0x00000000 __FLOAT32_IEEE_Z 0 NO_COMPU_METHOD -3.40282346639E+38 3.40282346639E+38 /end CHARACTERISTIC
/begin CHARACTERISTIC DfRPObj13Probabil "" VALUE 0x00000000 __UBYTE_Z 0 NO_COMPU_METHOD 0 255 /end CHARACTERISTIC
/begin CHARACTERISTIC DfRPObj14detect "" VALUE 0x00000000 __UBYTE_Z 0 NO_COMPU_METHOD 0 255 /end CHARACTERISTIC
/begin CHARACTERISTIC DfRPObj14Sx1 "" VALUE 0x00000000 __FLOAT32_IEEE_Z 0 NO_COMPU_METHOD -3.40282346639E+38 3.40282346639E+38 /end CHARACTERISTIC
/begin CHARACTERISTIC DfRPObj14Sy1 "" VALUE 0x00000000 __FLOAT32_IEEE_Z 0 NO_COMPU_METHOD -3.40282346639E+38 3.40282346639E+38 /end CHARACTERISTIC
/begin CHARACTERISTIC DfRPObj14Sx2 "" VALUE 0x00000000 __FLOAT32_IEEE_Z 0 NO_COMPU_METHOD -3.40282346639E+38 3.40282346639E+38 /end CHARACTERISTIC
/begin CHARACTERISTIC DfRPObj14Sy2 "" VALUE 0x00000000 __FLOAT32_IEEE_Z 0 NO_COMPU_METHOD -3.40282346639E+38 3.40282346639E+38 /end CHARACTERISTIC
/begin CHARACTERISTIC DfRPObj14Vx "" VALUE 0x00000000 __FLOAT32_IEEE_Z 0 NO_COMPU_METHOD -3.40282346639E+38 3.40282346639E+38 /end CHARACTERISTIC
/begin CHARACTERISTIC DfRPObj14Vy "" VALUE 0x00000000 __FLOAT32_IEEE_Z 0 NO_COMPU_METHOD -3.40282346639E+38 3.40282346639E+38 /end CHARACTERISTIC
/begin CHARACTERISTIC DfRPObj14Probabil "" VALUE 0x00000000 __UBYTE_Z 0 NO_COMPU_METHOD 0 255 /end CHARACTERISTIC
/begin CHARACTERISTIC DfRPObj15detect "" VALUE 0x00000000 __UBYTE_Z 0 NO_COMPU_METHOD 0 255 /end CHARACTERISTIC
/begin CHARACTERISTIC DfRPObj15Sx1 "" VALUE 0x00000000 __FLOAT32_IEEE_Z 0 NO_COMPU_METHOD -3.40282346639E+38 3.40282346639E+38 /end CHARACTERISTIC
/begin CHARACTERISTIC DfRPObj15Sy1 "" VALUE 0x00000000 __FLOAT32_IEEE_Z 0 NO_COMPU_METHOD -3.40282346639E+38 3.40282346639E+38 /end CHARACTERISTIC
/begin CHARACTERISTIC DfRPObj15Sx2 "" VALUE 0x00000000 __FLOAT32_IEEE_Z 0 NO_COMPU_METHOD -3.40282346639E+38 3.40282346639E+38 /end CHARACTERISTIC
/begin CHARACTERISTIC DfRPObj15Sy2 "" VALUE 0x00000000 __FLOAT32_IEEE_Z 0 NO_COMPU_METHOD -3.40282346639E+38 3.40282346639E+38 /end CHARACTERISTIC
/begin CHARACTERISTIC DfRPObj15Vx "" VALUE 0x00000000 __FLOAT32_IEEE_Z 0 NO_COMPU_METHOD -3.40282346639E+38 3.40282346639E+38 /end CHARACTERISTIC
/begin CHARACTERISTIC DfRPObj15Vy "" VALUE 0x00000000 __FLOAT32_IEEE_Z 0 NO_COMPU_METHOD -3.40282346639E+38 3.40282346639E+38 /end CHARACTERISTIC
/begin CHARACTERISTIC DfRPObj15Probabil "" VALUE 0x00000000 __UBYTE_Z 0 NO_COMPU_METHOD 0 255 /end CHARACTERISTIC
/begin CHARACTERISTIC DfRPObj16detect "" VALUE 0x00000000 __UBYTE_Z 0 NO_COMPU_METHOD 0 255 /end CHARACTERISTIC
/begin CHARACTERISTIC DfRPObj16Sx1 "" VALUE 0x00000000 __FLOAT32_IEEE_Z 0 NO_COMPU_METHOD -3.40282346639E+38 3.40282346639E+38 /end CHARACTERISTIC
/begin CHARACTERISTIC DfRPObj16Sy1 "" VALUE 0x00000000 __FLOAT32_IEEE_Z 0 NO_COMPU_METHOD -3.40282346639E+38 3.40282346639E+38 /end CHARACTERISTIC
/begin CHARACTERISTIC DfRPObj16Sx2 "" VALUE 0x00000000 __FLOAT32_IEEE_Z 0 NO_COMPU_METHOD -3.40282346639E+38 3.40282346639E+38 /end CHARACTERISTIC
/begin CHARACTERISTIC DfRPObj16Sy2 "" VALUE 0x00000000 __FLOAT32_IEEE_Z 0 NO_COMPU_METHOD -3.40282346639E+38 3.40282346639E+38 /end CHARACTERISTIC
/begin CHARACTERISTIC DfRPObj16Vx "" VALUE 0x00000000 __FLOAT32_IEEE_Z 0 NO_COMPU_METHOD -3.40282346639E+38 3.40282346639E+38 /end CHARACTERISTIC
/begin CHARACTERISTIC DfRPObj16Vy "" VALUE 0x00000000 __FLOAT32_IEEE_Z 0 NO_COMPU_METHOD -3.40282346639E+38 3.40282346639E+38 /end CHARACTERISTIC
/begin CHARACTERISTIC DfRPObj16Probabil "" VALUE 0x00000000 __UBYTE_Z 0 NO_COMPU_METHOD 0 255 /end CHARACTERISTIC
/begin CHARACTERISTIC DfRPObj17detect "" VALUE 0x00000000 __UBYTE_Z 0 NO_COMPU_METHOD 0 255 /end CHARACTERISTIC
/begin CHARACTERISTIC DfRPObj17Sx1 "" VALUE 0x00000000 __FLOAT32_IEEE_Z 0 NO_COMPU_METHOD -3.40282346639E+38 3.40282346639E+38 /end CHARACTERISTIC
/begin CHARACTERISTIC DfRPObj17Sy1 "" VALUE 0x00000000 __FLOAT32_IEEE_Z 0 NO_COMPU_METHOD -3.40282346639E+38 3.40282346639E+38 /end CHARACTERISTIC
/begin CHARACTERISTIC DfRPObj17Sx2 "" VALUE 0x00000000 __FLOAT32_IEEE_Z 0 NO_COMPU_METHOD -3.40282346639E+38 3.40282346639E+38 /end CHARACTERISTIC
/begin CHARACTERISTIC DfRPObj17Sy2 "" VALUE 0x00000000 __FLOAT32_IEEE_Z 0 NO_COMPU_METHOD -3.40282346639E+38 3.40282346639E+38 /end CHARACTERISTIC
/begin CHARACTERISTIC DfRPObj17Vx "" VALUE 0x00000000 __FLOAT32_IEEE_Z 0 NO_COMPU_METHOD -3.40282346639E+38 3.40282346639E+38 /end CHARACTERISTIC
/begin CHARACTERISTIC DfRPObj17Vy "" VALUE 0x00000000 __FLOAT32_IEEE_Z 0 NO_COMPU_METHOD -3.40282346639E+38 3.40282346639E+38 /end CHARACTERISTIC
/begin CHARACTERISTIC DfRPObj17Probabil "" VALUE 0x00000000 __UBYTE_Z 0 NO_COMPU_METHOD 0 255 /end CHARACTERISTIC
/begin CHARACTERISTIC DfRPObj18detect "" VALUE 0x00000000 __UBYTE_Z 0 NO_COMPU_METHOD 0 255 /end CHARACTERISTIC
/begin CHARACTERISTIC DfRPObj18Sx1 "" VALUE 0x00000000 __FLOAT32_IEEE_Z 0 NO_COMPU_METHOD -3.40282346639E+38 3.40282346639E+38 /end CHARACTERISTIC
/begin CHARACTERISTIC DfRPObj18Sy1 "" VALUE 0x00000000 __FLOAT32_IEEE_Z 0 NO_COMPU_METHOD -3.40282346639E+38 3.40282346639E+38 /end CHARACTERISTIC
/begin CHARACTERISTIC DfRPObj18Sx2 "" VALUE 0x00000000 __FLOAT32_IEEE_Z 0 NO_COMPU_METHOD -3.40282346639E+38 3.40282346639E+38 /end CHARACTERISTIC
/begin CHARACTERISTIC DfRPObj18Sy2 "" VALUE 0x00000000 __FLOAT32_IEEE_Z 0 NO_COMPU_METHOD -3.40282346639E+38 3.40282346639E+38 /end CHARACTERISTIC
/begin CHARACTERISTIC DfRPObj18Vx "" VALUE 0x00000000 __FLOAT32_IEEE_Z 0 NO_COMPU_METHOD -3.40282346639E+38 3.40282346639E+38 /end CHARACTERISTIC
/begin CHARACTERISTIC DfRPObj18Vy "" VALUE 0x00000000 __FLOAT32_IEEE_Z 0 NO_COMPU_METHOD -3.40282346639E+38 3.40282346639E+38 /end CHARACTERISTIC
/begin CHARACTERISTIC DfRPObj18Probabil "" VALUE 0x00000000 __UBYTE_Z 0 NO_COMPU_METHOD 0 255 /end CHARACTERISTIC
/begin CHARACTERISTIC DfLanePFrontLSx0 "" VALUE 0x00000000 __FLOAT32_IEEE_Z 0 NO_COMPU_METHOD -3.40282346639E+38 3.40282346639E+38 /end CHARACTERISTIC
/begin CHARACTERISTIC DfLanePFrontLSxFA "" VALUE 0x00000000 __FLOAT32_IEEE_Z 0 NO_COMPU_METHOD -3.40282346639E+38 3.40282346639E+38 /end CHARACTERISTIC
/begin CHARACTERISTIC DfLanePFrontLSx10 "" VALUE 0x00000000 __FLOAT32_IEEE_Z 0 NO_COMPU_METHOD -3.40282346639E+38 3.40282346639E+38 /end CHARACTERISTIC
/begin CHARACTERISTIC DfLanePFrontLSx15 "" VALUE 0x00000000 __FLOAT32_IEEE_Z 0 NO_COMPU_METHOD -3.40282346639E+38 3.40282346639E+38 /end CHARACTERISTIC
/begin CHARACTERISTIC DfLanePFrontLSx20 "" VALUE 0x00000000 __FLOAT32_IEEE_Z 0 NO_COMPU_METHOD -3.40282346639E+38 3.40282346639E+38 /end CHARACTERISTIC
/begin CHARACTERISTIC DfLanePFrontLSx25 "" VALUE 0x00000000 __FLOAT32_IEEE_Z 0 NO_COMPU_METHOD -3.40282346639E+38 3.40282346639E+38 /end CHARACTERISTIC
/begin CHARACTERISTIC DfLanePFrontLSx30 "" VALUE 0x00000000 __FLOAT32_IEEE_Z 0 NO_COMPU_METHOD -3.40282346639E+38 3.40282346639E+38 /end CHARACTERISTIC
/begin CHARACTERISTIC DfLanePFrontLSx40 "" VALUE 0x00000000 __FLOAT32_IEEE_Z 0 NO_COMPU_METHOD -3.40282346639E+38 3.40282346639E+38 /end CHARACTERISTIC
/begin CHARACTERISTIC DfLanePFrontLSx50 "" VALUE 0x00000000 __FLOAT32_IEEE_Z 0 NO_COMPU_METHOD -3.40282346639E+38 3.40282346639E+38 /end CHARACTERISTIC
/begin CHARACTERISTIC DfLanePFrontLSx60 "" VALUE 0x00000000 __FLOAT32_IEEE_Z 0 NO_COMPU_METHOD -3.40282346639E+38 3.40282346639E+38 /end CHARACTERISTIC
/begin CHARACTERISTIC DfLanePFrontLSx70 "" VALUE 0x00000000 __FLOAT32_IEEE_Z 0 NO_COMPU_METHOD -3.40282346639E+38 3.40282346639E+38 /end CHARACTERISTIC
/begin CHARACTERISTIC DfLanePFrontLSx80 "" VALUE 0x00000000 __FLOAT32_IEEE_Z 0 NO_COMPU_METHOD -3.40282346639E+38 3.40282346639E+38 /end CHARACTERISTIC
/begin CHARACTERISTIC DfLanePFrontLSx90 "" VALUE 0x00000000 __FLOAT32_IEEE_Z 0 NO_COMPU_METHOD -3.40282346639E+38 3.40282346639E+38 /end CHARACTERISTIC
/begin CHARACTERISTIC DfLanePFrontLSx100 "" VALUE 0x00000000 __FLOAT32_IEEE_Z 0 NO_COMPU_METHOD -3.40282346639E+38 3.40282346639E+38 /end CHARACTERISTIC
/begin CHARACTERISTIC DfLanePFrontLColor "" VALUE 0x00000000 __UBYTE_Z 0 NO_COMPU_METHOD 0 255 /end CHARACTERISTIC
/begin CHARACTERISTIC DfLanePFrontLType "" VALUE 0x00000000 __UBYTE_Z 0 NO_COMPU_METHOD 0 255 /end CHARACTERISTIC
/begin CHARACTERISTIC DfLanePFrontRSx0 "" VALUE 0x00000000 __FLOAT32_IEEE_Z 0 NO_COMPU_METHOD -3.40282346639E+38 3.40282346639E+38 /end CHARACTERISTIC
/begin CHARACTERISTIC DfLanePFrontRSxFA "" VALUE 0x00000000 __FLOAT32_IEEE_Z 0 NO_COMPU_METHOD -3.40282346639E+38 3.40282346639E+38 /end CHARACTERISTIC
/begin CHARACTERISTIC DfLanePFrontRSx10 "" VALUE 0x00000000 __FLOAT32_IEEE_Z 0 NO_COMPU_METHOD -3.40282346639E+38 3.40282346639E+38 SYMBOL_LINK "DfLanePFrontRSx10 " 0 /end CHARACTERISTIC
/begin CHARACTERISTIC DfLanePFrontRSx15 "" VALUE 0x00000000 __FLOAT32_IEEE_Z 0 NO_COMPU_METHOD -3.40282346639E+38 3.40282346639E+38 SYMBOL_LINK "DfLanePFrontRSx15 " 0 /end CHARACTERISTIC
/begin CHARACTERISTIC DfLanePFrontRSx20 "" VALUE 0x00000000 __FLOAT32_IEEE_Z 0 NO_COMPU_METHOD -3.40282346639E+38 3.40282346639E+38 /end CHARACTERISTIC
/begin CHARACTERISTIC DfLanePFrontRSx25 "" VALUE 0x00000000 __FLOAT32_IEEE_Z 0 NO_COMPU_METHOD -3.40282346639E+38 3.40282346639E+38 /end CHARACTERISTIC
/begin CHARACTERISTIC DfLanePFrontRSx30 "" VALUE 0x00000000 __FLOAT32_IEEE_Z 0 NO_COMPU_METHOD -3.40282346639E+38 3.40282346639E+38 /end CHARACTERISTIC
/begin CHARACTERISTIC DfLanePFrontRSx40 "" VALUE 0x00000000 __FLOAT32_IEEE_Z 0 NO_COMPU_METHOD -3.40282346639E+38 3.40282346639E+38 /end CHARACTERISTIC
/begin CHARACTERISTIC DfLanePFrontRSx50 "" VALUE 0x00000000 __FLOAT32_IEEE_Z 0 NO_COMPU_METHOD -3.40282346639E+38 3.40282346639E+38 /end CHARACTERISTIC
/begin CHARACTERISTIC DfLanePFrontRSx60 "" VALUE 0x00000000 __FLOAT32_IEEE_Z 0 NO_COMPU_METHOD -3.40282346639E+38 3.40282346639E+38 /end CHARACTERISTIC
/begin CHARACTERISTIC DfLanePFrontRSx70 "" VALUE 0x00000000 __FLOAT32_IEEE_Z 0 NO_COMPU_METHOD -3.40282346639E+38 3.40282346639E+38 /end CHARACTERISTIC
/begin CHARACTERISTIC DfLanePFrontRSx80 "" VALUE 0x00000000 __FLOAT32_IEEE_Z 0 NO_COMPU_METHOD -3.40282346639E+38 3.40282346639E+38 /end CHARACTERISTIC
/begin CHARACTERISTIC DfLanePFrontRSx90 "" VALUE 0x00000000 __FLOAT32_IEEE_Z 0 NO_COMPU_METHOD -3.40282346639E+38 3.40282346639E+38 /end CHARACTERISTIC
/begin CHARACTERISTIC DfLanePFrontRSx100 "" VALUE 0x00000000 __FLOAT32_IEEE_Z 0 NO_COMPU_METHOD -3.40282346639E+38 3.40282346639E+38 /end CHARACTERISTIC
/begin CHARACTERISTIC DfLanePFrontRColor "" VALUE 0x00000000 __UBYTE_Z 0 NO_COMPU_METHOD 0 255 /end CHARACTERISTIC
/begin CHARACTERISTIC DfLanePFrontRType "" VALUE 0x00000000 __UBYTE_Z 0 NO_COMPU_METHOD 0 255 /end CHARACTERISTIC
/begin CHARACTERISTIC DfLanePTrgtLineS0 "" VALUE 0x00000000 __FLOAT32_IEEE_Z 0 NO_COMPU_METHOD -3.40282346639E+38 3.40282346639E+38 /end CHARACTERISTIC
/begin CHARACTERISTIC DfLanePTrgtLineS1 "" VALUE 0x00000000 __FLOAT32_IEEE_Z 0 NO_COMPU_METHOD -3.40282346639E+38 3.40282346639E+38 /end CHARACTERISTIC
/begin CHARACTERISTIC DfLanePTrgtLineS2 "" VALUE 0x00000000 __FLOAT32_IEEE_Z 0 NO_COMPU_METHOD -3.40282346639E+38 3.40282346639E+38 /end CHARACTERISTIC
/begin CHARACTERISTIC DfLanePTrgtLineS3 "" VALUE 0x00000000 __FLOAT32_IEEE_Z 0 NO_COMPU_METHOD -3.40282346639E+38 3.40282346639E+38 /end CHARACTERISTIC
/begin CHARACTERISTIC DfLanePTrgtLineS4 "" VALUE 0x00000000 __FLOAT32_IEEE_Z 0 NO_COMPU_METHOD -3.40282346639E+38 3.40282346639E+38 /end CHARACTERISTIC
/begin CHARACTERISTIC DfLanePRearLSx5 "" VALUE 0x00000000 __FLOAT32_IEEE_Z 0 NO_COMPU_METHOD -3.40282346639E+38 3.40282346639E+38 /end CHARACTERISTIC
/begin CHARACTERISTIC DfLanePRearLSx10 "" VALUE 0x00000000 __FLOAT32_IEEE_Z 0 NO_COMPU_METHOD -3.40282346639E+38 3.40282346639E+38 /end CHARACTERISTIC
/begin CHARACTERISTIC DfLanePRearLSx20 "" VALUE 0x00000000 __FLOAT32_IEEE_Z 0 NO_COMPU_METHOD -3.40282346639E+38 3.40282346639E+38 /end CHARACTERISTIC
/begin CHARACTERISTIC DfLanePRearLSx30 "" VALUE 0x00000000 __FLOAT32_IEEE_Z 0 NO_COMPU_METHOD -3.40282346639E+38 3.40282346639E+38 /end CHARACTERISTIC
/begin CHARACTERISTIC DfLanePRearLSx40 "" VALUE 0x00000000 __FLOAT32_IEEE_Z 0 NO_COMPU_METHOD -3.40282346639E+38 3.40282346639E+38 /end CHARACTERISTIC
/begin CHARACTERISTIC DfLanePRearLSx50 "" VALUE 0x00000000 __FLOAT32_IEEE_Z 0 NO_COMPU_METHOD -3.40282346639E+38 3.40282346639E+38 /end CHARACTERISTIC
/begin CHARACTERISTIC DfLanePRearLSx60 "" VALUE 0x00000000 __FLOAT32_IEEE_Z 0 NO_COMPU_METHOD -3.40282346639E+38 3.40282346639E+38 /end CHARACTERISTIC
/begin CHARACTERISTIC DfLanePRearLSx70 "" VALUE 0x00000000 __FLOAT32_IEEE_Z 0 NO_COMPU_METHOD -3.40282346639E+38 3.40282346639E+38 /end CHARACTERISTIC
/begin CHARACTERISTIC DfLanePRearLSx80 "" VALUE 0x00000000 __FLOAT32_IEEE_Z 0 NO_COMPU_METHOD -3.40282346639E+38 3.40282346639E+38 /end CHARACTERISTIC
/begin CHARACTERISTIC DfLanePRearLSx90 "" VALUE 0x00000000 __FLOAT32_IEEE_Z 0 NO_COMPU_METHOD -3.40282346639E+38 3.40282346639E+38 /end CHARACTERISTIC
/begin CHARACTERISTIC DfLanePRearLSx100 "" VALUE 0x00000000 __FLOAT32_IEEE_Z 0 NO_COMPU_METHOD -3.40282346639E+38 3.40282346639E+38 /end CHARACTERISTIC
/begin CHARACTERISTIC DfLanePRearRSx5 "" VALUE 0x00000000 __FLOAT32_IEEE_Z 0 NO_COMPU_METHOD -3.40282346639E+38 3.40282346639E+38 /end CHARACTERISTIC
/begin CHARACTERISTIC DfLanePRearRSx10 "" VALUE 0x00000000 __FLOAT32_IEEE_Z 0 NO_COMPU_METHOD -3.40282346639E+38 3.40282346639E+38 /end CHARACTERISTIC
/begin CHARACTERISTIC DfLanePRearRSx20 "" VALUE 0x00000000 __FLOAT32_IEEE_Z 0 NO_COMPU_METHOD -3.40282346639E+38 3.40282346639E+38 /end CHARACTERISTIC
/begin CHARACTERISTIC DfLanePRearRSx30 "" VALUE 0x00000000 __FLOAT32_IEEE_Z 0 NO_COMPU_METHOD -3.40282346639E+38 3.40282346639E+38 /end CHARACTERISTIC
/begin CHARACTERISTIC DfLanePRearRSx40 "" VALUE 0x00000000 __FLOAT32_IEEE_Z 0 NO_COMPU_METHOD -3.40282346639E+38 3.40282346639E+38 /end CHARACTERISTIC
/begin CHARACTERISTIC DfLanePRearRSx50 "" VALUE 0x00000000 __FLOAT32_IEEE_Z 0 NO_COMPU_METHOD -3.40282346639E+38 3.40282346639E+38 /end CHARACTERISTIC
/begin CHARACTERISTIC DfLanePRearRSx60 "" VALUE 0x00000000 __FLOAT32_IEEE_Z 0 NO_COMPU_METHOD -3.40282346639E+38 3.40282346639E+38 /end CHARACTERISTIC
/begin CHARACTERISTIC DfLanePRearRSx70 "" VALUE 0x00000000 __FLOAT32_IEEE_Z 0 NO_COMPU_METHOD -3.40282346639E+38 3.40282346639E+38 /end CHARACTERISTIC
/begin CHARACTERISTIC DfLanePRearRSx80 "" VALUE 0x00000000 __FLOAT32_IEEE_Z 0 NO_COMPU_METHOD -3.40282346639E+38 3.40282346639E+38 /end CHARACTERISTIC
/begin CHARACTERISTIC DfLanePRearRSx90 "" VALUE 0x00000000 __FLOAT32_IEEE_Z 0 NO_COMPU_METHOD -3.40282346639E+38 3.40282346639E+38 /end CHARACTERISTIC
/begin CHARACTERISTIC DfLanePRearRSx100 "" VALUE 0x00000000 __FLOAT32_IEEE_Z 0 NO_COMPU_METHOD -3.40282346639E+38 3.40282346639E+38 /end CHARACTERISTIC
/begin CHARACTERISTIC DfSignPerc1Obj_detect "" VALUE 0x00000000 __UBYTE_Z 0 NO_COMPU_METHOD 0 255 /end CHARACTERISTIC
/begin CHARACTERISTIC DfSignPerc1Sx "" VALUE 0x00000000 __FLOAT32_IEEE_Z 0 NO_COMPU_METHOD -3.40282346639E+38 3.40282346639E+38 /end CHARACTERISTIC
/begin CHARACTERISTIC DfSignPerc1Sy "" VALUE 0x00000000 __FLOAT32_IEEE_Z 0 NO_COMPU_METHOD -3.40282346639E+38 3.40282346639E+38 /end CHARACTERISTIC
/begin CHARACTERISTIC DfSignPerc1CurrSpeed "" VALUE 0x00000000 __UBYTE_Z 0 NO_COMPU_METHOD 0 255 /end CHARACTERISTIC
/begin CHARACTERISTIC DfSignPerc1Color "" VALUE 0x00000000 __UBYTE_Z 0 NO_COMPU_METHOD 0 255 /end CHARACTERISTIC
/begin CHARACTERISTIC DfSignPerc1Type "" VALUE 0x00000000 __UBYTE_Z 0 NO_COMPU_METHOD 0 255 /end CHARACTERISTIC
/begin CHARACTERISTIC DfSignPerc2Obj_detect "" VALUE 0x00000000 __UBYTE_Z 0 NO_COMPU_METHOD 0 255 /end CHARACTERISTIC
/begin CHARACTERISTIC DfSignPerc2Sx "" VALUE 0x00000000 __FLOAT32_IEEE_Z 0 NO_COMPU_METHOD -3.40282346639E+38 3.40282346639E+38 /end CHARACTERISTIC
/begin CHARACTERISTIC DfSignPerc2Sy "" VALUE 0x00000000 __FLOAT32_IEEE_Z 0 NO_COMPU_METHOD -3.40282346639E+38 3.40282346639E+38 /end CHARACTERISTIC
/begin CHARACTERISTIC DfSignPerc2CurrSpeed "" VALUE 0x00000000 __UBYTE_Z 0 NO_COMPU_METHOD 0 255 /end CHARACTERISTIC
/begin CHARACTERISTIC DfSignPerc2Color "" VALUE 0x00000000 __UBYTE_Z 0 NO_COMPU_METHOD 0 255 /end CHARACTERISTIC
/begin CHARACTERISTIC DfSignPerc2Type "" VALUE 0x00000000 __UBYTE_Z 0 NO_COMPU_METHOD 0 255 /end CHARACTERISTIC
/begin CHARACTERISTIC DfSignPerc3Obj_detect "" VALUE 0x00000000 __UBYTE_Z 0 NO_COMPU_METHOD 0 255 /end CHARACTERISTIC
/begin CHARACTERISTIC DfSignPerc3Sx "" VALUE 0x00000000 __FLOAT32_IEEE_Z 0 NO_COMPU_METHOD -3.40282346639E+38 3.40282346639E+38 /end CHARACTERISTIC
/begin CHARACTERISTIC DfSignPerc3Sy "" VALUE 0x00000000 __FLOAT32_IEEE_Z 0 NO_COMPU_METHOD -3.40282346639E+38 3.40282346639E+38 /end CHARACTERISTIC
/begin CHARACTERISTIC DfSignPerc3CurrSpeed "" VALUE 0x00000000 __UBYTE_Z 0 NO_COMPU_METHOD 0 255 /end CHARACTERISTIC
/begin CHARACTERISTIC DfSignPerc3Color "" VALUE 0x00000000 __UBYTE_Z 0 NO_COMPU_METHOD 0 255 /end CHARACTERISTIC
/begin CHARACTERISTIC DfSignPerc3Type "" VALUE 0x00000000 __UBYTE_Z 0 NO_COMPU_METHOD 0 255 /end CHARACTERISTIC
/begin CHARACTERISTIC DfSignPerc4Obj_detect "" VALUE 0x00000000 __UBYTE_Z 0 NO_COMPU_METHOD 0 255 /end CHARACTERISTIC
/begin CHARACTERISTIC DfSignPerc4Sx "" VALUE 0x00000000 __FLOAT32_IEEE_Z 0 NO_COMPU_METHOD -3.40282346639E+38 3.40282346639E+38 /end CHARACTERISTIC
/begin CHARACTERISTIC DfSignPerc4Sy "" VALUE 0x00000000 __FLOAT32_IEEE_Z 0 NO_COMPU_METHOD -3.40282346639E+38 3.40282346639E+38 /end CHARACTERISTIC
/begin CHARACTERISTIC DfSignPerc4CurrSpeed "" VALUE 0x00000000 __UBYTE_Z 0 NO_COMPU_METHOD 0 255 /end CHARACTERISTIC
/begin CHARACTERISTIC DfSignPerc4Color "" VALUE 0x00000000 __UBYTE_Z 0 NO_COMPU_METHOD 0 255 /end CHARACTERISTIC
/begin CHARACTERISTIC DfSignPerc4Type "" VALUE 0x00000000 __UBYTE_Z 0 NO_COMPU_METHOD 0 255 /end CHARACTERISTIC
/begin CHARACTERISTIC DfMliaPercStreetLightDetect "" VALUE 0x00000000 __UBYTE_Z 0 NO_COMPU_METHOD 0 255 /end CHARACTERISTIC
/begin CHARACTERISTIC DfMliaPercObj1Detect "" VALUE 0x00000000 __UBYTE_Z 0 NO_COMPU_METHOD 0 255 /end CHARACTERISTIC
/begin CHARACTERISTIC DfMliaPercObj1Sx1 "" VALUE 0x00000000 __FLOAT32_IEEE_Z 0 NO_COMPU_METHOD -3.40282346639E+38 3.40282346639E+38 /end CHARACTERISTIC
/begin CHARACTERISTIC DfMliaPercObj1Sy1 "" VALUE 0x00000000 __FLOAT32_IEEE_Z 0 NO_COMPU_METHOD -3.40282346639E+38 3.40282346639E+38 /end CHARACTERISTIC
/begin CHARACTERISTIC DfMliaPercObj1Sx2 "" VALUE 0x00000000 __FLOAT32_IEEE_Z 0 NO_COMPU_METHOD -3.40282346639E+38 3.40282346639E+38 /end CHARACTERISTIC
/begin CHARACTERISTIC DfMliaPercObj1Sy2 "" VALUE 0x00000000 __FLOAT32_IEEE_Z 0 NO_COMPU_METHOD -3.40282346639E+38 3.40282346639E+38 /end CHARACTERISTIC
/begin CHARACTERISTIC DfMliaPercObj1Vel "" VALUE 0x00000000 __FLOAT32_IEEE_Z 0 NO_COMPU_METHOD -3.40282346639E+38 3.40282346639E+38 /end CHARACTERISTIC
/begin CHARACTERISTIC DfMliaPercObj1Precision "" VALUE 0x00000000 __UBYTE_Z 0 NO_COMPU_METHOD 0 255 /end CHARACTERISTIC
/begin CHARACTERISTIC DfMliaPercObj1LightSts "" VALUE 0x00000000 __UBYTE_Z 0 NO_COMPU_METHOD 0 255 /end CHARACTERISTIC
/begin CHARACTERISTIC DfMliaPercObj1Sz "" VALUE 0x00000000 __FLOAT32_IEEE_Z 0 NO_COMPU_METHOD -3.40282346639E+38 3.40282346639E+38 /end CHARACTERISTIC
/begin CHARACTERISTIC DfMliaPercObj2Detect "" VALUE 0x00000000 __UBYTE_Z 0 NO_COMPU_METHOD 0 255 /end CHARACTERISTIC
/begin CHARACTERISTIC DfMliaPercObj2Sx1 "" VALUE 0x00000000 __FLOAT32_IEEE_Z 0 NO_COMPU_METHOD -3.40282346639E+38 3.40282346639E+38 /end CHARACTERISTIC
/begin CHARACTERISTIC DfMliaPercObj2Sy1 "" VALUE 0x00000000 __FLOAT32_IEEE_Z 0 NO_COMPU_METHOD -3.40282346639E+38 3.40282346639E+38 /end CHARACTERISTIC
/begin CHARACTERISTIC DfMliaPercObj2Sx2 "" VALUE 0x00000000 __FLOAT32_IEEE_Z 0 NO_COMPU_METHOD -3.40282346639E+38 3.40282346639E+38 /end CHARACTERISTIC
/begin CHARACTERISTIC DfMliaPercObj2Sy2 "" VALUE 0x00000000 __FLOAT32_IEEE_Z 0 NO_COMPU_METHOD -3.40282346639E+38 3.40282346639E+38 /end CHARACTERISTIC
/begin CHARACTERISTIC DfMliaPercObj2Vel "" VALUE 0x00000000 __FLOAT32_IEEE_Z 0 NO_COMPU_METHOD -3.40282346639E+38 3.40282346639E+38 /end CHARACTERISTIC
/begin CHARACTERISTIC DfMliaPercObj2Precision "" VALUE 0x00000000 __UBYTE_Z 0 NO_COMPU_METHOD 0 255 /end CHARACTERISTIC
/begin CHARACTERISTIC DfMliaPercObj2LightSts "" VALUE 0x00000000 __UBYTE_Z 0 NO_COMPU_METHOD 0 255 /end CHARACTERISTIC
/begin CHARACTERISTIC DfMliaPercObj2Sz "" VALUE 0x00000000 __FLOAT32_IEEE_Z 0 NO_COMPU_METHOD -3.40282346639E+38 3.40282346639E+38 /end CHARACTERISTIC
/begin CHARACTERISTIC DfMliaPercObj3Detect "" VALUE 0x00000000 __UBYTE_Z 0 NO_COMPU_METHOD 0 255 /end CHARACTERISTIC
/begin CHARACTERISTIC DfMliaPercObj3Sx1 "" VALUE 0x00000000 __FLOAT32_IEEE_Z 0 NO_COMPU_METHOD -3.40282346639E+38 3.40282346639E+38 /end CHARACTERISTIC
/begin CHARACTERISTIC DfMliaPercObj3Sy1 "" VALUE 0x00000000 __FLOAT32_IEEE_Z 0 NO_COMPU_METHOD -3.40282346639E+38 3.40282346639E+38 /end CHARACTERISTIC
/begin CHARACTERISTIC DfMliaPercObj3Sx2 "" VALUE 0x00000000 __FLOAT32_IEEE_Z 0 NO_COMPU_METHOD -3.40282346639E+38 3.40282346639E+38 /end CHARACTERISTIC
/begin CHARACTERISTIC DfMliaPercObj3Sy2 "" VALUE 0x00000000 __FLOAT32_IEEE_Z 0 NO_COMPU_METHOD -3.40282346639E+38 3.40282346639E+38 /end CHARACTERISTIC
/begin CHARACTERISTIC DfMliaPercObj3Vel "" VALUE 0x00000000 __FLOAT32_IEEE_Z 0 NO_COMPU_METHOD -3.40282346639E+38 3.40282346639E+38 /end CHARACTERISTIC
/begin CHARACTERISTIC DfMliaPercObj3Precision "" VALUE 0x00000000 __UBYTE_Z 0 NO_COMPU_METHOD 0 255 /end CHARACTERISTIC
/begin CHARACTERISTIC DfMliaPercObj3LightSts "" VALUE 0x00000000 __UBYTE_Z 0 NO_COMPU_METHOD 0 255 /end CHARACTERISTIC
/begin CHARACTERISTIC DfMliaPercObj3Sz "" VALUE 0x00000000 __FLOAT32_IEEE_Z 0 NO_COMPU_METHOD -3.40282346639E+38 3.40282346639E+38 /end CHARACTERISTIC
/begin CHARACTERISTIC DfMliaPercObj4Detect "" VALUE 0x00000000 __UBYTE_Z 0 NO_COMPU_METHOD 0 255 /end CHARACTERISTIC
/begin CHARACTERISTIC DfMliaPercObj4Sx1 "" VALUE 0x00000000 __FLOAT32_IEEE_Z 0 NO_COMPU_METHOD -3.40282346639E+38 3.40282346639E+38 /end CHARACTERISTIC
/begin CHARACTERISTIC DfMliaPercObj4Sy1 "" VALUE 0x00000000 __FLOAT32_IEEE_Z 0 NO_COMPU_METHOD -3.40282346639E+38 3.40282346639E+38 /end CHARACTERISTIC
/begin CHARACTERISTIC DfMliaPercObj4Sx2 "" VALUE 0x00000000 __FLOAT32_IEEE_Z 0 NO_COMPU_METHOD -3.40282346639E+38 3.40282346639E+38 /end CHARACTERISTIC
/begin CHARACTERISTIC DfMliaPercObj4Sy2 "" VALUE 0x00000000 __FLOAT32_IEEE_Z 0 NO_COMPU_METHOD -3.40282346639E+38 3.40282346639E+38 /end CHARACTERISTIC
/begin CHARACTERISTIC DfMliaPercObj4Vel "" VALUE 0x00000000 __FLOAT32_IEEE_Z 0 NO_COMPU_METHOD -3.40282346639E+38 3.40282346639E+38 /end CHARACTERISTIC
/begin CHARACTERISTIC DfMliaPercObj4Precision "" VALUE 0x00000000 __UBYTE_Z 0 NO_COMPU_METHOD 0 255 /end CHARACTERISTIC
/begin CHARACTERISTIC DfMliaPercObj4LightSts "" VALUE 0x00000000 __UBYTE_Z 0 NO_COMPU_METHOD 0 255 /end CHARACTERISTIC
/begin CHARACTERISTIC DfMliaPercObj4Sz "" VALUE 0x00000000 __FLOAT32_IEEE_Z 0 NO_COMPU_METHOD -3.40282346639E+38 3.40282346639E+38 /end CHARACTERISTIC
/begin CHARACTERISTIC DfMliaPercObj5Detect "" VALUE 0x00000000 __UBYTE_Z 0 NO_COMPU_METHOD 0 255 /end CHARACTERISTIC
/begin CHARACTERISTIC DfMliaPercObj5Sx1 "" VALUE 0x00000000 __FLOAT32_IEEE_Z 0 NO_COMPU_METHOD -3.40282346639E+38 3.40282346639E+38 /end CHARACTERISTIC
/begin CHARACTERISTIC DfMliaPercObj5Sy1 "" VALUE 0x00000000 __FLOAT32_IEEE_Z 0 NO_COMPU_METHOD -3.40282346639E+38 3.40282346639E+38 /end CHARACTERISTIC
/begin CHARACTERISTIC DfMliaPercObj5Sx2 "" VALUE 0x00000000 __FLOAT32_IEEE_Z 0 NO_COMPU_METHOD -3.40282346639E+38 3.40282346639E+38 /end CHARACTERISTIC
/begin CHARACTERISTIC DfMliaPercObj5Sy2 "" VALUE 0x00000000 __FLOAT32_IEEE_Z 0 NO_COMPU_METHOD -3.40282346639E+38 3.40282346639E+38 /end CHARACTERISTIC
/begin CHARACTERISTIC DfMliaPercObj5Vel "" VALUE 0x00000000 __FLOAT32_IEEE_Z 0 NO_COMPU_METHOD -3.40282346639E+38 3.40282346639E+38 /end CHARACTERISTIC
/begin CHARACTERISTIC DfMliaPercObj5Precision "" VALUE 0x00000000 __UBYTE_Z 0 NO_COMPU_METHOD 0 255 /end CHARACTERISTIC
/begin CHARACTERISTIC DfMliaPercObj5LightSts "" VALUE 0x00000000 __UBYTE_Z 0 NO_COMPU_METHOD 0 255 /end CHARACTERISTIC
/begin CHARACTERISTIC DfMliaPercObj5Sz "" VALUE 0x00000000 __FLOAT32_IEEE_Z 0 NO_COMPU_METHOD -3.40282346639E+38 3.40282346639E+38 /end CHARACTERISTIC
/begin CHARACTERISTIC DfMliaPercObj6Detect "" VALUE 0x00000000 __UBYTE_Z 0 NO_COMPU_METHOD 0 255 /end CHARACTERISTIC
/begin CHARACTERISTIC DfMliaPercObj6Sx1 "" VALUE 0x00000000 __FLOAT32_IEEE_Z 0 NO_COMPU_METHOD -3.40282346639E+38 3.40282346639E+38 /end CHARACTERISTIC
/begin CHARACTERISTIC DfMliaPercObj6Sy1 "" VALUE 0x00000000 __FLOAT32_IEEE_Z 0 NO_COMPU_METHOD -3.40282346639E+38 3.40282346639E+38 /end CHARACTERISTIC
/begin CHARACTERISTIC DfMliaPercObj6Sx2 "" VALUE 0x00000000 __FLOAT32_IEEE_Z 0 NO_COMPU_METHOD -3.40282346639E+38 3.40282346639E+38 /end CHARACTERISTIC
/begin CHARACTERISTIC DfMliaPercObj6Sy2 "" VALUE 0x00000000 __FLOAT32_IEEE_Z 0 NO_COMPU_METHOD -3.40282346639E+38 3.40282346639E+38 /end CHARACTERISTIC
/begin CHARACTERISTIC DfMliaPercObj6Vel "" VALUE 0x00000000 __FLOAT32_IEEE_Z 0 NO_COMPU_METHOD -3.40282346639E+38 3.40282346639E+38 /end CHARACTERISTIC
/begin CHARACTERISTIC DfMliaPercObj6Precision "" VALUE 0x00000000 __UBYTE_Z 0 NO_COMPU_METHOD 0 255 /end CHARACTERISTIC
/begin CHARACTERISTIC DfMliaPercObj6LightSts "" VALUE 0x00000000 __UBYTE_Z 0 NO_COMPU_METHOD 0 255 /end CHARACTERISTIC
/begin CHARACTERISTIC DfMliaPercObj6Sz "" VALUE 0x00000000 __FLOAT32_IEEE_Z 0 NO_COMPU_METHOD -3.40282346639E+38 3.40282346639E+38 /end CHARACTERISTIC
/begin CHARACTERISTIC DfMliaPercObj7Detect "" VALUE 0x00000000 __UBYTE_Z 0 NO_COMPU_METHOD 0 255 /end CHARACTERISTIC
/begin CHARACTERISTIC DfMliaPercObj7Sx1 "" VALUE 0x00000000 __FLOAT32_IEEE_Z 0 NO_COMPU_METHOD -3.40282346639E+38 3.40282346639E+38 /end CHARACTERISTIC
/begin CHARACTERISTIC DfMliaPercObj7Sy1 "" VALUE 0x00000000 __FLOAT32_IEEE_Z 0 NO_COMPU_METHOD -3.40282346639E+38 3.40282346639E+38 /end CHARACTERISTIC
/begin CHARACTERISTIC DfMliaPercObj7Sx2 "" VALUE 0x00000000 __FLOAT32_IEEE_Z 0 NO_COMPU_METHOD -3.40282346639E+38 3.40282346639E+38 /end CHARACTERISTIC
/begin CHARACTERISTIC DfMliaPercObj7Sy2 "" VALUE 0x00000000 __FLOAT32_IEEE_Z 0 NO_COMPU_METHOD -3.40282346639E+38 3.40282346639E+38 /end CHARACTERISTIC
/begin CHARACTERISTIC DfMliaPercObj7Vel "" VALUE 0x00000000 __FLOAT32_IEEE_Z 0 NO_COMPU_METHOD -3.40282346639E+38 3.40282346639E+38 /end CHARACTERISTIC
/begin CHARACTERISTIC DfMliaPercObj7Precision "" VALUE 0x00000000 __UBYTE_Z 0 NO_COMPU_METHOD 0 255 /end CHARACTERISTIC
/begin CHARACTERISTIC DfMliaPercObj7LightSts "" VALUE 0x00000000 __UBYTE_Z 0 NO_COMPU_METHOD 0 255 /end CHARACTERISTIC
/begin CHARACTERISTIC DfMliaPercObj7Sz "" VALUE 0x00000000 __FLOAT32_IEEE_Z 0 NO_COMPU_METHOD -3.40282346639E+38 3.40282346639E+38 /end CHARACTERISTIC
/begin CHARACTERISTIC DfMliaPercObj8Detect "" VALUE 0x00000000 __UBYTE_Z 0 NO_COMPU_METHOD 0 255 /end CHARACTERISTIC
/begin CHARACTERISTIC DfMliaPercObj8Sx1 "" VALUE 0x00000000 __FLOAT32_IEEE_Z 0 NO_COMPU_METHOD -3.40282346639E+38 3.40282346639E+38 /end CHARACTERISTIC
/begin CHARACTERISTIC DfMliaPercObj8Sy1 "" VALUE 0x00000000 __FLOAT32_IEEE_Z 0 NO_COMPU_METHOD -3.40282346639E+38 3.40282346639E+38 /end CHARACTERISTIC
/begin CHARACTERISTIC DfMliaPercObj8Sx2 "" VALUE 0x00000000 __FLOAT32_IEEE_Z 0 NO_COMPU_METHOD -3.40282346639E+38 3.40282346639E+38 /end CHARACTERISTIC
/begin CHARACTERISTIC DfMliaPercObj8Sy2 "" VALUE 0x00000000 __FLOAT32_IEEE_Z 0 NO_COMPU_METHOD -3.40282346639E+38 3.40282346639E+38 /end CHARACTERISTIC
/begin CHARACTERISTIC DfMliaPercObj8Vel "" VALUE 0x00000000 __FLOAT32_IEEE_Z 0 NO_COMPU_METHOD -3.40282346639E+38 3.40282346639E+38 /end CHARACTERISTIC
/begin CHARACTERISTIC DfMliaPercObj8Precision "" VALUE 0x00000000 __UBYTE_Z 0 NO_COMPU_METHOD 0 255 /end CHARACTERISTIC
/begin CHARACTERISTIC DfMliaPercObj8LightSts "" VALUE 0x00000000 __UBYTE_Z 0 NO_COMPU_METHOD 0 255 /end CHARACTERISTIC
/begin CHARACTERISTIC DfMliaPercObj8Sz "" VALUE 0x00000000 __FLOAT32_IEEE_Z 0 NO_COMPU_METHOD -3.40282346639E+38 3.40282346639E+38 /end CHARACTERISTIC
/begin CHARACTERISTIC DfMliaPercObj9Detect "" VALUE 0x00000000 __UBYTE_Z 0 NO_COMPU_METHOD 0 255 /end CHARACTERISTIC
/begin CHARACTERISTIC DfMliaPercObj9Sx1 "" VALUE 0x00000000 __FLOAT32_IEEE_Z 0 NO_COMPU_METHOD -3.40282346639E+38 3.40282346639E+38 /end CHARACTERISTIC
/begin CHARACTERISTIC DfMliaPercObj9Sy1 "" VALUE 0x00000000 __FLOAT32_IEEE_Z 0 NO_COMPU_METHOD -3.40282346639E+38 3.40282346639E+38 /end CHARACTERISTIC
/begin CHARACTERISTIC DfMliaPercObj9Sx2 "" VALUE 0x00000000 __FLOAT32_IEEE_Z 0 NO_COMPU_METHOD -3.40282346639E+38 3.40282346639E+38 /end CHARACTERISTIC
/begin CHARACTERISTIC DfMliaPercObj9Sy2 "" VALUE 0x00000000 __FLOAT32_IEEE_Z 0 NO_COMPU_METHOD -3.40282346639E+38 3.40282346639E+38 /end CHARACTERISTIC
/begin CHARACTERISTIC DfMliaPercObj9Vel "" VALUE 0x00000000 __FLOAT32_IEEE_Z 0 NO_COMPU_METHOD -3.40282346639E+38 3.40282346639E+38 /end CHARACTERISTIC
/begin CHARACTERISTIC DfMliaPercObj9Precision "" VALUE 0x00000000 __UBYTE_Z 0 NO_COMPU_METHOD 0 255 /end CHARACTERISTIC
/begin CHARACTERISTIC DfMliaPercObj9LightSts "" VALUE 0x00000000 __UBYTE_Z 0 NO_COMPU_METHOD 0 255 /end CHARACTERISTIC
/begin CHARACTERISTIC DfMliaPercObj9Sz "" VALUE 0x00000000 __FLOAT32_IEEE_Z 0 NO_COMPU_METHOD -3.40282346639E+38 3.40282346639E+38 /end CHARACTERISTIC
/begin CHARACTERISTIC DfMliaPercObj10Detect "" VALUE 0x00000000 __UBYTE_Z 0 NO_COMPU_METHOD 0 255 /end CHARACTERISTIC
/begin CHARACTERISTIC DfMliaPercObj10Sx1 "" VALUE 0x00000000 __FLOAT32_IEEE_Z 0 NO_COMPU_METHOD -3.40282346639E+38 3.40282346639E+38 /end CHARACTERISTIC
/begin CHARACTERISTIC DfMliaPercObj10Sy1 "" VALUE 0x00000000 __FLOAT32_IEEE_Z 0 NO_COMPU_METHOD -3.40282346639E+38 3.40282346639E+38 /end CHARACTERISTIC
/begin CHARACTERISTIC DfMliaPercObj10Sx2 "" VALUE 0x00000000 __FLOAT32_IEEE_Z 0 NO_COMPU_METHOD -3.40282346639E+38 3.40282346639E+38 /end CHARACTERISTIC
/begin CHARACTERISTIC DfMliaPercObj10Sy2 "" VALUE 0x00000000 __FLOAT32_IEEE_Z 0 NO_COMPU_METHOD -3.40282346639E+38 3.40282346639E+38 /end CHARACTERISTIC
/begin CHARACTERISTIC DfMliaPercObj10Vel "" VALUE 0x00000000 __FLOAT32_IEEE_Z 0 NO_COMPU_METHOD -3.40282346639E+38 3.40282346639E+38 /end CHARACTERISTIC
/begin CHARACTERISTIC DfMliaPercObj10Precision "" VALUE 0x00000000 __UBYTE_Z 0 NO_COMPU_METHOD 0 255 /end CHARACTERISTIC
/begin CHARACTERISTIC DfMliaPercObj10LightSts "" VALUE 0x00000000 __UBYTE_Z 0 NO_COMPU_METHOD 0 255 /end CHARACTERISTIC
/begin CHARACTERISTIC DfMliaPercObj10Sz "" VALUE 0x00000000 __FLOAT32_IEEE_Z 0 NO_COMPU_METHOD -3.40282346639E+38 3.40282346639E+38 /end CHARACTERISTIC
/begin CHARACTERISTIC DfMliaPercObj11Detect "" VALUE 0x00000000 __UBYTE_Z 0 NO_COMPU_METHOD 0 255 /end CHARACTERISTIC
/begin CHARACTERISTIC DfMliaPercObj11Sx1 "" VALUE 0x00000000 __FLOAT32_IEEE_Z 0 NO_COMPU_METHOD -3.40282346639E+38 3.40282346639E+38 /end CHARACTERISTIC
/begin CHARACTERISTIC DfMliaPercObj11Sy1 "" VALUE 0x00000000 __FLOAT32_IEEE_Z 0 NO_COMPU_METHOD -3.40282346639E+38 3.40282346639E+38 /end CHARACTERISTIC
/begin CHARACTERISTIC DfMliaPercObj11Sx2 "" VALUE 0x00000000 __FLOAT32_IEEE_Z 0 NO_COMPU_METHOD -3.40282346639E+38 3.40282346639E+38 /end CHARACTERISTIC
/begin CHARACTERISTIC DfMliaPercObj11Sy2 "" VALUE 0x00000000 __FLOAT32_IEEE_Z 0 NO_COMPU_METHOD -3.40282346639E+38 3.40282346639E+38 /end CHARACTERISTIC
/begin CHARACTERISTIC DfMliaPercObj11Vel "" VALUE 0x00000000 __FLOAT32_IEEE_Z 0 NO_COMPU_METHOD -3.40282346639E+38 3.40282346639E+38 /end CHARACTERISTIC
/begin CHARACTERISTIC DfMliaPercObj11Precision "" VALUE 0x00000000 __UBYTE_Z 0 NO_COMPU_METHOD 0 255 /end CHARACTERISTIC
/begin CHARACTERISTIC DfMliaPercObj11LightSts "" VALUE 0x00000000 __UBYTE_Z 0 NO_COMPU_METHOD 0 255 /end CHARACTERISTIC
/begin CHARACTERISTIC DfMliaPercObj11Sz "" VALUE 0x00000000 __FLOAT32_IEEE_Z 0 NO_COMPU_METHOD -3.40282346639E+38 3.40282346639E+38 /end CHARACTERISTIC
/begin CHARACTERISTIC DfMliaPercObj12Detect "" VALUE 0x00000000 __UBYTE_Z 0 NO_COMPU_METHOD 0 255 /end CHARACTERISTIC
/begin CHARACTERISTIC DfMliaPercObj12Sx1 "" VALUE 0x00000000 __FLOAT32_IEEE_Z 0 NO_COMPU_METHOD -3.40282346639E+38 3.40282346639E+38 /end CHARACTERISTIC
/begin CHARACTERISTIC DfMliaPercObj12Sy1 "" VALUE 0x00000000 __FLOAT32_IEEE_Z 0 NO_COMPU_METHOD -3.40282346639E+38 3.40282346639E+38 /end CHARACTERISTIC
/begin CHARACTERISTIC DfMliaPercObj12Sx2 "" VALUE 0x00000000 __FLOAT32_IEEE_Z 0 NO_COMPU_METHOD -3.40282346639E+38 3.40282346639E+38 /end CHARACTERISTIC
/begin CHARACTERISTIC DfMliaPercObj12Sy2 "" VALUE 0x00000000 __FLOAT32_IEEE_Z 0 NO_COMPU_METHOD -3.40282346639E+38 3.40282346639E+38 /end CHARACTERISTIC
/begin CHARACTERISTIC DfMliaPercObj12Vel "" VALUE 0x00000000 __FLOAT32_IEEE_Z 0 NO_COMPU_METHOD -3.40282346639E+38 3.40282346639E+38 /end CHARACTERISTIC
/begin CHARACTERISTIC DfMliaPercObj12Precision "" VALUE 0x00000000 __UBYTE_Z 0 NO_COMPU_METHOD 0 255 /end CHARACTERISTIC
/begin CHARACTERISTIC DfMliaPercObj12LightSts "" VALUE 0x00000000 __UBYTE_Z 0 NO_COMPU_METHOD 0 255 /end CHARACTERISTIC
/begin CHARACTERISTIC DfMliaPercObj12Sz "" VALUE 0x00000000 __FLOAT32_IEEE_Z 0 NO_COMPU_METHOD -3.40282346639E+38 3.40282346639E+38 /end CHARACTERISTIC
/begin CHARACTERISTIC DfMliaPercObj13Detect "" VALUE 0x00000000 __UBYTE_Z 0 NO_COMPU_METHOD 0 255 /end CHARACTERISTIC
/begin CHARACTERISTIC DfMliaPercObj13Sx1 "" VALUE 0x00000000 __FLOAT32_IEEE_Z 0 NO_COMPU_METHOD -3.40282346639E+38 3.40282346639E+38 /end CHARACTERISTIC
/begin CHARACTERISTIC DfMliaPercObj13Sy1 "" VALUE 0x00000000 __FLOAT32_IEEE_Z 0 NO_COMPU_METHOD -3.40282346639E+38 3.40282346639E+38 /end CHARACTERISTIC
/begin CHARACTERISTIC DfMliaPercObj13Sx2 "" VALUE 0x00000000 __FLOAT32_IEEE_Z 0 NO_COMPU_METHOD -3.40282346639E+38 3.40282346639E+38 /end CHARACTERISTIC
/begin CHARACTERISTIC DfMliaPercObj13Sy2 "" VALUE 0x00000000 __FLOAT32_IEEE_Z 0 NO_COMPU_METHOD -3.40282346639E+38 3.40282346639E+38 /end CHARACTERISTIC
/begin CHARACTERISTIC DfMliaPercObj13Vel "" VALUE 0x00000000 __FLOAT32_IEEE_Z 0 NO_COMPU_METHOD -3.40282346639E+38 3.40282346639E+38 /end CHARACTERISTIC
/begin CHARACTERISTIC DfMliaPercObj13Precision "" VALUE 0x00000000 __UBYTE_Z 0 NO_COMPU_METHOD 0 255 /end CHARACTERISTIC
/begin CHARACTERISTIC DfMliaPercObj13LightSts "" VALUE 0x00000000 __UBYTE_Z 0 NO_COMPU_METHOD 0 255 /end CHARACTERISTIC
/begin CHARACTERISTIC DfMliaPercObj13Sz "" VALUE 0x00000000 __FLOAT32_IEEE_Z 0 NO_COMPU_METHOD -3.40282346639E+38 3.40282346639E+38 /end CHARACTERISTIC
/begin CHARACTERISTIC DfMliaPercObj14Detect "" VALUE 0x00000000 __UBYTE_Z 0 NO_COMPU_METHOD 0 255 /end CHARACTERISTIC
/begin CHARACTERISTIC DfMliaPercObj14Sx1 "" VALUE 0x00000000 __FLOAT32_IEEE_Z 0 NO_COMPU_METHOD -3.40282346639E+38 3.40282346639E+38 /end CHARACTERISTIC
/begin CHARACTERISTIC DfMliaPercObj14Sy1 "" VALUE 0x00000000 __FLOAT32_IEEE_Z 0 NO_COMPU_METHOD -3.40282346639E+38 3.40282346639E+38 /end CHARACTERISTIC
/begin CHARACTERISTIC DfMliaPercObj14Sx2 "" VALUE 0x00000000 __FLOAT32_IEEE_Z 0 NO_COMPU_METHOD -3.40282346639E+38 3.40282346639E+38 /end CHARACTERISTIC
/begin CHARACTERISTIC DfMliaPercObj14Sy2 "" VALUE 0x00000000 __FLOAT32_IEEE_Z 0 NO_COMPU_METHOD -3.40282346639E+38 3.40282346639E+38 /end CHARACTERISTIC
/begin CHARACTERISTIC DfMliaPercObj14Vel "" VALUE 0x00000000 __FLOAT32_IEEE_Z 0 NO_COMPU_METHOD -3.40282346639E+38 3.40282346639E+38 /end CHARACTERISTIC
/begin CHARACTERISTIC DfMliaPercObj14Precision "" VALUE 0x00000000 __UBYTE_Z 0 NO_COMPU_METHOD 0 255 /end CHARACTERISTIC
/begin CHARACTERISTIC DfMliaPercObj14LightSts "" VALUE 0x00000000 __UBYTE_Z 0 NO_COMPU_METHOD 0 255 /end CHARACTERISTIC
/begin CHARACTERISTIC DfMliaPercObj14Sz "" VALUE 0x00000000 __FLOAT32_IEEE_Z 0 NO_COMPU_METHOD -3.40282346639E+38 3.40282346639E+38 /end CHARACTERISTIC
/begin CHARACTERISTIC DfMliaPercObj15Detect "" VALUE 0x00000000 __UBYTE_Z 0 NO_COMPU_METHOD 0 255 /end CHARACTERISTIC
/begin CHARACTERISTIC DfMliaPercObj15Sx1 "" VALUE 0x00000000 __FLOAT32_IEEE_Z 0 NO_COMPU_METHOD -3.40282346639E+38 3.40282346639E+38 /end CHARACTERISTIC
/begin CHARACTERISTIC DfMliaPercObj15Sy1 "" VALUE 0x00000000 __FLOAT32_IEEE_Z 0 NO_COMPU_METHOD -3.40282346639E+38 3.40282346639E+38 /end CHARACTERISTIC
/begin CHARACTERISTIC DfMliaPercObj15Sx2 "" VALUE 0x00000000 __FLOAT32_IEEE_Z 0 NO_COMPU_METHOD -3.40282346639E+38 3.40282346639E+38 /end CHARACTERISTIC
/begin CHARACTERISTIC DfMliaPercObj15Sy2 "" VALUE 0x00000000 __FLOAT32_IEEE_Z 0 NO_COMPU_METHOD -3.40282346639E+38 3.40282346639E+38 /end CHARACTERISTIC
/begin CHARACTERISTIC DfMliaPercObj15Vel "" VALUE 0x00000000 __FLOAT32_IEEE_Z 0 NO_COMPU_METHOD -3.40282346639E+38 3.40282346639E+38 /end CHARACTERISTIC
/begin CHARACTERISTIC DfMliaPercObj15Precision "" VALUE 0x00000000 __UBYTE_Z 0 NO_COMPU_METHOD 0 255 /end CHARACTERISTIC
/begin CHARACTERISTIC DfMliaPercObj15LightSts "" VALUE 0x00000000 __UBYTE_Z 0 NO_COMPU_METHOD 0 255 /end CHARACTERISTIC
/begin CHARACTERISTIC DfMliaPercObj15Sz "" VALUE 0x00000000 __FLOAT32_IEEE_Z 0 NO_COMPU_METHOD -3.40282346639E+38 3.40282346639E+38 /end CHARACTERISTIC
/begin CHARACTERISTIC DfMliaPercObj16Detect "" VALUE 0x00000000 __UBYTE_Z 0 NO_COMPU_METHOD 0 255 /end CHARACTERISTIC
/begin CHARACTERISTIC DfMliaPercObj16Sx1 "" VALUE 0x00000000 __FLOAT32_IEEE_Z 0 NO_COMPU_METHOD -3.40282346639E+38 3.40282346639E+38 /end CHARACTERISTIC
/begin CHARACTERISTIC DfMliaPercObj16Sy1 "" VALUE 0x00000000 __FLOAT32_IEEE_Z 0 NO_COMPU_METHOD -3.40282346639E+38 3.40282346639E+38 /end CHARACTERISTIC
/begin CHARACTERISTIC DfMliaPercObj16Sx2 "" VALUE 0x00000000 __FLOAT32_IEEE_Z 0 NO_COMPU_METHOD -3.40282346639E+38 3.40282346639E+38 /end CHARACTERISTIC
/begin CHARACTERISTIC DfMliaPercObj16Sy2 "" VALUE 0x00000000 __FLOAT32_IEEE_Z 0 NO_COMPU_METHOD -3.40282346639E+38 3.40282346639E+38 /end CHARACTERISTIC
/begin CHARACTERISTIC DfMliaPercObj16Vel "" VALUE 0x00000000 __FLOAT32_IEEE_Z 0 NO_COMPU_METHOD -3.40282346639E+38 3.40282346639E+38 /end CHARACTERISTIC
/begin CHARACTERISTIC DfMliaPercObj16Precision "" VALUE 0x00000000 __UBYTE_Z 0 NO_COMPU_METHOD 0 255 /end CHARACTERISTIC
/begin CHARACTERISTIC DfMliaPercObj16LightSts "" VALUE 0x00000000 __UBYTE_Z 0 NO_COMPU_METHOD 0 255 /end CHARACTERISTIC
/begin CHARACTERISTIC DfMliaPercObj16Sz "" VALUE 0x00000000 __FLOAT32_IEEE_Z 0 NO_COMPU_METHOD -3.40282346639E+38 3.40282346639E+38 /end CHARACTERISTIC
/begin CHARACTERISTIC DfMliaPercObj17Detect "" VALUE 0x00000000 __UBYTE_Z 0 NO_COMPU_METHOD 0 255 /end CHARACTERISTIC
/begin CHARACTERISTIC DfMliaPercObj17Sx1 "" VALUE 0x00000000 __FLOAT32_IEEE_Z 0 NO_COMPU_METHOD -3.40282346639E+38 3.40282346639E+38 /end CHARACTERISTIC
/begin CHARACTERISTIC DfMliaPercObj17Sy1 "" VALUE 0x00000000 __FLOAT32_IEEE_Z 0 NO_COMPU_METHOD -3.40282346639E+38 3.40282346639E+38 /end CHARACTERISTIC
/begin CHARACTERISTIC DfMliaPercObj17Sx2 "" VALUE 0x00000000 __FLOAT32_IEEE_Z 0 NO_COMPU_METHOD -3.40282346639E+38 3.40282346639E+38 /end CHARACTERISTIC
/begin CHARACTERISTIC DfMliaPercObj17Sy2 "" VALUE 0x00000000 __FLOAT32_IEEE_Z 0 NO_COMPU_METHOD -3.40282346639E+38 3.40282346639E+38 /end CHARACTERISTIC
/begin CHARACTERISTIC DfMliaPercObj17Vel "" VALUE 0x00000000 __FLOAT32_IEEE_Z 0 NO_COMPU_METHOD -3.40282346639E+38 3.40282346639E+38 /end CHARACTERISTIC
/begin CHARACTERISTIC DfMliaPercObj17Precision "" VALUE 0x00000000 __UBYTE_Z 0 NO_COMPU_METHOD 0 255 /end CHARACTERISTIC
/begin CHARACTERISTIC DfMliaPercObj17LightSts "" VALUE 0x00000000 __UBYTE_Z 0 NO_COMPU_METHOD 0 255 /end CHARACTERISTIC
/begin CHARACTERISTIC DfMliaPercObj17Sz "" VALUE 0x00000000 __FLOAT32_IEEE_Z 0 NO_COMPU_METHOD -3.40282346639E+38 3.40282346639E+38 /end CHARACTERISTIC
/begin CHARACTERISTIC DfMliaPercObj18Detect "" VALUE 0x00000000 __UBYTE_Z 0 NO_COMPU_METHOD 0 255 /end CHARACTERISTIC
/begin CHARACTERISTIC DfMliaPercObj18Sx1 "" VALUE 0x00000000 __FLOAT32_IEEE_Z 0 NO_COMPU_METHOD -3.40282346639E+38 3.40282346639E+38 /end CHARACTERISTIC
/begin CHARACTERISTIC DfMliaPercObj18Sy1 "" VALUE 0x00000000 __FLOAT32_IEEE_Z 0 NO_COMPU_METHOD -3.40282346639E+38 3.40282346639E+38 /end CHARACTERISTIC
/begin CHARACTERISTIC DfMliaPercObj18Sx2 "" VALUE 0x00000000 __FLOAT32_IEEE_Z 0 NO_COMPU_METHOD -3.40282346639E+38 3.40282346639E+38 /end CHARACTERISTIC
/begin CHARACTERISTIC DfMliaPercObj18Sy2 "" VALUE 0x00000000 __FLOAT32_IEEE_Z 0 NO_COMPU_METHOD -3.40282346639E+38 3.40282346639E+38 /end CHARACTERISTIC
/begin CHARACTERISTIC DfMliaPercObj18Vel "" VALUE 0x00000000 __FLOAT32_IEEE_Z 0 NO_COMPU_METHOD -3.40282346639E+38 3.40282346639E+38 /end CHARACTERISTIC
/begin CHARACTERISTIC DfMliaPercObj18Precision "" VALUE 0x00000000 __UBYTE_Z 0 NO_COMPU_METHOD 0 255 /end CHARACTERISTIC
/begin CHARACTERISTIC DfMliaPercObj18LightSts "" VALUE 0x00000000 __UBYTE_Z 0 NO_COMPU_METHOD 0 255 /end CHARACTERISTIC
/begin CHARACTERISTIC DfMliaPercObj18Sz "" VALUE 0x00000000 __FLOAT32_IEEE_Z 0 NO_COMPU_METHOD -3.40282346639E+38 3.40282346639E+38 /end CHARACTERISTIC
/begin CHARACTERISTIC DfMliaPercObj19Detect "" VALUE 0x00000000 __UBYTE_Z 0 NO_COMPU_METHOD 0 255 /end CHARACTERISTIC
/begin CHARACTERISTIC DfMliaPercObj19Sx1 "" VALUE 0x00000000 __FLOAT32_IEEE_Z 0 NO_COMPU_METHOD -3.40282346639E+38 3.40282346639E+38 /end CHARACTERISTIC
/begin CHARACTERISTIC DfMliaPercObj19Sy1 "" VALUE 0x00000000 __FLOAT32_IEEE_Z 0 NO_COMPU_METHOD -3.40282346639E+38 3.40282346639E+38 /end CHARACTERISTIC
/begin CHARACTERISTIC DfMliaPercObj19Sx2 "" VALUE 0x00000000 __FLOAT32_IEEE_Z 0 NO_COMPU_METHOD -3.40282346639E+38 3.40282346639E+38 /end CHARACTERISTIC
/begin CHARACTERISTIC DfMliaPercObj19Sy2 "" VALUE 0x00000000 __FLOAT32_IEEE_Z 0 NO_COMPU_METHOD -3.40282346639E+38 3.40282346639E+38 /end CHARACTERISTIC
/begin CHARACTERISTIC DfMliaPercObj19Vel "" VALUE 0x00000000 __FLOAT32_IEEE_Z 0 NO_COMPU_METHOD -3.40282346639E+38 3.40282346639E+38 /end CHARACTERISTIC
/begin CHARACTERISTIC DfMliaPercObj19Precision "" VALUE 0x00000000 __UBYTE_Z 0 NO_COMPU_METHOD 0 255 /end CHARACTERISTIC
/begin CHARACTERISTIC DfMliaPercObj19LightSts "" VALUE 0x00000000 __UBYTE_Z 0 NO_COMPU_METHOD 0 255 /end CHARACTERISTIC
/begin CHARACTERISTIC DfMliaPercObj19Sz "" VALUE 0x00000000 __FLOAT32_IEEE_Z 0 NO_COMPU_METHOD -3.40282346639E+38 3.40282346639E+38 /end CHARACTERISTIC
/begin CHARACTERISTIC DfMliaPercObj20Detect "" VALUE 0x00000000 __UBYTE_Z 0 NO_COMPU_METHOD 0 255 /end CHARACTERISTIC
/begin CHARACTERISTIC DfMliaPercObj20Sx1 "" VALUE 0x00000000 __FLOAT32_IEEE_Z 0 NO_COMPU_METHOD -3.40282346639E+38 3.40282346639E+38 /end CHARACTERISTIC
/begin CHARACTERISTIC DfMliaPercObj20Sy1 "" VALUE 0x00000000 __FLOAT32_IEEE_Z 0 NO_COMPU_METHOD -3.40282346639E+38 3.40282346639E+38 /end CHARACTERISTIC
/begin CHARACTERISTIC DfMliaPercObj20Sx2 "" VALUE 0x00000000 __FLOAT32_IEEE_Z 0 NO_COMPU_METHOD -3.40282346639E+38 3.40282346639E+38 /end CHARACTERISTIC
/begin CHARACTERISTIC DfMliaPercObj20Sy2 "" VALUE 0x00000000 __FLOAT32_IEEE_Z 0 NO_COMPU_METHOD -3.40282346639E+38 3.40282346639E+38 /end CHARACTERISTIC
/begin CHARACTERISTIC DfMliaPercObj20Vel "" VALUE 0x00000000 __FLOAT32_IEEE_Z 0 NO_COMPU_METHOD -3.40282346639E+38 3.40282346639E+38 /end CHARACTERISTIC
/begin CHARACTERISTIC DfMliaPercObj20Precision "" VALUE 0x00000000 __UBYTE_Z 0 NO_COMPU_METHOD 0 255 /end CHARACTERISTIC
/begin CHARACTERISTIC DfMliaPercObj20LightSts "" VALUE 0x00000000 __UBYTE_Z 0 NO_COMPU_METHOD 0 255 /end CHARACTERISTIC
/begin CHARACTERISTIC DfMliaPercObj20Sz "" VALUE 0x00000000 __FLOAT32_IEEE_Z 0 NO_COMPU_METHOD -3.40282346639E+38 3.40282346639E+38 /end CHARACTERISTIC
/begin CHARACTERISTIC DfMliaPercObj21Detect "" VALUE 0x00000000 __UBYTE_Z 0 NO_COMPU_METHOD 0 255 /end CHARACTERISTIC
/begin CHARACTERISTIC DfMliaPercObj21Sx1 "" VALUE 0x00000000 __FLOAT32_IEEE_Z 0 NO_COMPU_METHOD -3.40282346639E+38 3.40282346639E+38 /end CHARACTERISTIC
/begin CHARACTERISTIC DfMliaPercObj21Sy1 "" VALUE 0x00000000 __FLOAT32_IEEE_Z 0 NO_COMPU_METHOD -3.40282346639E+38 3.40282346639E+38 /end CHARACTERISTIC
/begin CHARACTERISTIC DfMliaPercObj21Sx2 "" VALUE 0x00000000 __FLOAT32_IEEE_Z 0 NO_COMPU_METHOD -3.40282346639E+38 3.40282346639E+38 /end CHARACTERISTIC
/begin CHARACTERISTIC DfMliaPercObj21Sy2 "" VALUE 0x00000000 __FLOAT32_IEEE_Z 0 NO_COMPU_METHOD -3.40282346639E+38 3.40282346639E+38 /end CHARACTERISTIC
/begin CHARACTERISTIC DfMliaPercObj21Vel "" VALUE 0x00000000 __FLOAT32_IEEE_Z 0 NO_COMPU_METHOD -3.40282346639E+38 3.40282346639E+38 /end CHARACTERISTIC
/begin CHARACTERISTIC DfMliaPercObj21Precision "" VALUE 0x00000000 __UBYTE_Z 0 NO_COMPU_METHOD 0 255 /end CHARACTERISTIC
/begin CHARACTERISTIC DfMliaPercObj21LightSts "" VALUE 0x00000000 __UBYTE_Z 0 NO_COMPU_METHOD 0 255 /end CHARACTERISTIC
/begin CHARACTERISTIC DfMliaPercObj21Sz "" VALUE 0x00000000 __FLOAT32_IEEE_Z 0 NO_COMPU_METHOD -3.40282346639E+38 3.40282346639E+38 /end CHARACTERISTIC
/begin CHARACTERISTIC DfGpuTemp "" VALUE 0x00000000 __FLOAT32_IEEE_Z 0 NO_COMPU_METHOD -3.40282346639E+38 3.40282346639E+38 /end CHARACTERISTIC
/begin CHARACTERISTIC DfGpuFrcuErrorSts "" VALUE 0x00000000 __UBYTE_Z 0 NO_COMPU_METHOD 0 255 /end CHARACTERISTIC
/begin CHARACTERISTIC DfGpuFcuWErrorSts "" VALUE 0x00000000 __UBYTE_Z 0 NO_COMPU_METHOD 0 255 /end CHARACTERISTIC
/begin CHARACTERISTIC DfGpuFcuNErrorSts "" VALUE 0x00000000 __UBYTE_Z 0 NO_COMPU_METHOD 0 255 /end CHARACTERISTIC
/begin CHARACTERISTIC DfGpuTicuErrorSts "" VALUE 0x00000000 __UBYTE_Z 0 NO_COMPU_METHOD 0 255 /end CHARACTERISTIC
/begin CHARACTERISTIC DfGpuLidarErrorSts "" VALUE 0x00000000 __UBYTE_Z 0 NO_COMPU_METHOD 0 255 /end CHARACTERISTIC
/begin CHARACTERISTIC DfGpuFrcuVirtYaw "" VALUE 0x00000000 __FLOAT32_IEEE_Z 0 NO_COMPU_METHOD -3.40282346639E+38 3.40282346639E+38 /end CHARACTERISTIC
/begin CHARACTERISTIC DfGpuFrcuProb "" VALUE 0x00000000 __FLOAT32_IEEE_Z 0 NO_COMPU_METHOD -3.40282346639E+38 3.40282346639E+38 /end CHARACTERISTIC
/begin CHARACTERISTIC DfGpuFcuCalibSts "" VALUE 0x00000000 __UBYTE_Z 0 NO_COMPU_METHOD 0 255 /end CHARACTERISTIC
/begin CHARACTERISTIC DfGpuFcuStaticAngYaw "" VALUE 0x00000000 __FLOAT32_IEEE_Z 0 NO_COMPU_METHOD -3.40282346639E+38 3.40282346639E+38 /end CHARACTERISTIC
/begin CHARACTERISTIC DfGpuFcuStaticAngPitch "" VALUE 0x00000000 __FLOAT32_IEEE_Z 0 NO_COMPU_METHOD -3.40282346639E+38 3.40282346639E+38 /end CHARACTERISTIC
/begin CHARACTERISTIC DfGpuFcuVirtYaw "" VALUE 0x00000000 __FLOAT32_IEEE_Z 0 NO_COMPU_METHOD -3.40282346639E+38 3.40282346639E+38 /end CHARACTERISTIC
/begin CHARACTERISTIC DfGpuTicuCalibSts "" VALUE 0x00000000 __UBYTE_Z 0 NO_COMPU_METHOD 0 255 /end CHARACTERISTIC
/begin CHARACTERISTIC DfGpuTicuVirtYaw "" VALUE 0x00000000 __FLOAT32_IEEE_Z 0 NO_COMPU_METHOD -3.40282346639E+38 3.40282346639E+38 /end CHARACTERISTIC
/begin CHARACTERISTIC DfGpuTicuStaticYaw "" VALUE 0x00000000 __FLOAT32_IEEE_Z 0 NO_COMPU_METHOD -3.40282346639E+38 3.40282346639E+38 /end CHARACTERISTIC
/begin CHARACTERISTIC DfGpuTicuStaticPitch "" VALUE 0x00000000 __FLOAT32_IEEE_Z 0 NO_COMPU_METHOD -3.40282346639E+38 3.40282346639E+38 /end CHARACTERISTIC
/begin CHARACTERISTIC DfGpuLidCalibSts "" VALUE 0x00000000 __UBYTE_Z 0 NO_COMPU_METHOD 0 255 /end CHARACTERISTIC
/begin CHARACTERISTIC DfGpuLidVirtYaw "" VALUE 0x00000000 __FLOAT32_IEEE_Z 0 NO_COMPU_METHOD -3.40282346639E+38 3.40282346639E+38 /end CHARACTERISTIC
/begin CHARACTERISTIC DfGpuLidStaticYaw "" VALUE 0x00000000 __FLOAT32_IEEE_Z 0 NO_COMPU_METHOD -3.40282346639E+38 3.40282346639E+38 /end CHARACTERISTIC
/begin CHARACTERISTIC DfGpuLidStaticPitch "" VALUE 0x00000000 __FLOAT32_IEEE_Z 0 NO_COMPU_METHOD -3.40282346639E+38 3.40282346639E+38 /end CHARACTERISTIC
/begin CHARACTERISTIC DfGpuTemp "" VALUE 0x00000000 __FLOAT32_IEEE_Z 0 NO_COMPU_METHOD -3.40282346639E+38 3.40282346639E+38 /end CHARACTERISTIC
/begin CHARACTERISTIC DfGpuFrcuErrorSts "" VALUE 0x00000000 __UBYTE_Z 0 NO_COMPU_METHOD 0 255 /end CHARACTERISTIC
/begin CHARACTERISTIC DfGpuFcuWErrorSts "" VALUE 0x00000000 __UBYTE_Z 0 NO_COMPU_METHOD 0 255 /end CHARACTERISTIC
/begin CHARACTERISTIC DfGpuFcuNErrorSts "" VALUE 0x00000000 __UBYTE_Z 0 NO_COMPU_METHOD 0 255 /end CHARACTERISTIC
/begin CHARACTERISTIC DfGpuTicuErrorSts "" VALUE 0x00000000 __UBYTE_Z 0 NO_COMPU_METHOD 0 255 /end CHARACTERISTIC
/begin CHARACTERISTIC DfGpuLidarErrorSts "" VALUE 0x00000000 __UBYTE_Z 0 NO_COMPU_METHOD 0 255 /end CHARACTERISTIC
/begin CHARACTERISTIC DfGpuFrcuVirtYaw "" VALUE 0x00000000 __FLOAT32_IEEE_Z 0 NO_COMPU_METHOD -3.40282346639E+38 3.40282346639E+38 /end CHARACTERISTIC
/begin CHARACTERISTIC DfGpuFrcuProb "" VALUE 0x00000000 __FLOAT32_IEEE_Z 0 NO_COMPU_METHOD -3.40282346639E+38 3.40282346639E+38 /end CHARACTERISTIC
/begin CHARACTERISTIC DfGpuFcuCalibSts "" VALUE 0x00000000 __UBYTE_Z 0 NO_COMPU_METHOD 0 255 /end CHARACTERISTIC
/begin CHARACTERISTIC DfGpuFcuStaticAngYaw "" VALUE 0x00000000 __FLOAT32_IEEE_Z 0 NO_COMPU_METHOD -3.40282346639E+38 3.40282346639E+38 /end CHARACTERISTIC
/begin CHARACTERISTIC DfGpuFcuStaticAngPitch "" VALUE 0x00000000 __FLOAT32_IEEE_Z 0 NO_COMPU_METHOD -3.40282346639E+38 3.40282346639E+38 /end CHARACTERISTIC
/begin CHARACTERISTIC DfGpuFcuVirtYaw "" VALUE 0x00000000 __FLOAT32_IEEE_Z 0 NO_COMPU_METHOD -3.40282346639E+38 3.40282346639E+38 /end CHARACTERISTIC
/begin CHARACTERISTIC DfGpuTicuCalibSts "" VALUE 0x00000000 __UBYTE_Z 0 NO_COMPU_METHOD 0 255 /end CHARACTERISTIC
/begin CHARACTERISTIC DfGpuTicuVirtYaw "" VALUE 0x00000000 __FLOAT32_IEEE_Z 0 NO_COMPU_METHOD -3.40282346639E+38 3.40282346639E+38 /end CHARACTERISTIC
/begin CHARACTERISTIC DfGpuTicuStaticYaw "" VALUE 0x00000000 __FLOAT32_IEEE_Z 0 NO_COMPU_METHOD -3.40282346639E+38 3.40282346639E+38 /end CHARACTERISTIC
/begin CHARACTERISTIC DfGpuTicuStaticPitch "" VALUE 0x00000000 __FLOAT32_IEEE_Z 0 NO_COMPU_METHOD -3.40282346639E+38 3.40282346639E+38 /end CHARACTERISTIC
/begin CHARACTERISTIC DfGpuLidCalibSts "" VALUE 0x00000000 __UBYTE_Z 0 NO_COMPU_METHOD 0 255 /end CHARACTERISTIC
/begin CHARACTERISTIC DfGpuLidVirtYaw "" VALUE 0x00000000 __FLOAT32_IEEE_Z 0 NO_COMPU_METHOD -3.40282346639E+38 3.40282346639E+38 /end CHARACTERISTIC
/begin CHARACTERISTIC DfGpuLidStaticYaw "" VALUE 0x00000000 __FLOAT32_IEEE_Z 0 NO_COMPU_METHOD -3.40282346639E+38 3.40282346639E+38 /end CHARACTERISTIC
/begin CHARACTERISTIC DfGpuLidStaticPitch "" VALUE 0x00000000 __FLOAT32_IEEE_Z 0 NO_COMPU_METHOD -3.40282346639E+38 3.40282346639E+38 /end CHARACTERISTIC
/begin CHARACTERISTIC ADAS_RCW_W "" VALUE 0x00000000 __UBYTE_Z 0 NO_COMPU_METHOD 0 255 /end CHARACTERISTIC
/begin CHARACTERISTIC ADAS_LCA_R_W "" VALUE 0x00000000 __UBYTE_Z 0 NO_COMPU_METHOD 0 255 /end CHARACTERISTIC
/begin CHARACTERISTIC ADAS_BSD_R_W "" VALUE 0x00000000 __UBYTE_Z 0 NO_COMPU_METHOD 0 255 /end CHARACTERISTIC
/begin CHARACTERISTIC ADAS_RCTA_R_W "" VALUE 0x00000000 __UBYTE_Z 0 NO_COMPU_METHOD 0 255 /end CHARACTERISTIC
/begin CHARACTERISTIC ADAS_DOW_R_W "" VALUE 0x00000000 __UBYTE_Z 0 NO_COMPU_METHOD 0 255 /end CHARACTERISTIC
/begin CHARACTERISTIC ADAS_RCTB_R_W "" VALUE 0x00000000 __UBYTE_Z 0 NO_COMPU_METHOD 0 255 /end CHARACTERISTIC
/begin CHARACTERISTIC ADAS_LCA_L_W "" VALUE 0x00000000 __UBYTE_Z 0 NO_COMPU_METHOD 0 255 /end CHARACTERISTIC
/begin CHARACTERISTIC ADAS_BSD_L_W "" VALUE 0x00000000 __UBYTE_Z 0 NO_COMPU_METHOD 0 255 /end CHARACTERISTIC
/begin CHARACTERISTIC ADAS_RCTA_L_W "" VALUE 0x00000000 __UBYTE_Z 0 NO_COMPU_METHOD 0 255 /end CHARACTERISTIC
/begin CHARACTERISTIC ADAS_DOW_L_W "" VALUE 0x00000000 __UBYTE_Z 0 NO_COMPU_METHOD 0 255 /end CHARACTERISTIC
/begin CHARACTERISTIC ADAS_RCTB_L_W "" VALUE 0x00000000 __UBYTE_Z 0 NO_COMPU_METHOD 0 255 /end CHARACTERISTIC
/begin CHARACTERISTIC Str_Angle "" VALUE 0x00000000 __FLOAT32_IEEE_Z 0 NO_COMPU_METHOD -3.40282346639E+38 3.40282346639E+38 /end CHARACTERISTIC
/begin CHARACTERISTIC Str_Angle_V "" VALUE 0x00000000 __UBYTE_Z 0 NO_COMPU_METHOD 0 255 /end CHARACTERISTIC
/begin CHARACTERISTIC VehSpeed_IN "" VALUE 0x00000000 __FLOAT32_IEEE_Z 0 NO_COMPU_METHOD -3.40282346639E+38 3.40282346639E+38 /end CHARACTERISTIC
/begin CHARACTERISTIC VehSpeed_V "" VALUE 0x00000000 __UBYTE_Z 0 NO_COMPU_METHOD 0 255 /end CHARACTERISTIC
/begin CHARACTERISTIC YawRat_V "" VALUE 0x00000000 __UBYTE_Z 0 NO_COMPU_METHOD 0 255 /end CHARACTERISTIC
/begin CHARACTERISTIC YawRate_IN "" VALUE 0x00000000 __FLOAT32_IEEE_Z 0 NO_COMPU_METHOD -3.40282346639E+38 3.40282346639E+38 /end CHARACTERISTIC
/begin CHARACTERISTIC GEAR_STA_NOW_V "" VALUE 0x00000000 __UBYTE_Z 0 NO_COMPU_METHOD 0 255 /end CHARACTERISTIC
/begin CHARACTERISTIC GEAR_STATE_NOW "" VALUE 0x00000000 __UBYTE_Z 0 NO_COMPU_METHOD 0 255 /end CHARACTERISTIC
/begin CHARACTERISTIC IGN_State "" VALUE 0x00000000 __UBYTE_Z 0 NO_COMPU_METHOD 0 255 /end CHARACTERISTIC
/begin CHARACTERISTIC IGN_State_V "" VALUE 0x00000000 __UBYTE_Z 0 NO_COMPU_METHOD 0 255 /end CHARACTERISTIC
/begin CHARACTERISTIC DriverDoorSts "" VALUE 0x00000000 __UBYTE_Z 0 NO_COMPU_METHOD 0 255 /end CHARACTERISTIC
/begin CHARACTERISTIC LeftTurnSWSts "" VALUE 0x00000000 __UBYTE_Z 0 NO_COMPU_METHOD 0 255 /end CHARACTERISTIC
/begin CHARACTERISTIC LockSts "" VALUE 0x00000000 __UBYTE_Z 0 NO_COMPU_METHOD 0 255 /end CHARACTERISTIC
/begin CHARACTERISTIC PassengerDoorSts "" VALUE 0x00000000 __UBYTE_Z 0 NO_COMPU_METHOD 0 255 /end CHARACTERISTIC
/begin CHARACTERISTIC RightTurnSWSts "" VALUE 0x00000000 __UBYTE_Z 0 NO_COMPU_METHOD 0 255 /end CHARACTERISTIC
/begin CHARACTERISTIC RLDoorSts "" VALUE 0x00000000 __UBYTE_Z 0 NO_COMPU_METHOD 0 255 /end CHARACTERISTIC
/begin CHARACTERISTIC RRDoorSts "" VALUE 0x00000000 __UBYTE_Z 0 NO_COMPU_METHOD 0 255 /end CHARACTERISTIC
/begin CHARACTERISTIC ComScl_UDP_MainDataFromPerc_Timeout "" VALUE 0x00000000 __UBYTE_Z 0 NO_COMPU_METHOD 0 255 /end CHARACTERISTIC
/begin CHARACTERISTIC ComScl_UDP_FrontPas_Timeout "" VALUE 0x00000000 __UBYTE_Z 0 NO_COMPU_METHOD 0 255 /end CHARACTERISTIC
/begin CHARACTERISTIC ComScl_UDP_RearPass_Timeout "" VALUE 0x00000000 __UBYTE_Z 0 NO_COMPU_METHOD 0 255 /end CHARACTERISTIC
/begin CHARACTERISTIC ComScl_UDP_Lane_Timeout "" VALUE 0x00000000 __UBYTE_Z 0 NO_COMPU_METHOD 0 255 /end CHARACTERISTIC
/begin CHARACTERISTIC ComScl_UDP_SignPerc_Timeout "" VALUE 0x00000000 __UBYTE_Z 0 NO_COMPU_METHOD 0 255 /end CHARACTERISTIC
/begin CHARACTERISTIC ComScl_UDP_MliaPerc_Timeout "" VALUE 0x00000000 __UBYTE_Z 0 NO_COMPU_METHOD 0 255 /end CHARACTERISTIC
/begin CHARACTERISTIC ComScl_UDP_GPU_States_Timeout "" VALUE 0x00000000 __UBYTE_Z 0 NO_COMPU_METHOD 0 255 /end CHARACTERISTIC
/begin CHARACTERISTIC ComScl_ACU_01_Timeout "" VALUE 0x00000000 __UBYTE_Z 0 NO_COMPU_METHOD 0 255 /end CHARACTERISTIC
/begin CHARACTERISTIC ComScl_ATC_TX_Timeout "" VALUE 0x00000000 __UBYTE_Z 0 NO_COMPU_METHOD 0 255 /end CHARACTERISTIC
/begin CHARACTERISTIC ComScl_BCM_CLIMATIC_DATA_Timeout "" VALUE 0x00000000 __UBYTE_Z 0 NO_COMPU_METHOD 0 255 /end CHARACTERISTIC
/begin CHARACTERISTIC ComScl_BCM_DMS_01_Timeout "" VALUE 0x00000000 __UBYTE_Z 0 NO_COMPU_METHOD 0 255 /end CHARACTERISTIC
/begin CHARACTERISTIC ComScl_BCM_EXT_LGT_Timeout "" VALUE 0x00000000 __UBYTE_Z 0 NO_COMPU_METHOD 0 255 /end CHARACTERISTIC
/begin CHARACTERISTIC ComScl_BCM_IC_Info_Msg_Timeout "" VALUE 0x00000000 __UBYTE_Z 0 NO_COMPU_METHOD 0 255 /end CHARACTERISTIC
/begin CHARACTERISTIC ComScl_BCM_Lock_CTR_Timeout "" VALUE 0x00000000 __UBYTE_Z 0 NO_COMPU_METHOD 0 255 /end CHARACTERISTIC
/begin CHARACTERISTIC ComScl_BCM_RLS_Stat_Timeout "" VALUE 0x00000000 __UBYTE_Z 0 NO_COMPU_METHOD 0 255 /end CHARACTERISTIC
/begin CHARACTERISTIC ComScl_BCM_VEH_STATE_Timeout "" VALUE 0x00000000 __UBYTE_Z 0 NO_COMPU_METHOD 0 255 /end CHARACTERISTIC
/begin CHARACTERISTIC ComScl_BCM_Veh_State2_Timeout "" VALUE 0x00000000 __UBYTE_Z 0 NO_COMPU_METHOD 0 255 /end CHARACTERISTIC
/begin CHARACTERISTIC ComScl_CCU_Stat1_Timeout "" VALUE 0x00000000 __UBYTE_Z 0 NO_COMPU_METHOD 0 255 /end CHARACTERISTIC
/begin CHARACTERISTIC ComScl_DMFL_Msg1_Timeout "" VALUE 0x00000000 __UBYTE_Z 0 NO_COMPU_METHOD 0 255 /end CHARACTERISTIC
/begin CHARACTERISTIC ComScl_DMFR_Msg1_Timeout "" VALUE 0x00000000 __UBYTE_Z 0 NO_COMPU_METHOD 0 255 /end CHARACTERISTIC
/begin CHARACTERISTIC ComScl_DMRL_Msg1_Timeout "" VALUE 0x00000000 __UBYTE_Z 0 NO_COMPU_METHOD 0 255 /end CHARACTERISTIC
/begin CHARACTERISTIC ComScl_DMRR_Msg1_Timeout "" VALUE 0x00000000 __UBYTE_Z 0 NO_COMPU_METHOD 0 255 /end CHARACTERISTIC
/begin CHARACTERISTIC ComScl_EMS_03_Timeout "" VALUE 0x00000000 __UBYTE_Z 0 NO_COMPU_METHOD 0 255 /end CHARACTERISTIC
/begin CHARACTERISTIC ComScl_EMS_04_Timeout "" VALUE 0x00000000 __UBYTE_Z 0 NO_COMPU_METHOD 0 255 /end CHARACTERISTIC
/begin CHARACTERISTIC ComScl_EMS_14_Timeout "" VALUE 0x00000000 __UBYTE_Z 0 NO_COMPU_METHOD 0 255 /end CHARACTERISTIC
/begin CHARACTERISTIC ComScl_EMS_16_Timeout "" VALUE 0x00000000 __UBYTE_Z 0 NO_COMPU_METHOD 0 255 /end CHARACTERISTIC
/begin CHARACTERISTIC ComScl_EMS_3_Timeout "" VALUE 0x00000000 __UBYTE_Z 0 NO_COMPU_METHOD 0 255 /end CHARACTERISTIC
/begin CHARACTERISTIC ComScl_EMS_4_Timeout "" VALUE 0x00000000 __UBYTE_Z 0 NO_COMPU_METHOD 0 255 /end CHARACTERISTIC
/begin CHARACTERISTIC ComScl_EPB_Status_Timeout "" VALUE 0x00000000 __UBYTE_Z 0 NO_COMPU_METHOD 0 255 /end CHARACTERISTIC
/begin CHARACTERISTIC ComScl_ERAG_DATA_MSG_Timeout "" VALUE 0x00000000 __UBYTE_Z 0 NO_COMPU_METHOD 0 255 /end CHARACTERISTIC
/begin CHARACTERISTIC ComScl_ERAG_NMEA1_Timeout "" VALUE 0x00000000 __UBYTE_Z 0 NO_COMPU_METHOD 0 255 /end CHARACTERISTIC
/begin CHARACTERISTIC ComScl_ERAG_NMEA2_Timeout "" VALUE 0x00000000 __UBYTE_Z 0 NO_COMPU_METHOD 0 255 /end CHARACTERISTIC
/begin CHARACTERISTIC ComScl_ERAG_NMEA3_Timeout "" VALUE 0x00000000 __UBYTE_Z 0 NO_COMPU_METHOD 0 255 /end CHARACTERISTIC
/begin CHARACTERISTIC ComScl_ERAG_NMEA4_Timeout "" VALUE 0x00000000 __UBYTE_Z 0 NO_COMPU_METHOD 0 255 /end CHARACTERISTIC
/begin CHARACTERISTIC ComScl_ERAG_NMEA5_Timeout "" VALUE 0x00000000 __UBYTE_Z 0 NO_COMPU_METHOD 0 255 /end CHARACTERISTIC
/begin CHARACTERISTIC ComScl_ERAG_NMEA6_Timeout "" VALUE 0x00000000 __UBYTE_Z 0 NO_COMPU_METHOD 0 255 /end CHARACTERISTIC
/begin CHARACTERISTIC ComScl_ESC_02_Timeout "" VALUE 0x00000000 __UBYTE_Z 0 NO_COMPU_METHOD 0 255 /end CHARACTERISTIC
/begin CHARACTERISTIC ComScl_ESC_03_Timeout "" VALUE 0x00000000 __UBYTE_Z 0 NO_COMPU_METHOD 0 255 /end CHARACTERISTIC
/begin CHARACTERISTIC ComScl_ESC_04_Timeout "" VALUE 0x00000000 __UBYTE_Z 0 NO_COMPU_METHOD 0 255 /end CHARACTERISTIC
/begin CHARACTERISTIC ComScl_ESC_06_Timeout "" VALUE 0x00000000 __UBYTE_Z 0 NO_COMPU_METHOD 0 255 /end CHARACTERISTIC
/begin CHARACTERISTIC ComScl_ESC_07_Timeout "" VALUE 0x00000000 __UBYTE_Z 0 NO_COMPU_METHOD 0 255 /end CHARACTERISTIC
/begin CHARACTERISTIC ComScl_ESC_09_Timeout "" VALUE 0x00000000 __UBYTE_Z 0 NO_COMPU_METHOD 0 255 /end CHARACTERISTIC
/begin CHARACTERISTIC ComScl_ESC_10_Timeout "" VALUE 0x00000000 __UBYTE_Z 0 NO_COMPU_METHOD 0 255 /end CHARACTERISTIC
/begin CHARACTERISTIC ComScl_ESC_YRS_01_Timeout "" VALUE 0x00000000 __UBYTE_Z 0 NO_COMPU_METHOD 0 255 /end CHARACTERISTIC
/begin CHARACTERISTIC ComScl_ESC_YRS_02_Timeout "" VALUE 0x00000000 __UBYTE_Z 0 NO_COMPU_METHOD 0 255 /end CHARACTERISTIC
/begin CHARACTERISTIC ComScl_HLL_STATE_Timeout "" VALUE 0x00000000 __UBYTE_Z 0 NO_COMPU_METHOD 0 255 /end CHARACTERISTIC
/begin CHARACTERISTIC ComScl_HLR_STATE_Timeout "" VALUE 0x00000000 __UBYTE_Z 0 NO_COMPU_METHOD 0 255 /end CHARACTERISTIC
/begin CHARACTERISTIC ComScl_IC_ABSOLUTE_CLOCK_Timeout "" VALUE 0x00000000 __UBYTE_Z 0 NO_COMPU_METHOD 0 255 /end CHARACTERISTIC
/begin CHARACTERISTIC ComScl_IC_ADAS_REST_Timeout "" VALUE 0x00000000 __UBYTE_Z 0 NO_COMPU_METHOD 0 255 /end CHARACTERISTIC
/begin CHARACTERISTIC ComScl_IC_DMS_Timeout "" VALUE 0x00000000 __UBYTE_Z 0 NO_COMPU_METHOD 0 255 /end CHARACTERISTIC
/begin CHARACTERISTIC ComScl_MAS_FrontUSS_Timeout "" VALUE 0x00000000 __UBYTE_Z 0 NO_COMPU_METHOD 0 255 /end CHARACTERISTIC
/begin CHARACTERISTIC ComScl_MAS_RearUSS_Timeout "" VALUE 0x00000000 __UBYTE_Z 0 NO_COMPU_METHOD 0 255 /end CHARACTERISTIC
/begin CHARACTERISTIC ComScl_MAS_SideUSS_Timeout "" VALUE 0x00000000 __UBYTE_Z 0 NO_COMPU_METHOD 0 255 /end CHARACTERISTIC
/begin CHARACTERISTIC ComScl_MAS_Status_Timeout "" VALUE 0x00000000 __UBYTE_Z 0 NO_COMPU_METHOD 0 255 /end CHARACTERISTIC
/begin CHARACTERISTIC ComScl_mLEDL_STATE_Timeout "" VALUE 0x00000000 __UBYTE_Z 0 NO_COMPU_METHOD 0 255 /end CHARACTERISTIC
/begin CHARACTERISTIC ComScl_mLEDR_STATE_Timeout "" VALUE 0x00000000 __UBYTE_Z 0 NO_COMPU_METHOD 0 255 /end CHARACTERISTIC
/begin CHARACTERISTIC ComScl_RSA_Status_Timeout "" VALUE 0x00000000 __UBYTE_Z 0 NO_COMPU_METHOD 0 255 /end CHARACTERISTIC
/begin CHARACTERISTIC ComScl_SAS_Standard_Timeout "" VALUE 0x00000000 __UBYTE_Z 0 NO_COMPU_METHOD 0 255 /end CHARACTERISTIC
/begin CHARACTERISTIC ComScl_SCU_02_Timeout "" VALUE 0x00000000 __UBYTE_Z 0 NO_COMPU_METHOD 0 255 /end CHARACTERISTIC
/begin CHARACTERISTIC ComScl_SWM_ContrlsState_Old_Timeout "" VALUE 0x00000000 __UBYTE_Z 0 NO_COMPU_METHOD 0 255 /end CHARACTERISTIC
/begin CHARACTERISTIC ComScl_SWM_ContrlsState_Timeout "" VALUE 0x00000000 __UBYTE_Z 0 NO_COMPU_METHOD 0 255 /end CHARACTERISTIC
/begin CHARACTERISTIC ComScl_TCU_R932_1_Timeout "" VALUE 0x00000000 __UBYTE_Z 0 NO_COMPU_METHOD 0 255 /end CHARACTERISTIC
/begin CHARACTERISTIC ComScl_TM_Stat_Timeout "" VALUE 0x00000000 __UBYTE_Z 0 NO_COMPU_METHOD 0 255 /end CHARACTERISTIC
/begin CHARACTERISTIC ComScl_VCU_ADAS_01_Timeout "" VALUE 0x00000000 __UBYTE_Z 0 NO_COMPU_METHOD 0 255 /end CHARACTERISTIC
/begin CHARACTERISTIC ComScl_VCU_DriverDmd_Timeout "" VALUE 0x00000000 __UBYTE_Z 0 NO_COMPU_METHOD 0 255 /end CHARACTERISTIC
/begin CHARACTERISTIC ERAG_Year "" SYMBOL_LINK "ERAG_Year" 0 /end CHARACTERISTIC
/begin CHARACTERISTIC ERAG_Month "" VALUE 0x00000000 __UBYTE_Z 0 NO_COMPU_METHOD 0 255 /end CHARACTERISTIC
/begin CHARACTERISTIC ERAG_Day "" VALUE 0x00000000 __UBYTE_Z 0 NO_COMPU_METHOD 0 255 /end CHARACTERISTIC
/begin CHARACTERISTIC ERAG_Hours "" VALUE 0x00000000 __UBYTE_Z 0 NO_COMPU_METHOD 0 255 /end CHARACTERISTIC
/begin CHARACTERISTIC ERAG_Minutes "" VALUE 0x00000000 __UBYTE_Z 0 NO_COMPU_METHOD 0 255 /end CHARACTERISTIC
/begin CHARACTERISTIC ERAG_Seconds "" VALUE 0x00000000 __UBYTE_Z 0 NO_COMPU_METHOD 0 255 /end CHARACTERISTIC
/begin CHARACTERISTIC ERAG_Longitude "" VALUE 0x00000000 __FLOAT32_IEEE_Z 0 NO_COMPU_METHOD -3.40282346639E+38 3.40282346639E+38 /end CHARACTERISTIC
/begin CHARACTERISTIC ERAG_Latitude "" VALUE 0x00000000 __FLOAT32_IEEE_Z 0 NO_COMPU_METHOD -3.40282346639E+38 3.40282346639E+38 /end CHARACTERISTIC
/begin CHARACTERISTIC ERAG_Course "" VALUE 0x00000000 __FLOAT32_IEEE_Z 0 NO_COMPU_METHOD -3.40282346639E+38 3.40282346639E+38 /end CHARACTERISTIC
/begin CHARACTERISTIC ERAG_Speed "" VALUE 0x00000000 __FLOAT32_IEEE_Z 0 NO_COMPU_METHOD -3.40282346639E+38 3.40282346639E+38 /end CHARACTERISTIC
/begin CHARACTERISTIC DtLogAaEragDate "" VALUE 0x00000000 __FLOAT32_IEEE_Z 0 NO_COMPU_METHOD -3.40282346639E+38 3.40282346639E+38 /end CHARACTERISTIC
/begin CHARACTERISTIC DtLogAaEragTime "" VALUE 0x00000000 __FLOAT32_IEEE_Z 0 NO_COMPU_METHOD -3.40282346639E+38 3.40282346639E+38 /end CHARACTERISTIC
/begin CHARACTERISTIC DtLogAaFuzzyScore "" VALUE 0x00000000 __FLOAT32_IEEE_Z 0 NO_COMPU_METHOD -3.40282346639E+38 3.40282346639E+38 /end CHARACTERISTIC
/begin CHARACTERISTIC DtLogAaWarnDms "" VALUE 0x00000000 __UBYTE_Z 0 NO_COMPU_METHOD 0 255 /end CHARACTERISTIC
/begin CHARACTERISTIC DtLogAaTimeAnalWarn "" VALUE 0x00000000 __FLOAT32_IEEE_Z 0 NO_COMPU_METHOD -3.40282346639E+38 3.40282346639E+38 /end CHARACTERISTIC
/begin CHARACTERISTIC DtLogAaSolverTrans "" VALUE 0x00000000 __UBYTE_Z 0 NO_COMPU_METHOD 0 255 /end CHARACTERISTIC
/begin GROUP SignalsTx "SignalsTx" ROOT
 /begin REF_CHARACTERISTIC CcBrakeLightReq CcAfsDecelReq AebPreCrash AebDecelReq AebBoostReq AebPrefillReq DAS_AccFuncError_Stat LkaMode LkaAngleReq LkaAngleReqFlag RsaAngleDirect LkaFuncError AfsMode AfsDoorUnlookReq AfsSosReq AfsDecelReqFlag AfsNotifError AfsFuncError LdpMode LdpAngleReqFlag LdwFuncError ALccMode AlccAngleReqFlag LccFuncError RdaMode RctcMode RdaDecelReqFalg RctcDecelReqFalg RdaFuncError RctcFuncError RctcNotifError CcType CcSetSpeed CcSetDist CcReject CcTargetId CcSleepSt DAS_LimNotifError_Req DAS_AccToCc_Req DAS_AccNotifError_Req CcNotifError AslaMode AslaChSpdReq FcwMode AebDeactivNotif FcwActivNotif AebUnAvaliable FcwSoundWarnReq AebNotifError FcwNotifError LkaShootdownNotifReq MliaMode MliaStreetLightStat MliaFuncError CcMode CcBrakeStandStReq CcBrakeReleaseReq CcDecelReqFlag CcFuncError AebMode AebDecelReqFlag AebRdaStandReq AebFuncError AfsBrakeJerkLevel AfsBrakeJerkEn AfsBrakeJerkReq LkaWarnSoundReq LkaShotdownSoundReq LkaWarnNotifReq LkaNotifError LdwMode LdwLeftLaneWarnReq LdwRightLaneWarnReq LdpLeftLaneWarnReq LdpRightLaneWarnReq LdwSoundReq LdpNotifError LdwNotifError LccMode DowMode LccLeftLedReq LccRightLedReq LccLeftWarnReq LccRightWarnReq LccSoundReq ALccNotifError LccNotifError DowNotifError RdaWarnReq RctcWarnReq RdaNotifError TsrMode TsrSignSpeed TsrSignOverTaking TsrSignError TsrSignNotifError AaMode AaWarnNotifReq NvMode NvFuncError RcwMode RcwWarnReq RecMode DfDiagCcAvail DfDiagAccAvail DfDiagLimAvail DfDiagAslaAvail DfDiagLkaAvail DfDiagFcwAvail DfDiagAebAvail DfDiagLccAvail DfDiagAlccAvail DfDiagDowAvail DfDiagLdwAvail DfDiagLdpAvail DfDiagTsrAvail DfDiagAaAvail DfDiagAfsAvail DfDiagRdaAvail DfDiagRctcAvail DfDiagRcwAvail DfDiagRecAvail DfDiagNvAvail DfDiagVisualAvail CcEmsMotIncFlag CcEmsMotInc CcEmsEngagement_Stat CcEmsState_Stat OSettCcTypeSts OSettCcModeSts OSettCcSpdCorrectSts OSettAslaSts OSettAslaOverCmd OSettLkaSts OSettFcwSts OSettFcwModeSts OSettFcwVibrationSts OSettAebSts OSettLccSts OSettLccModeSts OSettLccVibrationSts OSettLccSoundSts OSettAlccSts OSettDowSts OSettDowSoundSts OSettLdwSts OSettLdwModeSts OSettLdwVibrationSts OSettLdwSoundSts OSettLdpSts OSettTsrSts OSettAaSts OSettAaModeSts OSettAfsSts OSettRdaSts OSettRdaAutoBrakeSts OSettRctcSts OSettRecSts OSettSensCleanSts OSettRoadSignSts OSettNavigSts OSettOtherObjSts OSettProjectionOnARoadSts DAS_ACCResDistance_Stat CcHudSetDist DAS_ACCResSpeed_Val CcHudSetSpeed CcHudTargDetect TsrHudMultiSign DAS_SPLimRoadSignInf2_Stat DAS_SPLimRoadSignInf3_Stat TsrHudMultSignAddres DAS_SPLimRoadSignCurrSpeed_Stat LdwHudMultiLaneWarnReq DAS_RightLaneLDWWarning_Req LdwHudMultiLaneAddres USSFrontReq USSRearReq USSSideReq AdasAvailMode SensAllDirty_Stat SensTicuDirty_Stat SensLidarDirty_Stat SensMrrxDirty_Stat SensFrcuDirty_Stat SensClearReq SensWSHeatReq SensSteerWhVibrReq SensSteerWhLvl CcVcuMotIncFlag CcVcuMotInc CcVcuEngagement_Stat CcVcuState_Stat DAS_TmissionChange_Req MliaLADBLED1Req MliaLADBLED2Req MliaLADBLED3Req MliaLADBLED4Req MliaLADBLED5Req MliaLADBLED6Req MliaLADBLED7Req MliaLADBLED8Req MliaLADBLED9Req MliaLADBLED10Req MliaLADBLED11Req MliaLADBLED12Req MliaLADBLED13Req MliaLADBLED14Req MliaLADBLED15Req MliaLADBLED16Req MliaLADBLED17Req MliaLADBLED18Req MliaLeftObj1Y1Val MliaLeftObj1Z1Val MliaLeftObj1Y2Val MliaLeftObj1Z2Val MliaLeftObj2Y1Val MliaLeftObj2Z1Val MliaLeftObj2Y2Val MliaLeftObj2Z2Val MliaLeftObj3Y1Val MliaLeftObj3Z1Val MliaLeftObj3Y2Val MliaLeftObj3Z2Val MliaLeftObj4Y1Val MliaLeftObj4Z1Val MliaLeftObj4Y2Val MliaLeftObj4Z2Val MliaLeftObj5Y1Val MliaLeftObj5Z1Val MliaLeftObj5Y2Val MliaLeftObj5Z2Val MliaLeftObj6Y1Val MliaLeftObj6Z1Val MliaLeftObj6Y2Val MliaLeftObj6Z2Val MliaLeftObj7Y1Val MliaLeftObj7Z1Val MliaLeftObj7Y2Val MliaLeftObj7Z2Val MliaLeftObj8Y1Val MliaLeftObj8Z1Val MliaLeftObj8Y2Val MliaLeftObj8Z2Val MliaLeftObj9Y1Val MliaLeftObj9Z1Val MliaLeftObj9Y2Val MliaLeftObj9Z2Val MliaLeftObj10Y1Val MliaLeftObj10Z1Val MliaLeftObj10Y2Val MliaLeftObj10Z2Val MliaRADBLED1Req MliaRADBLED2Req MliaRADBLED3Req MliaRADBLED4Req MliaRADBLED5Req MliaRADBLED6Req MliaRADBLED7Req MliaRADBLED8Req MliaRADBLED9Req MliaRADBLED10Req MliaRADBLED11Req MliaRADBLED12Req MliaRADBLED13Req MliaRADBLED14Req MliaRADBLED15Req MliaRADBLED16Req MliaRADBLED17Req MliaRADBLED18Req MliaRightObj1Y1Val MliaRightObj1Z1Val MliaRightObj1Y2Val MliaRightObj1Z2Val MliaRightObj2Y1Val MliaRightObj2Z1Val MliaRightObj2Y2Val MliaRightObj2Z2Val MliaRightObj3Y1Val MliaRightObj3Z1Val MliaRightObj3Y2Val MliaRightObj3Z2Val MliaRightObj4Y1Val MliaRightObj4Z1Val MliaRightObj4Y2Val MliaRightObj4Z2Val MliaRightObj5Y1Val MliaRightObj5Z1Val MliaRightObj5Y2Val MliaRightObj5Z2Val MliaRightObj6Y1Val MliaRightObj6Z1Val MliaRightObj6Y2Val MliaRightObj6Z2Val MliaRightObj7Y1Val MliaRightObj7Z1Val MliaRightObj7Y2Val MliaRightObj7Z2Val MliaRightObj8Y1Val MliaRightObj8Z1Val MliaRightObj8Y2Val MliaRightObj8Z2Val MliaRightObj9Y1Val MliaRightObj9Z1Val MliaRightObj9Y2Val MliaRightObj9Z2Val MliaRightObj10Y1Val MliaRightObj10Z1Val MliaRightObj10Y2Val MliaRightObj10Z2Val MliaRightProjSlot1Req MliaRightProjBrightSlot1Req MliaRightProjSlot2Req MliaRightProjBrightSlot2Req MliaRightProjSlot3Req MliaRightProjBrightSlot3Req MliaRightProjSlot4Req MliaRightProjBrightSlot4Req MliaLeftProjSlot1Req MliaLeftProjBrightSlot1Req MliaLeftProjSlot2Req MliaLeftProjBrightSlot2Req MliaLeftProjSlot3Req MliaLeftProjBrightSlot3Req MliaLeftProjSlot4Req MliaLeftProjBrightSlot4Req DtLogAccTargetDetect DtLogAccDistSetm DtLogAccDistRealm DtLogAccLeadSpeedReal_kmh DtLogAccLeadAccelReal DtLogAccLogicTrans DtLogAccSolverTrans DtLogAccVlcTrans DtLogAccErrFlag DtLogAccErrCode DtLogAebTargetDetect DtLogAebDistRealm DtLogAebLeadSpeedRealKmh DtLogAebLeadAccelReal DtLogAebLogicTrans DtLogAebSolverTrans DtLogAebErrFlag DtLogAebErrCode DtLogFiuLogicTrans DtLogFiuSolverTrans DtLogLkaTargetAngle DtLogLkaLogicTrans DtLogLkaSolverTrans DtLogLkaErrFlag DtLogLkaErrCode DtLogLdwLogicTrans DtLogLdwSolverTransLeft DtLogLdwWarnBlockTransLeft DtLogLdwTTLCTransLeft DtLogLdwTurnRadiusLeft DtLogLdwYawRate_dtLeft DtLogLdwVdepartureLeft DtLogLdwTTLCLeft DtLogLdwWarnDistLeft DtLogLdwWarnTimeLeft DtLogLdwWarnPredictLeft DtLogLdwSolverTransRight DtLogLdwWarnDistRight DtLogLdwWarnTimeRight DtLogLdwWarnPredictRight DtLogLccLogicTrans DtLogLccWarnReqTransLeft DtLogLccWarnReqTransRight DtLogLccIsObjInLeftCvwZone DtLogLccIsObjInRightCvwZone DtLogLccEnaSts DtLogLccSetSound DtLogLccSetVibration DtLogLccSetMode DtLogLccErrFlag DtLogLccErrCode DtLogAlccEnaSts DtLogDowLogicTrans DtLogDowWarnReqTransLeft DtLogDowWarnReqTransRight DtLogDowIsObjInLeftZone DtLogDowIsObjInRightZone DtLogRcwDistToObjRear DtLogRcwLogicTrans DtLogRcwLatObj DtLogRcwTimeCrash DtLogRcwVelRel DtLogRcwDimanWh DtLogRdaDistToObjRear DtLogRdaLogicTrans DtLogRdaSolverTrans DtLogRdaErrFlag DtLogRdaErrCode DtLogMliaDistToObj1 DtLogMliaDistToObj2 DtLogMliaDistToObj3 DtLogMliaDistToObj4 DtLogMliaLogicTrans DtLogMliaSolverTrans DtLogMliaErrFlag DtLogMliaErrCode DtLogVisualLogicTrans DtLogVisualSolverTrans DtLogVisualErrFlag DtLogVisualErrCode VisAccSetDist VisAccTargetObj VisAebTargetObj VisEgoZone VisFcwTargetObj VisLaneLLType VisLaneLType VisLaneRRType VisLaneRType VisLccLeftLane VisLccRightLane VisLdpLeftLine VisLdpRightLine VisLdwLeftLine VisLdwRightLine VisLkaAct VisObj1_Type VisObj1DistLong VisObj1Orient VisObj1Zone VisObj2_Type VisObj2DistLong VisObj2Orient VisObj2Zone VisObj3_Type VisObj3DistLong VisObj3Orient VisObj3Zone VisObj4_Type VisObj4DistLong VisObj4Orient VisObj4Zone VisObj5_Type VisObj5DistLong VisObj5Orient VisObj5Zone VisObj6_Type VisObj6DistLong VisObj6Orient VisObj6Zone VisObj7_Type VisObj7DistLong VisObj7Orient VisObj7Zone VisObj8_Type VisObj8DistLong VisObj8Orient VisObj8Zone VisObj9_Type VisObj9DistLong VisObj9Orient VisObj9Zone VisObjDynam1ID VisObjDynam2ID VisObjDynam3ID VisObjDynam4ID VisObjDynam5ID VisObjDynam6ID VisObjDynam7ID VisObjDynam8ID VisObjDynam9ID VisRoadAngleLvl DfPercFcuDirtSts DfPercFrcuDirtSts DfPercTicuDirtSts DfPercMrrxDirtSts DfPercLidarDirtSts DfPercValidDataFront DfPercValidDataRear DfPercValidDataLane DfPercValidDataSign DfPercValidDataMlia DfFPObj1detect DfFPObj1Sx1 DfFPObj1Sy1 DfFPObj1Sx2 DfFPObj1Sy2 DfFPObj1Vx DfFPObj1Vy DfFPObj1type DfFPObj1Orient DfFPObj1DynamID DfFPObj1Probabil DfFPObj2detect DfFPObj2Sx1 DfFPObj2Sy1 DfFPObj2Sx2 DfFPObj2Sy2 DfFPObj2Vx DfFPObj2Vy DfFPObj2type DfFPObj2Orient DfFPObj2DynamID DfFPObj2Probabil DfFPObj3detect DfFPObj3Sx1 DfFPObj3Sy1 DfFPObj3Sx2 DfFPObj3Sy2 DfFPObj3Vx DfFPObj3Vy DfFPObj3type DfFPObj3Orient DfFPObj3DynamID DfFPObj3Probabil DfFPObj4detect DfFPObj4Sx1 DfFPObj4Sy1 DfFPObj4Sx2 DfFPObj4Sy2 DfFPObj4Vx DfFPObj4Vy DfFPObj4type DfFPObj4Orient DfFPObj4DynamID DfFPObj4Probabil DfFPObj5detect DfFPObj5Sx1 DfFPObj5Sy1 DfFPObj5Sx2 DfFPObj5Sy2 DfFPObj5Vx DfFPObj5Vy DfFPObj5type DfFPObj5Orient DfFPObj5DynamID DfFPObj5Probabil DfFPObj6detect DfFPObj6Sx1 DfFPObj6Sy1 DfFPObj6Sx2 DfFPObj6Sy2 DfFPObj6Vx DfFPObj6Vy DfFPObj6type DfFPObj6Orient DfFPObj6DynamID DfFPObj6Probabil DfFPObj7detect DfFPObj7Sx1 DfFPObj7Sy1 DfFPObj7Sx2 DfFPObj7Sy2 DfFPObj7Vx DfFPObj7Vy DfFPObj7type DfFPObj7Orient DfFPObj7DynamID DfFPObj7Probabil DfFPObj8detect DfFPObj8Sx1 DfFPObj8Sy1 DfFPObj8Sx2 DfFPObj8Sy2 DfFPObj8Vx DfFPObj8Vy DfFPObj8type DfFPObj8Orient DfFPObj8DynamID DfFPObj8Probabil DfFPObj9detect DfFPObj9Sx1 DfFPObj9Sy1 DfFPObj9Sx2 DfFPObj9Sy2 DfFPObj9Vx DfFPObj9Vy DfFPObj9type DfFPObj9Orient DfFPObj9DynamID DfFPObj9Probabil DfFPObj10detect DfFPObj10Sx1 DfFPObj10Sy1 DfFPObj10Sx2 DfFPObj10Sy2 DfFPObj10Vx DfFPObj10Vy DfFPObj10type DfFPObj10Orient DfFPObj10DynamID DfFPObj10Probabil DfFPObj11detect DfFPObj11Sx1 DfFPObj11Sy1 DfFPObj11Sx2 DfFPObj11Sy2 DfFPObj11Vx DfFPObj11Vy DfFPObj11type DfFPObj11Orient DfFPObj11DynamID DfFPObj11Probabil DfRPObj12detect DfRPObj12Sx1 DfRPObj12Sy1 DfRPObj12Sx2 DfRPObj12Sy2 DfRPObj12Vx DfRPObj12Vy DfRPObj12Probabil DfRPObj13detect DfRPObj13Sx1 DfRPObj13Sy1 DfRPObj13Sx2 DfRPObj13Sy2 DfRPObj13Vx DfRPObj13Vy DfRPObj13Probabil DfRPObj14detect DfRPObj14Sx1 DfRPObj14Sy1 DfRPObj14Sx2 DfRPObj14Sy2 DfRPObj14Vx DfRPObj14Vy DfRPObj14Probabil DfRPObj15detect DfRPObj15Sx1 DfRPObj15Sy1 DfRPObj15Sx2 DfRPObj15Sy2 DfRPObj15Vx DfRPObj15Vy DfRPObj15Probabil DfRPObj16detect DfRPObj16Sx1 DfRPObj16Sy1 DfRPObj16Sx2 DfRPObj16Sy2 DfRPObj16Vx DfRPObj16Vy DfRPObj16Probabil DfRPObj17detect DfRPObj17Sx1 DfRPObj17Sy1 DfRPObj17Sx2 DfRPObj17Sy2 DfRPObj17Vx DfRPObj17Vy DfRPObj17Probabil DfRPObj18detect DfRPObj18Sx1 DfRPObj18Sy1 DfRPObj18Sx2 DfRPObj18Sy2 DfRPObj18Vx DfRPObj18Vy DfRPObj18Probabil DfLanePFrontLSx0 DfLanePFrontLSxFA DfLanePFrontLSx10 DfLanePFrontLSx15 DfLanePFrontLSx20 DfLanePFrontLSx25 DfLanePFrontLSx30 DfLanePFrontLSx40 DfLanePFrontLSx50 DfLanePFrontLSx60 DfLanePFrontLSx70 DfLanePFrontLSx80 DfLanePFrontLSx90 DfLanePFrontLSx100 DfLanePFrontLColor DfLanePFrontLType DfLanePFrontRSx0 DfLanePFrontRSxFA DfLanePFrontRSx10 DfLanePFrontRSx15 DfLanePFrontRSx20 DfLanePFrontRSx25 DfLanePFrontRSx30 DfLanePFrontRSx40 DfLanePFrontRSx50 DfLanePFrontRSx60 DfLanePFrontRSx70 DfLanePFrontRSx80 DfLanePFrontRSx90 DfLanePFrontRSx100 DfLanePFrontRColor DfLanePFrontRType DfLanePTrgtLineS0 DfLanePTrgtLineS1 DfLanePTrgtLineS2 DfLanePTrgtLineS3 DfLanePTrgtLineS4 DfLanePRearLSx5 DfLanePRearLSx10 DfLanePRearLSx20 DfLanePRearLSx30 DfLanePRearLSx40 DfLanePRearLSx50 DfLanePRearLSx60 DfLanePRearLSx70 DfLanePRearLSx80 DfLanePRearLSx90 DfLanePRearLSx100 DfLanePRearRSx5 DfLanePRearRSx10 DfLanePRearRSx20 DfLanePRearRSx30 DfLanePRearRSx40 DfLanePRearRSx50 DfLanePRearRSx60 DfLanePRearRSx70 DfLanePRearRSx80 DfLanePRearRSx90 DfLanePRearRSx100 DfSignPerc1Obj_detect DfSignPerc1Sx DfSignPerc1Sy DfSignPerc1CurrSpeed DfSignPerc1Color DfSignPerc1Type DfSignPerc2Obj_detect DfSignPerc2Sx DfSignPerc2Sy DfSignPerc2CurrSpeed DfSignPerc2Color DfSignPerc2Type DfSignPerc3Obj_detect DfSignPerc3Sx DfSignPerc3Sy DfSignPerc3CurrSpeed DfSignPerc3Color DfSignPerc3Type DfSignPerc4Obj_detect DfSignPerc4Sx DfSignPerc4Sy DfSignPerc4CurrSpeed DfSignPerc4Color DfSignPerc4Type DfMliaPercStreetLightDetect DfMliaPercObj1Detect DfMliaPercObj1Sx1 DfMliaPercObj1Sy1 DfMliaPercObj1Sx2 DfMliaPercObj1Sy2 DfMliaPercObj1Vel DfMliaPercObj1Precision DfMliaPercObj1LightSts DfMliaPercObj1Sz DfMliaPercObj2Detect DfMliaPercObj2Sx1 DfMliaPercObj2Sy1 DfMliaPercObj2Sx2 DfMliaPercObj2Sy2 DfMliaPercObj2Vel DfMliaPercObj2Precision DfMliaPercObj2LightSts DfMliaPercObj2Sz DfMliaPercObj3Detect DfMliaPercObj3Sx1 DfMliaPercObj3Sy1 DfMliaPercObj3Sx2 DfMliaPercObj3Sy2 DfMliaPercObj3Vel DfMliaPercObj3Precision DfMliaPercObj3LightSts DfMliaPercObj3Sz DfMliaPercObj4Detect DfMliaPercObj4Sx1 DfMliaPercObj4Sy1 DfMliaPercObj4Sx2 DfMliaPercObj4Sy2 DfMliaPercObj4Vel DfMliaPercObj4Precision DfMliaPercObj4LightSts DfMliaPercObj4Sz DfMliaPercObj5Detect DfMliaPercObj5Sx1 DfMliaPercObj5Sy1 DfMliaPercObj5Sx2 DfMliaPercObj5Sy2 DfMliaPercObj5Vel DfMliaPercObj5Precision DfMliaPercObj5LightSts DfMliaPercObj5Sz DfMliaPercObj6Detect DfMliaPercObj6Sx1 DfMliaPercObj6Sy1 DfMliaPercObj6Sx2 DfMliaPercObj6Sy2 DfMliaPercObj6Vel DfMliaPercObj6Precision DfMliaPercObj6LightSts DfMliaPercObj6Sz DfMliaPercObj7Detect DfMliaPercObj7Sx1 DfMliaPercObj7Sy1 DfMliaPercObj7Sx2 DfMliaPercObj7Sy2 DfMliaPercObj7Vel DfMliaPercObj7Precision DfMliaPercObj7LightSts DfMliaPercObj7Sz DfMliaPercObj8Detect DfMliaPercObj8Sx1 DfMliaPercObj8Sy1 DfMliaPercObj8Sx2 DfMliaPercObj8Sy2 DfMliaPercObj8Vel DfMliaPercObj8Precision DfMliaPercObj8LightSts DfMliaPercObj8Sz DfMliaPercObj9Detect DfMliaPercObj9Sx1 DfMliaPercObj9Sy1 DfMliaPercObj9Sx2 DfMliaPercObj9Sy2 DfMliaPercObj9Vel DfMliaPercObj9Precision DfMliaPercObj9LightSts DfMliaPercObj9Sz DfMliaPercObj10Detect DfMliaPercObj10Sx1 DfMliaPercObj10Sy1 DfMliaPercObj10Sx2 DfMliaPercObj10Sy2 DfMliaPercObj10Vel DfMliaPercObj10Precision DfMliaPercObj10LightSts DfMliaPercObj10Sz DfMliaPercObj11Detect DfMliaPercObj11Sx1 DfMliaPercObj11Sy1 DfMliaPercObj11Sx2 DfMliaPercObj11Sy2 DfMliaPercObj11Vel DfMliaPercObj11Precision DfMliaPercObj11LightSts DfMliaPercObj11Sz DfMliaPercObj12Detect DfMliaPercObj12Sx1 DfMliaPercObj12Sy1 DfMliaPercObj12Sx2 DfMliaPercObj12Sy2 DfMliaPercObj12Vel DfMliaPercObj12Precision DfMliaPercObj12LightSts DfMliaPercObj12Sz DfMliaPercObj13Detect DfMliaPercObj13Sx1 DfMliaPercObj13Sy1 DfMliaPercObj13Sx2 DfMliaPercObj13Sy2 DfMliaPercObj13Vel DfMliaPercObj13Precision DfMliaPercObj13LightSts DfMliaPercObj13Sz DfMliaPercObj14Detect DfMliaPercObj14Sx1 DfMliaPercObj14Sy1 DfMliaPercObj14Sx2 DfMliaPercObj14Sy2 DfMliaPercObj14Vel DfMliaPercObj14Precision DfMliaPercObj14LightSts DfMliaPercObj14Sz DfMliaPercObj15Detect DfMliaPercObj15Sx1 DfMliaPercObj15Sy1 DfMliaPercObj15Sx2 DfMliaPercObj15Sy2 DfMliaPercObj15Vel DfMliaPercObj15Precision DfMliaPercObj15LightSts DfMliaPercObj15Sz DfMliaPercObj16Detect DfMliaPercObj16Sx1 DfMliaPercObj16Sy1 DfMliaPercObj16Sx2 DfMliaPercObj16Sy2 DfMliaPercObj16Vel DfMliaPercObj16Precision DfMliaPercObj16LightSts DfMliaPercObj16Sz DfMliaPercObj17Detect DfMliaPercObj17Sx1 DfMliaPercObj17Sy1 DfMliaPercObj17Sx2 DfMliaPercObj17Sy2 DfMliaPercObj17Vel DfMliaPercObj17Precision DfMliaPercObj17LightSts DfMliaPercObj17Sz DfMliaPercObj18Detect DfMliaPercObj18Sx1 DfMliaPercObj18Sy1 DfMliaPercObj18Sx2 DfMliaPercObj18Sy2 DfMliaPercObj18Vel DfMliaPercObj18Precision DfMliaPercObj18LightSts DfMliaPercObj18Sz DfMliaPercObj19Detect DfMliaPercObj19Sx1 DfMliaPercObj19Sy1 DfMliaPercObj19Sx2 DfMliaPercObj19Sy2 DfMliaPercObj19Vel DfMliaPercObj19Precision DfMliaPercObj19LightSts DfMliaPercObj19Sz DfMliaPercObj20Detect DfMliaPercObj20Sx1 DfMliaPercObj20Sy1 DfMliaPercObj20Sx2 DfMliaPercObj20Sy2 DfMliaPercObj20Vel DfMliaPercObj20Precision DfMliaPercObj20LightSts DfMliaPercObj20Sz DfMliaPercObj21Detect DfMliaPercObj21Sx1 DfMliaPercObj21Sy1 DfMliaPercObj21Sx2 DfMliaPercObj21Sy2 DfMliaPercObj21Vel DfMliaPercObj21Precision DfMliaPercObj21LightSts DfMliaPercObj21Sz DfGpuTemp DfGpuFrcuErrorSts DfGpuFcuWErrorSts DfGpuFcuNErrorSts DfGpuTicuErrorSts DfGpuLidarErrorSts DfGpuFrcuVirtYaw DfGpuFrcuProb DfGpuFcuCalibSts DfGpuFcuStaticAngYaw DfGpuFcuStaticAngPitch DfGpuFcuVirtYaw DfGpuTicuCalibSts DfGpuTicuVirtYaw DfGpuTicuStaticYaw DfGpuTicuStaticPitch DfGpuLidCalibSts DfGpuLidVirtYaw DfGpuLidStaticYaw DfGpuLidStaticPitch DfGpuTemp DfGpuFrcuErrorSts DfGpuFcuWErrorSts DfGpuFcuNErrorSts DfGpuTicuErrorSts DfGpuLidarErrorSts DfGpuFrcuVirtYaw DfGpuFrcuProb DfGpuFcuCalibSts DfGpuFcuStaticAngYaw DfGpuFcuStaticAngPitch DfGpuFcuVirtYaw DfGpuTicuCalibSts DfGpuTicuVirtYaw DfGpuTicuStaticYaw DfGpuTicuStaticPitch DfGpuLidCalibSts DfGpuLidVirtYaw DfGpuLidStaticYaw DfGpuLidStaticPitch ADAS_RCW_W ADAS_LCA_R_W ADAS_BSD_R_W ADAS_RCTA_R_W ADAS_DOW_R_W ADAS_RCTB_R_W ADAS_LCA_L_W ADAS_BSD_L_W ADAS_RCTA_L_W ADAS_DOW_L_W ADAS_RCTB_L_W Str_Angle Str_Angle_V VehSpeed_IN VehSpeed_V YawRat_V YawRate_IN GEAR_STA_NOW_V GEAR_STATE_NOW IGN_State IGN_State_V DriverDoorSts LeftTurnSWSts LockSts PassengerDoorSts RightTurnSWSts RLDoorSts RRDoorSts ComScl_UDP_MainDataFromPerc_Timeout ComScl_UDP_FrontPas_Timeout ComScl_UDP_RearPass_Timeout ComScl_UDP_Lane_Timeout ComScl_UDP_SignPerc_Timeout ComScl_UDP_MliaPerc_Timeout ComScl_UDP_GPU_States_Timeout ERAG_Year ERAG_Month ERAG_Day ERAG_Hours ERAG_Minutes ERAG_Seconds ERAG_Longitude ERAG_Latitude ERAG_Course ERAG_Speed DtLogAaEragDate DtLogAaEragTime DtLogAaFuzzyScore DtLogAaWarnDms DtLogAaTimeAnalWarn DtLogAaSolverTrans /end REF_CHARACTERISTIC
/end GROUP
/begin CHARACTERISTIC CAN_Debug "" VALUE 0x00000000 __UBYTE_Z 0 NO_COMPU_METHOD 0 255 /end CHARACTERISTIC
/end MODULE
/end PROJECT
