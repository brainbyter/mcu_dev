ASAP2_VERSION 1 71
/begin PROJECT ProjectName "Project Comment Goes Here"
/begin HEADER "Header Comments go here" /end HEADER
/begin MODULE ModuleName "Module Comment Goes Here"
/begin MOD_COMMON "Mod Common Comment Here" BYTE_ORDER MSB_LAST ALIGNMENT_BYTE 1 ALIGNMENT_WORD 2 ALIGNMENT_LONG 4 ALIGNMENT_FLOAT32_IEEE 4 ALIGNMENT_FLOAT64_IEEE 8 ALIGNMENT_INT64 8 /end MOD_COMMON
/begin MEASUREMENT AbsActive "" UBYTE ADAS_CM_uint8 0 0 0.000000 1.000000 ECU_ADDRESS 0x0000 /* @ECU_Address@AbsActive@ */ /end MEASUREMENT
/begin MEASUREMENT AbsoluteDateAndTime "" ULONG ADAS_CM_uint32 0 0 0.000000 4294967295.000000 ECU_ADDRESS 0x0000 /* @ECU_Address@AbsoluteDateAndTime@ */ /end MEASUREMENT
/begin MEASUREMENT AccelPedalPos "" FLOAT32_IEEE ADAS_CM_single 0 0 0.000000 99.450000 ECU_ADDRESS 0x0000 /* @ECU_Address@AccelPedalPos@ */ /end MEASUREMENT
/begin MEASUREMENT AdasSensCleanSt "" UBYTE ADAS_CM_uint8 0 0 0.000000 1.000000 ECU_ADDRESS 0x0000 /* @ECU_Address@AdasSensCleanSt@ */ /end MEASUREMENT
/begin MEASUREMENT AebAvl "" UBYTE ADAS_CM_uint8 0 0 0.000000 1.000000 ECU_ADDRESS 0x0000 /* @ECU_Address@AebAvl@ */ /end MEASUREMENT
/begin MEASUREMENT AebDecelReqFlag "" UBYTE ADAS_CM_uint8 0 0 0.000000 1.000000 ECU_ADDRESS 0x0000 /* @ECU_Address@AebDecelReqFlag@ */ /end MEASUREMENT
/begin MEASUREMENT AebPreCrash "" UBYTE ADAS_CM_uint8 0 0 0.000000 1.000000 ECU_ADDRESS 0x0000 /* @ECU_Address@AebPreCrash@ */ /end MEASUREMENT
/begin MEASUREMENT AmbTemp "" FLOAT32_IEEE ADAS_CM_single 0 0 -50.000000 75.000000 ECU_ADDRESS 0x0000 /* @ECU_Address@AmbTemp@ */ /end MEASUREMENT
/begin MEASUREMENT BlaActive "" UBYTE ADAS_CM_uint8 0 0 0.000000 1.000000 ECU_ADDRESS 0x0000 /* @ECU_Address@BlaActive@ */ /end MEASUREMENT
/begin MEASUREMENT BlsActive "" UBYTE ADAS_CM_uint8 0 0 0.000000 1.000000 ECU_ADDRESS 0x0000 /* @ECU_Address@BlsActive@ */ /end MEASUREMENT
/begin MEASUREMENT BtActivMode "" UBYTE ADAS_CM_uint8 0 0 0.000000 3.000000 ECU_ADDRESS 0x0000 /* @ECU_Address@BtActivMode@ */ /end MEASUREMENT
/begin MEASUREMENT BtCncl "" UBYTE ADAS_CM_uint8 0 0 0.000000 3.000000 ECU_ADDRESS 0x0000 /* @ECU_Address@BtCncl@ */ /end MEASUREMENT
/begin MEASUREMENT BtDist "" UBYTE ADAS_CM_uint8 0 0 0.000000 3.000000 ECU_ADDRESS 0x0000 /* @ECU_Address@BtDist@ */ /end MEASUREMENT
/begin MEASUREMENT BtRes "" UBYTE ADAS_CM_uint8 0 0 0.000000 3.000000 ECU_ADDRESS 0x0000 /* @ECU_Address@BtRes@ */ /end MEASUREMENT
/begin MEASUREMENT BtSet "" UBYTE ADAS_CM_uint8 0 0 0.000000 3.000000 ECU_ADDRESS 0x0000 /* @ECU_Address@BtSet@ */ /end MEASUREMENT
/begin MEASUREMENT BtSpdDec "" UBYTE ADAS_CM_uint8 0 0 0.000000 3.000000 ECU_ADDRESS 0x0000 /* @ECU_Address@BtSpdDec@ */ /end MEASUREMENT
/begin MEASUREMENT BtSpdInc "" UBYTE ADAS_CM_uint8 0 0 0.000000 3.000000 ECU_ADDRESS 0x0000 /* @ECU_Address@BtSpdInc@ */ /end MEASUREMENT
/begin MEASUREMENT BtStar "" UBYTE ADAS_CM_uint8 0 0 0.000000 3.000000 ECU_ADDRESS 0x0000 /* @ECU_Address@BtStar@ */ /end MEASUREMENT
/begin MEASUREMENT CcAfsDecelReq "" FLOAT32_IEEE ADAS_CM_single 0 0 -20.000000 20.000000 ECU_ADDRESS 0x0000 /* @ECU_Address@CcAfsDecelReq@ */ /end MEASUREMENT
/begin MEASUREMENT CcBrakeReleaseReq "" UBYTE ADAS_CM_uint8 0 0 0.000000 1.000000 ECU_ADDRESS 0x0000 /* @ECU_Address@CcBrakeReleaseReq@ */ /end MEASUREMENT
/begin MEASUREMENT CcBrakeStandStReq "" UBYTE ADAS_CM_uint8 0 0 0.000000 1.000000 ECU_ADDRESS 0x0000 /* @ECU_Address@CcBrakeStandStReq@ */ /end MEASUREMENT
/begin MEASUREMENT CcDecelReqFlag "" UBYTE ADAS_CM_uint8 0 0 0.000000 1.000000 ECU_ADDRESS 0x0000 /* @ECU_Address@CcDecelReqFlag@ */ /end MEASUREMENT
/begin MEASUREMENT CcEmsMotInc "" FLOAT32_IEEE ADAS_CM_single 0 0 -200.000000 1000.000000 ECU_ADDRESS 0x0000 /* @ECU_Address@CcEmsMotInc@ */ /end MEASUREMENT
/begin MEASUREMENT CcMode "" UBYTE ADAS_CM_uint8 0 0 0.000000 3.000000 ECU_ADDRESS 0x0000 /* @ECU_Address@CcMode@ */ /end MEASUREMENT
/begin MEASUREMENT CcSetSpeed "" UBYTE ADAS_CM_uint8 0 0 0.000000 255.000000 ECU_ADDRESS 0x0000 /* @ECU_Address@CcSetSpeed@ */ /end MEASUREMENT
/begin MEASUREMENT CcType "" UBYTE ADAS_CM_uint8 0 0 0.000000 3.000000 ECU_ADDRESS 0x0000 /* @ECU_Address@CcType@ */ /end MEASUREMENT
/begin MEASUREMENT CddActv "" UBYTE ADAS_CM_uint8 0 0 0.000000 1.000000 ECU_ADDRESS 0x0000 /* @ECU_Address@CddActv@ */ /end MEASUREMENT
/begin MEASUREMENT CddAvl "" UBYTE ADAS_CM_uint8 0 0 0.000000 1.000000 ECU_ADDRESS 0x0000 /* @ECU_Address@CddAvl@ */ /end MEASUREMENT
/begin MEASUREMENT CddSkiddingDetd "" UBYTE ADAS_CM_uint8 0 0 0.000000 1.000000 ECU_ADDRESS 0x0000 /* @ECU_Address@CddSkiddingDetd@ */ /end MEASUREMENT
/begin MEASUREMENT CddStandstillSt "" UBYTE ADAS_CM_uint8 0 0 0.000000 1.000000 ECU_ADDRESS 0x0000 /* @ECU_Address@CddStandstillSt@ */ /end MEASUREMENT
/begin MEASUREMENT CddTempSwitchOff "" UBYTE ADAS_CM_uint8 0 0 0.000000 1.000000 ECU_ADDRESS 0x0000 /* @ECU_Address@CddTempSwitchOff@ */ /end MEASUREMENT
/begin MEASUREMENT CorrectorActValLeft "" UBYTE ADAS_CM_uint8 0 0 0.000000 255.000000 ECU_ADDRESS 0x0000 /* @ECU_Address@CorrectorActValLeft@ */ /end MEASUREMENT
/begin MEASUREMENT CorrectorActValRight "" UBYTE ADAS_CM_uint8 0 0 0.000000 255.000000 ECU_ADDRESS 0x0000 /* @ECU_Address@CorrectorActValRight@ */ /end MEASUREMENT
/begin MEASUREMENT CrashEveDetd "" UBYTE ADAS_CM_uint8 0 0 0.000000 1.000000 ECU_ADDRESS 0x0000 /* @ECU_Address@CrashEveDetd@ */ /end MEASUREMENT
/begin MEASUREMENT DfConfAccAutoStandBy "" UBYTE ADAS_CM_uint8 0 0 0.000000 1.000000 ECU_ADDRESS 0x0000 /* @ECU_Address@DfConfAccAutoStandBy@ */ /end MEASUREMENT
/begin MEASUREMENT DfConfAccColumnMode "" UBYTE ADAS_CM_uint8 0 0 0.000000 1.000000 ECU_ADDRESS 0x0000 /* @ECU_Address@DfConfAccColumnMode@ */ /end MEASUREMENT
/begin MEASUREMENT DfConfAccParadMode "" UBYTE ADAS_CM_uint8 0 0 0.000000 1.000000 ECU_ADDRESS 0x0000 /* @ECU_Address@DfConfAccParadMode@ */ /end MEASUREMENT
/begin MEASUREMENT DfConfAccReversOrder "" UBYTE ADAS_CM_uint8 0 0 0.000000 1.000000 ECU_ADDRESS 0x0000 /* @ECU_Address@DfConfAccReversOrder@ */ /end MEASUREMENT
/begin MEASUREMENT DfConfAccSeatBeltIgnore "" UBYTE ADAS_CM_uint8 0 0 0.000000 1.000000 ECU_ADDRESS 0x0000 /* @ECU_Address@DfConfAccSeatBeltIgnore@ */ /end MEASUREMENT
/begin MEASUREMENT DfConfAccStartFromMem "" UBYTE ADAS_CM_uint8 0 0 0.000000 3.000000 ECU_ADDRESS 0x0000 /* @ECU_Address@DfConfAccStartFromMem@ */ /end MEASUREMENT
/begin MEASUREMENT DfConfAebActiveEveryIgnition "" UBYTE ADAS_CM_uint8 0 0 0.000000 1.000000 ECU_ADDRESS 0x0000 /* @ECU_Address@DfConfAebActiveEveryIgnition@ */ /end MEASUREMENT
/begin MEASUREMENT DfConfAebType "" UBYTE ADAS_CM_uint8 0 0 0.000000 1.000000 ECU_ADDRESS 0x0000 /* @ECU_Address@DfConfAebType@ */ /end MEASUREMENT
/begin MEASUREMENT DfConfAfsSosMode "" UBYTE ADAS_CM_uint8 0 0 0.000000 1.000000 ECU_ADDRESS 0x0000 /* @ECU_Address@DfConfAfsSosMode@ */ /end MEASUREMENT
/begin MEASUREMENT DfConfDasAvail "" UBYTE ADAS_CM_uint8 0 0 0.000000 1.000000 ECU_ADDRESS 0x0000 /* @ECU_Address@DfConfDasAvail@ */ /end MEASUREMENT
/begin MEASUREMENT DfConfLimSpeedMemAvail "" UBYTE ADAS_CM_uint8 0 0 0.000000 1.000000 ECU_ADDRESS 0x0000 /* @ECU_Address@DfConfLimSpeedMemAvail@ */ /end MEASUREMENT
/begin MEASUREMENT DfDiagAAErReq "" UBYTE ADAS_CM_uint8 0 0 0.000000 1.000000 ECU_ADDRESS 0x0000 /* @ECU_Address@DfDiagAAErReq@ */ /end MEASUREMENT
/begin MEASUREMENT DfDiagAaAvail "" UBYTE ADAS_CM_uint8 0 0 0.000000 1.000000 ECU_ADDRESS 0x0000 /* @ECU_Address@DfDiagAaAvail@ */ /end MEASUREMENT
/begin MEASUREMENT DfDiagAccAvail "" UBYTE ADAS_CM_uint8 0 0 0.000000 1.000000 ECU_ADDRESS 0x0000 /* @ECU_Address@DfDiagAccAvail@ */ /end MEASUREMENT
/begin MEASUREMENT DfDiagAccErReq "" UBYTE ADAS_CM_uint8 0 0 0.000000 1.000000 ECU_ADDRESS 0x0000 /* @ECU_Address@DfDiagAccErReq@ */ /end MEASUREMENT
/begin MEASUREMENT DfDiagAebAvail "" UBYTE ADAS_CM_uint8 0 0 0.000000 1.000000 ECU_ADDRESS 0x0000 /* @ECU_Address@DfDiagAebAvail@ */ /end MEASUREMENT
/begin MEASUREMENT DfDiagAebErReq "" UBYTE ADAS_CM_uint8 0 0 0.000000 1.000000 ECU_ADDRESS 0x0000 /* @ECU_Address@DfDiagAebErReq@ */ /end MEASUREMENT
/begin MEASUREMENT DfDiagAfsAvail "" UBYTE ADAS_CM_uint8 0 0 0.000000 1.000000 ECU_ADDRESS 0x0000 /* @ECU_Address@DfDiagAfsAvail@ */ /end MEASUREMENT
/begin MEASUREMENT DfDiagAfsErReq "" UBYTE ADAS_CM_uint8 0 0 0.000000 1.000000 ECU_ADDRESS 0x0000 /* @ECU_Address@DfDiagAfsErReq@ */ /end MEASUREMENT
/begin MEASUREMENT DfDiagAlccAvail "" UBYTE ADAS_CM_uint8 0 0 0.000000 1.000000 ECU_ADDRESS 0x0000 /* @ECU_Address@DfDiagAlccAvail@ */ /end MEASUREMENT
/begin MEASUREMENT DfDiagAlccErReq "" UBYTE ADAS_CM_uint8 0 0 0.000000 1.000000 ECU_ADDRESS 0x0000 /* @ECU_Address@DfDiagAlccErReq@ */ /end MEASUREMENT
/begin MEASUREMENT DfDiagArmorType "" UBYTE ADAS_CM_uint8 0 0 0.000000 1.000000 ECU_ADDRESS 0x0000 /* @ECU_Address@DfDiagArmorType@ */ /end MEASUREMENT
/begin MEASUREMENT DfDiagAslaAvail "" UBYTE ADAS_CM_uint8 0 0 0.000000 1.000000 ECU_ADDRESS 0x0000 /* @ECU_Address@DfDiagAslaAvail@ */ /end MEASUREMENT
/begin MEASUREMENT DfDiagAslaErReq "" UBYTE ADAS_CM_uint8 0 0 0.000000 1.000000 ECU_ADDRESS 0x0000 /* @ECU_Address@DfDiagAslaErReq@ */ /end MEASUREMENT
/begin MEASUREMENT DfDiagBodyType "" UBYTE ADAS_CM_uint8 0 0 0.000000 5.000000 ECU_ADDRESS 0x0000 /* @ECU_Address@DfDiagBodyType@ */ /end MEASUREMENT
/begin MEASUREMENT DfDiagBrakeType "" UBYTE ADAS_CM_uint8 0 0 0.000000 2.000000 ECU_ADDRESS 0x0000 /* @ECU_Address@DfDiagBrakeType@ */ /end MEASUREMENT
/begin MEASUREMENT DfDiagCCErReq "" UBYTE ADAS_CM_uint8 0 0 0.000000 1.000000 ECU_ADDRESS 0x0000 /* @ECU_Address@DfDiagCCErReq@ */ /end MEASUREMENT
/begin MEASUREMENT DfDiagCcAvail "" UBYTE ADAS_CM_uint8 0 0 0.000000 1.000000 ECU_ADDRESS 0x0000 /* @ECU_Address@DfDiagCcAvail@ */ /end MEASUREMENT
/begin MEASUREMENT DfDiagDowAvail "" UBYTE ADAS_CM_uint8 0 0 0.000000 1.000000 ECU_ADDRESS 0x0000 /* @ECU_Address@DfDiagDowAvail@ */ /end MEASUREMENT
/begin MEASUREMENT DfDiagDowErReq "" UBYTE ADAS_CM_uint8 0 0 0.000000 1.000000 ECU_ADDRESS 0x0000 /* @ECU_Address@DfDiagDowErReq@ */ /end MEASUREMENT
/begin MEASUREMENT DfDiagFcwAvail "" UBYTE ADAS_CM_uint8 0 0 0.000000 1.000000 ECU_ADDRESS 0x0000 /* @ECU_Address@DfDiagFcwAvail@ */ /end MEASUREMENT
/begin MEASUREMENT DfDiagFcwErReq "" UBYTE ADAS_CM_uint8 0 0 0.000000 1.000000 ECU_ADDRESS 0x0000 /* @ECU_Address@DfDiagFcwErReq@ */ /end MEASUREMENT
/begin MEASUREMENT DfDiagHeatCamera "" UBYTE ADAS_CM_uint8 0 0 0.000000 2.000000 ECU_ADDRESS 0x0000 /* @ECU_Address@DfDiagHeatCamera@ */ /end MEASUREMENT
/begin MEASUREMENT DfDiagLccAvail "" UBYTE ADAS_CM_uint8 0 0 0.000000 1.000000 ECU_ADDRESS 0x0000 /* @ECU_Address@DfDiagLccAvail@ */ /end MEASUREMENT
/begin MEASUREMENT DfDiagLccErReq "" UBYTE ADAS_CM_uint8 0 0 0.000000 1.000000 ECU_ADDRESS 0x0000 /* @ECU_Address@DfDiagLccErReq@ */ /end MEASUREMENT
/begin MEASUREMENT DfDiagLdpAvail "" UBYTE ADAS_CM_uint8 0 0 0.000000 1.000000 ECU_ADDRESS 0x0000 /* @ECU_Address@DfDiagLdpAvail@ */ /end MEASUREMENT
/begin MEASUREMENT DfDiagLdpErReq "" UBYTE ADAS_CM_uint8 0 0 0.000000 1.000000 ECU_ADDRESS 0x0000 /* @ECU_Address@DfDiagLdpErReq@ */ /end MEASUREMENT
/begin MEASUREMENT DfDiagLdwAvail "" UBYTE ADAS_CM_uint8 0 0 0.000000 1.000000 ECU_ADDRESS 0x0000 /* @ECU_Address@DfDiagLdwAvail@ */ /end MEASUREMENT
/begin MEASUREMENT DfDiagLdwErReq "" UBYTE ADAS_CM_uint8 0 0 0.000000 1.000000 ECU_ADDRESS 0x0000 /* @ECU_Address@DfDiagLdwErReq@ */ /end MEASUREMENT
/begin MEASUREMENT DfDiagLidarWash "" UBYTE ADAS_CM_uint8 0 0 0.000000 2.000000 ECU_ADDRESS 0x0000 /* @ECU_Address@DfDiagLidarWash@ */ /end MEASUREMENT
/begin MEASUREMENT DfDiagLimAvail "" UBYTE ADAS_CM_uint8 0 0 0.000000 1.000000 ECU_ADDRESS 0x0000 /* @ECU_Address@DfDiagLimAvail@ */ /end MEASUREMENT
/begin MEASUREMENT DfDiagLimErReq "" UBYTE ADAS_CM_uint8 0 0 0.000000 1.000000 ECU_ADDRESS 0x0000 /* @ECU_Address@DfDiagLimErReq@ */ /end MEASUREMENT
/begin MEASUREMENT DfDiagLkaAutoStart "" UBYTE ADAS_CM_uint8 0 0 0.000000 1.000000 ECU_ADDRESS 0x0000 /* @ECU_Address@DfDiagLkaAutoStart@ */ /end MEASUREMENT
/begin MEASUREMENT DfDiagLkaAvail "" UBYTE ADAS_CM_uint8 0 0 0.000000 1.000000 ECU_ADDRESS 0x0000 /* @ECU_Address@DfDiagLkaAvail@ */ /end MEASUREMENT
/begin MEASUREMENT DfDiagLkaErReq "" UBYTE ADAS_CM_uint8 0 0 0.000000 1.000000 ECU_ADDRESS 0x0000 /* @ECU_Address@DfDiagLkaErReq@ */ /end MEASUREMENT
/begin MEASUREMENT DfDiagMliaAvail "" UBYTE ADAS_CM_uint8 0 0 0.000000 1.000000 ECU_ADDRESS 0x0000 /* @ECU_Address@DfDiagMliaAvail@ */ /end MEASUREMENT
/begin MEASUREMENT DfDiagMliaByeType "" UBYTE ADAS_CM_uint8 0 0 0.000000 5.000000 ECU_ADDRESS 0x0000 /* @ECU_Address@DfDiagMliaByeType@ */ /end MEASUREMENT
/begin MEASUREMENT DfDiagMliaErReq "" UBYTE ADAS_CM_uint8 0 0 0.000000 1.000000 ECU_ADDRESS 0x0000 /* @ECU_Address@DfDiagMliaErReq@ */ /end MEASUREMENT
/begin MEASUREMENT DfDiagMliaHba "" UBYTE ADAS_CM_uint8 0 0 0.000000 1.000000 ECU_ADDRESS 0x0000 /* @ECU_Address@DfDiagMliaHba@ */ /end MEASUREMENT
/begin MEASUREMENT DfDiagMliaWelcomeType "" UBYTE ADAS_CM_uint8 0 0 0.000000 5.000000 ECU_ADDRESS 0x0000 /* @ECU_Address@DfDiagMliaWelcomeType@ */ /end MEASUREMENT
/begin MEASUREMENT DfDiagNvAvail "" UBYTE ADAS_CM_uint8 0 0 0.000000 1.000000 ECU_ADDRESS 0x0000 /* @ECU_Address@DfDiagNvAvail@ */ /end MEASUREMENT
/begin MEASUREMENT DfDiagNvErReq "" UBYTE ADAS_CM_uint8 0 0 0.000000 1.000000 ECU_ADDRESS 0x0000 /* @ECU_Address@DfDiagNvErReq@ */ /end MEASUREMENT
/begin MEASUREMENT DfDiagPowerType "" UBYTE ADAS_CM_uint8 0 0 0.000000 3.000000 ECU_ADDRESS 0x0000 /* @ECU_Address@DfDiagPowerType@ */ /end MEASUREMENT
/begin MEASUREMENT DfDiagRadarWash "" UBYTE ADAS_CM_uint8 0 0 0.000000 2.000000 ECU_ADDRESS 0x0000 /* @ECU_Address@DfDiagRadarWash@ */ /end MEASUREMENT
/begin MEASUREMENT DfDiagRctcAvail "" UBYTE ADAS_CM_uint8 0 0 0.000000 1.000000 ECU_ADDRESS 0x0000 /* @ECU_Address@DfDiagRctcAvail@ */ /end MEASUREMENT
/begin MEASUREMENT DfDiagRctcErReq "" UBYTE ADAS_CM_uint8 0 0 0.000000 1.000000 ECU_ADDRESS 0x0000 /* @ECU_Address@DfDiagRctcErReq@ */ /end MEASUREMENT
/begin MEASUREMENT DfDiagRcwAvail "" UBYTE ADAS_CM_uint8 0 0 0.000000 1.000000 ECU_ADDRESS 0x0000 /* @ECU_Address@DfDiagRcwAvail@ */ /end MEASUREMENT
/begin MEASUREMENT DfDiagRcwErReq "" UBYTE ADAS_CM_uint8 0 0 0.000000 1.000000 ECU_ADDRESS 0x0000 /* @ECU_Address@DfDiagRcwErReq@ */ /end MEASUREMENT
/begin MEASUREMENT DfDiagRdaAvail "" UBYTE ADAS_CM_uint8 0 0 0.000000 1.000000 ECU_ADDRESS 0x0000 /* @ECU_Address@DfDiagRdaAvail@ */ /end MEASUREMENT
/begin MEASUREMENT DfDiagRdaErReq "" UBYTE ADAS_CM_uint8 0 0 0.000000 1.000000 ECU_ADDRESS 0x0000 /* @ECU_Address@DfDiagRdaErReq@ */ /end MEASUREMENT
/begin MEASUREMENT DfDiagRearSteeringActuatorAvail "" UBYTE ADAS_CM_uint8 0 0 0.000000 1.000000 ECU_ADDRESS 0x0000 /* @ECU_Address@DfDiagRearSteeringActuatorAvail@ */ /end MEASUREMENT
/begin MEASUREMENT DfDiagRecAvail "" UBYTE ADAS_CM_uint8 0 0 0.000000 1.000000 ECU_ADDRESS 0x0000 /* @ECU_Address@DfDiagRecAvail@ */ /end MEASUREMENT
/begin MEASUREMENT DfDiagRecErReq "" UBYTE ADAS_CM_uint8 0 0 0.000000 1.000000 ECU_ADDRESS 0x0000 /* @ECU_Address@DfDiagRecErReq@ */ /end MEASUREMENT
/begin MEASUREMENT DfDiagSteeringRackType "" UBYTE ADAS_CM_uint8 0 0 0.000000 1.000000 ECU_ADDRESS 0x0000 /* @ECU_Address@DfDiagSteeringRackType@ */ /end MEASUREMENT
/begin MEASUREMENT DfDiagSteeringWheelType "" UBYTE ADAS_CM_uint8 0 0 0.000000 1.000000 ECU_ADDRESS 0x0000 /* @ECU_Address@DfDiagSteeringWheelType@ */ /end MEASUREMENT
/begin MEASUREMENT DfDiagSuspentionType "" UBYTE ADAS_CM_uint8 0 0 0.000000 1.000000 ECU_ADDRESS 0x0000 /* @ECU_Address@DfDiagSuspentionType@ */ /end MEASUREMENT
/begin MEASUREMENT DfDiagThermalCameraWash "" UBYTE ADAS_CM_uint8 0 0 0.000000 2.000000 ECU_ADDRESS 0x0000 /* @ECU_Address@DfDiagThermalCameraWash@ */ /end MEASUREMENT
/begin MEASUREMENT DfDiagTsrAvail "" UBYTE ADAS_CM_uint8 0 0 0.000000 1.000000 ECU_ADDRESS 0x0000 /* @ECU_Address@DfDiagTsrAvail@ */ /end MEASUREMENT
/begin MEASUREMENT DfDiagTsrErReq "" UBYTE ADAS_CM_uint8 0 0 0.000000 1.000000 ECU_ADDRESS 0x0000 /* @ECU_Address@DfDiagTsrErReq@ */ /end MEASUREMENT
/begin MEASUREMENT DfDiagValidDataMAS_Front "" UBYTE ADAS_CM_uint8 0 0 0.000000 1.000000 ECU_ADDRESS 0x0000 /* @ECU_Address@DfDiagValidDataMAS_Front@ */ /end MEASUREMENT
/begin MEASUREMENT DfDiagValidDataMAS_Rear "" UBYTE ADAS_CM_uint8 0 0 0.000000 1.000000 ECU_ADDRESS 0x0000 /* @ECU_Address@DfDiagValidDataMAS_Rear@ */ /end MEASUREMENT
/begin MEASUREMENT DfDiagValidDataMAS_Side "" UBYTE ADAS_CM_uint8 0 0 0.000000 1.000000 ECU_ADDRESS 0x0000 /* @ECU_Address@DfDiagValidDataMAS_Side@ */ /end MEASUREMENT
/begin MEASUREMENT DfDiagVisualAvail "" UBYTE ADAS_CM_uint8 0 0 0.000000 1.000000 ECU_ADDRESS 0x0000 /* @ECU_Address@DfDiagVisualAvail@ */ /end MEASUREMENT
/begin MEASUREMENT DfDiagVisualErReq "" UBYTE ADAS_CM_uint8 0 0 0.000000 1.000000 ECU_ADDRESS 0x0000 /* @ECU_Address@DfDiagVisualErReq@ */ /end MEASUREMENT
/begin MEASUREMENT DfEragCourse "" FLOAT32_IEEE ADAS_CM_single 0 0 0.000000 999.900000 ECU_ADDRESS 0x0000 /* @ECU_Address@DfEragCourse@ */ /end MEASUREMENT
/begin MEASUREMENT DfEragDay "" UBYTE ADAS_CM_uint8 0 0 0.000000 31.000000 ECU_ADDRESS 0x0000 /* @ECU_Address@DfEragDay@ */ /end MEASUREMENT
/begin MEASUREMENT DfEragHours "" UBYTE ADAS_CM_uint8 0 0 0.000000 24.000000 ECU_ADDRESS 0x0000 /* @ECU_Address@DfEragHours@ */ /end MEASUREMENT
/begin MEASUREMENT DfEragLatitude "" FLOAT32_IEEE ADAS_CM_single 0 0 -90.000000 90.000000 ECU_ADDRESS 0x0000 /* @ECU_Address@DfEragLatitude@ */ /end MEASUREMENT
/begin MEASUREMENT DfEragLongitude "" FLOAT32_IEEE ADAS_CM_single 0 0 -180.000000 180.000000 ECU_ADDRESS 0x0000 /* @ECU_Address@DfEragLongitude@ */ /end MEASUREMENT
/begin MEASUREMENT DfEragMinutes "" UBYTE ADAS_CM_uint8 0 0 0.000000 60.000000 ECU_ADDRESS 0x0000 /* @ECU_Address@DfEragMinutes@ */ /end MEASUREMENT
/begin MEASUREMENT DfEragMonth "" UBYTE ADAS_CM_uint8 0 0 0.000000 12.000000 ECU_ADDRESS 0x0000 /* @ECU_Address@DfEragMonth@ */ /end MEASUREMENT
/begin MEASUREMENT DfEragSeconds "" UBYTE ADAS_CM_uint8 0 0 0.000000 60.000000 ECU_ADDRESS 0x0000 /* @ECU_Address@DfEragSeconds@ */ /end MEASUREMENT
/begin MEASUREMENT DfEragSpeed "" FLOAT32_IEEE ADAS_CM_single 0 0 0.000000 999.900000 ECU_ADDRESS 0x0000 /* @ECU_Address@DfEragSpeed@ */ /end MEASUREMENT
/begin MEASUREMENT DfEragYear "" UBYTE ADAS_CM_uint8 0 0 0.000000 255.000000 ECU_ADDRESS 0x0000 /* @ECU_Address@DfEragYear@ */ /end MEASUREMENT
/begin MEASUREMENT DfMemAaCoeffAtts "" UBYTE ADAS_CM_uint8 0 0 0.000000 20.000000 ECU_ADDRESS 0x0000 /* @ECU_Address@DfMemAaCoeffAtts@ */ /end MEASUREMENT
/begin MEASUREMENT DfMemAaStTest "" UBYTE ADAS_CM_uint8 0 0 0.000000 1.000000 ECU_ADDRESS 0x0000 /* @ECU_Address@DfMemAaStTest@ */ /end MEASUREMENT
/begin MEASUREMENT DfMemAaTimeIgn "" ULONG ADAS_CM_uint32 0 0 0.000000 4294967295.000000 ECU_ADDRESS 0x0000 /* @ECU_Address@DfMemAaTimeIgn@ */ /end MEASUREMENT
/begin MEASUREMENT DfMemAaTimeSave "" ULONG ADAS_CM_uint32 0 0 0.000000 4294967295.000000 ECU_ADDRESS 0x0000 /* @ECU_Address@DfMemAaTimeSave@ */ /end MEASUREMENT
/begin MEASUREMENT DfMemAccDist "" UBYTE ADAS_CM_uint8 0 0 0.000000 1.000000 ECU_ADDRESS 0x0000 /* @ECU_Address@DfMemAccDist@ */ /end MEASUREMENT
/begin MEASUREMENT DfMemAccSpeedKmh "" UBYTE ADAS_CM_uint8 0 0 0.000000 255.000000 ECU_ADDRESS 0x0000 /* @ECU_Address@DfMemAccSpeedKmh@ */ /end MEASUREMENT
/begin MEASUREMENT DfMemAnAccTimeCity "" FLOAT32_IEEE ADAS_CM_single 0 0 0.000000 65535.000000 ECU_ADDRESS 0x0000 /* @ECU_Address@DfMemAnAccTimeCity@ */ /end MEASUREMENT
/begin MEASUREMENT DfMemAnAccTimeHighWay "" FLOAT32_IEEE ADAS_CM_single 0 0 0.000000 65535.000000 ECU_ADDRESS 0x0000 /* @ECU_Address@DfMemAnAccTimeHighWay@ */ /end MEASUREMENT
/begin MEASUREMENT DfMemAnAccTimeJam "" FLOAT32_IEEE ADAS_CM_single 0 0 0.000000 65535.000000 ECU_ADDRESS 0x0000 /* @ECU_Address@DfMemAnAccTimeJam@ */ /end MEASUREMENT
/begin MEASUREMENT DfMemAnAccTimeMedDist "" FLOAT32_IEEE ADAS_CM_single 0 0 0.000000 65535.000000 ECU_ADDRESS 0x0000 /* @ECU_Address@DfMemAnAccTimeMedDist@ */ /end MEASUREMENT
/begin MEASUREMENT DfMemAnAccTimeMedMaxDist "" FLOAT32_IEEE ADAS_CM_single 0 0 0.000000 65535.000000 ECU_ADDRESS 0x0000 /* @ECU_Address@DfMemAnAccTimeMedMaxDist@ */ /end MEASUREMENT
/begin MEASUREMENT DfMemAnAccTimeMinDist "" FLOAT32_IEEE ADAS_CM_single 0 0 0.000000 65535.000000 ECU_ADDRESS 0x0000 /* @ECU_Address@DfMemAnAccTimeMinDist@ */ /end MEASUREMENT
/begin MEASUREMENT DfMemAnAebActvnDst "" FLOAT32_IEEE ADAS_CM_single 0 0 0.000000 65535.000000 ECU_ADDRESS 0x0000 /* @ECU_Address@DfMemAnAebActvnDst@ */ /end MEASUREMENT
/begin MEASUREMENT DfMemAnAebAvgDistToTar "" FLOAT32_IEEE ADAS_CM_single 0 0 0.000000 65535.000000 ECU_ADDRESS 0x0000 /* @ECU_Address@DfMemAnAebAvgDistToTar@ */ /end MEASUREMENT
/begin MEASUREMENT DfMemAnAebCorrnTiWarn "" FLOAT32_IEEE ADAS_CM_single 0 0 -1.000000 1.000000 ECU_ADDRESS 0x0000 /* @ECU_Address@DfMemAnAebCorrnTiWarn@ */ /end MEASUREMENT
/begin MEASUREMENT DfMemAnAebNrOfOper "" UBYTE ADAS_CM_uint8 0 0 0.000000 255.000000 ECU_ADDRESS 0x0000 /* @ECU_Address@DfMemAnAebNrOfOper@ */ /end MEASUREMENT
/begin MEASUREMENT DfMemAnAlccActvnDst "" FLOAT32_IEEE ADAS_CM_single 0 0 0.000000 65535.000000 ECU_ADDRESS 0x0000 /* @ECU_Address@DfMemAnAlccActvnDst@ */ /end MEASUREMENT
/begin MEASUREMENT DfMemAnAlccNrOfOper "" FLOAT32_IEEE ADAS_CM_single 0 0 0.000000 65535.000000 ECU_ADDRESS 0x0000 /* @ECU_Address@DfMemAnAlccNrOfOper@ */ /end MEASUREMENT
/begin MEASUREMENT DfMemAnCcTime "" FLOAT32_IEEE ADAS_CM_single 0 0 0.000000 65535.000000 ECU_ADDRESS 0x0000 /* @ECU_Address@DfMemAnCcTime@ */ /end MEASUREMENT
/begin MEASUREMENT DfMemAnDowCorrnTiWarn "" FLOAT32_IEEE ADAS_CM_single 0 0 -1.000000 1.000000 ECU_ADDRESS 0x0000 /* @ECU_Address@DfMemAnDowCorrnTiWarn@ */ /end MEASUREMENT
/begin MEASUREMENT DfMemAnDowNrOfOper "" FLOAT32_IEEE ADAS_CM_single 0 0 0.000000 65535.000000 ECU_ADDRESS 0x0000 /* @ECU_Address@DfMemAnDowNrOfOper@ */ /end MEASUREMENT
/begin MEASUREMENT DfMemAnDowTime "" FLOAT32_IEEE ADAS_CM_single 0 0 0.000000 65535.000000 ECU_ADDRESS 0x0000 /* @ECU_Address@DfMemAnDowTime@ */ /end MEASUREMENT
/begin MEASUREMENT DfMemAnFcwActvnDst "" FLOAT32_IEEE ADAS_CM_single 0 0 0.000000 65535.000000 ECU_ADDRESS 0x0000 /* @ECU_Address@DfMemAnFcwActvnDst@ */ /end MEASUREMENT
/begin MEASUREMENT DfMemAnFcwNrOfOper "" UBYTE ADAS_CM_uint8 0 0 0.000000 255.000000 ECU_ADDRESS 0x0000 /* @ECU_Address@DfMemAnFcwNrOfOper@ */ /end MEASUREMENT
/begin MEASUREMENT DfMemAnLccActvnDst "" FLOAT32_IEEE ADAS_CM_single 0 0 0.000000 65535.000000 ECU_ADDRESS 0x0000 /* @ECU_Address@DfMemAnLccActvnDst@ */ /end MEASUREMENT
/begin MEASUREMENT DfMemAnLccCorrnTiWarn "" FLOAT32_IEEE ADAS_CM_single 0 0 -1.000000 1.000000 ECU_ADDRESS 0x0000 /* @ECU_Address@DfMemAnLccCorrnTiWarn@ */ /end MEASUREMENT
/begin MEASUREMENT DfMemAnLccNrOfOper "" FLOAT32_IEEE ADAS_CM_single 0 0 0.000000 65535.000000 ECU_ADDRESS 0x0000 /* @ECU_Address@DfMemAnLccNrOfOper@ */ /end MEASUREMENT
/begin MEASUREMENT DfMemAnLdpNumOfWarn "" FLOAT32_IEEE ADAS_CM_single 0 0 0.000000 65535.000000 ECU_ADDRESS 0x0000 /* @ECU_Address@DfMemAnLdpNumOfWarn@ */ /end MEASUREMENT
/begin MEASUREMENT DfMemAnLdpTimeActive "" FLOAT32_IEEE ADAS_CM_single 0 0 0.000000 65535.000000 ECU_ADDRESS 0x0000 /* @ECU_Address@DfMemAnLdpTimeActive@ */ /end MEASUREMENT
/begin MEASUREMENT DfMemAnLdwNumOfWarn "" FLOAT32_IEEE ADAS_CM_single 0 0 0.000000 65535.000000 ECU_ADDRESS 0x0000 /* @ECU_Address@DfMemAnLdwNumOfWarn@ */ /end MEASUREMENT
/begin MEASUREMENT DfMemAnLdwTimeActive "" FLOAT32_IEEE ADAS_CM_single 0 0 0.000000 65535.000000 ECU_ADDRESS 0x0000 /* @ECU_Address@DfMemAnLdwTimeActive@ */ /end MEASUREMENT
/begin MEASUREMENT DfMemAnLkaTimeActive "" FLOAT32_IEEE ADAS_CM_single 0 0 0.000000 65535.000000 ECU_ADDRESS 0x0000 /* @ECU_Address@DfMemAnLkaTimeActive@ */ /end MEASUREMENT
/begin MEASUREMENT DfMemAnLkaTimeTotal "" FLOAT32_IEEE ADAS_CM_single 0 0 0.000000 65535.000000 ECU_ADDRESS 0x0000 /* @ECU_Address@DfMemAnLkaTimeTotal@ */ /end MEASUREMENT
/begin MEASUREMENT DfMemAnMliaTimeObj "" FLOAT32_IEEE ADAS_CM_single 0 0 0.000000 65535.000000 ECU_ADDRESS 0x0000 /* @ECU_Address@DfMemAnMliaTimeObj@ */ /end MEASUREMENT
/begin MEASUREMENT DfMemAnMliaTimeTotal "" FLOAT32_IEEE ADAS_CM_single 0 0 0.000000 65535.000000 ECU_ADDRESS 0x0000 /* @ECU_Address@DfMemAnMliaTimeTotal@ */ /end MEASUREMENT
/begin MEASUREMENT DfMemAnRctcAvgDistToTar "" UBYTE ADAS_CM_uint8 0 0 0.000000 255.000000 ECU_ADDRESS 0x0000 /* @ECU_Address@DfMemAnRctcAvgDistToTar@ */ /end MEASUREMENT
/begin MEASUREMENT DfMemAnRctcNrOfOper "" UBYTE ADAS_CM_uint8 0 0 0.000000 255.000000 ECU_ADDRESS 0x0000 /* @ECU_Address@DfMemAnRctcNrOfOper@ */ /end MEASUREMENT
/begin MEASUREMENT DfMemAnRctcaActvnDst "" FLOAT32_IEEE ADAS_CM_single 0 0 0.000000 65535.000000 ECU_ADDRESS 0x0000 /* @ECU_Address@DfMemAnRctcaActvnDst@ */ /end MEASUREMENT
/begin MEASUREMENT DfMemAnRcwAvgDistToTar "" UBYTE ADAS_CM_uint8 0 0 0.000000 255.000000 ECU_ADDRESS 0x0000 /* @ECU_Address@DfMemAnRcwAvgDistToTar@ */ /end MEASUREMENT
/begin MEASUREMENT DfMemAnRcwNrOfOper "" UBYTE ADAS_CM_uint8 0 0 0.000000 255.000000 ECU_ADDRESS 0x0000 /* @ECU_Address@DfMemAnRcwNrOfOper@ */ /end MEASUREMENT
/begin MEASUREMENT DfMemAnRdaActvnDst "" FLOAT32_IEEE ADAS_CM_single 0 0 0.000000 65535.000000 ECU_ADDRESS 0x0000 /* @ECU_Address@DfMemAnRdaActvnDst@ */ /end MEASUREMENT
/begin MEASUREMENT DfMemAnRdaAvgDistToTar "" FLOAT32_IEEE ADAS_CM_single 0 0 0.000000 65535.000000 ECU_ADDRESS 0x0000 /* @ECU_Address@DfMemAnRdaAvgDistToTar@ */ /end MEASUREMENT
/begin MEASUREMENT DfMemAnRdaCorrnTiWarn "" FLOAT32_IEEE ADAS_CM_single 0 0 -1.000000 1.000000 ECU_ADDRESS 0x0000 /* @ECU_Address@DfMemAnRdaCorrnTiWarn@ */ /end MEASUREMENT
/begin MEASUREMENT DfMemAnRdaNrOfOper "" FLOAT32_IEEE ADAS_CM_single 0 0 0.000000 65535.000000 ECU_ADDRESS 0x0000 /* @ECU_Address@DfMemAnRdaNrOfOper@ */ /end MEASUREMENT
/begin MEASUREMENT DfMemFiuAaMode "" UBYTE ADAS_CM_uint8 0 0 0.000000 2.000000 ECU_ADDRESS 0x0000 /* @ECU_Address@DfMemFiuAaMode@ */ /end MEASUREMENT
/begin MEASUREMENT DfMemFiuAaStat "" UBYTE ADAS_CM_uint8 0 0 0.000000 1.000000 ECU_ADDRESS 0x0000 /* @ECU_Address@DfMemFiuAaStat@ */ /end MEASUREMENT
/begin MEASUREMENT DfMemFiuAebStat "" UBYTE ADAS_CM_uint8 0 0 0.000000 1.000000 ECU_ADDRESS 0x0000 /* @ECU_Address@DfMemFiuAebStat@ */ /end MEASUREMENT
/begin MEASUREMENT DfMemFiuAfsStat "" UBYTE ADAS_CM_uint8 0 0 0.000000 1.000000 ECU_ADDRESS 0x0000 /* @ECU_Address@DfMemFiuAfsStat@ */ /end MEASUREMENT
/begin MEASUREMENT DfMemFiuAlccStat "" UBYTE ADAS_CM_uint8 0 0 0.000000 1.000000 ECU_ADDRESS 0x0000 /* @ECU_Address@DfMemFiuAlccStat@ */ /end MEASUREMENT
/begin MEASUREMENT DfMemFiuAslaOver "" FLOAT32_IEEE ADAS_CM_single 0 0 0.000000 60.000000 ECU_ADDRESS 0x0000 /* @ECU_Address@DfMemFiuAslaOver@ */ /end MEASUREMENT
/begin MEASUREMENT DfMemFiuAslaStat "" UBYTE ADAS_CM_uint8 0 0 0.000000 1.000000 ECU_ADDRESS 0x0000 /* @ECU_Address@DfMemFiuAslaStat@ */ /end MEASUREMENT
/begin MEASUREMENT DfMemFiuAssistActive1Stat "" UBYTE ADAS_CM_uint8 0 0 0.000000 1.000000 ECU_ADDRESS 0x0000 /* @ECU_Address@DfMemFiuAssistActive1Stat@ */ /end MEASUREMENT
/begin MEASUREMENT DfMemFiuAssistActive2Stat "" UBYTE ADAS_CM_uint8 0 0 0.000000 1.000000 ECU_ADDRESS 0x0000 /* @ECU_Address@DfMemFiuAssistActive2Stat@ */ /end MEASUREMENT
/begin MEASUREMENT DfMemFiuAssistActive3Stat "" UBYTE ADAS_CM_uint8 0 0 0.000000 1.000000 ECU_ADDRESS 0x0000 /* @ECU_Address@DfMemFiuAssistActive3Stat@ */ /end MEASUREMENT
/begin MEASUREMENT DfMemFiuAssistActive4Stat "" UBYTE ADAS_CM_uint8 0 0 0.000000 1.000000 ECU_ADDRESS 0x0000 /* @ECU_Address@DfMemFiuAssistActive4Stat@ */ /end MEASUREMENT
/begin MEASUREMENT DfMemFiuCcMode "" UBYTE ADAS_CM_uint8 0 0 0.000000 1.000000 ECU_ADDRESS 0x0000 /* @ECU_Address@DfMemFiuCcMode@ */ /end MEASUREMENT
/begin MEASUREMENT DfMemFiuCcSpdCorrect "" UBYTE ADAS_CM_uint8 0 0 0.000000 1.000000 ECU_ADDRESS 0x0000 /* @ECU_Address@DfMemFiuCcSpdCorrect@ */ /end MEASUREMENT
/begin MEASUREMENT DfMemFiuCcType "" UBYTE ADAS_CM_uint8 0 0 0.000000 3.000000 ECU_ADDRESS 0x0000 /* @ECU_Address@DfMemFiuCcType@ */ /end MEASUREMENT
/begin MEASUREMENT DfMemFiuDowSound "" UBYTE ADAS_CM_uint8 0 0 0.000000 1.000000 ECU_ADDRESS 0x0000 /* @ECU_Address@DfMemFiuDowSound@ */ /end MEASUREMENT
/begin MEASUREMENT DfMemFiuDowStat "" UBYTE ADAS_CM_uint8 0 0 0.000000 1.000000 ECU_ADDRESS 0x0000 /* @ECU_Address@DfMemFiuDowStat@ */ /end MEASUREMENT
/begin MEASUREMENT DfMemFiuFcwMode "" UBYTE ADAS_CM_uint8 0 0 0.000000 2.000000 ECU_ADDRESS 0x0000 /* @ECU_Address@DfMemFiuFcwMode@ */ /end MEASUREMENT
/begin MEASUREMENT DfMemFiuFcwStat "" UBYTE ADAS_CM_uint8 0 0 0.000000 1.000000 ECU_ADDRESS 0x0000 /* @ECU_Address@DfMemFiuFcwStat@ */ /end MEASUREMENT
/begin MEASUREMENT DfMemFiuFcwVibration "" UBYTE ADAS_CM_uint8 0 0 0.000000 1.000000 ECU_ADDRESS 0x0000 /* @ECU_Address@DfMemFiuFcwVibration@ */ /end MEASUREMENT
/begin MEASUREMENT DfMemFiuLccMode "" UBYTE ADAS_CM_uint8 0 0 0.000000 2.000000 ECU_ADDRESS 0x0000 /* @ECU_Address@DfMemFiuLccMode@ */ /end MEASUREMENT
/begin MEASUREMENT DfMemFiuLccSound "" UBYTE ADAS_CM_uint8 0 0 0.000000 1.000000 ECU_ADDRESS 0x0000 /* @ECU_Address@DfMemFiuLccSound@ */ /end MEASUREMENT
/begin MEASUREMENT DfMemFiuLccStat "" UBYTE ADAS_CM_uint8 0 0 0.000000 1.000000 ECU_ADDRESS 0x0000 /* @ECU_Address@DfMemFiuLccStat@ */ /end MEASUREMENT
/begin MEASUREMENT DfMemFiuLccVibration "" UBYTE ADAS_CM_uint8 0 0 0.000000 1.000000 ECU_ADDRESS 0x0000 /* @ECU_Address@DfMemFiuLccVibration@ */ /end MEASUREMENT
/begin MEASUREMENT DfMemFiuLdpStat "" UBYTE ADAS_CM_uint8 0 0 0.000000 1.000000 ECU_ADDRESS 0x0000 /* @ECU_Address@DfMemFiuLdpStat@ */ /end MEASUREMENT
/begin MEASUREMENT DfMemFiuLdwMode "" UBYTE ADAS_CM_uint8 0 0 0.000000 1.000000 ECU_ADDRESS 0x0000 /* @ECU_Address@DfMemFiuLdwMode@ */ /end MEASUREMENT
/begin MEASUREMENT DfMemFiuLdwSound "" UBYTE ADAS_CM_uint8 0 0 0.000000 1.000000 ECU_ADDRESS 0x0000 /* @ECU_Address@DfMemFiuLdwSound@ */ /end MEASUREMENT
/begin MEASUREMENT DfMemFiuLdwStat "" UBYTE ADAS_CM_uint8 0 0 0.000000 1.000000 ECU_ADDRESS 0x0000 /* @ECU_Address@DfMemFiuLdwStat@ */ /end MEASUREMENT
/begin MEASUREMENT DfMemFiuLdwVibration "" UBYTE ADAS_CM_uint8 0 0 0.000000 1.000000 ECU_ADDRESS 0x0000 /* @ECU_Address@DfMemFiuLdwVibration@ */ /end MEASUREMENT
/begin MEASUREMENT DfMemFiuLkaStat "" UBYTE ADAS_CM_uint8 0 0 0.000000 1.000000 ECU_ADDRESS 0x0000 /* @ECU_Address@DfMemFiuLkaStat@ */ /end MEASUREMENT
/begin MEASUREMENT DfMemFiuNavigStat "" UBYTE ADAS_CM_uint8 0 0 0.000000 1.000000 ECU_ADDRESS 0x0000 /* @ECU_Address@DfMemFiuNavigStat@ */ /end MEASUREMENT
/begin MEASUREMENT DfMemFiuOtherObjStat "" UBYTE ADAS_CM_uint8 0 0 0.000000 1.000000 ECU_ADDRESS 0x0000 /* @ECU_Address@DfMemFiuOtherObjStat@ */ /end MEASUREMENT
/begin MEASUREMENT DfMemFiuProjectionOnARoadStat "" UBYTE ADAS_CM_uint8 0 0 0.000000 1.000000 ECU_ADDRESS 0x0000 /* @ECU_Address@DfMemFiuProjectionOnARoadStat@ */ /end MEASUREMENT
/begin MEASUREMENT DfMemFiuRctcStat "" UBYTE ADAS_CM_uint8 0 0 0.000000 1.000000 ECU_ADDRESS 0x0000 /* @ECU_Address@DfMemFiuRctcStat@ */ /end MEASUREMENT
/begin MEASUREMENT DfMemFiuRcwStat "" UBYTE ADAS_CM_uint8 0 0 0.000000 3.000000 ECU_ADDRESS 0x0000 /* @ECU_Address@DfMemFiuRcwStat@ */ /end MEASUREMENT
/begin MEASUREMENT DfMemFiuRdaAutoBrakeStat "" UBYTE ADAS_CM_uint8 0 0 0.000000 1.000000 ECU_ADDRESS 0x0000 /* @ECU_Address@DfMemFiuRdaAutoBrakeStat@ */ /end MEASUREMENT
/begin MEASUREMENT DfMemFiuRdaStat "" UBYTE ADAS_CM_uint8 0 0 0.000000 1.000000 ECU_ADDRESS 0x0000 /* @ECU_Address@DfMemFiuRdaStat@ */ /end MEASUREMENT
/begin MEASUREMENT DfMemFiuRecStat "" UBYTE ADAS_CM_uint8 0 0 0.000000 1.000000 ECU_ADDRESS 0x0000 /* @ECU_Address@DfMemFiuRecStat@ */ /end MEASUREMENT
/begin MEASUREMENT DfMemFiuRoadSignStat "" UBYTE ADAS_CM_uint8 0 0 0.000000 1.000000 ECU_ADDRESS 0x0000 /* @ECU_Address@DfMemFiuRoadSignStat@ */ /end MEASUREMENT
/begin MEASUREMENT DfMemFiuSensCleanStat "" UBYTE ADAS_CM_uint8 0 0 0.000000 1.000000 ECU_ADDRESS 0x0000 /* @ECU_Address@DfMemFiuSensCleanStat@ */ /end MEASUREMENT
/begin MEASUREMENT DfMemFiuTsrStat "" UBYTE ADAS_CM_uint8 0 0 0.000000 1.000000 ECU_ADDRESS 0x0000 /* @ECU_Address@DfMemFiuTsrStat@ */ /end MEASUREMENT
/begin MEASUREMENT DfMemTypeCC "" UBYTE ADAS_CM_uint8 0 0 0.000000 3.000000 ECU_ADDRESS 0x0000 /* @ECU_Address@DfMemTypeCC@ */ /end MEASUREMENT
/begin MEASUREMENT DmsCentrWindArea "" UBYTE ADAS_CM_uint8 0 0 0.000000 1.000000 ECU_ADDRESS 0x0000 /* @ECU_Address@DmsCentrWindArea@ */ /end MEASUREMENT
/begin MEASUREMENT DmsCillArea "" UBYTE ADAS_CM_uint8 0 0 0.000000 1.000000 ECU_ADDRESS 0x0000 /* @ECU_Address@DmsCillArea@ */ /end MEASUREMENT
/begin MEASUREMENT DmsDistractLvl "" UBYTE ADAS_CM_uint8 0 0 0.000000 2.000000 ECU_ADDRESS 0x0000 /* @ECU_Address@DmsDistractLvl@ */ /end MEASUREMENT
/begin MEASUREMENT DmsEyeClosed "" UBYTE ADAS_CM_uint8 0 0 0.000000 1.000000 ECU_ADDRESS 0x0000 /* @ECU_Address@DmsEyeClosed@ */ /end MEASUREMENT
/begin MEASUREMENT DmsFatiqueLvl "" UBYTE ADAS_CM_uint8 0 0 0.000000 3.000000 ECU_ADDRESS 0x0000 /* @ECU_Address@DmsFatiqueLvl@ */ /end MEASUREMENT
/begin MEASUREMENT DmsLeftWindArea "" UBYTE ADAS_CM_uint8 0 0 0.000000 1.000000 ECU_ADDRESS 0x0000 /* @ECU_Address@DmsLeftWindArea@ */ /end MEASUREMENT
/begin MEASUREMENT DmsOtherArea "" UBYTE ADAS_CM_uint8 0 0 0.000000 1.000000 ECU_ADDRESS 0x0000 /* @ECU_Address@DmsOtherArea@ */ /end MEASUREMENT
/begin MEASUREMENT DmsRecognition "" UBYTE ADAS_CM_uint8 0 0 0.000000 1.000000 ECU_ADDRESS 0x0000 /* @ECU_Address@DmsRecognition@ */ /end MEASUREMENT
/begin MEASUREMENT DmsReliability "" UBYTE ADAS_CM_uint8 0 0 0.000000 1.000000 ECU_ADDRESS 0x0000 /* @ECU_Address@DmsReliability@ */ /end MEASUREMENT
/begin MEASUREMENT DmsRightWindArea "" UBYTE ADAS_CM_uint8 0 0 0.000000 1.000000 ECU_ADDRESS 0x0000 /* @ECU_Address@DmsRightWindArea@ */ /end MEASUREMENT
/begin MEASUREMENT DmsViewRoadSide "" UBYTE ADAS_CM_uint8 0 0 0.000000 1.000000 ECU_ADDRESS 0x0000 /* @ECU_Address@DmsViewRoadSide@ */ /end MEASUREMENT
/begin MEASUREMENT DoorFrontLeftHandleReq "" UBYTE ADAS_CM_uint8 0 0 0.000000 1.000000 ECU_ADDRESS 0x0000 /* @ECU_Address@DoorFrontLeftHandleReq@ */ /end MEASUREMENT
/begin MEASUREMENT DoorFrontLeftSt "" UBYTE ADAS_CM_uint8 0 0 0.000000 1.000000 ECU_ADDRESS 0x0000 /* @ECU_Address@DoorFrontLeftSt@ */ /end MEASUREMENT
/begin MEASUREMENT DoorFrontRightHandleReq "" UBYTE ADAS_CM_uint8 0 0 0.000000 1.000000 ECU_ADDRESS 0x0000 /* @ECU_Address@DoorFrontRightHandleReq@ */ /end MEASUREMENT
/begin MEASUREMENT DoorFrontRightSt "" UBYTE ADAS_CM_uint8 0 0 0.000000 1.000000 ECU_ADDRESS 0x0000 /* @ECU_Address@DoorFrontRightSt@ */ /end MEASUREMENT
/begin MEASUREMENT DoorRearLeftHandleReq "" UBYTE ADAS_CM_uint8 0 0 0.000000 1.000000 ECU_ADDRESS 0x0000 /* @ECU_Address@DoorRearLeftHandleReq@ */ /end MEASUREMENT
/begin MEASUREMENT DoorRearLeftSt "" UBYTE ADAS_CM_uint8 0 0 0.000000 1.000000 ECU_ADDRESS 0x0000 /* @ECU_Address@DoorRearLeftSt@ */ /end MEASUREMENT
/begin MEASUREMENT DoorRearRightHandleReq "" UBYTE ADAS_CM_uint8 0 0 0.000000 1.000000 ECU_ADDRESS 0x0000 /* @ECU_Address@DoorRearRightHandleReq@ */ /end MEASUREMENT
/begin MEASUREMENT DoorRearRightSt "" UBYTE ADAS_CM_uint8 0 0 0.000000 1.000000 ECU_ADDRESS 0x0000 /* @ECU_Address@DoorRearRightSt@ */ /end MEASUREMENT
/begin MEASUREMENT DriveOperMode "" UBYTE ADAS_CM_uint8 0 0 0.000000 7.000000 ECU_ADDRESS 0x0000 /* @ECU_Address@DriveOperMode@ */ /end MEASUREMENT
/begin MEASUREMENT DriverTorqueDmd "" FLOAT32_IEEE ADAS_CM_single 0 0 -500.000000 1547.000000 ECU_ADDRESS 0x0000 /* @ECU_Address@DriverTorqueDmd@ */ /end MEASUREMENT
/begin MEASUREMENT DynamicEmergActive "" UBYTE ADAS_CM_uint8 0 0 0.000000 1.000000 ECU_ADDRESS 0x0000 /* @ECU_Address@DynamicEmergActive@ */ /end MEASUREMENT
/begin MEASUREMENT EbdActive "" UBYTE ADAS_CM_uint8 0 0 0.000000 1.000000 ECU_ADDRESS 0x0000 /* @ECU_Address@EbdActive@ */ /end MEASUREMENT
/begin MEASUREMENT EngineSpeed "" FLOAT32_IEEE ADAS_CM_single 0 0 0.000000 16383.750000 ECU_ADDRESS 0x0000 /* @ECU_Address@EngineSpeed@ */ /end MEASUREMENT
/begin MEASUREMENT EpbSt "" UBYTE ADAS_CM_uint8 0 0 0.000000 7.000000 ECU_ADDRESS 0x0000 /* @ECU_Address@EpbSt@ */ /end MEASUREMENT
/begin MEASUREMENT EragSt "" UBYTE ADAS_CM_uint8 0 0 0.000000 1.000000 ECU_ADDRESS 0x0000 /* @ECU_Address@EragSt@ */ /end MEASUREMENT
/begin MEASUREMENT FanSpeed "" UBYTE ADAS_CM_uint8 0 0 0.000000 7.000000 ECU_ADDRESS 0x0000 /* @ECU_Address@FanSpeed@ */ /end MEASUREMENT
/begin MEASUREMENT FcwActivNotif "" UBYTE ADAS_CM_uint8 0 0 0.000000 1.000000 ECU_ADDRESS 0x0000 /* @ECU_Address@FcwActivNotif@ */ /end MEASUREMENT
/begin MEASUREMENT FcwSoundWarnReq "" UBYTE ADAS_CM_uint8 0 0 0.000000 1.000000 ECU_ADDRESS 0x0000 /* @ECU_Address@FcwSoundWarnReq@ */ /end MEASUREMENT
/begin MEASUREMENT GearManualModeSt "" UBYTE ADAS_CM_uint8 0 0 0.000000 1.000000 ECU_ADDRESS 0x0000 /* @ECU_Address@GearManualModeSt@ */ /end MEASUREMENT
/begin MEASUREMENT GearSt "" UBYTE ADAS_CM_uint8 0 0 0.000000 7.000000 ECU_ADDRESS 0x0000 /* @ECU_Address@GearSt@ */ /end MEASUREMENT
/begin MEASUREMENT HdcActive "" UBYTE ADAS_CM_uint8 0 0 0.000000 1.000000 ECU_ADDRESS 0x0000 /* @ECU_Address@HdcActive@ */ /end MEASUREMENT
/begin MEASUREMENT HighBeamReq "" UBYTE ADAS_CM_uint8 0 0 0.000000 3.000000 ECU_ADDRESS 0x0000 /* @ECU_Address@HighBeamReq@ */ /end MEASUREMENT
/begin MEASUREMENT ISettAaActReq "" UBYTE ADAS_CM_uint8 0 0 0.000000 1.000000 ECU_ADDRESS 0x0000 /* @ECU_Address@ISettAaActReq@ */ /end MEASUREMENT
/begin MEASUREMENT ISettAaModeReq "" UBYTE ADAS_CM_uint8 0 0 0.000000 2.000000 ECU_ADDRESS 0x0000 /* @ECU_Address@ISettAaModeReq@ */ /end MEASUREMENT
/begin MEASUREMENT ISettAebActReq "" UBYTE ADAS_CM_uint8 0 0 0.000000 1.000000 ECU_ADDRESS 0x0000 /* @ECU_Address@ISettAebActReq@ */ /end MEASUREMENT
/begin MEASUREMENT ISettAfsActReq "" UBYTE ADAS_CM_uint8 0 0 0.000000 1.000000 ECU_ADDRESS 0x0000 /* @ECU_Address@ISettAfsActReq@ */ /end MEASUREMENT
/begin MEASUREMENT ISettAlccActReq "" UBYTE ADAS_CM_uint8 0 0 0.000000 1.000000 ECU_ADDRESS 0x0000 /* @ECU_Address@ISettAlccActReq@ */ /end MEASUREMENT
/begin MEASUREMENT ISettAslaActReq "" UBYTE ADAS_CM_uint8 0 0 0.000000 1.000000 ECU_ADDRESS 0x0000 /* @ECU_Address@ISettAslaActReq@ */ /end MEASUREMENT
/begin MEASUREMENT ISettAslaDeltaReq "" FLOAT32_IEEE ADAS_CM_single 0 0 -1.000000 60.000000 ECU_ADDRESS 0x0000 /* @ECU_Address@ISettAslaDeltaReq@ */ /end MEASUREMENT
/begin MEASUREMENT ISettCcAutoSpeedReq "" UBYTE ADAS_CM_uint8 0 0 0.000000 1.000000 ECU_ADDRESS 0x0000 /* @ECU_Address@ISettCcAutoSpeedReq@ */ /end MEASUREMENT
/begin MEASUREMENT ISettCcTypeReq "" UBYTE ADAS_CM_uint8 0 0 0.000000 4.000000 ECU_ADDRESS 0x0000 /* @ECU_Address@ISettCcTypeReq@ */ /end MEASUREMENT
/begin MEASUREMENT ISettCcmodeReq "" UBYTE ADAS_CM_uint8 0 0 0.000000 3.000000 ECU_ADDRESS 0x0000 /* @ECU_Address@ISettCcmodeReq@ */ /end MEASUREMENT
/begin MEASUREMENT ISettCleanSensorReq "" UBYTE ADAS_CM_uint8 0 0 0.000000 1.000000 ECU_ADDRESS 0x0000 /* @ECU_Address@ISettCleanSensorReq@ */ /end MEASUREMENT
/begin MEASUREMENT ISettDowActReq "" UBYTE ADAS_CM_uint8 0 0 0.000000 1.000000 ECU_ADDRESS 0x0000 /* @ECU_Address@ISettDowActReq@ */ /end MEASUREMENT
/begin MEASUREMENT ISettDowSoundWarnReq "" UBYTE ADAS_CM_uint8 0 0 0.000000 1.000000 ECU_ADDRESS 0x0000 /* @ECU_Address@ISettDowSoundWarnReq@ */ /end MEASUREMENT
/begin MEASUREMENT ISettFcwActReq "" UBYTE ADAS_CM_uint8 0 0 0.000000 1.000000 ECU_ADDRESS 0x0000 /* @ECU_Address@ISettFcwActReq@ */ /end MEASUREMENT
/begin MEASUREMENT ISettFcwModeReq "" UBYTE ADAS_CM_uint8 0 0 0.000000 3.000000 ECU_ADDRESS 0x0000 /* @ECU_Address@ISettFcwModeReq@ */ /end MEASUREMENT
/begin MEASUREMENT ISettFcwVibrWarnReq "" UBYTE ADAS_CM_uint8 0 0 0.000000 1.000000 ECU_ADDRESS 0x0000 /* @ECU_Address@ISettFcwVibrWarnReq@ */ /end MEASUREMENT
/begin MEASUREMENT ISettLccActReq "" UBYTE ADAS_CM_uint8 0 0 0.000000 1.000000 ECU_ADDRESS 0x0000 /* @ECU_Address@ISettLccActReq@ */ /end MEASUREMENT
/begin MEASUREMENT ISettLccModeReq "" UBYTE ADAS_CM_uint8 0 0 0.000000 3.000000 ECU_ADDRESS 0x0000 /* @ECU_Address@ISettLccModeReq@ */ /end MEASUREMENT
/begin MEASUREMENT ISettLccSoundAlertReq "" UBYTE ADAS_CM_uint8 0 0 0.000000 1.000000 ECU_ADDRESS 0x0000 /* @ECU_Address@ISettLccSoundAlertReq@ */ /end MEASUREMENT
/begin MEASUREMENT ISettLccVibrationWarnReq "" UBYTE ADAS_CM_uint8 0 0 0.000000 3.000000 ECU_ADDRESS 0x0000 /* @ECU_Address@ISettLccVibrationWarnReq@ */ /end MEASUREMENT
/begin MEASUREMENT ISettLdpActReq "" UBYTE ADAS_CM_uint8 0 0 0.000000 1.000000 ECU_ADDRESS 0x0000 /* @ECU_Address@ISettLdpActReq@ */ /end MEASUREMENT
/begin MEASUREMENT ISettLdwActReq "" UBYTE ADAS_CM_uint8 0 0 0.000000 1.000000 ECU_ADDRESS 0x0000 /* @ECU_Address@ISettLdwActReq@ */ /end MEASUREMENT
/begin MEASUREMENT ISettLdwModeReq "" UBYTE ADAS_CM_uint8 0 0 0.000000 3.000000 ECU_ADDRESS 0x0000 /* @ECU_Address@ISettLdwModeReq@ */ /end MEASUREMENT
/begin MEASUREMENT ISettLdwSoundReq "" UBYTE ADAS_CM_uint8 0 0 0.000000 1.000000 ECU_ADDRESS 0x0000 /* @ECU_Address@ISettLdwSoundReq@ */ /end MEASUREMENT
/begin MEASUREMENT ISettLdwVibrReq "" UBYTE ADAS_CM_uint8 0 0 0.000000 1.000000 ECU_ADDRESS 0x0000 /* @ECU_Address@ISettLdwVibrReq@ */ /end MEASUREMENT
/begin MEASUREMENT ISettLkaActReq "" UBYTE ADAS_CM_uint8 0 0 0.000000 1.000000 ECU_ADDRESS 0x0000 /* @ECU_Address@ISettLkaActReq@ */ /end MEASUREMENT
/begin MEASUREMENT ISettNavigStsReq "" UBYTE ADAS_CM_uint8 0 0 0.000000 1.000000 ECU_ADDRESS 0x0000 /* @ECU_Address@ISettNavigStsReq@ */ /end MEASUREMENT
/begin MEASUREMENT ISettOtherObjStsReq "" UBYTE ADAS_CM_uint8 0 0 0.000000 1.000000 ECU_ADDRESS 0x0000 /* @ECU_Address@ISettOtherObjStsReq@ */ /end MEASUREMENT
/begin MEASUREMENT ISettProjectionOnARoadReq "" UBYTE ADAS_CM_uint8 0 0 0.000000 1.000000 ECU_ADDRESS 0x0000 /* @ECU_Address@ISettProjectionOnARoadReq@ */ /end MEASUREMENT
/begin MEASUREMENT ISettRDAAutoBrake_Req "" UBYTE ADAS_CM_uint8 0 0 0.000000 1.000000 ECU_ADDRESS 0x0000 /* @ECU_Address@ISettRDAAutoBrake_Req@ */ /end MEASUREMENT
/begin MEASUREMENT ISettRctcActReq "" UBYTE ADAS_CM_uint8 0 0 0.000000 2.000000 ECU_ADDRESS 0x0000 /* @ECU_Address@ISettRctcActReq@ */ /end MEASUREMENT
/begin MEASUREMENT ISettRdaActReq "" UBYTE ADAS_CM_uint8 0 0 0.000000 1.000000 ECU_ADDRESS 0x0000 /* @ECU_Address@ISettRdaActReq@ */ /end MEASUREMENT
/begin MEASUREMENT ISettRecActReq "" UBYTE ADAS_CM_uint8 0 0 0.000000 1.000000 ECU_ADDRESS 0x0000 /* @ECU_Address@ISettRecActReq@ */ /end MEASUREMENT
/begin MEASUREMENT ISettRoadSignStsReq "" UBYTE ADAS_CM_uint8 0 0 0.000000 1.000000 ECU_ADDRESS 0x0000 /* @ECU_Address@ISettRoadSignStsReq@ */ /end MEASUREMENT
/begin MEASUREMENT ISettStartSettReq "" UBYTE ADAS_CM_uint8 0 0 0.000000 1.000000 ECU_ADDRESS 0x0000 /* @ECU_Address@ISettStartSettReq@ */ /end MEASUREMENT
/begin MEASUREMENT ISettTsrActReq "" UBYTE ADAS_CM_uint8 0 0 0.000000 1.000000 ECU_ADDRESS 0x0000 /* @ECU_Address@ISettTsrActReq@ */ /end MEASUREMENT
/begin MEASUREMENT IgnSt "" UBYTE ADAS_CM_uint8 0 0 0.000000 1.000000 ECU_ADDRESS 0x0000 /* @ECU_Address@IgnSt@ */ /end MEASUREMENT
/begin MEASUREMENT KickDownSt "" UBYTE ADAS_CM_uint8 0 0 0.000000 3.000000 ECU_ADDRESS 0x0000 /* @ECU_Address@KickDownSt@ */ /end MEASUREMENT
/begin MEASUREMENT LateralAccel "" FLOAT32_IEEE ADAS_CM_single 0 0 -4.174500 4.174700 ECU_ADDRESS 0x0000 /* @ECU_Address@LateralAccel@ */ /end MEASUREMENT
/begin MEASUREMENT LccBt "" UBYTE ADAS_CM_uint8 0 0 0.000000 1.000000 ECU_ADDRESS 0x0000 /* @ECU_Address@LccBt@ */ /end MEASUREMENT
/begin MEASUREMENT LdwBt "" UBYTE ADAS_CM_uint8 0 0 0.000000 1.000000 ECU_ADDRESS 0x0000 /* @ECU_Address@LdwBt@ */ /end MEASUREMENT
/begin MEASUREMENT LightAmbient_Val "" FLOAT32_IEEE ADAS_CM_single 0 0 0.000000 25500.000000 ECU_ADDRESS 0x0000 /* @ECU_Address@LightAmbient_Val@ */ /end MEASUREMENT
/begin MEASUREMENT LightFront_Val "" FLOAT32_IEEE ADAS_CM_single 0 0 0.000000 12750.000000 ECU_ADDRESS 0x0000 /* @ECU_Address@LightFront_Val@ */ /end MEASUREMENT
/begin MEASUREMENT LightSwReason_Val "" UBYTE ADAS_CM_uint8 0 0 0.000000 6.000000 ECU_ADDRESS 0x0000 /* @ECU_Address@LightSwReason_Val@ */ /end MEASUREMENT
/begin MEASUREMENT LkaMode "" UBYTE ADAS_CM_uint8 0 0 0.000000 3.000000 ECU_ADDRESS 0x0000 /* @ECU_Address@LkaMode@ */ /end MEASUREMENT
/begin MEASUREMENT LockSt "" UBYTE ADAS_CM_uint8 0 0 0.000000 1.000000 ECU_ADDRESS 0x0000 /* @ECU_Address@LockSt@ */ /end MEASUREMENT
/begin MEASUREMENT LongAccel "" FLOAT32_IEEE ADAS_CM_single 0 0 -4.174500 4.174500 ECU_ADDRESS 0x0000 /* @ECU_Address@LongAccel@ */ /end MEASUREMENT
/begin MEASUREMENT MasActivReq "" UBYTE ADAS_CM_uint8 0 0 0.000000 3.000000 ECU_ADDRESS 0x0000 /* @ECU_Address@MasActivReq@ */ /end MEASUREMENT
/begin MEASUREMENT MasApaDistReq "" FLOAT32_IEEE ADAS_CM_single 0 0 0.000000 4096.000000 ECU_ADDRESS 0x0000 /* @ECU_Address@MasApaDistReq@ */ /end MEASUREMENT
/begin MEASUREMENT MasDrivingSt "" UBYTE ADAS_CM_uint8 0 0 0.000000 1.000000 ECU_ADDRESS 0x0000 /* @ECU_Address@MasDrivingSt@ */ /end MEASUREMENT
/begin MEASUREMENT MasErrSt "" UBYTE ADAS_CM_uint8 0 0 0.000000 1.000000 ECU_ADDRESS 0x0000 /* @ECU_Address@MasErrSt@ */ /end MEASUREMENT
/begin MEASUREMENT MasGearReq "" UBYTE ADAS_CM_uint8 0 0 0.000000 7.000000 ECU_ADDRESS 0x0000 /* @ECU_Address@MasGearReq@ */ /end MEASUREMENT
/begin MEASUREMENT MasNegTrq "" FLOAT32_IEEE ADAS_CM_single 0 0 -4095.000000 0.000000 ECU_ADDRESS 0x0000 /* @ECU_Address@MasNegTrq@ */ /end MEASUREMENT
/begin MEASUREMENT MasParkSt "" UBYTE ADAS_CM_uint8 0 0 0.000000 2.000000 ECU_ADDRESS 0x0000 /* @ECU_Address@MasParkSt@ */ /end MEASUREMENT
/begin MEASUREMENT MasPosTrq "" FLOAT32_IEEE ADAS_CM_single 0 0 0.000000 4095.000000 ECU_ADDRESS 0x0000 /* @ECU_Address@MasPosTrq@ */ /end MEASUREMENT
/begin MEASUREMENT McBrakePressure "" FLOAT32_IEEE ADAS_CM_single 0 0 0.000000 409.500000 ECU_ADDRESS 0x0000 /* @ECU_Address@McBrakePressure@ */ /end MEASUREMENT
/begin MEASUREMENT MliaStartReq "" UBYTE ADAS_CM_uint8 0 0 0.000000 1.000000 ECU_ADDRESS 0x0000 /* @ECU_Address@MliaStartReq@ */ /end MEASUREMENT
/begin MEASUREMENT NvActReq "" UBYTE ADAS_CM_uint8 0 0 0.000000 1.000000 ECU_ADDRESS 0x0000 /* @ECU_Address@NvActReq@ */ /end MEASUREMENT
/begin MEASUREMENT ParkDistFront1 "" UBYTE ADAS_CM_uint8 0 0 0.000000 255.000000 ECU_ADDRESS 0x0000 /* @ECU_Address@ParkDistFront1@ */ /end MEASUREMENT
/begin MEASUREMENT ParkDistFront2 "" UBYTE ADAS_CM_uint8 0 0 0.000000 255.000000 ECU_ADDRESS 0x0000 /* @ECU_Address@ParkDistFront2@ */ /end MEASUREMENT
/begin MEASUREMENT ParkDistFront3 "" UBYTE ADAS_CM_uint8 0 0 0.000000 255.000000 ECU_ADDRESS 0x0000 /* @ECU_Address@ParkDistFront3@ */ /end MEASUREMENT
/begin MEASUREMENT ParkDistFront4 "" UBYTE ADAS_CM_uint8 0 0 0.000000 255.000000 ECU_ADDRESS 0x0000 /* @ECU_Address@ParkDistFront4@ */ /end MEASUREMENT
/begin MEASUREMENT ParkDistFrontLeftSide "" FLOAT32_IEEE ADAS_CM_single 0 0 0.000000 4095.000000 ECU_ADDRESS 0x0000 /* @ECU_Address@ParkDistFrontLeftSide@ */ /end MEASUREMENT
/begin MEASUREMENT ParkDistFrontRightSide "" FLOAT32_IEEE ADAS_CM_single 0 0 0.000000 4095.000000 ECU_ADDRESS 0x0000 /* @ECU_Address@ParkDistFrontRightSide@ */ /end MEASUREMENT
/begin MEASUREMENT ParkDistRear1 "" UBYTE ADAS_CM_uint8 0 0 0.000000 255.000000 ECU_ADDRESS 0x0000 /* @ECU_Address@ParkDistRear1@ */ /end MEASUREMENT
/begin MEASUREMENT ParkDistRear2 "" UBYTE ADAS_CM_uint8 0 0 0.000000 255.000000 ECU_ADDRESS 0x0000 /* @ECU_Address@ParkDistRear2@ */ /end MEASUREMENT
/begin MEASUREMENT ParkDistRear3 "" UBYTE ADAS_CM_uint8 0 0 0.000000 255.000000 ECU_ADDRESS 0x0000 /* @ECU_Address@ParkDistRear3@ */ /end MEASUREMENT
/begin MEASUREMENT ParkDistRear4 "" UBYTE ADAS_CM_uint8 0 0 0.000000 255.000000 ECU_ADDRESS 0x0000 /* @ECU_Address@ParkDistRear4@ */ /end MEASUREMENT
/begin MEASUREMENT ParkDistRearLeftSide "" FLOAT32_IEEE ADAS_CM_single 0 0 0.000000 4095.000000 ECU_ADDRESS 0x0000 /* @ECU_Address@ParkDistRearLeftSide@ */ /end MEASUREMENT
/begin MEASUREMENT ParkDistRearRightSide "" FLOAT32_IEEE ADAS_CM_single 0 0 0.000000 4095.000000 ECU_ADDRESS 0x0000 /* @ECU_Address@ParkDistRearRightSide@ */ /end MEASUREMENT
/begin MEASUREMENT PosHandSt "" UBYTE ADAS_CM_uint8 0 0 0.000000 3.000000 ECU_ADDRESS 0x0000 /* @ECU_Address@PosHandSt@ */ /end MEASUREMENT
/begin MEASUREMENT ProjAnimationStat "" UBYTE ADAS_CM_uint8 0 0 0.000000 2.000000 ECU_ADDRESS 0x0000 /* @ECU_Address@ProjAnimationStat@ */ /end MEASUREMENT
/begin MEASUREMENT RainDens "" UBYTE ADAS_CM_uint8 0 0 0.000000 1.000000 ECU_ADDRESS 0x0000 /* @ECU_Address@RainDens@ */ /end MEASUREMENT
/begin MEASUREMENT RainDetd "" UBYTE ADAS_CM_uint8 0 0 0.000000 1.000000 ECU_ADDRESS 0x0000 /* @ECU_Address@RainDetd@ */ /end MEASUREMENT
/begin MEASUREMENT SasAng "" FLOAT32_IEEE ADAS_CM_single 0 0 -780.000000 779.900000 ECU_ADDRESS 0x0000 /* @ECU_Address@SasAng@ */ /end MEASUREMENT
/begin MEASUREMENT SasCalSt "" UBYTE ADAS_CM_uint8 0 0 0.000000 1.000000 ECU_ADDRESS 0x0000 /* @ECU_Address@SasCalSt@ */ /end MEASUREMENT
/begin MEASUREMENT SasOKSt "" UBYTE ADAS_CM_uint8 0 0 0.000000 1.000000 ECU_ADDRESS 0x0000 /* @ECU_Address@SasOKSt@ */ /end MEASUREMENT
/begin MEASUREMENT SasSpd "" FLOAT32_IEEE ADAS_CM_single 0 0 0.000000 1016.000000 ECU_ADDRESS 0x0000 /* @ECU_Address@SasSpd@ */ /end MEASUREMENT
/begin MEASUREMENT SeatBeltStatus "" UBYTE ADAS_CM_uint8 0 0 0.000000 3.000000 ECU_ADDRESS 0x0000 /* @ECU_Address@SeatBeltStatus@ */ /end MEASUREMENT
/begin MEASUREMENT SensTermSt "" UBYTE ADAS_CM_uint8 0 0 0.000000 1.000000 ECU_ADDRESS 0x0000 /* @ECU_Address@SensTermSt@ */ /end MEASUREMENT
/begin MEASUREMENT SolarSnsrLeVal "" FLOAT32_IEEE ADAS_CM_single 0 0 0.000000 1024.016300 ECU_ADDRESS 0x0000 /* @ECU_Address@SolarSnsrLeVal@ */ /end MEASUREMENT
/begin MEASUREMENT SolarSnsrRiVal "" FLOAT32_IEEE ADAS_CM_single 0 0 0.000000 1024.016200 ECU_ADDRESS 0x0000 /* @ECU_Address@SolarSnsrRiVal@ */ /end MEASUREMENT
/begin MEASUREMENT SpdFromIc "" FLOAT32_IEEE ADAS_CM_single 0 0 0.000000 510.000000 ECU_ADDRESS 0x0000 /* @ECU_Address@SpdFromIc@ */ /end MEASUREMENT
/begin MEASUREMENT TargetLvlALS "" UBYTE ADAS_CM_uint8 0 0 0.000000 255.000000 ECU_ADDRESS 0x0000 /* @ECU_Address@TargetLvlALS@ */ /end MEASUREMENT
/begin MEASUREMENT TcsActive "" UBYTE ADAS_CM_uint8 0 0 0.000000 1.000000 ECU_ADDRESS 0x0000 /* @ECU_Address@TcsActive@ */ /end MEASUREMENT
/begin MEASUREMENT TrqClutch "" FLOAT32_IEEE ADAS_CM_single 0 0 -30000.000000 30000.000000 ECU_ADDRESS 0x0000 /* @ECU_Address@TrqClutch@ */ /end MEASUREMENT
/begin MEASUREMENT TsrSignSpeed "" UBYTE ADAS_CM_uint8 0 0 0.000000 20.000000 ECU_ADDRESS 0x0000 /* @ECU_Address@TsrSignSpeed@ */ /end MEASUREMENT
/begin MEASUREMENT TurnLeftSt "" UBYTE ADAS_CM_uint8 0 0 0.000000 1.000000 ECU_ADDRESS 0x0000 /* @ECU_Address@TurnLeftSt@ */ /end MEASUREMENT
/begin MEASUREMENT TurnRightSt "" UBYTE ADAS_CM_uint8 0 0 0.000000 1.000000 ECU_ADDRESS 0x0000 /* @ECU_Address@TurnRightSt@ */ /end MEASUREMENT
/begin MEASUREMENT VdcActive "" UBYTE ADAS_CM_uint8 0 0 0.000000 1.000000 ECU_ADDRESS 0x0000 /* @ECU_Address@VdcActive@ */ /end MEASUREMENT
/begin MEASUREMENT VehBody "" UBYTE ADAS_CM_uint8 0 0 0.000000 15.000000 ECU_ADDRESS 0x0000 /* @ECU_Address@VehBody@ */ /end MEASUREMENT
/begin MEASUREMENT VehicleMode "" UBYTE ADAS_CM_uint8 0 0 0.000000 15.000000 ECU_ADDRESS 0x0000 /* @ECU_Address@VehicleMode@ */ /end MEASUREMENT
/begin MEASUREMENT VehicleSpd "" FLOAT32_IEEE ADAS_CM_single 0 0 0.000000 655.340000 ECU_ADDRESS 0x0000 /* @ECU_Address@VehicleSpd@ */ /end MEASUREMENT
/begin MEASUREMENT VisualActReq "" UBYTE ADAS_CM_uint8 0 0 0.000000 1.000000 ECU_ADDRESS 0x0000 /* @ECU_Address@VisualActReq@ */ /end MEASUREMENT
/begin MEASUREMENT WashFluidLvl "" UBYTE ADAS_CM_uint8 0 0 0.000000 1.000000 ECU_ADDRESS 0x0000 /* @ECU_Address@WashFluidLvl@ */ /end MEASUREMENT
/begin MEASUREMENT WheelBrakePressureFrontLeft "" FLOAT32_IEEE ADAS_CM_single 0 0 0.000000 425.000000 ECU_ADDRESS 0x0000 /* @ECU_Address@WheelBrakePressureFrontLeft@ */ /end MEASUREMENT
/begin MEASUREMENT WheelBrakePressureFrontRight "" FLOAT32_IEEE ADAS_CM_single 0 0 0.000000 425.000000 ECU_ADDRESS 0x0000 /* @ECU_Address@WheelBrakePressureFrontRight@ */ /end MEASUREMENT
/begin MEASUREMENT WheelBrakePressureRearLeft "" FLOAT32_IEEE ADAS_CM_single 0 0 0.000000 425.000000 ECU_ADDRESS 0x0000 /* @ECU_Address@WheelBrakePressureRearLeft@ */ /end MEASUREMENT
/begin MEASUREMENT WheelBrakePressureRearRight "" FLOAT32_IEEE ADAS_CM_single 0 0 0.000000 425.000000 ECU_ADDRESS 0x0000 /* @ECU_Address@WheelBrakePressureRearRight@ */ /end MEASUREMENT
/begin MEASUREMENT WheelDirectionFL "" UBYTE ADAS_CM_uint8 0 0 0.000000 3.000000 ECU_ADDRESS 0x0000 /* @ECU_Address@WheelDirectionFL@ */ /end MEASUREMENT
/begin MEASUREMENT WheelDirectionFR "" UBYTE ADAS_CM_uint8 0 0 0.000000 3.000000 ECU_ADDRESS 0x0000 /* @ECU_Address@WheelDirectionFR@ */ /end MEASUREMENT
/begin MEASUREMENT WheelSpdFrontLeft "" FLOAT32_IEEE ADAS_CM_single 0 0 0.000000 655.340000 ECU_ADDRESS 0x0000 /* @ECU_Address@WheelSpdFrontLeft@ */ /end MEASUREMENT
/begin MEASUREMENT WheelSpdFrontRight "" FLOAT32_IEEE ADAS_CM_single 0 0 0.000000 655.340000 ECU_ADDRESS 0x0000 /* @ECU_Address@WheelSpdFrontRight@ */ /end MEASUREMENT
/begin MEASUREMENT WheelSpdRearLeft "" FLOAT32_IEEE ADAS_CM_single 0 0 0.000000 655.340000 ECU_ADDRESS 0x0000 /* @ECU_Address@WheelSpdRearLeft@ */ /end MEASUREMENT
/begin MEASUREMENT WheelSpdRearRight "" FLOAT32_IEEE ADAS_CM_single 0 0 0.000000 655.350000 ECU_ADDRESS 0x0000 /* @ECU_Address@WheelSpdRearRight@ */ /end MEASUREMENT
/begin MEASUREMENT WindscreenHeat "" UBYTE ADAS_CM_uint8 0 0 0.000000 1.000000 ECU_ADDRESS 0x0000 /* @ECU_Address@WindscreenHeat@ */ /end MEASUREMENT
/begin MEASUREMENT WindscreenHum "" FLOAT32_IEEE ADAS_CM_single 0 0 0.000000 127.500000 ECU_ADDRESS 0x0000 /* @ECU_Address@WindscreenHum@ */ /end MEASUREMENT
/begin MEASUREMENT WindscreenTemp "" FLOAT32_IEEE ADAS_CM_single 0 0 -40.000000 87.500000 ECU_ADDRESS 0x0000 /* @ECU_Address@WindscreenTemp@ */ /end MEASUREMENT
/begin MEASUREMENT WiprSt "" UBYTE ADAS_CM_uint8 0 0 0.000000 1.000000 ECU_ADDRESS 0x0000 /* @ECU_Address@WiprSt@ */ /end MEASUREMENT
/begin MEASUREMENT YawRate "" FLOAT32_IEEE ADAS_CM_single 0 0 -163.840000 163.830000 ECU_ADDRESS 0x0000 /* @ECU_Address@YawRate@ */ /end MEASUREMENT
/begin MEASUREMENT YawRateValidSts "" UBYTE ADAS_CM_uint8 0 0 0.000000 1.000000 ECU_ADDRESS 0x0000 /* @ECU_Address@YawRateValidSts@ */ /end MEASUREMENT
/begin MEASUREMENT rtDW_ADAS.GTAbs1 "" FLOAT32_IEEE ADAS_CM_single 0 0 -3.4E+38 3.4E+38 ECU_ADDRESS 0x0000 /* @ECU_Address@rtDW_ADAS.GTAbs1@ */ /end MEASUREMENT
/begin MEASUREMENT rtDW_ADAS.GTAbs1_g "" FLOAT32_IEEE ADAS_CM_single 0 0 -3.4E+38 3.4E+38 ECU_ADDRESS 0x0000 /* @ECU_Address@rtDW_ADAS.GTAbs1_g@ */ /end MEASUREMENT
/begin MEASUREMENT rtDW_ADAS.GTAdd1 "" FLOAT64_IEEE ADAS_CM_double 0 0 -1.7E+308 1.7E+308 ECU_ADDRESS 0x0000 /* @ECU_Address@rtDW_ADAS.GTAdd1@ */ /end MEASUREMENT
/begin MEASUREMENT rtDW_ADAS.GTAdd1_e "" FLOAT32_IEEE ADAS_CM_single 0 0 -3.4E+38 3.4E+38 ECU_ADDRESS 0x0000 /* @ECU_Address@rtDW_ADAS.GTAdd1_e@ */ /end MEASUREMENT
/begin MEASUREMENT rtDW_ADAS.GTAdd1_l "" FLOAT32_IEEE ADAS_CM_single 0 0 -3.4E+38 3.4E+38 ECU_ADDRESS 0x0000 /* @ECU_Address@rtDW_ADAS.GTAdd1_l@ */ /end MEASUREMENT
/begin MEASUREMENT rtDW_ADAS.GTAdd2 "" FLOAT64_IEEE ADAS_CM_double 0 0 -1.7E+308 1.7E+308 ECU_ADDRESS 0x0000 /* @ECU_Address@rtDW_ADAS.GTAdd2@ */ /end MEASUREMENT
/begin MEASUREMENT rtDW_ADAS.GTAdd4 "" FLOAT32_IEEE ADAS_CM_single 0 0 -3.4E+38 3.4E+38 ECU_ADDRESS 0x0000 /* @ECU_Address@rtDW_ADAS.GTAdd4@ */ /end MEASUREMENT
/begin MEASUREMENT rtDW_ADAS.GTAdd4_c "" FLOAT32_IEEE ADAS_CM_single 0 0 -3.4E+38 3.4E+38 ECU_ADDRESS 0x0000 /* @ECU_Address@rtDW_ADAS.GTAdd4_c@ */ /end MEASUREMENT
/begin MEASUREMENT rtDW_ADAS.GTAdd5_e "" FLOAT64_IEEE ADAS_CM_double 0 0 -1.7E+308 1.7E+308 ECU_ADDRESS 0x0000 /* @ECU_Address@rtDW_ADAS.GTAdd5_e@ */ /end MEASUREMENT
/begin MEASUREMENT rtDW_ADAS.GTAdd5_j "" FLOAT64_IEEE ADAS_CM_double 0 0 -1.7E+308 1.7E+308 ECU_ADDRESS 0x0000 /* @ECU_Address@rtDW_ADAS.GTAdd5_j@ */ /end MEASUREMENT
/begin MEASUREMENT rtDW_ADAS.GTAdd5_k "" FLOAT32_IEEE ADAS_CM_single 0 0 -3.4E+38 3.4E+38 ECU_ADDRESS 0x0000 /* @ECU_Address@rtDW_ADAS.GTAdd5_k@ */ /end MEASUREMENT
/begin MEASUREMENT rtDW_ADAS.GTAdd5_m "" FLOAT64_IEEE ADAS_CM_double 0 0 -1.7E+308 1.7E+308 ECU_ADDRESS 0x0000 /* @ECU_Address@rtDW_ADAS.GTAdd5_m@ */ /end MEASUREMENT
/begin MEASUREMENT rtDW_ADAS.GTAdd5_mf "" FLOAT32_IEEE ADAS_CM_single 0 0 -3.4E+38 3.4E+38 ECU_ADDRESS 0x0000 /* @ECU_Address@rtDW_ADAS.GTAdd5_mf@ */ /end MEASUREMENT
/begin MEASUREMENT rtDW_ADAS.GTAdd5_o "" FLOAT64_IEEE ADAS_CM_double 0 0 -1.7E+308 1.7E+308 ECU_ADDRESS 0x0000 /* @ECU_Address@rtDW_ADAS.GTAdd5_o@ */ /end MEASUREMENT
/begin MEASUREMENT rtDW_ADAS.GTAdd_c "" FLOAT64_IEEE ADAS_CM_double 0 0 -1.7E+308 1.7E+308 ECU_ADDRESS 0x0000 /* @ECU_Address@rtDW_ADAS.GTAdd_c@ */ /end MEASUREMENT
/begin MEASUREMENT rtDW_ADAS.GTAdd_cp "" FLOAT32_IEEE ADAS_CM_single 0 0 -3.4E+38 3.4E+38 ECU_ADDRESS 0x0000 /* @ECU_Address@rtDW_ADAS.GTAdd_cp@ */ /end MEASUREMENT
/begin MEASUREMENT rtDW_ADAS.GTAdd_cv "" FLOAT32_IEEE ADAS_CM_single 0 0 -3.4E+38 3.4E+38 ECU_ADDRESS 0x0000 /* @ECU_Address@rtDW_ADAS.GTAdd_cv@ */ /end MEASUREMENT
/begin MEASUREMENT rtDW_ADAS.GTAdd_d "" FLOAT32_IEEE ADAS_CM_single 0 0 -3.4E+38 3.4E+38 ECU_ADDRESS 0x0000 /* @ECU_Address@rtDW_ADAS.GTAdd_d@ */ /end MEASUREMENT
/begin MEASUREMENT rtDW_ADAS.GTAdd_k "" FLOAT32_IEEE ADAS_CM_single 0 0 -3.4E+38 3.4E+38 ECU_ADDRESS 0x0000 /* @ECU_Address@rtDW_ADAS.GTAdd_k@ */ /end MEASUREMENT
/begin MEASUREMENT rtDW_ADAS.GTAdd_p "" FLOAT64_IEEE ADAS_CM_double 0 0 -1.7E+308 1.7E+308 ECU_ADDRESS 0x0000 /* @ECU_Address@rtDW_ADAS.GTAdd_p@ */ /end MEASUREMENT
/begin MEASUREMENT rtDW_ADAS.GTAdd_py "" FLOAT64_IEEE ADAS_CM_double 0 0 -1.7E+308 1.7E+308 ECU_ADDRESS 0x0000 /* @ECU_Address@rtDW_ADAS.GTAdd_py@ */ /end MEASUREMENT
/begin MEASUREMENT rtDW_ADAS.GTAngLvl "" UBYTE ADAS_CM_uint8 0 0 0 255 ECU_ADDRESS 0x0000 /* @ECU_Address@rtDW_ADAS.GTAngLvl@ */ /end MEASUREMENT
/begin MEASUREMENT rtDW_ADAS.GTBcmSensCleanSt "" UBYTE ADAS_CM_uint8 0 0 0 255 ECU_ADDRESS 0x0000 /* @ECU_Address@rtDW_ADAS.GTBcmSensCleanSt@ */ /end MEASUREMENT
/begin MEASUREMENT rtDW_ADAS.GTCancelAllFlag "" UBYTE ADAS_CM_uint8 0 0 0 255 ECU_ADDRESS 0x0000 /* @ECU_Address@rtDW_ADAS.GTCancelAllFlag@ */ /end MEASUREMENT
/begin MEASUREMENT rtDW_ADAS.GTCastToBoolean2 "" FLOAT32_IEEE ADAS_CM_single 0 0 -3.4E+38 3.4E+38 ECU_ADDRESS 0x0000 /* @ECU_Address@rtDW_ADAS.GTCastToBoolean2@ */ /end MEASUREMENT
/begin MEASUREMENT rtDW_ADAS.GTCastToBoolean2_g "" FLOAT32_IEEE ADAS_CM_single 0 0 -3.4E+38 3.4E+38 ECU_ADDRESS 0x0000 /* @ECU_Address@rtDW_ADAS.GTCastToBoolean2_g@ */ /end MEASUREMENT
/begin MEASUREMENT rtDW_ADAS.GTCastToBoolean2_gd "" FLOAT32_IEEE ADAS_CM_single 0 0 -3.4E+38 3.4E+38 ECU_ADDRESS 0x0000 /* @ECU_Address@rtDW_ADAS.GTCastToBoolean2_gd@ */ /end MEASUREMENT
/begin MEASUREMENT rtDW_ADAS.GTCastToBoolean2_m "" FLOAT32_IEEE ADAS_CM_single 0 0 -3.4E+38 3.4E+38 ECU_ADDRESS 0x0000 /* @ECU_Address@rtDW_ADAS.GTCastToBoolean2_m@ */ /end MEASUREMENT
/begin MEASUREMENT rtDW_ADAS.GTCnt "" UBYTE ADAS_CM_uint8 0 0 0 255 ECU_ADDRESS 0x0000 /* @ECU_Address@rtDW_ADAS.GTCnt@ */ /end MEASUREMENT
/begin MEASUREMENT rtDW_ADAS.GTCnt_p "" UBYTE ADAS_CM_uint8 0 0 0 255 ECU_ADDRESS 0x0000 /* @ECU_Address@rtDW_ADAS.GTCnt_p@ */ /end MEASUREMENT
/begin MEASUREMENT rtDW_ADAS.GTCrsWlk "" UBYTE ADAS_CM_uint8 0 0 0 255 ECU_ADDRESS 0x0000 /* @ECU_Address@rtDW_ADAS.GTCrsWlk@ */ /end MEASUREMENT
/begin MEASUREMENT rtDW_ADAS.GTCrsWlkMem "" UBYTE ADAS_CM_uint8 0 0 0 255 ECU_ADDRESS 0x0000 /* @ECU_Address@rtDW_ADAS.GTCrsWlkMem@ */ /end MEASUREMENT
/begin MEASUREMENT rtDW_ADAS.GTDelay1_DSTATE_e "" UBYTE ADAS_CM_uint8 0 0 0 255 LAYOUT COLUMN_DIR MATRIX_DIM 2 ECU_ADDRESS 0x0000 /* @ECU_Address@rtDW_ADAS.GTDelay1_DSTATE_e@ */ /end MEASUREMENT
/begin MEASUREMENT rtDW_ADAS.GTDelay1_DSTATE_io "" UBYTE ADAS_CM_uint8 0 0 0 255 LAYOUT COLUMN_DIR MATRIX_DIM 2 ECU_ADDRESS 0x0000 /* @ECU_Address@rtDW_ADAS.GTDelay1_DSTATE_io@ */ /end MEASUREMENT
/begin MEASUREMENT rtDW_ADAS.GTDelay1_DSTATE_jp "" UBYTE ADAS_CM_uint8 0 0 0 255 LAYOUT COLUMN_DIR MATRIX_DIM 2 ECU_ADDRESS 0x0000 /* @ECU_Address@rtDW_ADAS.GTDelay1_DSTATE_jp@ */ /end MEASUREMENT
/begin MEASUREMENT rtDW_ADAS.GTDelay1_DSTATE_n "" FLOAT32_IEEE ADAS_CM_single 0 0 -3.4E+38 3.4E+38 LAYOUT COLUMN_DIR MATRIX_DIM 22 ECU_ADDRESS 0x0000 /* @ECU_Address@rtDW_ADAS.GTDelay1_DSTATE_n@ */ /end MEASUREMENT
/begin MEASUREMENT rtDW_ADAS.GTDelay1_DSTATE_o "" UBYTE ADAS_CM_uint8 0 0 0 255 LAYOUT COLUMN_DIR MATRIX_DIM 2 ECU_ADDRESS 0x0000 /* @ECU_Address@rtDW_ADAS.GTDelay1_DSTATE_o@ */ /end MEASUREMENT
/begin MEASUREMENT rtDW_ADAS.GTDelay2_DSTATE_d "" FLOAT32_IEEE ADAS_CM_single 0 0 -3.4E+38 3.4E+38 LAYOUT COLUMN_DIR MATRIX_DIM 11 ECU_ADDRESS 0x0000 /* @ECU_Address@rtDW_ADAS.GTDelay2_DSTATE_d@ */ /end MEASUREMENT
/begin MEASUREMENT rtDW_ADAS.GTDelay3_DSTATE_p "" FLOAT32_IEEE ADAS_CM_single 0 0 -3.4E+38 3.4E+38 LAYOUT COLUMN_DIR MATRIX_DIM 11 ECU_ADDRESS 0x0000 /* @ECU_Address@rtDW_ADAS.GTDelay3_DSTATE_p@ */ /end MEASUREMENT
/begin MEASUREMENT rtDW_ADAS.GTDelay5_DSTATE "" FLOAT32_IEEE ADAS_CM_single 0 0 -3.4E+38 3.4E+38 LAYOUT COLUMN_DIR MATRIX_DIM 22 ECU_ADDRESS 0x0000 /* @ECU_Address@rtDW_ADAS.GTDelay5_DSTATE@ */ /end MEASUREMENT
/begin MEASUREMENT rtDW_ADAS.GTDelayInput1_DSTATE "" UBYTE ADAS_CM_uint8 0 0 0 255 ECU_ADDRESS 0x0000 /* @ECU_Address@rtDW_ADAS.GTDelayInput1_DSTATE@ */ /end MEASUREMENT
/begin MEASUREMENT rtDW_ADAS.GTDelayInput1_DSTATE_a "" UBYTE ADAS_CM_uint8 0 0 0 255 ECU_ADDRESS 0x0000 /* @ECU_Address@rtDW_ADAS.GTDelayInput1_DSTATE_a@ */ /end MEASUREMENT
/begin MEASUREMENT rtDW_ADAS.GTDelayInput1_DSTATE_b "" UBYTE ADAS_CM_uint8 0 0 0 255 ECU_ADDRESS 0x0000 /* @ECU_Address@rtDW_ADAS.GTDelayInput1_DSTATE_b@ */ /end MEASUREMENT
/begin MEASUREMENT rtDW_ADAS.GTDelayInput1_DSTATE_c4 "" UBYTE ADAS_CM_uint8 0 0 0 255 ECU_ADDRESS 0x0000 /* @ECU_Address@rtDW_ADAS.GTDelayInput1_DSTATE_c4@ */ /end MEASUREMENT
/begin MEASUREMENT rtDW_ADAS.GTDelayInput1_DSTATE_cg "" UBYTE ADAS_CM_uint8 0 0 0 255 ECU_ADDRESS 0x0000 /* @ECU_Address@rtDW_ADAS.GTDelayInput1_DSTATE_cg@ */ /end MEASUREMENT
/begin MEASUREMENT rtDW_ADAS.GTDelayInput1_DSTATE_cy "" UBYTE ADAS_CM_uint8 0 0 0 255 ECU_ADDRESS 0x0000 /* @ECU_Address@rtDW_ADAS.GTDelayInput1_DSTATE_cy@ */ /end MEASUREMENT
/begin MEASUREMENT rtDW_ADAS.GTDelayInput1_DSTATE_cy3 "" UBYTE ADAS_CM_uint8 0 0 0 255 ECU_ADDRESS 0x0000 /* @ECU_Address@rtDW_ADAS.GTDelayInput1_DSTATE_cy3@ */ /end MEASUREMENT
/begin MEASUREMENT rtDW_ADAS.GTDelayInput1_DSTATE_d "" UBYTE ADAS_CM_uint8 0 0 0 255 ECU_ADDRESS 0x0000 /* @ECU_Address@rtDW_ADAS.GTDelayInput1_DSTATE_d@ */ /end MEASUREMENT
/begin MEASUREMENT rtDW_ADAS.GTDelayInput1_DSTATE_di "" UBYTE ADAS_CM_uint8 0 0 0 255 ECU_ADDRESS 0x0000 /* @ECU_Address@rtDW_ADAS.GTDelayInput1_DSTATE_di@ */ /end MEASUREMENT
/begin MEASUREMENT rtDW_ADAS.GTDelayInput1_DSTATE_dt "" UBYTE ADAS_CM_uint8 0 0 0 255 ECU_ADDRESS 0x0000 /* @ECU_Address@rtDW_ADAS.GTDelayInput1_DSTATE_dt@ */ /end MEASUREMENT
/begin MEASUREMENT rtDW_ADAS.GTDelayInput1_DSTATE_e "" UBYTE ADAS_CM_uint8 0 0 0 255 ECU_ADDRESS 0x0000 /* @ECU_Address@rtDW_ADAS.GTDelayInput1_DSTATE_e@ */ /end MEASUREMENT
/begin MEASUREMENT rtDW_ADAS.GTDelayInput1_DSTATE_e1 "" UBYTE ADAS_CM_uint8 0 0 0 255 ECU_ADDRESS 0x0000 /* @ECU_Address@rtDW_ADAS.GTDelayInput1_DSTATE_e1@ */ /end MEASUREMENT
/begin MEASUREMENT rtDW_ADAS.GTDelayInput1_DSTATE_f "" UBYTE ADAS_CM_uint8 0 0 0 255 ECU_ADDRESS 0x0000 /* @ECU_Address@rtDW_ADAS.GTDelayInput1_DSTATE_f@ */ /end MEASUREMENT
/begin MEASUREMENT rtDW_ADAS.GTDelayInput1_DSTATE_fn "" UBYTE ADAS_CM_uint8 0 0 0 255 ECU_ADDRESS 0x0000 /* @ECU_Address@rtDW_ADAS.GTDelayInput1_DSTATE_fn@ */ /end MEASUREMENT
/begin MEASUREMENT rtDW_ADAS.GTDelayInput1_DSTATE_fy "" UBYTE ADAS_CM_uint8 0 0 0 255 ECU_ADDRESS 0x0000 /* @ECU_Address@rtDW_ADAS.GTDelayInput1_DSTATE_fy@ */ /end MEASUREMENT
/begin MEASUREMENT rtDW_ADAS.GTDelayInput1_DSTATE_h "" UBYTE ADAS_CM_uint8 0 0 0 255 ECU_ADDRESS 0x0000 /* @ECU_Address@rtDW_ADAS.GTDelayInput1_DSTATE_h@ */ /end MEASUREMENT
/begin MEASUREMENT rtDW_ADAS.GTDelayInput1_DSTATE_i "" UBYTE ADAS_CM_uint8 0 0 0 255 ECU_ADDRESS 0x0000 /* @ECU_Address@rtDW_ADAS.GTDelayInput1_DSTATE_i@ */ /end MEASUREMENT
/begin MEASUREMENT rtDW_ADAS.GTDelayInput1_DSTATE_in "" UBYTE ADAS_CM_uint8 0 0 0 255 ECU_ADDRESS 0x0000 /* @ECU_Address@rtDW_ADAS.GTDelayInput1_DSTATE_in@ */ /end MEASUREMENT
/begin MEASUREMENT rtDW_ADAS.GTDelayInput1_DSTATE_j "" UBYTE ADAS_CM_uint8 0 0 0 255 ECU_ADDRESS 0x0000 /* @ECU_Address@rtDW_ADAS.GTDelayInput1_DSTATE_j@ */ /end MEASUREMENT
/begin MEASUREMENT rtDW_ADAS.GTDelayInput1_DSTATE_k "" UBYTE ADAS_CM_uint8 0 0 0 255 ECU_ADDRESS 0x0000 /* @ECU_Address@rtDW_ADAS.GTDelayInput1_DSTATE_k@ */ /end MEASUREMENT
/begin MEASUREMENT rtDW_ADAS.GTDelayInput1_DSTATE_k4 "" UBYTE ADAS_CM_uint8 0 0 0 255 ECU_ADDRESS 0x0000 /* @ECU_Address@rtDW_ADAS.GTDelayInput1_DSTATE_k4@ */ /end MEASUREMENT
/begin MEASUREMENT rtDW_ADAS.GTDelayInput1_DSTATE_km "" UBYTE ADAS_CM_uint8 0 0 0 255 ECU_ADDRESS 0x0000 /* @ECU_Address@rtDW_ADAS.GTDelayInput1_DSTATE_km@ */ /end MEASUREMENT
/begin MEASUREMENT rtDW_ADAS.GTDelayInput1_DSTATE_l "" UBYTE ADAS_CM_uint8 0 0 0 255 ECU_ADDRESS 0x0000 /* @ECU_Address@rtDW_ADAS.GTDelayInput1_DSTATE_l@ */ /end MEASUREMENT
/begin MEASUREMENT rtDW_ADAS.GTDelayInput1_DSTATE_lq "" UBYTE ADAS_CM_uint8 0 0 0 255 ECU_ADDRESS 0x0000 /* @ECU_Address@rtDW_ADAS.GTDelayInput1_DSTATE_lq@ */ /end MEASUREMENT
/begin MEASUREMENT rtDW_ADAS.GTDelayInput1_DSTATE_lr "" UBYTE ADAS_CM_uint8 0 0 0 255 ECU_ADDRESS 0x0000 /* @ECU_Address@rtDW_ADAS.GTDelayInput1_DSTATE_lr@ */ /end MEASUREMENT
/begin MEASUREMENT rtDW_ADAS.GTDelayInput1_DSTATE_m "" UBYTE ADAS_CM_uint8 0 0 0 255 ECU_ADDRESS 0x0000 /* @ECU_Address@rtDW_ADAS.GTDelayInput1_DSTATE_m@ */ /end MEASUREMENT
/begin MEASUREMENT rtDW_ADAS.GTDelayInput1_DSTATE_mk "" UBYTE ADAS_CM_uint8 0 0 0 255 ECU_ADDRESS 0x0000 /* @ECU_Address@rtDW_ADAS.GTDelayInput1_DSTATE_mk@ */ /end MEASUREMENT
/begin MEASUREMENT rtDW_ADAS.GTDelayInput1_DSTATE_n "" UBYTE ADAS_CM_uint8 0 0 0 255 ECU_ADDRESS 0x0000 /* @ECU_Address@rtDW_ADAS.GTDelayInput1_DSTATE_n@ */ /end MEASUREMENT
/begin MEASUREMENT rtDW_ADAS.GTDelayInput1_DSTATE_o "" UBYTE ADAS_CM_uint8 0 0 0 255 ECU_ADDRESS 0x0000 /* @ECU_Address@rtDW_ADAS.GTDelayInput1_DSTATE_o@ */ /end MEASUREMENT
/begin MEASUREMENT rtDW_ADAS.GTDelayInput1_DSTATE_o1 "" UBYTE ADAS_CM_uint8 0 0 0 255 ECU_ADDRESS 0x0000 /* @ECU_Address@rtDW_ADAS.GTDelayInput1_DSTATE_o1@ */ /end MEASUREMENT
/begin MEASUREMENT rtDW_ADAS.GTDelayInput1_DSTATE_oq "" UBYTE ADAS_CM_uint8 0 0 0 255 ECU_ADDRESS 0x0000 /* @ECU_Address@rtDW_ADAS.GTDelayInput1_DSTATE_oq@ */ /end MEASUREMENT
/begin MEASUREMENT rtDW_ADAS.GTDelayInput1_DSTATE_or "" UBYTE ADAS_CM_uint8 0 0 0 255 ECU_ADDRESS 0x0000 /* @ECU_Address@rtDW_ADAS.GTDelayInput1_DSTATE_or@ */ /end MEASUREMENT
/begin MEASUREMENT rtDW_ADAS.GTDelayInput1_DSTATE_p "" UBYTE ADAS_CM_uint8 0 0 0 255 ECU_ADDRESS 0x0000 /* @ECU_Address@rtDW_ADAS.GTDelayInput1_DSTATE_p@ */ /end MEASUREMENT
/begin MEASUREMENT rtDW_ADAS.GTDelayInput1_DSTATE_pt "" UBYTE ADAS_CM_uint8 0 0 0 255 ECU_ADDRESS 0x0000 /* @ECU_Address@rtDW_ADAS.GTDelayInput1_DSTATE_pt@ */ /end MEASUREMENT
/begin MEASUREMENT rtDW_ADAS.GTDelay_DSTATE_h "" UBYTE ADAS_CM_uint8 0 0 0 255 LAYOUT COLUMN_DIR MATRIX_DIM 2 ECU_ADDRESS 0x0000 /* @ECU_Address@rtDW_ADAS.GTDelay_DSTATE_h@ */ /end MEASUREMENT
/begin MEASUREMENT rtDW_ADAS.GTDelay_DSTATE_k "" UBYTE ADAS_CM_uint8 0 0 0 255 LAYOUT COLUMN_DIR MATRIX_DIM 2 ECU_ADDRESS 0x0000 /* @ECU_Address@rtDW_ADAS.GTDelay_DSTATE_k@ */ /end MEASUREMENT
/begin MEASUREMENT rtDW_ADAS.GTDelay_DSTATE_lw "" UBYTE ADAS_CM_uint8 0 0 0 255 LAYOUT COLUMN_DIR MATRIX_DIM 2 ECU_ADDRESS 0x0000 /* @ECU_Address@rtDW_ADAS.GTDelay_DSTATE_lw@ */ /end MEASUREMENT
/begin MEASUREMENT rtDW_ADAS.GTDelay_DSTATE_p "" FLOAT32_IEEE ADAS_CM_single 0 0 -3.4E+38 3.4E+38 LAYOUT COLUMN_DIR MATRIX_DIM 55 ECU_ADDRESS 0x0000 /* @ECU_Address@rtDW_ADAS.GTDelay_DSTATE_p@ */ /end MEASUREMENT
/begin MEASUREMENT rtDW_ADAS.GTDelay_DSTATE_ph "" UBYTE ADAS_CM_uint8 0 0 0 255 LAYOUT COLUMN_DIR MATRIX_DIM 2 ECU_ADDRESS 0x0000 /* @ECU_Address@rtDW_ADAS.GTDelay_DSTATE_ph@ */ /end MEASUREMENT
/begin MEASUREMENT rtDW_ADAS.GTDstRealRear18X_m "" FLOAT32_IEEE ADAS_CM_single 0 0 -3.4E+38 3.4E+38 ECU_ADDRESS 0x0000 /* @ECU_Address@rtDW_ADAS.GTDstRealRear18X_m@ */ /end MEASUREMENT
/begin MEASUREMENT rtDW_ADAS.GTIn "" UBYTE ADAS_CM_uint8 0 0 0 255 ECU_ADDRESS 0x0000 /* @ECU_Address@rtDW_ADAS.GTIn@ */ /end MEASUREMENT
/begin MEASUREMENT rtDW_ADAS.GTIn_g "" UBYTE ADAS_CM_uint8 0 0 0 255 ECU_ADDRESS 0x0000 /* @ECU_Address@rtDW_ADAS.GTIn_g@ */ /end MEASUREMENT
/begin MEASUREMENT rtDW_ADAS.GTIn_gp "" UBYTE ADAS_CM_uint8 0 0 0 255 ECU_ADDRESS 0x0000 /* @ECU_Address@rtDW_ADAS.GTIn_gp@ */ /end MEASUREMENT
/begin MEASUREMENT rtDW_ADAS.GTIn_gp4 "" UBYTE ADAS_CM_uint8 0 0 0 255 ECU_ADDRESS 0x0000 /* @ECU_Address@rtDW_ADAS.GTIn_gp4@ */ /end MEASUREMENT
/begin MEASUREMENT rtDW_ADAS.GTIn_gp4l "" UBYTE ADAS_CM_uint8 0 0 0 255 ECU_ADDRESS 0x0000 /* @ECU_Address@rtDW_ADAS.GTIn_gp4l@ */ /end MEASUREMENT
/begin MEASUREMENT rtDW_ADAS.GTIn_gp4lv "" UBYTE ADAS_CM_uint8 0 0 0 255 ECU_ADDRESS 0x0000 /* @ECU_Address@rtDW_ADAS.GTIn_gp4lv@ */ /end MEASUREMENT
/begin MEASUREMENT rtDW_ADAS.GTIn_gp4lve "" UBYTE ADAS_CM_uint8 0 0 0 255 ECU_ADDRESS 0x0000 /* @ECU_Address@rtDW_ADAS.GTIn_gp4lve@ */ /end MEASUREMENT
/begin MEASUREMENT rtDW_ADAS.GTIn_gp4lvew "" UBYTE ADAS_CM_uint8 0 0 0 255 ECU_ADDRESS 0x0000 /* @ECU_Address@rtDW_ADAS.GTIn_gp4lvew@ */ /end MEASUREMENT
/begin MEASUREMENT rtDW_ADAS.GTLastRightPot "" UBYTE ADAS_CM_uint8 0 0 0 255 ECU_ADDRESS 0x0000 /* @ECU_Address@rtDW_ADAS.GTLastRightPot@ */ /end MEASUREMENT
/begin MEASUREMENT rtDW_ADAS.GTLastSign "" FLOAT32_IEEE ADAS_CM_single 0 0 -3.4E+38 3.4E+38 ECU_ADDRESS 0x0000 /* @ECU_Address@rtDW_ADAS.GTLastSign@ */ /end MEASUREMENT
/begin MEASUREMENT rtDW_ADAS.GTLidarWash "" UBYTE ADAS_CM_uint8 0 0 0 255 ECU_ADDRESS 0x0000 /* @ECU_Address@rtDW_ADAS.GTLidarWash@ */ /end MEASUREMENT
/begin MEASUREMENT rtDW_ADAS.GTMemory1_PreviousInput "" FLOAT32_IEEE ADAS_CM_single 0 0 -3.4E+38 3.4E+38 ECU_ADDRESS 0x0000 /* @ECU_Address@rtDW_ADAS.GTMemory1_PreviousInput@ */ /end MEASUREMENT
/begin MEASUREMENT rtDW_ADAS.GTMemory1_PreviousInput_a "" FLOAT32_IEEE ADAS_CM_single 0 0 -3.4E+38 3.4E+38 ECU_ADDRESS 0x0000 /* @ECU_Address@rtDW_ADAS.GTMemory1_PreviousInput_a@ */ /end MEASUREMENT
/begin MEASUREMENT rtDW_ADAS.GTMemory1_PreviousInput_c "" FLOAT32_IEEE ADAS_CM_single 0 0 -3.4E+38 3.4E+38 ECU_ADDRESS 0x0000 /* @ECU_Address@rtDW_ADAS.GTMemory1_PreviousInput_c@ */ /end MEASUREMENT
/begin MEASUREMENT rtDW_ADAS.GTMemory1_PreviousInput_n "" FLOAT32_IEEE ADAS_CM_single 0 0 -3.4E+38 3.4E+38 ECU_ADDRESS 0x0000 /* @ECU_Address@rtDW_ADAS.GTMemory1_PreviousInput_n@ */ /end MEASUREMENT
/begin MEASUREMENT rtDW_ADAS.GTMemory2_PreviousInput_l "" UWORD ADAS_CM_uint16 0 0 0 65535 ECU_ADDRESS 0x0000 /* @ECU_Address@rtDW_ADAS.GTMemory2_PreviousInput_l@ */ /end MEASUREMENT
/begin MEASUREMENT rtDW_ADAS.GTMemory_PreviousInput "" FLOAT32_IEEE ADAS_CM_single 0 0 -3.4E+38 3.4E+38 ECU_ADDRESS 0x0000 /* @ECU_Address@rtDW_ADAS.GTMemory_PreviousInput@ */ /end MEASUREMENT
/begin MEASUREMENT rtDW_ADAS.GTMemory_PreviousInput_a "" FLOAT32_IEEE ADAS_CM_single 0 0 -3.4E+38 3.4E+38 ECU_ADDRESS 0x0000 /* @ECU_Address@rtDW_ADAS.GTMemory_PreviousInput_a@ */ /end MEASUREMENT
/begin MEASUREMENT rtDW_ADAS.GTMemory_PreviousInput_al "" UWORD ADAS_CM_uint16 0 0 0 65535 ECU_ADDRESS 0x0000 /* @ECU_Address@rtDW_ADAS.GTMemory_PreviousInput_al@ */ /end MEASUREMENT
/begin MEASUREMENT rtDW_ADAS.GTMemory_PreviousInput_c "" FLOAT32_IEEE ADAS_CM_single 0 0 -3.4E+38 3.4E+38 ECU_ADDRESS 0x0000 /* @ECU_Address@rtDW_ADAS.GTMemory_PreviousInput_c@ */ /end MEASUREMENT
/begin MEASUREMENT rtDW_ADAS.GTMemory_PreviousInput_f "" UWORD ADAS_CM_uint16 0 0 0 65535 ECU_ADDRESS 0x0000 /* @ECU_Address@rtDW_ADAS.GTMemory_PreviousInput_f@ */ /end MEASUREMENT
/begin MEASUREMENT rtDW_ADAS.GTMemory_PreviousInput_g "" UBYTE ADAS_CM_uint8 0 0 0 255 ECU_ADDRESS 0x0000 /* @ECU_Address@rtDW_ADAS.GTMemory_PreviousInput_g@ */ /end MEASUREMENT
/begin MEASUREMENT rtDW_ADAS.GTMemory_PreviousInput_h "" FLOAT32_IEEE ADAS_CM_single 0 0 -3.4E+38 3.4E+38 ECU_ADDRESS 0x0000 /* @ECU_Address@rtDW_ADAS.GTMemory_PreviousInput_h@ */ /end MEASUREMENT
/begin MEASUREMENT rtDW_ADAS.GTMemory_PreviousInput_hw "" UWORD ADAS_CM_uint16 0 0 0 65535 ECU_ADDRESS 0x0000 /* @ECU_Address@rtDW_ADAS.GTMemory_PreviousInput_hw@ */ /end MEASUREMENT
/begin MEASUREMENT rtDW_ADAS.GTMemory_PreviousInput_n "" FLOAT32_IEEE ADAS_CM_single 0 0 -3.4E+38 3.4E+38 ECU_ADDRESS 0x0000 /* @ECU_Address@rtDW_ADAS.GTMemory_PreviousInput_n@ */ /end MEASUREMENT
/begin MEASUREMENT rtDW_ADAS.GTNoEntryMem "" UBYTE ADAS_CM_uint8 0 0 0 255 ECU_ADDRESS 0x0000 /* @ECU_Address@rtDW_ADAS.GTNoEntryMem@ */ /end MEASUREMENT
/begin MEASUREMENT rtDW_ADAS.GTNvHeatFlag "" UBYTE ADAS_CM_uint8 0 0 0 255 ECU_ADDRESS 0x0000 /* @ECU_Address@rtDW_ADAS.GTNvHeatFlag@ */ /end MEASUREMENT
/begin MEASUREMENT rtDW_ADAS.GTNvMode "" UBYTE ADAS_CM_uint8 0 0 0 255 ECU_ADDRESS 0x0000 /* @ECU_Address@rtDW_ADAS.GTNvMode@ */ /end MEASUREMENT
/begin MEASUREMENT rtDW_ADAS.GTObjBack "" UWORD ADAS_CM_uint16 0 0 0 65535 ECU_ADDRESS 0x0000 /* @ECU_Address@rtDW_ADAS.GTObjBack@ */ /end MEASUREMENT
/begin MEASUREMENT rtDW_ADAS.GTObjBack12 "" UBYTE ADAS_CM_uint8 0 0 0 255 ECU_ADDRESS 0x0000 /* @ECU_Address@rtDW_ADAS.GTObjBack12@ */ /end MEASUREMENT
/begin MEASUREMENT rtDW_ADAS.GTObjBack14 "" UBYTE ADAS_CM_uint8 0 0 0 255 ECU_ADDRESS 0x0000 /* @ECU_Address@rtDW_ADAS.GTObjBack14@ */ /end MEASUREMENT
/begin MEASUREMENT rtDW_ADAS.GTObjBack17 "" UBYTE ADAS_CM_uint8 0 0 0 255 ECU_ADDRESS 0x0000 /* @ECU_Address@rtDW_ADAS.GTObjBack17@ */ /end MEASUREMENT
/begin MEASUREMENT rtDW_ADAS.GTObjBack18 "" UBYTE ADAS_CM_uint8 0 0 0 255 ECU_ADDRESS 0x0000 /* @ECU_Address@rtDW_ADAS.GTObjBack18@ */ /end MEASUREMENT
/begin MEASUREMENT rtDW_ADAS.GTOtherSigns "" UBYTE ADAS_CM_uint8 0 0 0 255 ECU_ADDRESS 0x0000 /* @ECU_Address@rtDW_ADAS.GTOtherSigns@ */ /end MEASUREMENT
/begin MEASUREMENT rtDW_ADAS.GTOut_c "" UBYTE ADAS_CM_uint8 0 0 0 255 ECU_ADDRESS 0x0000 /* @ECU_Address@rtDW_ADAS.GTOut_c@ */ /end MEASUREMENT
/begin MEASUREMENT rtDW_ADAS.GTPrevY "" FLOAT64_IEEE ADAS_CM_double 0 0 -1.7E+308 1.7E+308 ECU_ADDRESS 0x0000 /* @ECU_Address@rtDW_ADAS.GTPrevY@ */ /end MEASUREMENT
/begin MEASUREMENT rtDW_ADAS.GTPrevY_c "" FLOAT64_IEEE ADAS_CM_double 0 0 -1.7E+308 1.7E+308 ECU_ADDRESS 0x0000 /* @ECU_Address@rtDW_ADAS.GTPrevY_c@ */ /end MEASUREMENT
/begin MEASUREMENT rtDW_ADAS.GTPrevY_g "" FLOAT32_IEEE ADAS_CM_single 0 0 -3.4E+38 3.4E+38 ECU_ADDRESS 0x0000 /* @ECU_Address@rtDW_ADAS.GTPrevY_g@ */ /end MEASUREMENT
/begin MEASUREMENT rtDW_ADAS.GTPrevY_id "" FLOAT32_IEEE ADAS_CM_single 0 0 -3.4E+38 3.4E+38 ECU_ADDRESS 0x0000 /* @ECU_Address@rtDW_ADAS.GTPrevY_id@ */ /end MEASUREMENT
/begin MEASUREMENT rtDW_ADAS.GTPrevY_n "" FLOAT64_IEEE ADAS_CM_double 0 0 -1.7E+308 1.7E+308 ECU_ADDRESS 0x0000 /* @ECU_Address@rtDW_ADAS.GTPrevY_n@ */ /end MEASUREMENT
/begin MEASUREMENT rtDW_ADAS.GTPrevY_p "" FLOAT64_IEEE ADAS_CM_double 0 0 -1.7E+308 1.7E+308 ECU_ADDRESS 0x0000 /* @ECU_Address@rtDW_ADAS.GTPrevY_p@ */ /end MEASUREMENT
/begin MEASUREMENT rtDW_ADAS.GTProduct1 "" FLOAT32_IEEE ADAS_CM_single 0 0 -3.4E+38 3.4E+38 ECU_ADDRESS 0x0000 /* @ECU_Address@rtDW_ADAS.GTProduct1@ */ /end MEASUREMENT
/begin MEASUREMENT rtDW_ADAS.GTProduct1_b "" FLOAT32_IEEE ADAS_CM_single 0 0 -3.4E+38 3.4E+38 ECU_ADDRESS 0x0000 /* @ECU_Address@rtDW_ADAS.GTProduct1_b@ */ /end MEASUREMENT
/begin MEASUREMENT rtDW_ADAS.GTRctcLogicTrans_l "" UBYTE ADAS_CM_uint8 0 0 0 255 ECU_ADDRESS 0x0000 /* @ECU_Address@rtDW_ADAS.GTRctcLogicTrans_l@ */ /end MEASUREMENT
/begin MEASUREMENT rtDW_ADAS.GTRecMode "" UBYTE ADAS_CM_uint8 0 0 0 255 ECU_ADDRESS 0x0000 /* @ECU_Address@rtDW_ADAS.GTRecMode@ */ /end MEASUREMENT
/begin MEASUREMENT rtDW_ADAS.GTRecToInc "" UBYTE ADAS_CM_uint8 0 0 0 255 ECU_ADDRESS 0x0000 /* @ECU_Address@rtDW_ADAS.GTRecToInc@ */ /end MEASUREMENT
/begin MEASUREMENT rtDW_ADAS.GTRelationalOperator1 "" UBYTE ADAS_CM_logical 0 0 0 1 ECU_ADDRESS 0x0000 /* @ECU_Address@rtDW_ADAS.GTRelationalOperator1@ */ /end MEASUREMENT
/begin MEASUREMENT rtDW_ADAS.GTRelationalOperator1_n "" UBYTE ADAS_CM_logical 0 0 0 1 ECU_ADDRESS 0x0000 /* @ECU_Address@rtDW_ADAS.GTRelationalOperator1_n@ */ /end MEASUREMENT
/begin MEASUREMENT rtDW_ADAS.GTRelay_Mode "" UBYTE ADAS_CM_logical 0 0 0 1 ECU_ADDRESS 0x0000 /* @ECU_Address@rtDW_ADAS.GTRelay_Mode@ */ /end MEASUREMENT
/begin MEASUREMENT rtDW_ADAS.GTSpdBmpMem "" UBYTE ADAS_CM_uint8 0 0 0 255 ECU_ADDRESS 0x0000 /* @ECU_Address@rtDW_ADAS.GTSpdBmpMem@ */ /end MEASUREMENT
/begin MEASUREMENT rtDW_ADAS.GTSpdSign1 "" FLOAT32_IEEE ADAS_CM_single 0 0 -3.4E+38 3.4E+38 ECU_ADDRESS 0x0000 /* @ECU_Address@rtDW_ADAS.GTSpdSign1@ */ /end MEASUREMENT
/begin MEASUREMENT rtDW_ADAS.GTStartRec "" UBYTE ADAS_CM_uint8 0 0 0 255 ECU_ADDRESS 0x0000 /* @ECU_Address@rtDW_ADAS.GTStartRec@ */ /end MEASUREMENT
/begin MEASUREMENT rtDW_ADAS.GTStopMem "" UBYTE ADAS_CM_uint8 0 0 0 255 ECU_ADDRESS 0x0000 /* @ECU_Address@rtDW_ADAS.GTStopMem@ */ /end MEASUREMENT
/begin MEASUREMENT rtDW_ADAS.GTSwitch_l "" FLOAT64_IEEE ADAS_CM_double 0 0 -1.7E+308 1.7E+308 ECU_ADDRESS 0x0000 /* @ECU_Address@rtDW_ADAS.GTSwitch_l@ */ /end MEASUREMENT
/begin MEASUREMENT rtDW_ADAS.GTSwitch_o "" FLOAT64_IEEE ADAS_CM_double 0 0 -1.7E+308 1.7E+308 ECU_ADDRESS 0x0000 /* @ECU_Address@rtDW_ADAS.GTSwitch_o@ */ /end MEASUREMENT
/begin MEASUREMENT rtDW_ADAS.GTTarHonk12 "" UBYTE ADAS_CM_uint8 0 0 0 255 ECU_ADDRESS 0x0000 /* @ECU_Address@rtDW_ADAS.GTTarHonk12@ */ /end MEASUREMENT
/begin MEASUREMENT rtDW_ADAS.GTTarHonk13 "" UBYTE ADAS_CM_uint8 0 0 0 255 ECU_ADDRESS 0x0000 /* @ECU_Address@rtDW_ADAS.GTTarHonk13@ */ /end MEASUREMENT
/begin MEASUREMENT rtDW_ADAS.GTTarHonk14 "" UBYTE ADAS_CM_uint8 0 0 0 255 ECU_ADDRESS 0x0000 /* @ECU_Address@rtDW_ADAS.GTTarHonk14@ */ /end MEASUREMENT
/begin MEASUREMENT rtDW_ADAS.GTTarHonk17 "" UBYTE ADAS_CM_uint8 0 0 0 255 ECU_ADDRESS 0x0000 /* @ECU_Address@rtDW_ADAS.GTTarHonk17@ */ /end MEASUREMENT
/begin MEASUREMENT rtDW_ADAS.GTTarHonk18 "" UBYTE ADAS_CM_uint8 0 0 0 255 ECU_ADDRESS 0x0000 /* @ECU_Address@rtDW_ADAS.GTTarHonk18@ */ /end MEASUREMENT
/begin MEASUREMENT rtDW_ADAS.GTTestDataWarnTar_g "" UBYTE ADAS_CM_uint8 0 0 0 255 ECU_ADDRESS 0x0000 /* @ECU_Address@rtDW_ADAS.GTTestDataWarnTar_g@ */ /end MEASUREMENT
/begin MEASUREMENT rtDW_ADAS.GTTicuBlk "" UBYTE ADAS_CM_uint8 0 0 0 255 ECU_ADDRESS 0x0000 /* @ECU_Address@rtDW_ADAS.GTTicuBlk@ */ /end MEASUREMENT
/begin MEASUREMENT rtDW_ADAS.GTTimeObj "" FLOAT32_IEEE ADAS_CM_single 0 0 -3.4E+38 3.4E+38 ECU_ADDRESS 0x0000 /* @ECU_Address@rtDW_ADAS.GTTimeObj@ */ /end MEASUREMENT
/begin MEASUREMENT rtDW_ADAS.GTTimeOver12 "" FLOAT32_IEEE ADAS_CM_single 0 0 -3.4E+38 3.4E+38 ECU_ADDRESS 0x0000 /* @ECU_Address@rtDW_ADAS.GTTimeOver12@ */ /end MEASUREMENT
/begin MEASUREMENT rtDW_ADAS.GTTimeOver14 "" FLOAT32_IEEE ADAS_CM_single 0 0 -3.4E+38 3.4E+38 ECU_ADDRESS 0x0000 /* @ECU_Address@rtDW_ADAS.GTTimeOver14@ */ /end MEASUREMENT
/begin MEASUREMENT rtDW_ADAS.GTTimeOver17 "" FLOAT32_IEEE ADAS_CM_single 0 0 -3.4E+38 3.4E+38 ECU_ADDRESS 0x0000 /* @ECU_Address@rtDW_ADAS.GTTimeOver17@ */ /end MEASUREMENT
/begin MEASUREMENT rtDW_ADAS.GTTimeOver18 "" FLOAT32_IEEE ADAS_CM_single 0 0 -3.4E+38 3.4E+38 ECU_ADDRESS 0x0000 /* @ECU_Address@rtDW_ADAS.GTTimeOver18@ */ /end MEASUREMENT
/begin MEASUREMENT rtDW_ADAS.GTTimeTotal "" FLOAT32_IEEE ADAS_CM_single 0 0 -3.4E+38 3.4E+38 ECU_ADDRESS 0x0000 /* @ECU_Address@rtDW_ADAS.GTTimeTotal@ */ /end MEASUREMENT
/begin MEASUREMENT rtDW_ADAS.GTTsrMode "" UBYTE ADAS_CM_uint8 0 0 0 255 ECU_ADDRESS 0x0000 /* @ECU_Address@rtDW_ADAS.GTTsrMode@ */ /end MEASUREMENT
/begin MEASUREMENT rtDW_ADAS.GTTsrSignOverTaking "" UBYTE ADAS_CM_uint8 0 0 0 255 ECU_ADDRESS 0x0000 /* @ECU_Address@rtDW_ADAS.GTTsrSignOverTaking@ */ /end MEASUREMENT
/begin MEASUREMENT rtDW_ADAS.GTTsrSignSpeed "" UBYTE ADAS_CM_uint8 0 0 0 255 ECU_ADDRESS 0x0000 /* @ECU_Address@rtDW_ADAS.GTTsrSignSpeed@ */ /end MEASUREMENT
/begin MEASUREMENT rtDW_ADAS.GTWaitFlagCrsWlk "" UBYTE ADAS_CM_uint8 0 0 0 255 ECU_ADDRESS 0x0000 /* @ECU_Address@rtDW_ADAS.GTWaitFlagCrsWlk@ */ /end MEASUREMENT
/begin MEASUREMENT rtDW_ADAS.GTWaitFlagNoEntry "" UBYTE ADAS_CM_uint8 0 0 0 255 ECU_ADDRESS 0x0000 /* @ECU_Address@rtDW_ADAS.GTWaitFlagNoEntry@ */ /end MEASUREMENT
/begin MEASUREMENT rtDW_ADAS.GTWaitFlagSpdBmp "" UBYTE ADAS_CM_uint8 0 0 0 255 ECU_ADDRESS 0x0000 /* @ECU_Address@rtDW_ADAS.GTWaitFlagSpdBmp@ */ /end MEASUREMENT
/begin MEASUREMENT rtDW_ADAS.GTWaitFlagStop "" UBYTE ADAS_CM_uint8 0 0 0 255 ECU_ADDRESS 0x0000 /* @ECU_Address@rtDW_ADAS.GTWaitFlagStop@ */ /end MEASUREMENT
/begin MEASUREMENT rtDW_ADAS.GTisStable "" UBYTE ADAS_CM_logical 0 0 0 1 ECU_ADDRESS 0x0000 /* @ECU_Address@rtDW_ADAS.GTisStable@ */ /end MEASUREMENT
/begin MEASUREMENT rtDW_ADAS.GTis_ACTIVE "" UBYTE ADAS_CM_uint8 0 0 0 255 ECU_ADDRESS 0x0000 /* @ECU_Address@rtDW_ADAS.GTis_ACTIVE@ */ /end MEASUREMENT
/begin MEASUREMENT rtDW_ADAS.GTis_Active_j "" UBYTE ADAS_CM_uint8 0 0 0 255 ECU_ADDRESS 0x0000 /* @ECU_Address@rtDW_ADAS.GTis_Active_j@ */ /end MEASUREMENT
/begin MEASUREMENT rtDW_ADAS.GTis_CrossWalk "" UBYTE ADAS_CM_uint8 0 0 0 255 ECU_ADDRESS 0x0000 /* @ECU_Address@rtDW_ADAS.GTis_CrossWalk@ */ /end MEASUREMENT
/begin MEASUREMENT rtDW_ADAS.GTis_CrossWalk_o "" UBYTE ADAS_CM_uint8 0 0 0 255 ECU_ADDRESS 0x0000 /* @ECU_Address@rtDW_ADAS.GTis_CrossWalk_o@ */ /end MEASUREMENT
/begin MEASUREMENT rtDW_ADAS.GTis_LeftPot "" UBYTE ADAS_CM_uint8 0 0 0 255 ECU_ADDRESS 0x0000 /* @ECU_Address@rtDW_ADAS.GTis_LeftPot@ */ /end MEASUREMENT
/begin MEASUREMENT rtDW_ADAS.GTis_NoEntry "" UBYTE ADAS_CM_uint8 0 0 0 255 ECU_ADDRESS 0x0000 /* @ECU_Address@rtDW_ADAS.GTis_NoEntry@ */ /end MEASUREMENT
/begin MEASUREMENT rtDW_ADAS.GTis_NoEntry_o "" UBYTE ADAS_CM_uint8 0 0 0 255 ECU_ADDRESS 0x0000 /* @ECU_Address@rtDW_ADAS.GTis_NoEntry_o@ */ /end MEASUREMENT
/begin MEASUREMENT rtDW_ADAS.GTis_ON "" UBYTE ADAS_CM_uint8 0 0 0 255 ECU_ADDRESS 0x0000 /* @ECU_Address@rtDW_ADAS.GTis_ON@ */ /end MEASUREMENT
/begin MEASUREMENT rtDW_ADAS.GTis_On "" UBYTE ADAS_CM_uint8 0 0 0 255 ECU_ADDRESS 0x0000 /* @ECU_Address@rtDW_ADAS.GTis_On@ */ /end MEASUREMENT
/begin MEASUREMENT rtDW_ADAS.GTis_OtherSigns "" UBYTE ADAS_CM_uint8 0 0 0 255 ECU_ADDRESS 0x0000 /* @ECU_Address@rtDW_ADAS.GTis_OtherSigns@ */ /end MEASUREMENT
/begin MEASUREMENT rtDW_ADAS.GTis_OverTakeTaboo "" UBYTE ADAS_CM_uint8 0 0 0 255 ECU_ADDRESS 0x0000 /* @ECU_Address@rtDW_ADAS.GTis_OverTakeTaboo@ */ /end MEASUREMENT
/begin MEASUREMENT rtDW_ADAS.GTis_RctcOn "" UBYTE ADAS_CM_uint8 0 0 0 255 ECU_ADDRESS 0x0000 /* @ECU_Address@rtDW_ADAS.GTis_RctcOn@ */ /end MEASUREMENT
/begin MEASUREMENT rtDW_ADAS.GTis_Rcw12 "" UBYTE ADAS_CM_uint8 0 0 0 255 ECU_ADDRESS 0x0000 /* @ECU_Address@rtDW_ADAS.GTis_Rcw12@ */ /end MEASUREMENT
/begin MEASUREMENT rtDW_ADAS.GTis_Rcw13 "" UBYTE ADAS_CM_uint8 0 0 0 255 ECU_ADDRESS 0x0000 /* @ECU_Address@rtDW_ADAS.GTis_Rcw13@ */ /end MEASUREMENT
/begin MEASUREMENT rtDW_ADAS.GTis_Rcw14 "" UBYTE ADAS_CM_uint8 0 0 0 255 ECU_ADDRESS 0x0000 /* @ECU_Address@rtDW_ADAS.GTis_Rcw14@ */ /end MEASUREMENT
/begin MEASUREMENT rtDW_ADAS.GTis_Rcw17 "" UBYTE ADAS_CM_uint8 0 0 0 255 ECU_ADDRESS 0x0000 /* @ECU_Address@rtDW_ADAS.GTis_Rcw17@ */ /end MEASUREMENT
/begin MEASUREMENT rtDW_ADAS.GTis_Rcw18 "" UBYTE ADAS_CM_uint8 0 0 0 255 ECU_ADDRESS 0x0000 /* @ECU_Address@rtDW_ADAS.GTis_Rcw18@ */ /end MEASUREMENT
/begin MEASUREMENT rtDW_ADAS.GTis_RdaMain "" UBYTE ADAS_CM_uint8 0 0 0 255 ECU_ADDRESS 0x0000 /* @ECU_Address@rtDW_ADAS.GTis_RdaMain@ */ /end MEASUREMENT
/begin MEASUREMENT rtDW_ADAS.GTis_Request_to_save_in_inceden "" UBYTE ADAS_CM_uint8 0 0 0 255 ECU_ADDRESS 0x0000 /* @ECU_Address@rtDW_ADAS.GTis_Request_to_save_in_inceden@ */ /end MEASUREMENT
/begin MEASUREMENT rtDW_ADAS.GTis_Request_to_start_recording "" UBYTE ADAS_CM_uint8 0 0 0 255 ECU_ADDRESS 0x0000 /* @ECU_Address@rtDW_ADAS.GTis_Request_to_start_recording@ */ /end MEASUREMENT
/begin MEASUREMENT rtDW_ADAS.GTis_RightPot "" UBYTE ADAS_CM_uint8 0 0 0 255 ECU_ADDRESS 0x0000 /* @ECU_Address@rtDW_ADAS.GTis_RightPot@ */ /end MEASUREMENT
/begin MEASUREMENT rtDW_ADAS.GTis_SpdSignEna "" UBYTE ADAS_CM_uint8 0 0 0 255 ECU_ADDRESS 0x0000 /* @ECU_Address@rtDW_ADAS.GTis_SpdSignEna@ */ /end MEASUREMENT
/begin MEASUREMENT rtDW_ADAS.GTis_SpeedBump "" UBYTE ADAS_CM_uint8 0 0 0 255 ECU_ADDRESS 0x0000 /* @ECU_Address@rtDW_ADAS.GTis_SpeedBump@ */ /end MEASUREMENT
/begin MEASUREMENT rtDW_ADAS.GTis_SpeedBump_e "" UBYTE ADAS_CM_uint8 0 0 0 255 ECU_ADDRESS 0x0000 /* @ECU_Address@rtDW_ADAS.GTis_SpeedBump_e@ */ /end MEASUREMENT
/begin MEASUREMENT rtDW_ADAS.GTis_Stop "" UBYTE ADAS_CM_uint8 0 0 0 255 ECU_ADDRESS 0x0000 /* @ECU_Address@rtDW_ADAS.GTis_Stop@ */ /end MEASUREMENT
/begin MEASUREMENT rtDW_ADAS.GTis_Stop_h "" UBYTE ADAS_CM_uint8 0 0 0 255 ECU_ADDRESS 0x0000 /* @ECU_Address@rtDW_ADAS.GTis_Stop_h@ */ /end MEASUREMENT
/begin MEASUREMENT rtDW_ADAS.GTis_TargetDone "" UBYTE ADAS_CM_uint8 0 0 0 255 ECU_ADDRESS 0x0000 /* @ECU_Address@rtDW_ADAS.GTis_TargetDone@ */ /end MEASUREMENT
/begin MEASUREMENT rtDW_ADAS.GTis_TargetDone_i "" UBYTE ADAS_CM_uint8 0 0 0 255 ECU_ADDRESS 0x0000 /* @ECU_Address@rtDW_ADAS.GTis_TargetDone_i@ */ /end MEASUREMENT
/begin MEASUREMENT rtDW_ADAS.GTis_TargetDone_j "" UBYTE ADAS_CM_uint8 0 0 0 255 ECU_ADDRESS 0x0000 /* @ECU_Address@rtDW_ADAS.GTis_TargetDone_j@ */ /end MEASUREMENT
/begin MEASUREMENT rtDW_ADAS.GTis_TargetDone_l "" UBYTE ADAS_CM_uint8 0 0 0 255 ECU_ADDRESS 0x0000 /* @ECU_Address@rtDW_ADAS.GTis_TargetDone_l@ */ /end MEASUREMENT
/begin MEASUREMENT rtDW_ADAS.GTis_TargetDone_o "" UBYTE ADAS_CM_uint8 0 0 0 255 ECU_ADDRESS 0x0000 /* @ECU_Address@rtDW_ADAS.GTis_TargetDone_o@ */ /end MEASUREMENT
/begin MEASUREMENT rtDW_ADAS.GTis_TargetOn "" UBYTE ADAS_CM_uint8 0 0 0 255 ECU_ADDRESS 0x0000 /* @ECU_Address@rtDW_ADAS.GTis_TargetOn@ */ /end MEASUREMENT
/begin MEASUREMENT rtDW_ADAS.GTis_Working "" UBYTE ADAS_CM_uint8 0 0 0 255 ECU_ADDRESS 0x0000 /* @ECU_Address@rtDW_ADAS.GTis_Working@ */ /end MEASUREMENT
/begin MEASUREMENT rtDW_ADAS.GTis_active_c231_ADAS "" UBYTE ADAS_CM_uint8 0 0 0 255 ECU_ADDRESS 0x0000 /* @ECU_Address@rtDW_ADAS.GTis_active_c231_ADAS@ */ /end MEASUREMENT
/begin MEASUREMENT rtDW_ADAS.GTis_active_c233_ADAS "" UBYTE ADAS_CM_uint8 0 0 0 255 ECU_ADDRESS 0x0000 /* @ECU_Address@rtDW_ADAS.GTis_active_c233_ADAS@ */ /end MEASUREMENT
/begin MEASUREMENT rtDW_ADAS.GTis_active_c234_ADAS "" UBYTE ADAS_CM_uint8 0 0 0 255 ECU_ADDRESS 0x0000 /* @ECU_Address@rtDW_ADAS.GTis_active_c234_ADAS@ */ /end MEASUREMENT
/begin MEASUREMENT rtDW_ADAS.GTis_active_c236_ADAS "" UBYTE ADAS_CM_uint8 0 0 0 255 ECU_ADDRESS 0x0000 /* @ECU_Address@rtDW_ADAS.GTis_active_c236_ADAS@ */ /end MEASUREMENT
/begin MEASUREMENT rtDW_ADAS.GTis_active_c247_ADAS "" UBYTE ADAS_CM_uint8 0 0 0 255 ECU_ADDRESS 0x0000 /* @ECU_Address@rtDW_ADAS.GTis_active_c247_ADAS@ */ /end MEASUREMENT
/begin MEASUREMENT rtDW_ADAS.GTis_active_c24_ADAS "" UBYTE ADAS_CM_uint8 0 0 0 255 ECU_ADDRESS 0x0000 /* @ECU_Address@rtDW_ADAS.GTis_active_c24_ADAS@ */ /end MEASUREMENT
/begin MEASUREMENT rtDW_ADAS.GTis_active_c25_ADAS "" UBYTE ADAS_CM_uint8 0 0 0 255 ECU_ADDRESS 0x0000 /* @ECU_Address@rtDW_ADAS.GTis_active_c25_ADAS@ */ /end MEASUREMENT
/begin MEASUREMENT rtDW_ADAS.GTis_active_c29_ADAS "" UBYTE ADAS_CM_uint8 0 0 0 255 ECU_ADDRESS 0x0000 /* @ECU_Address@rtDW_ADAS.GTis_active_c29_ADAS@ */ /end MEASUREMENT
/begin MEASUREMENT rtDW_ADAS.GTis_active_c447_ADAS "" UBYTE ADAS_CM_uint8 0 0 0 255 ECU_ADDRESS 0x0000 /* @ECU_Address@rtDW_ADAS.GTis_active_c447_ADAS@ */ /end MEASUREMENT
/begin MEASUREMENT rtDW_ADAS.GTis_active_c554_ADAS "" UBYTE ADAS_CM_uint8 0 0 0 255 ECU_ADDRESS 0x0000 /* @ECU_Address@rtDW_ADAS.GTis_active_c554_ADAS@ */ /end MEASUREMENT
/begin MEASUREMENT rtDW_ADAS.GTis_active_c555_ADAS "" UBYTE ADAS_CM_uint8 0 0 0 255 ECU_ADDRESS 0x0000 /* @ECU_Address@rtDW_ADAS.GTis_active_c555_ADAS@ */ /end MEASUREMENT
/begin MEASUREMENT rtDW_ADAS.GTis_active_c556_ADAS "" UBYTE ADAS_CM_uint8 0 0 0 255 ECU_ADDRESS 0x0000 /* @ECU_Address@rtDW_ADAS.GTis_active_c556_ADAS@ */ /end MEASUREMENT
/begin MEASUREMENT rtDW_ADAS.GTis_active_c557_ADAS "" UBYTE ADAS_CM_uint8 0 0 0 255 ECU_ADDRESS 0x0000 /* @ECU_Address@rtDW_ADAS.GTis_active_c557_ADAS@ */ /end MEASUREMENT
/begin MEASUREMENT rtDW_ADAS.GTis_active_c641_ADAS "" UBYTE ADAS_CM_uint8 0 0 0 255 ECU_ADDRESS 0x0000 /* @ECU_Address@rtDW_ADAS.GTis_active_c641_ADAS@ */ /end MEASUREMENT
/begin MEASUREMENT rtDW_ADAS.GTis_active_c642_ADAS "" UBYTE ADAS_CM_uint8 0 0 0 255 ECU_ADDRESS 0x0000 /* @ECU_Address@rtDW_ADAS.GTis_active_c642_ADAS@ */ /end MEASUREMENT
/begin MEASUREMENT rtDW_ADAS.GTis_active_c643_ADAS "" UBYTE ADAS_CM_uint8 0 0 0 255 ECU_ADDRESS 0x0000 /* @ECU_Address@rtDW_ADAS.GTis_active_c643_ADAS@ */ /end MEASUREMENT
/begin MEASUREMENT rtDW_ADAS.GTis_active_c646_ADAS "" UBYTE ADAS_CM_uint8 0 0 0 255 ECU_ADDRESS 0x0000 /* @ECU_Address@rtDW_ADAS.GTis_active_c646_ADAS@ */ /end MEASUREMENT
/begin MEASUREMENT rtDW_ADAS.GTis_active_c647_ADAS "" UBYTE ADAS_CM_uint8 0 0 0 255 ECU_ADDRESS 0x0000 /* @ECU_Address@rtDW_ADAS.GTis_active_c647_ADAS@ */ /end MEASUREMENT
/begin MEASUREMENT rtDW_ADAS.GTis_active_c648_ADAS "" UBYTE ADAS_CM_uint8 0 0 0 255 ECU_ADDRESS 0x0000 /* @ECU_Address@rtDW_ADAS.GTis_active_c648_ADAS@ */ /end MEASUREMENT
/begin MEASUREMENT rtDW_ADAS.GTis_active_c649_ADAS "" UBYTE ADAS_CM_uint8 0 0 0 255 ECU_ADDRESS 0x0000 /* @ECU_Address@rtDW_ADAS.GTis_active_c649_ADAS@ */ /end MEASUREMENT
/begin MEASUREMENT rtDW_ADAS.GTis_active_c650_ADAS "" UBYTE ADAS_CM_uint8 0 0 0 255 ECU_ADDRESS 0x0000 /* @ECU_Address@rtDW_ADAS.GTis_active_c650_ADAS@ */ /end MEASUREMENT
/begin MEASUREMENT rtDW_ADAS.GTis_active_c652_ADAS "" UBYTE ADAS_CM_uint8 0 0 0 255 ECU_ADDRESS 0x0000 /* @ECU_Address@rtDW_ADAS.GTis_active_c652_ADAS@ */ /end MEASUREMENT
/begin MEASUREMENT rtDW_ADAS.GTis_active_c660_ADAS "" UBYTE ADAS_CM_uint8 0 0 0 255 ECU_ADDRESS 0x0000 /* @ECU_Address@rtDW_ADAS.GTis_active_c660_ADAS@ */ /end MEASUREMENT
/begin MEASUREMENT rtDW_ADAS.GTis_active_c675_ADAS "" UBYTE ADAS_CM_uint8 0 0 0 255 ECU_ADDRESS 0x0000 /* @ECU_Address@rtDW_ADAS.GTis_active_c675_ADAS@ */ /end MEASUREMENT
/begin MEASUREMENT rtDW_ADAS.GTis_active_c676_ADAS "" UBYTE ADAS_CM_uint8 0 0 0 255 ECU_ADDRESS 0x0000 /* @ECU_Address@rtDW_ADAS.GTis_active_c676_ADAS@ */ /end MEASUREMENT
/begin MEASUREMENT rtDW_ADAS.GTis_c231_ADAS "" UBYTE ADAS_CM_uint8 0 0 0 255 ECU_ADDRESS 0x0000 /* @ECU_Address@rtDW_ADAS.GTis_c231_ADAS@ */ /end MEASUREMENT
/begin MEASUREMENT rtDW_ADAS.GTis_c233_ADAS "" UBYTE ADAS_CM_uint8 0 0 0 255 ECU_ADDRESS 0x0000 /* @ECU_Address@rtDW_ADAS.GTis_c233_ADAS@ */ /end MEASUREMENT
/begin MEASUREMENT rtDW_ADAS.GTis_c234_ADAS "" UBYTE ADAS_CM_uint8 0 0 0 255 ECU_ADDRESS 0x0000 /* @ECU_Address@rtDW_ADAS.GTis_c234_ADAS@ */ /end MEASUREMENT
/begin MEASUREMENT rtDW_ADAS.GTis_c236_ADAS "" UBYTE ADAS_CM_uint8 0 0 0 255 ECU_ADDRESS 0x0000 /* @ECU_Address@rtDW_ADAS.GTis_c236_ADAS@ */ /end MEASUREMENT
/begin MEASUREMENT rtDW_ADAS.GTis_c247_ADAS "" UBYTE ADAS_CM_uint8 0 0 0 255 ECU_ADDRESS 0x0000 /* @ECU_Address@rtDW_ADAS.GTis_c247_ADAS@ */ /end MEASUREMENT
/begin MEASUREMENT rtDW_ADAS.GTis_c24_ADAS "" UBYTE ADAS_CM_uint8 0 0 0 255 ECU_ADDRESS 0x0000 /* @ECU_Address@rtDW_ADAS.GTis_c24_ADAS@ */ /end MEASUREMENT
/begin MEASUREMENT rtDW_ADAS.GTis_c25_ADAS "" UBYTE ADAS_CM_uint8 0 0 0 255 ECU_ADDRESS 0x0000 /* @ECU_Address@rtDW_ADAS.GTis_c25_ADAS@ */ /end MEASUREMENT
/begin MEASUREMENT rtDW_ADAS.GTis_c29_ADAS "" UBYTE ADAS_CM_uint8 0 0 0 255 ECU_ADDRESS 0x0000 /* @ECU_Address@rtDW_ADAS.GTis_c29_ADAS@ */ /end MEASUREMENT
/begin MEASUREMENT rtDW_ADAS.GTis_c447_ADAS "" UBYTE ADAS_CM_uint8 0 0 0 255 ECU_ADDRESS 0x0000 /* @ECU_Address@rtDW_ADAS.GTis_c447_ADAS@ */ /end MEASUREMENT
/begin MEASUREMENT rtDW_ADAS.GTis_c555_ADAS "" UBYTE ADAS_CM_uint8 0 0 0 255 ECU_ADDRESS 0x0000 /* @ECU_Address@rtDW_ADAS.GTis_c555_ADAS@ */ /end MEASUREMENT
/begin MEASUREMENT rtDW_ADAS.GTis_c556_ADAS "" UBYTE ADAS_CM_uint8 0 0 0 255 ECU_ADDRESS 0x0000 /* @ECU_Address@rtDW_ADAS.GTis_c556_ADAS@ */ /end MEASUREMENT
/begin MEASUREMENT rtDW_ADAS.GTis_c641_ADAS "" UBYTE ADAS_CM_uint8 0 0 0 255 ECU_ADDRESS 0x0000 /* @ECU_Address@rtDW_ADAS.GTis_c641_ADAS@ */ /end MEASUREMENT
/begin MEASUREMENT rtDW_ADAS.GTis_c642_ADAS "" UBYTE ADAS_CM_uint8 0 0 0 255 ECU_ADDRESS 0x0000 /* @ECU_Address@rtDW_ADAS.GTis_c642_ADAS@ */ /end MEASUREMENT
/begin MEASUREMENT rtDW_ADAS.GTis_c646_ADAS "" UBYTE ADAS_CM_uint8 0 0 0 255 ECU_ADDRESS 0x0000 /* @ECU_Address@rtDW_ADAS.GTis_c646_ADAS@ */ /end MEASUREMENT
/begin MEASUREMENT rtDW_ADAS.GTis_c647_ADAS "" UBYTE ADAS_CM_uint8 0 0 0 255 ECU_ADDRESS 0x0000 /* @ECU_Address@rtDW_ADAS.GTis_c647_ADAS@ */ /end MEASUREMENT
/begin MEASUREMENT rtDW_ADAS.GTis_c648_ADAS "" UBYTE ADAS_CM_uint8 0 0 0 255 ECU_ADDRESS 0x0000 /* @ECU_Address@rtDW_ADAS.GTis_c648_ADAS@ */ /end MEASUREMENT
/begin MEASUREMENT rtDW_ADAS.GTis_c649_ADAS "" UBYTE ADAS_CM_uint8 0 0 0 255 ECU_ADDRESS 0x0000 /* @ECU_Address@rtDW_ADAS.GTis_c649_ADAS@ */ /end MEASUREMENT
/begin MEASUREMENT rtDW_ADAS.GTis_c650_ADAS "" UBYTE ADAS_CM_uint8 0 0 0 255 ECU_ADDRESS 0x0000 /* @ECU_Address@rtDW_ADAS.GTis_c650_ADAS@ */ /end MEASUREMENT
/begin MEASUREMENT rtDW_ADAS.GTis_c652_ADAS "" UBYTE ADAS_CM_uint8 0 0 0 255 ECU_ADDRESS 0x0000 /* @ECU_Address@rtDW_ADAS.GTis_c652_ADAS@ */ /end MEASUREMENT
/begin MEASUREMENT rtDW_ADAS.GTis_c660_ADAS "" UBYTE ADAS_CM_uint8 0 0 0 255 ECU_ADDRESS 0x0000 /* @ECU_Address@rtDW_ADAS.GTis_c660_ADAS@ */ /end MEASUREMENT
/begin MEASUREMENT rtDW_ADAS.GTis_c675_ADAS "" UBYTE ADAS_CM_uint8 0 0 0 255 ECU_ADDRESS 0x0000 /* @ECU_Address@rtDW_ADAS.GTis_c675_ADAS@ */ /end MEASUREMENT
/begin MEASUREMENT rtDW_ADAS.GTis_c676_ADAS "" UBYTE ADAS_CM_uint8 0 0 0 255 ECU_ADDRESS 0x0000 /* @ECU_Address@rtDW_ADAS.GTis_c676_ADAS@ */ /end MEASUREMENT
/begin MEASUREMENT rtDW_ADAS.GTprevSmoothedVy "" FLOAT32_IEEE ADAS_CM_single 0 0 -3.4E+38 3.4E+38 ECU_ADDRESS 0x0000 /* @ECU_Address@rtDW_ADAS.GTprevSmoothedVy@ */ /end MEASUREMENT
/begin MEASUREMENT rtDW_ADAS.GTprevSmoothedVy_not_empty "" UBYTE ADAS_CM_logical 0 0 0 1 ECU_ADDRESS 0x0000 /* @ECU_Address@rtDW_ADAS.GTprevSmoothedVy_not_empty@ */ /end MEASUREMENT
/begin MEASUREMENT rtDW_ADAS.GTsts "" UBYTE ADAS_CM_uint8 0 0 0 255 ECU_ADDRESS 0x0000 /* @ECU_Address@rtDW_ADAS.GTsts@ */ /end MEASUREMENT
/begin MEASUREMENT rtDW_ADAS.GTsts_k "" UBYTE ADAS_CM_uint8 0 0 0 255 ECU_ADDRESS 0x0000 /* @ECU_Address@rtDW_ADAS.GTsts_k@ */ /end MEASUREMENT
/begin MEASUREMENT rtDW_ADAS.GTsts_m "" UBYTE ADAS_CM_uint8 0 0 0 255 ECU_ADDRESS 0x0000 /* @ECU_Address@rtDW_ADAS.GTsts_m@ */ /end MEASUREMENT
/begin MEASUREMENT rtDW_ADAS.GTtemporalCounter_i1_ad "" UBYTE ADAS_CM_uint8 0 0 0 255 ECU_ADDRESS 0x0000 /* @ECU_Address@rtDW_ADAS.GTtemporalCounter_i1_ad@ */ /end MEASUREMENT
/begin MEASUREMENT rtDW_ADAS.GTtemporalCounter_i1_av "" UBYTE ADAS_CM_uint8 0 0 0 255 ECU_ADDRESS 0x0000 /* @ECU_Address@rtDW_ADAS.GTtemporalCounter_i1_av@ */ /end MEASUREMENT
/begin MEASUREMENT rtDW_ADAS.GTtemporalCounter_i1_b "" ULONG ADAS_CM_uint32 0 0 0 4294967295 ECU_ADDRESS 0x0000 /* @ECU_Address@rtDW_ADAS.GTtemporalCounter_i1_b@ */ /end MEASUREMENT
/begin MEASUREMENT rtDW_ADAS.GTtemporalCounter_i1_c "" ULONG ADAS_CM_uint32 0 0 0 4294967295 ECU_ADDRESS 0x0000 /* @ECU_Address@rtDW_ADAS.GTtemporalCounter_i1_c@ */ /end MEASUREMENT
/begin MEASUREMENT rtDW_ADAS.GTtemporalCounter_i1_ch "" ULONG ADAS_CM_uint32 0 0 0 4294967295 ECU_ADDRESS 0x0000 /* @ECU_Address@rtDW_ADAS.GTtemporalCounter_i1_ch@ */ /end MEASUREMENT
/begin MEASUREMENT rtDW_ADAS.GTtemporalCounter_i1_cq "" UBYTE ADAS_CM_uint8 0 0 0 255 ECU_ADDRESS 0x0000 /* @ECU_Address@rtDW_ADAS.GTtemporalCounter_i1_cq@ */ /end MEASUREMENT
/begin MEASUREMENT rtDW_ADAS.GTtemporalCounter_i1_cs "" UBYTE ADAS_CM_uint8 0 0 0 255 ECU_ADDRESS 0x0000 /* @ECU_Address@rtDW_ADAS.GTtemporalCounter_i1_cs@ */ /end MEASUREMENT
/begin MEASUREMENT rtDW_ADAS.GTtemporalCounter_i1_d "" ULONG ADAS_CM_uint32 0 0 0 4294967295 ECU_ADDRESS 0x0000 /* @ECU_Address@rtDW_ADAS.GTtemporalCounter_i1_d@ */ /end MEASUREMENT
/begin MEASUREMENT rtDW_ADAS.GTtemporalCounter_i1_du "" UWORD ADAS_CM_uint16 0 0 0 65535 ECU_ADDRESS 0x0000 /* @ECU_Address@rtDW_ADAS.GTtemporalCounter_i1_du@ */ /end MEASUREMENT
/begin MEASUREMENT rtDW_ADAS.GTtemporalCounter_i1_e "" UBYTE ADAS_CM_uint8 0 0 0 255 ECU_ADDRESS 0x0000 /* @ECU_Address@rtDW_ADAS.GTtemporalCounter_i1_e@ */ /end MEASUREMENT
/begin MEASUREMENT rtDW_ADAS.GTtemporalCounter_i1_e2 "" UBYTE ADAS_CM_uint8 0 0 0 255 ECU_ADDRESS 0x0000 /* @ECU_Address@rtDW_ADAS.GTtemporalCounter_i1_e2@ */ /end MEASUREMENT
/begin MEASUREMENT rtDW_ADAS.GTtemporalCounter_i1_gn "" UBYTE ADAS_CM_uint8 0 0 0 255 ECU_ADDRESS 0x0000 /* @ECU_Address@rtDW_ADAS.GTtemporalCounter_i1_gn@ */ /end MEASUREMENT
/begin MEASUREMENT rtDW_ADAS.GTtemporalCounter_i1_h "" ULONG ADAS_CM_uint32 0 0 0 4294967295 ECU_ADDRESS 0x0000 /* @ECU_Address@rtDW_ADAS.GTtemporalCounter_i1_h@ */ /end MEASUREMENT
/begin MEASUREMENT rtDW_ADAS.GTtemporalCounter_i1_h5 "" ULONG ADAS_CM_uint32 0 0 0 4294967295 ECU_ADDRESS 0x0000 /* @ECU_Address@rtDW_ADAS.GTtemporalCounter_i1_h5@ */ /end MEASUREMENT
/begin MEASUREMENT rtDW_ADAS.GTtemporalCounter_i1_hk "" ULONG ADAS_CM_uint32 0 0 0 4294967295 ECU_ADDRESS 0x0000 /* @ECU_Address@rtDW_ADAS.GTtemporalCounter_i1_hk@ */ /end MEASUREMENT
/begin MEASUREMENT rtDW_ADAS.GTtemporalCounter_i1_hkpb "" UBYTE ADAS_CM_uint8 0 0 0 255 ECU_ADDRESS 0x0000 /* @ECU_Address@rtDW_ADAS.GTtemporalCounter_i1_hkpb@ */ /end MEASUREMENT
/begin MEASUREMENT rtDW_ADAS.GTtemporalCounter_i1_j "" UBYTE ADAS_CM_uint8 0 0 0 255 ECU_ADDRESS 0x0000 /* @ECU_Address@rtDW_ADAS.GTtemporalCounter_i1_j@ */ /end MEASUREMENT
/begin MEASUREMENT rtDW_ADAS.GTtemporalCounter_i1_k "" UBYTE ADAS_CM_uint8 0 0 0 255 ECU_ADDRESS 0x0000 /* @ECU_Address@rtDW_ADAS.GTtemporalCounter_i1_k@ */ /end MEASUREMENT
/begin MEASUREMENT rtDW_ADAS.GTtemporalCounter_i1_m "" UBYTE ADAS_CM_uint8 0 0 0 255 ECU_ADDRESS 0x0000 /* @ECU_Address@rtDW_ADAS.GTtemporalCounter_i1_m@ */ /end MEASUREMENT
/begin MEASUREMENT rtDW_ADAS.GTtemporalCounter_i1_p "" ULONG ADAS_CM_uint32 0 0 0 4294967295 ECU_ADDRESS 0x0000 /* @ECU_Address@rtDW_ADAS.GTtemporalCounter_i1_p@ */ /end MEASUREMENT
/begin MEASUREMENT rtDW_ADAS.GTtemporalCounter_i2 "" ULONG ADAS_CM_uint32 0 0 0 4294967295 ECU_ADDRESS 0x0000 /* @ECU_Address@rtDW_ADAS.GTtemporalCounter_i2@ */ /end MEASUREMENT
/begin MEASUREMENT rtDW_ADAS.GTtemporalCounter_i2_f "" UBYTE ADAS_CM_uint8 0 0 0 255 ECU_ADDRESS 0x0000 /* @ECU_Address@rtDW_ADAS.GTtemporalCounter_i2_f@ */ /end MEASUREMENT
/begin MEASUREMENT rtDW_ADAS.GTtemporalCounter_i2_j "" UWORD ADAS_CM_uint16 0 0 0 65535 ECU_ADDRESS 0x0000 /* @ECU_Address@rtDW_ADAS.GTtemporalCounter_i2_j@ */ /end MEASUREMENT
/begin MEASUREMENT rtDW_ADAS.GTtemporalCounter_i3_f "" UWORD ADAS_CM_uint16 0 0 0 65535 ECU_ADDRESS 0x0000 /* @ECU_Address@rtDW_ADAS.GTtemporalCounter_i3_f@ */ /end MEASUREMENT
/begin MEASUREMENT rtDW_ADAS.GTtemporalCounter_i4 "" UWORD ADAS_CM_uint16 0 0 0 65535 ECU_ADDRESS 0x0000 /* @ECU_Address@rtDW_ADAS.GTtemporalCounter_i4@ */ /end MEASUREMENT
/begin MEASUREMENT rtDW_ADAS.GTtemporalCounter_i5 "" UBYTE ADAS_CM_uint8 0 0 0 255 ECU_ADDRESS 0x0000 /* @ECU_Address@rtDW_ADAS.GTtemporalCounter_i5@ */ /end MEASUREMENT
/begin MEASUREMENT rtDW_ADAS.GTtemporalCounter_i6 "" UBYTE ADAS_CM_uint8 0 0 0 255 ECU_ADDRESS 0x0000 /* @ECU_Address@rtDW_ADAS.GTtemporalCounter_i6@ */ /end MEASUREMENT
/begin MEASUREMENT rtDW_ADAS.GTtemporalCounter_i7 "" UBYTE ADAS_CM_uint8 0 0 0 255 ECU_ADDRESS 0x0000 /* @ECU_Address@rtDW_ADAS.GTtemporalCounter_i7@ */ /end MEASUREMENT
/begin MEASUREMENT rtDW_ADAS.GTtemporalCounter_i8 "" UBYTE ADAS_CM_uint8 0 0 0 255 ECU_ADDRESS 0x0000 /* @ECU_Address@rtDW_ADAS.GTtemporalCounter_i8@ */ /end MEASUREMENT
/begin COMPU_METHOD ADAS_CM_double "" IDENTICAL "%15.10" "" /end COMPU_METHOD
/begin COMPU_METHOD ADAS_CM_logical "" IDENTICAL "%1.0" "" /end COMPU_METHOD
/begin COMPU_METHOD ADAS_CM_single "" IDENTICAL "%8.6" "" /end COMPU_METHOD
/begin COMPU_METHOD ADAS_CM_uint16 "" IDENTICAL "%5.0" "" /end COMPU_METHOD
/begin COMPU_METHOD ADAS_CM_uint32 "" IDENTICAL "%10.0" "" /end COMPU_METHOD
/begin COMPU_METHOD ADAS_CM_uint8 "" IDENTICAL "%3.0" "" /end COMPU_METHOD
/begin GROUP ADAS_FuncLevel_MLIA_MLIA_MLIA_calculation_Target_LEDs_ADB_target_LEDs_HLR_ADB_target_LEDs_AllDiodes_Filter_BlinkDetector_12 "ADAS/FuncLevel/MLIA/MLIA/MLIA calculation/Target LEDs/ADB target LEDs/HLR ADB target LEDs/AllDiodes_Filter/BlinkDetector_12"
 /begin SUB_GROUP ADAS_FuncLevel_MLIA_MLIA_MLIA_calculation_Target_LEDs_ADB_target_LEDs_HLR_ADB_target_LEDs_AllDiodes_Filter_BlinkDetector_12_Detect_Decrease ADAS_FuncLevel_MLIA_MLIA_MLIA_calculation_Target_LEDs_ADB_target_LEDs_HLR_ADB_target_LEDs_AllDiodes_Filter_BlinkDetector_12_Detect_Increase /end SUB_GROUP
/end GROUP
/begin GROUP ADAS_FuncLevel_MLIA_MLIA_MLIA_calculation_Target_LEDs_ADB_target_LEDs_HLR_ADB_target_LEDs_AllDiodes_Filter_BlinkDetector_12_Detect_Decrease "ADAS/FuncLevel/MLIA/MLIA/MLIA calculation/Target LEDs/ADB target LEDs/HLR ADB target LEDs/AllDiodes_Filter/BlinkDetector_12/Detect
Decrease" /begin REF_MEASUREMENT rtDW_ADAS.GTDelayInput1_DSTATE_l /end REF_MEASUREMENT /end GROUP
/begin GROUP ADAS_FuncLevel_MLIA_MLIA_MLIA_calculation_Target_LEDs_ADB_target_LEDs_HLR_ADB_target_LEDs_AllDiodes_Filter_BlinkDetector_12_Detect_Increase "ADAS/FuncLevel/MLIA/MLIA/MLIA calculation/Target LEDs/ADB target LEDs/HLR ADB target LEDs/AllDiodes_Filter/BlinkDetector_12/Detect
Increase" /begin REF_MEASUREMENT rtDW_ADAS.GTDelayInput1_DSTATE_k /end REF_MEASUREMENT /end GROUP
/begin GROUP ADAS_FuncLevel_MLIA_MLIA_MLIA_calculation_Target_LEDs_ADB_target_LEDs_HLR_ADB_target_LEDs_AllDiodes_Filter_BlinkDetector_13 "ADAS/FuncLevel/MLIA/MLIA/MLIA calculation/Target LEDs/ADB target LEDs/HLR ADB target LEDs/AllDiodes_Filter/BlinkDetector_13"
 /begin SUB_GROUP ADAS_FuncLevel_MLIA_MLIA_MLIA_calculation_Target_LEDs_ADB_target_LEDs_HLR_ADB_target_LEDs_AllDiodes_Filter_BlinkDetector_13_Detect_Decrease ADAS_FuncLevel_MLIA_MLIA_MLIA_calculation_Target_LEDs_ADB_target_LEDs_HLR_ADB_target_LEDs_AllDiodes_Filter_BlinkDetector_13_Detect_Increase /end SUB_GROUP
/end GROUP
/begin GROUP ADAS_FuncLevel_MLIA_MLIA_MLIA_calculation_Target_LEDs_ADB_target_LEDs_HLR_ADB_target_LEDs_AllDiodes_Filter_BlinkDetector_13_Detect_Decrease "ADAS/FuncLevel/MLIA/MLIA/MLIA calculation/Target LEDs/ADB target LEDs/HLR ADB target LEDs/AllDiodes_Filter/BlinkDetector_13/Detect
Decrease" /begin REF_MEASUREMENT rtDW_ADAS.GTDelayInput1_DSTATE_cg /end REF_MEASUREMENT /end GROUP
/begin GROUP ADAS_FuncLevel_MLIA_MLIA_MLIA_calculation_Target_LEDs_ADB_target_LEDs_HLR_ADB_target_LEDs_AllDiodes_Filter_BlinkDetector_13_Detect_Increase "ADAS/FuncLevel/MLIA/MLIA/MLIA calculation/Target LEDs/ADB target LEDs/HLR ADB target LEDs/AllDiodes_Filter/BlinkDetector_13/Detect
Increase" /begin REF_MEASUREMENT rtDW_ADAS.GTDelayInput1_DSTATE_a /end REF_MEASUREMENT /end GROUP
/begin GROUP ADAS_FuncLevel_MLIA_MLIA_MLIA_calculation_Target_LEDs_ADB_target_LEDs_HLR_ADB_target_LEDs_AllDiodes_Filter_BlinkDetector_14 "ADAS/FuncLevel/MLIA/MLIA/MLIA calculation/Target LEDs/ADB target LEDs/HLR ADB target LEDs/AllDiodes_Filter/BlinkDetector_14"
 /begin SUB_GROUP ADAS_FuncLevel_MLIA_MLIA_MLIA_calculation_Target_LEDs_ADB_target_LEDs_HLR_ADB_target_LEDs_AllDiodes_Filter_BlinkDetector_14_Detect_Decrease ADAS_FuncLevel_MLIA_MLIA_MLIA_calculation_Target_LEDs_ADB_target_LEDs_HLR_ADB_target_LEDs_AllDiodes_Filter_BlinkDetector_14_Detect_Increase /end SUB_GROUP
/end GROUP
/begin GROUP ADAS_FuncLevel_MLIA_MLIA_MLIA_calculation_Target_LEDs_ADB_target_LEDs_HLR_ADB_target_LEDs_AllDiodes_Filter_BlinkDetector_14_Detect_Decrease "ADAS/FuncLevel/MLIA/MLIA/MLIA calculation/Target LEDs/ADB target LEDs/HLR ADB target LEDs/AllDiodes_Filter/BlinkDetector_14/Detect
Decrease" /begin REF_MEASUREMENT rtDW_ADAS.GTDelayInput1_DSTATE_o /end REF_MEASUREMENT /end GROUP
/begin GROUP ADAS_FuncLevel_MLIA_MLIA_MLIA_calculation_Target_LEDs_ADB_target_LEDs_HLR_ADB_target_LEDs_AllDiodes_Filter_BlinkDetector_14_Detect_Increase "ADAS/FuncLevel/MLIA/MLIA/MLIA calculation/Target LEDs/ADB target LEDs/HLR ADB target LEDs/AllDiodes_Filter/BlinkDetector_14/Detect
Increase" /begin REF_MEASUREMENT rtDW_ADAS.GTDelayInput1_DSTATE_f /end REF_MEASUREMENT /end GROUP
/begin GROUP ADAS_FuncLevel_MLIA_MLIA_MLIA_calculation_Target_LEDs_ADB_target_LEDs_HLR_ADB_target_LEDs_AllDiodes_Filter_BlinkDetector_15 "ADAS/FuncLevel/MLIA/MLIA/MLIA calculation/Target LEDs/ADB target LEDs/HLR ADB target LEDs/AllDiodes_Filter/BlinkDetector_15"
 /begin SUB_GROUP ADAS_FuncLevel_MLIA_MLIA_MLIA_calculation_Target_LEDs_ADB_target_LEDs_HLR_ADB_target_LEDs_AllDiodes_Filter_BlinkDetector_15_Detect_Decrease ADAS_FuncLevel_MLIA_MLIA_MLIA_calculation_Target_LEDs_ADB_target_LEDs_HLR_ADB_target_LEDs_AllDiodes_Filter_BlinkDetector_15_Detect_Increase /end SUB_GROUP
/end GROUP
/begin GROUP ADAS_FuncLevel_MLIA_MLIA_MLIA_calculation_Target_LEDs_ADB_target_LEDs_HLR_ADB_target_LEDs_AllDiodes_Filter_BlinkDetector_15_Detect_Decrease "ADAS/FuncLevel/MLIA/MLIA/MLIA calculation/Target LEDs/ADB target LEDs/HLR ADB target LEDs/AllDiodes_Filter/BlinkDetector_15/Detect
Decrease" /begin REF_MEASUREMENT rtDW_ADAS.GTDelayInput1_DSTATE_dt /end REF_MEASUREMENT /end GROUP
/begin GROUP ADAS_FuncLevel_MLIA_MLIA_MLIA_calculation_Target_LEDs_ADB_target_LEDs_HLR_ADB_target_LEDs_AllDiodes_Filter_BlinkDetector_15_Detect_Increase "ADAS/FuncLevel/MLIA/MLIA/MLIA calculation/Target LEDs/ADB target LEDs/HLR ADB target LEDs/AllDiodes_Filter/BlinkDetector_15/Detect
Increase" /begin REF_MEASUREMENT rtDW_ADAS.GTDelayInput1_DSTATE_p /end REF_MEASUREMENT /end GROUP
/begin GROUP ADAS_FuncLevel_MLIA_MLIA_MLIA_calculation_Target_LEDs_ADB_target_LEDs_HLR_ADB_target_LEDs_AllDiodes_Filter_BlinkDetector_16 "ADAS/FuncLevel/MLIA/MLIA/MLIA calculation/Target LEDs/ADB target LEDs/HLR ADB target LEDs/AllDiodes_Filter/BlinkDetector_16"
 /begin SUB_GROUP ADAS_FuncLevel_MLIA_MLIA_MLIA_calculation_Target_LEDs_ADB_target_LEDs_HLR_ADB_target_LEDs_AllDiodes_Filter_BlinkDetector_16_Detect_Decrease ADAS_FuncLevel_MLIA_MLIA_MLIA_calculation_Target_LEDs_ADB_target_LEDs_HLR_ADB_target_LEDs_AllDiodes_Filter_BlinkDetector_16_Detect_Increase /end SUB_GROUP
/end GROUP
/begin GROUP ADAS_FuncLevel_MLIA_MLIA_MLIA_calculation_Target_LEDs_ADB_target_LEDs_HLR_ADB_target_LEDs_AllDiodes_Filter_BlinkDetector_16_Detect_Decrease "ADAS/FuncLevel/MLIA/MLIA/MLIA calculation/Target LEDs/ADB target LEDs/HLR ADB target LEDs/AllDiodes_Filter/BlinkDetector_16/Detect
Decrease" /begin REF_MEASUREMENT rtDW_ADAS.GTDelayInput1_DSTATE_pt /end REF_MEASUREMENT /end GROUP
/begin GROUP ADAS_FuncLevel_MLIA_MLIA_MLIA_calculation_Target_LEDs_ADB_target_LEDs_HLR_ADB_target_LEDs_AllDiodes_Filter_BlinkDetector_16_Detect_Increase "ADAS/FuncLevel/MLIA/MLIA/MLIA calculation/Target LEDs/ADB target LEDs/HLR ADB target LEDs/AllDiodes_Filter/BlinkDetector_16/Detect
Increase" /begin REF_MEASUREMENT rtDW_ADAS.GTDelayInput1_DSTATE_m /end REF_MEASUREMENT /end GROUP
/begin GROUP ADAS_FuncLevel_MLIA_MLIA_MLIA_calculation_Target_LEDs_ADB_target_LEDs_HLR_ADB_target_LEDs_AllDiodes_Filter_BlinkDetector_17 "ADAS/FuncLevel/MLIA/MLIA/MLIA calculation/Target LEDs/ADB target LEDs/HLR ADB target LEDs/AllDiodes_Filter/BlinkDetector_17"
 /begin SUB_GROUP ADAS_FuncLevel_MLIA_MLIA_MLIA_calculation_Target_LEDs_ADB_target_LEDs_HLR_ADB_target_LEDs_AllDiodes_Filter_BlinkDetector_17_Detect_Decrease ADAS_FuncLevel_MLIA_MLIA_MLIA_calculation_Target_LEDs_ADB_target_LEDs_HLR_ADB_target_LEDs_AllDiodes_Filter_BlinkDetector_17_Detect_Increase /end SUB_GROUP
/end GROUP
/begin GROUP ADAS_FuncLevel_MLIA_MLIA_MLIA_calculation_Target_LEDs_ADB_target_LEDs_HLR_ADB_target_LEDs_AllDiodes_Filter_BlinkDetector_17_Detect_Decrease "ADAS/FuncLevel/MLIA/MLIA/MLIA calculation/Target LEDs/ADB target LEDs/HLR ADB target LEDs/AllDiodes_Filter/BlinkDetector_17/Detect
Decrease" /begin REF_MEASUREMENT rtDW_ADAS.GTDelayInput1_DSTATE_i /end REF_MEASUREMENT /end GROUP
/begin GROUP ADAS_FuncLevel_MLIA_MLIA_MLIA_calculation_Target_LEDs_ADB_target_LEDs_HLR_ADB_target_LEDs_AllDiodes_Filter_BlinkDetector_17_Detect_Increase "ADAS/FuncLevel/MLIA/MLIA/MLIA calculation/Target LEDs/ADB target LEDs/HLR ADB target LEDs/AllDiodes_Filter/BlinkDetector_17/Detect
Increase" /begin REF_MEASUREMENT rtDW_ADAS.GTDelayInput1_DSTATE_km /end REF_MEASUREMENT /end GROUP
/begin GROUP ADAS_FuncLevel_MLIA_MLIA_MLIA_calculation_Target_LEDs_ADB_target_LEDs_HLR_ADB_target_LEDs_AllDiodes_Filter_BlinkDetector_18 "ADAS/FuncLevel/MLIA/MLIA/MLIA calculation/Target LEDs/ADB target LEDs/HLR ADB target LEDs/AllDiodes_Filter/BlinkDetector_18"
 /begin SUB_GROUP ADAS_FuncLevel_MLIA_MLIA_MLIA_calculation_Target_LEDs_ADB_target_LEDs_HLR_ADB_target_LEDs_AllDiodes_Filter_BlinkDetector_18_Detect_Decrease ADAS_FuncLevel_MLIA_MLIA_MLIA_calculation_Target_LEDs_ADB_target_LEDs_HLR_ADB_target_LEDs_AllDiodes_Filter_BlinkDetector_18_Detect_Increase /end SUB_GROUP
/end GROUP
/begin GROUP ADAS_FuncLevel_MLIA_MLIA_MLIA_calculation_Target_LEDs_ADB_target_LEDs_HLR_ADB_target_LEDs_AllDiodes_Filter_BlinkDetector_18_Detect_Decrease "ADAS/FuncLevel/MLIA/MLIA/MLIA calculation/Target LEDs/ADB target LEDs/HLR ADB target LEDs/AllDiodes_Filter/BlinkDetector_18/Detect
Decrease" /begin REF_MEASUREMENT rtDW_ADAS.GTDelayInput1_DSTATE_j /end REF_MEASUREMENT /end GROUP
/begin GROUP ADAS_FuncLevel_MLIA_MLIA_MLIA_calculation_Target_LEDs_ADB_target_LEDs_HLR_ADB_target_LEDs_AllDiodes_Filter_BlinkDetector_18_Detect_Increase "ADAS/FuncLevel/MLIA/MLIA/MLIA calculation/Target LEDs/ADB target LEDs/HLR ADB target LEDs/AllDiodes_Filter/BlinkDetector_18/Detect
Increase" /begin REF_MEASUREMENT rtDW_ADAS.GTDelayInput1_DSTATE_in /end REF_MEASUREMENT /end GROUP
/begin GROUP ADAS_FuncLevel_MLIA_MLIA_MLIA_calculation_Target_LEDs_ADB_target_LEDs_HLR_ADB_target_LEDs_AllDiodes_Filter_BlinkDetector_1_Detect_Decrease "ADAS/FuncLevel/MLIA/MLIA/MLIA calculation/Target LEDs/ADB target LEDs/HLR ADB target LEDs/AllDiodes_Filter/BlinkDetector_1/Detect
Decrease" /begin REF_MEASUREMENT rtDW_ADAS.GTDelayInput1_DSTATE_d /end REF_MEASUREMENT /end GROUP
/begin GROUP ADAS_FuncLevel_MLIA_MLIA_MLIA_calculation_Target_LEDs_ADB_target_LEDs_HLR_ADB_target_LEDs_AllDiodes_Filter_BlinkDetector_1_Detect_Increase "ADAS/FuncLevel/MLIA/MLIA/MLIA calculation/Target LEDs/ADB target LEDs/HLR ADB target LEDs/AllDiodes_Filter/BlinkDetector_1/Detect
Increase" /begin REF_MEASUREMENT rtDW_ADAS.GTDelayInput1_DSTATE_h /end REF_MEASUREMENT /end GROUP
/begin GROUP ADAS_FuncLevel_MLIA_MLIA_MLIA_calculation_Target_LEDs_ADB_target_LEDs_HLR_ADB_target_LEDs_AllDiodes_Filter_BlinkDetector_2 "ADAS/FuncLevel/MLIA/MLIA/MLIA calculation/Target LEDs/ADB target LEDs/HLR ADB target LEDs/AllDiodes_Filter/BlinkDetector_2"
 /begin SUB_GROUP ADAS_FuncLevel_MLIA_MLIA_MLIA_calculation_Target_LEDs_ADB_target_LEDs_HLR_ADB_target_LEDs_AllDiodes_Filter_BlinkDetector_2_Detect_Decrease ADAS_FuncLevel_MLIA_MLIA_MLIA_calculation_Target_LEDs_ADB_target_LEDs_HLR_ADB_target_LEDs_AllDiodes_Filter_BlinkDetector_2_Detect_Increase /end SUB_GROUP
/end GROUP
/begin GROUP ADAS_FuncLevel_MLIA_MLIA_MLIA_calculation_Target_LEDs_ADB_target_LEDs_HLR_ADB_target_LEDs_AllDiodes_Filter_BlinkDetector_2_Detect_Decrease "ADAS/FuncLevel/MLIA/MLIA/MLIA calculation/Target LEDs/ADB target LEDs/HLR ADB target LEDs/AllDiodes_Filter/BlinkDetector_2/Detect
Decrease" /begin REF_MEASUREMENT rtDW_ADAS.GTDelayInput1_DSTATE_fy /end REF_MEASUREMENT /end GROUP
/begin GROUP ADAS_FuncLevel_MLIA_MLIA_MLIA_calculation_Target_LEDs_ADB_target_LEDs_HLR_ADB_target_LEDs_AllDiodes_Filter_BlinkDetector_2_Detect_Increase "ADAS/FuncLevel/MLIA/MLIA/MLIA calculation/Target LEDs/ADB target LEDs/HLR ADB target LEDs/AllDiodes_Filter/BlinkDetector_2/Detect
Increase" /begin REF_MEASUREMENT rtDW_ADAS.GTDelayInput1_DSTATE_fn /end REF_MEASUREMENT /end GROUP
/begin GROUP ADAS_FuncLevel_MLIA_MLIA_MLIA_calculation_Target_LEDs_ADB_target_LEDs_HLR_ADB_target_LEDs_AllDiodes_Filter_BlinkDetector_3 "ADAS/FuncLevel/MLIA/MLIA/MLIA calculation/Target LEDs/ADB target LEDs/HLR ADB target LEDs/AllDiodes_Filter/BlinkDetector_3"
 /begin SUB_GROUP ADAS_FuncLevel_MLIA_MLIA_MLIA_calculation_Target_LEDs_ADB_target_LEDs_HLR_ADB_target_LEDs_AllDiodes_Filter_BlinkDetector_3_Detect_Decrease ADAS_FuncLevel_MLIA_MLIA_MLIA_calculation_Target_LEDs_ADB_target_LEDs_HLR_ADB_target_LEDs_AllDiodes_Filter_BlinkDetector_3_Detect_Increase /end SUB_GROUP
/end GROUP
/begin GROUP ADAS_FuncLevel_MLIA_MLIA_MLIA_calculation_Target_LEDs_ADB_target_LEDs_HLR_ADB_target_LEDs_AllDiodes_Filter_BlinkDetector_3_Detect_Decrease "ADAS/FuncLevel/MLIA/MLIA/MLIA calculation/Target LEDs/ADB target LEDs/HLR ADB target LEDs/AllDiodes_Filter/BlinkDetector_3/Detect
Decrease" /begin REF_MEASUREMENT rtDW_ADAS.GTDelayInput1_DSTATE_c4 /end REF_MEASUREMENT /end GROUP
/begin GROUP ADAS_FuncLevel_MLIA_MLIA_MLIA_calculation_Target_LEDs_ADB_target_LEDs_HLR_ADB_target_LEDs_AllDiodes_Filter_BlinkDetector_3_Detect_Increase "ADAS/FuncLevel/MLIA/MLIA/MLIA calculation/Target LEDs/ADB target LEDs/HLR ADB target LEDs/AllDiodes_Filter/BlinkDetector_3/Detect
Increase" /begin REF_MEASUREMENT rtDW_ADAS.GTDelayInput1_DSTATE_cy /end REF_MEASUREMENT /end GROUP
/begin GROUP ADAS_FuncLevel_MLIA_MLIA_MLIA_calculation_Target_LEDs_ADB_target_LEDs_HLR_ADB_target_LEDs_AllDiodes_Filter_BlinkDetector_4 "ADAS/FuncLevel/MLIA/MLIA/MLIA calculation/Target LEDs/ADB target LEDs/HLR ADB target LEDs/AllDiodes_Filter/BlinkDetector_4"
 /begin SUB_GROUP ADAS_FuncLevel_MLIA_MLIA_MLIA_calculation_Target_LEDs_ADB_target_LEDs_HLR_ADB_target_LEDs_AllDiodes_Filter_BlinkDetector_4_Detect_Decrease ADAS_FuncLevel_MLIA_MLIA_MLIA_calculation_Target_LEDs_ADB_target_LEDs_HLR_ADB_target_LEDs_AllDiodes_Filter_BlinkDetector_4_Detect_Increase /end SUB_GROUP
/end GROUP
/begin GROUP ADAS_FuncLevel_MLIA_MLIA_MLIA_calculation_Target_LEDs_ADB_target_LEDs_HLR_ADB_target_LEDs_AllDiodes_Filter_BlinkDetector_4_Detect_Decrease "ADAS/FuncLevel/MLIA/MLIA/MLIA calculation/Target LEDs/ADB target LEDs/HLR ADB target LEDs/AllDiodes_Filter/BlinkDetector_4/Detect
Decrease" /begin REF_MEASUREMENT rtDW_ADAS.GTDelayInput1_DSTATE_k4 /end REF_MEASUREMENT /end GROUP
/begin GROUP ADAS_FuncLevel_MLIA_MLIA_MLIA_calculation_Target_LEDs_ADB_target_LEDs_HLR_ADB_target_LEDs_AllDiodes_Filter_BlinkDetector_4_Detect_Increase "ADAS/FuncLevel/MLIA/MLIA/MLIA calculation/Target LEDs/ADB target LEDs/HLR ADB target LEDs/AllDiodes_Filter/BlinkDetector_4/Detect
Increase" /begin REF_MEASUREMENT rtDW_ADAS.GTDelayInput1_DSTATE_mk /end REF_MEASUREMENT /end GROUP
/begin GROUP ADAS_FuncLevel_MLIA_MLIA_MLIA_calculation_Target_LEDs_ADB_target_LEDs_HLR_ADB_target_LEDs_AllDiodes_Filter_BlinkDetector_5 "ADAS/FuncLevel/MLIA/MLIA/MLIA calculation/Target LEDs/ADB target LEDs/HLR ADB target LEDs/AllDiodes_Filter/BlinkDetector_5"
 /begin SUB_GROUP ADAS_FuncLevel_MLIA_MLIA_MLIA_calculation_Target_LEDs_ADB_target_LEDs_HLR_ADB_target_LEDs_AllDiodes_Filter_BlinkDetector_5_Detect_Decrease ADAS_FuncLevel_MLIA_MLIA_MLIA_calculation_Target_LEDs_ADB_target_LEDs_HLR_ADB_target_LEDs_AllDiodes_Filter_BlinkDetector_5_Detect_Increase /end SUB_GROUP
/end GROUP
/begin GROUP ADAS_FuncLevel_MLIA_MLIA_MLIA_calculation_Target_LEDs_ADB_target_LEDs_HLR_ADB_target_LEDs_AllDiodes_Filter_BlinkDetector_5_Detect_Decrease "ADAS/FuncLevel/MLIA/MLIA/MLIA calculation/Target LEDs/ADB target LEDs/HLR ADB target LEDs/AllDiodes_Filter/BlinkDetector_5/Detect
Decrease" /begin REF_MEASUREMENT rtDW_ADAS.GTDelayInput1_DSTATE_o1 /end REF_MEASUREMENT /end GROUP
/begin GROUP ADAS_FuncLevel_MLIA_MLIA_MLIA_calculation_Target_LEDs_ADB_target_LEDs_HLR_ADB_target_LEDs_AllDiodes_Filter_BlinkDetector_5_Detect_Increase "ADAS/FuncLevel/MLIA/MLIA/MLIA calculation/Target LEDs/ADB target LEDs/HLR ADB target LEDs/AllDiodes_Filter/BlinkDetector_5/Detect
Increase" /begin REF_MEASUREMENT rtDW_ADAS.GTDelayInput1_DSTATE_lq /end REF_MEASUREMENT /end GROUP
/begin GROUP ADAS_FuncLevel_MLIA_MLIA_MLIA_calculation_Target_LEDs_ADB_target_LEDs_HLR_ADB_target_LEDs_AllDiodes_Filter_BlinkDetector_6 "ADAS/FuncLevel/MLIA/MLIA/MLIA calculation/Target LEDs/ADB target LEDs/HLR ADB target LEDs/AllDiodes_Filter/BlinkDetector_6"
 /begin SUB_GROUP ADAS_FuncLevel_MLIA_MLIA_MLIA_calculation_Target_LEDs_ADB_target_LEDs_HLR_ADB_target_LEDs_AllDiodes_Filter_BlinkDetector_6_Detect_Decrease ADAS_FuncLevel_MLIA_MLIA_MLIA_calculation_Target_LEDs_ADB_target_LEDs_HLR_ADB_target_LEDs_AllDiodes_Filter_BlinkDetector_6_Detect_Increase /end SUB_GROUP
/end GROUP
/begin GROUP ADAS_FuncLevel_MLIA_MLIA_MLIA_calculation_Target_LEDs_ADB_target_LEDs_HLR_ADB_target_LEDs_AllDiodes_Filter_BlinkDetector_6_Detect_Decrease "ADAS/FuncLevel/MLIA/MLIA/MLIA calculation/Target LEDs/ADB target LEDs/HLR ADB target LEDs/AllDiodes_Filter/BlinkDetector_6/Detect
Decrease" /begin REF_MEASUREMENT rtDW_ADAS.GTDelayInput1_DSTATE_cy3 /end REF_MEASUREMENT /end GROUP
/begin GROUP ADAS_FuncLevel_MLIA_MLIA_MLIA_calculation_Target_LEDs_ADB_target_LEDs_HLR_ADB_target_LEDs_AllDiodes_Filter_BlinkDetector_6_Detect_Increase "ADAS/FuncLevel/MLIA/MLIA/MLIA calculation/Target LEDs/ADB target LEDs/HLR ADB target LEDs/AllDiodes_Filter/BlinkDetector_6/Detect
Increase" /begin REF_MEASUREMENT rtDW_ADAS.GTDelayInput1_DSTATE_e1 /end REF_MEASUREMENT /end GROUP
/begin GROUP ADAS_FuncLevel_MLIA_MLIA_MLIA_calculation_Target_LEDs_ADB_target_LEDs_HLR_ADB_target_LEDs_AllDiodes_Filter_BlinkDetector_7 "ADAS/FuncLevel/MLIA/MLIA/MLIA calculation/Target LEDs/ADB target LEDs/HLR ADB target LEDs/AllDiodes_Filter/BlinkDetector_7"
 /begin SUB_GROUP ADAS_FuncLevel_MLIA_MLIA_MLIA_calculation_Target_LEDs_ADB_target_LEDs_HLR_ADB_target_LEDs_AllDiodes_Filter_BlinkDetector_7_Detect_Decrease ADAS_FuncLevel_MLIA_MLIA_MLIA_calculation_Target_LEDs_ADB_target_LEDs_HLR_ADB_target_LEDs_AllDiodes_Filter_BlinkDetector_7_Detect_Increase /end SUB_GROUP
/end GROUP
/begin GROUP ADAS_FuncLevel_MLIA_MLIA_MLIA_calculation_Target_LEDs_ADB_target_LEDs_HLR_ADB_target_LEDs_AllDiodes_Filter_BlinkDetector_7_Detect_Decrease "ADAS/FuncLevel/MLIA/MLIA/MLIA calculation/Target LEDs/ADB target LEDs/HLR ADB target LEDs/AllDiodes_Filter/BlinkDetector_7/Detect
Decrease" /begin REF_MEASUREMENT rtDW_ADAS.GTDelayInput1_DSTATE_oq /end REF_MEASUREMENT /end GROUP
/begin GROUP ADAS_FuncLevel_MLIA_MLIA_MLIA_calculation_Target_LEDs_ADB_target_LEDs_HLR_ADB_target_LEDs_AllDiodes_Filter_BlinkDetector_7_Detect_Increase "ADAS/FuncLevel/MLIA/MLIA/MLIA calculation/Target LEDs/ADB target LEDs/HLR ADB target LEDs/AllDiodes_Filter/BlinkDetector_7/Detect
Increase" /begin REF_MEASUREMENT rtDW_ADAS.GTDelayInput1_DSTATE_b /end REF_MEASUREMENT /end GROUP
/begin GROUP ADAS_FuncLevel_MLIA_MLIA_MLIA_calculation_Target_LEDs_ADB_target_LEDs_HLR_ADB_target_LEDs_AllDiodes_Filter_BlinkDetector_8 "ADAS/FuncLevel/MLIA/MLIA/MLIA calculation/Target LEDs/ADB target LEDs/HLR ADB target LEDs/AllDiodes_Filter/BlinkDetector_8"
 /begin SUB_GROUP ADAS_FuncLevel_MLIA_MLIA_MLIA_calculation_Target_LEDs_ADB_target_LEDs_HLR_ADB_target_LEDs_AllDiodes_Filter_BlinkDetector_8_Detect_Decrease ADAS_FuncLevel_MLIA_MLIA_MLIA_calculation_Target_LEDs_ADB_target_LEDs_HLR_ADB_target_LEDs_AllDiodes_Filter_BlinkDetector_8_Detect_Increase /end SUB_GROUP
/end GROUP
/begin GROUP ADAS_FuncLevel_MLIA_MLIA_MLIA_calculation_Target_LEDs_ADB_target_LEDs_HLR_ADB_target_LEDs_AllDiodes_Filter_BlinkDetector_8_Detect_Decrease "ADAS/FuncLevel/MLIA/MLIA/MLIA calculation/Target LEDs/ADB target LEDs/HLR ADB target LEDs/AllDiodes_Filter/BlinkDetector_8/Detect
Decrease" /begin REF_MEASUREMENT rtDW_ADAS.GTDelayInput1_DSTATE_n /end REF_MEASUREMENT /end GROUP
/begin GROUP ADAS_FuncLevel_MLIA_MLIA_MLIA_calculation_Target_LEDs_ADB_target_LEDs_HLR_ADB_target_LEDs_AllDiodes_Filter_BlinkDetector_8_Detect_Increase "ADAS/FuncLevel/MLIA/MLIA/MLIA calculation/Target LEDs/ADB target LEDs/HLR ADB target LEDs/AllDiodes_Filter/BlinkDetector_8/Detect
Increase" /begin REF_MEASUREMENT rtDW_ADAS.GTDelayInput1_DSTATE_or /end REF_MEASUREMENT /end GROUP
/begin GROUP ADAS_FuncLevel_MLIA_MLIA_MLIA_calculation_Target_LEDs_ADB_target_LEDs_HLR_ADB_target_LEDs_AllDiodes_Filter_BlinkDetector_9 "ADAS/FuncLevel/MLIA/MLIA/MLIA calculation/Target LEDs/ADB target LEDs/HLR ADB target LEDs/AllDiodes_Filter/BlinkDetector_9"
 /begin SUB_GROUP ADAS_FuncLevel_MLIA_MLIA_MLIA_calculation_Target_LEDs_ADB_target_LEDs_HLR_ADB_target_LEDs_AllDiodes_Filter_BlinkDetector_9_Detect_Decrease ADAS_FuncLevel_MLIA_MLIA_MLIA_calculation_Target_LEDs_ADB_target_LEDs_HLR_ADB_target_LEDs_AllDiodes_Filter_BlinkDetector_9_Detect_Increase /end SUB_GROUP
/end GROUP
/begin GROUP ADAS_FuncLevel_MLIA_MLIA_MLIA_calculation_Target_LEDs_ADB_target_LEDs_HLR_ADB_target_LEDs_AllDiodes_Filter_BlinkDetector_9_Detect_Decrease "ADAS/FuncLevel/MLIA/MLIA/MLIA calculation/Target LEDs/ADB target LEDs/HLR ADB target LEDs/AllDiodes_Filter/BlinkDetector_9/Detect
Decrease" /begin REF_MEASUREMENT rtDW_ADAS.GTDelayInput1_DSTATE_di /end REF_MEASUREMENT /end GROUP
/begin GROUP ADAS_FuncLevel_MLIA_MLIA_MLIA_calculation_Target_LEDs_ADB_target_LEDs_HLR_ADB_target_LEDs_AllDiodes_Filter_BlinkDetector_9_Detect_Increase "ADAS/FuncLevel/MLIA/MLIA/MLIA calculation/Target LEDs/ADB target LEDs/HLR ADB target LEDs/AllDiodes_Filter/BlinkDetector_9/Detect
Increase" /begin REF_MEASUREMENT rtDW_ADAS.GTDelayInput1_DSTATE_lr /end REF_MEASUREMENT /end GROUP
/begin GROUP ADAS_FuncLevel_MLIA_MLIA_MLIA_calculation_Target_LEDs_microLED_target_LEDs "ADAS/FuncLevel/MLIA/MLIA/MLIA calculation/Target LEDs/microLED target LEDs"
 /begin SUB_GROUP ADAS_FuncLevel_MLIA_MLIA_MLIA_calculation_Target_LEDs_microLED_target_LEDs_HLL_microLED_target_LEDs ADAS_FuncLevel_MLIA_MLIA_MLIA_calculation_Target_LEDs_microLED_target_LEDs_HLR_microLED_target_LEDs /end SUB_GROUP
/end GROUP
/begin GROUP ADAS_FuncLevel_MLIA_MLIA_MLIA_calculation_Target_LEDs_microLED_target_LEDs_Filter "ADAS/FuncLevel/MLIA/MLIA/MLIA calculation/Target LEDs/microLED target LEDs_Filter"
 /begin SUB_GROUP ADAS_FuncLevel_MLIA_MLIA_MLIA_calculation_Target_LEDs_microLED_target_LEDs_Filter_HLL_microLED_target_LEDs ADAS_FuncLevel_MLIA_MLIA_MLIA_calculation_Target_LEDs_microLED_target_LEDs_Filter_HLR_microLED_target_LEDs /end SUB_GROUP
/end GROUP
/begin GROUP ADAS_FuncLevel_MLIA_MLIA_MLIA_calculation_Target_LEDs_microLED_target_LEDs_Filter_HLL_microLED_target_LEDs "ADAS/FuncLevel/MLIA/MLIA/MLIA calculation/Target LEDs/microLED target LEDs_Filter/HLL microLED target LEDs" /begin REF_MEASUREMENT rtDW_ADAS.GTDelay1_DSTATE_o rtDW_ADAS.GTDelay_DSTATE_h /end REF_MEASUREMENT /end GROUP
/begin GROUP ADAS_FuncLevel_MLIA_MLIA_MLIA_calculation_Target_LEDs_microLED_target_LEDs_Filter_HLR_microLED_target_LEDs "ADAS/FuncLevel/MLIA/MLIA/MLIA calculation/Target LEDs/microLED target LEDs_Filter/HLR microLED target LEDs" /begin REF_MEASUREMENT rtDW_ADAS.GTDelay1_DSTATE_io rtDW_ADAS.GTDelay_DSTATE_k /end REF_MEASUREMENT /end GROUP
/begin GROUP ADAS_FuncLevel_MLIA_MLIA_MLIA_calculation_Target_LEDs_microLED_target_LEDs_HLL_microLED_target_LEDs "ADAS/FuncLevel/MLIA/MLIA/MLIA calculation/Target LEDs/microLED target LEDs/HLL microLED target LEDs" /begin REF_MEASUREMENT rtDW_ADAS.GTDelay1_DSTATE_jp rtDW_ADAS.GTDelay_DSTATE_ph /end REF_MEASUREMENT /end GROUP
/begin GROUP ADAS_FuncLevel_MLIA_MLIA_MLIA_calculation_Target_LEDs_microLED_target_LEDs_HLR_microLED_target_LEDs "ADAS/FuncLevel/MLIA/MLIA/MLIA calculation/Target LEDs/microLED target LEDs/HLR microLED target LEDs" /begin REF_MEASUREMENT rtDW_ADAS.GTDelay1_DSTATE_e rtDW_ADAS.GTDelay_DSTATE_lw /end REF_MEASUREMENT /end GROUP
/begin GROUP ADAS_FuncLevel_MLIA_MLIA_MLIA_mode "ADAS/FuncLevel/MLIA/MLIA/MLIA mode"
 /begin SUB_GROUP ADAS_FuncLevel_MLIA_MLIA_MLIA_mode_Compare_To_Constant1 ADAS_FuncLevel_MLIA_MLIA_MLIA_mode_HBA_mode /end SUB_GROUP
 /begin REF_MEASUREMENT rtDW_ADAS.GTTimeObj rtDW_ADAS.GTTimeTotal rtDW_ADAS.GTis_ACTIVE rtDW_ADAS.GTis_ON rtDW_ADAS.GTis_active_c554_ADAS rtDW_ADAS.GTis_active_c556_ADAS rtDW_ADAS.GTis_active_c557_ADAS rtDW_ADAS.GTis_c556_ADAS rtDW_ADAS.GTtemporalCounter_i1_ad rtDW_ADAS.GTtemporalCounter_i1_e2 rtDW_ADAS.GTtemporalCounter_i1_k /end REF_MEASUREMENT
/end GROUP
/begin GROUP ADAS_FuncLevel_MLIA_MLIA_MLIA_mode_HBA_mode "ADAS/FuncLevel/MLIA/MLIA/MLIA mode/HBA mode"
 /begin REF_MEASUREMENT rtDW_ADAS.GTis_active_c555_ADAS rtDW_ADAS.GTis_c555_ADAS rtDW_ADAS.GTtemporalCounter_i1_hk /end REF_MEASUREMENT
/end GROUP
/begin GROUP ADAS_FuncLevel_MLIA_PROJECTION "ADAS/FuncLevel/MLIA/PROJECTION"
 /begin SUB_GROUP ADAS_FuncLevel_MLIA_PROJECTION_Compare_To_Zero ADAS_FuncLevel_MLIA_PROJECTION_Left_HL ADAS_FuncLevel_MLIA_PROJECTION_Right_HL ADAS_FuncLevel_MLIA_PROJECTION_Sign_display_duration ADAS_FuncLevel_MLIA_PROJECTION_Sign_display_duration1 /end SUB_GROUP
/end GROUP
/begin GROUP ADAS_FuncLevel_MLIA_PROJECTION_Left_HL "ADAS/FuncLevel/MLIA/PROJECTION/Left HL"
 /begin SUB_GROUP ADAS_FuncLevel_MLIA_PROJECTION_Left_HL_Compare_To_Constant ADAS_FuncLevel_MLIA_PROJECTION_Left_HL_Compare_To_Constant1 ADAS_FuncLevel_MLIA_PROJECTION_Left_HL_Compare_To_Constant2 ADAS_FuncLevel_MLIA_PROJECTION_Left_HL_Compare_To_Constant3 ADAS_FuncLevel_MLIA_PROJECTION_Left_HL_Enabled_Subsystem ADAS_FuncLevel_MLIA_PROJECTION_Left_HL_Enabled_Subsystem1 ADAS_FuncLevel_MLIA_PROJECTION_Left_HL_Enabled_Subsystem2 ADAS_FuncLevel_MLIA_PROJECTION_Left_HL_Enabled_Subsystem3 /end SUB_GROUP
 /begin REF_MEASUREMENT rtConstB_ADAS.GTMultiportSwitch rtConstB_ADAS.GTu rtConstB_ADAS.GTuDLookupTable1 rtConstB_ADAS.GTuDLookupTable2 rtConstB_ADAS.GTu_g /end REF_MEASUREMENT
/end GROUP
/begin GROUP ADAS_FuncLevel_MLIA_PROJECTION_Left_HL_Compare_To_Constant "ADAS/FuncLevel/MLIA/PROJECTION/Left HL/Compare
To Constant" /begin REF_MEASUREMENT rtConstB_ADAS.GTCompare_d rtConstB_ADAS.GTu /end REF_MEASUREMENT /end GROUP
/begin GROUP ADAS_FuncLevel_MLIA_PROJECTION_Left_HL_Compare_To_Constant1 "ADAS/FuncLevel/MLIA/PROJECTION/Left HL/Compare
To Constant1" /begin REF_MEASUREMENT rtConstB_ADAS.GTCompare_pn rtConstB_ADAS.GTu /end REF_MEASUREMENT /end GROUP
/begin GROUP ADAS_FuncLevel_MLIA_PROJECTION_Left_HL_Compare_To_Constant2 "ADAS/FuncLevel/MLIA/PROJECTION/Left HL/Compare
To Constant2" /begin REF_MEASUREMENT rtConstB_ADAS.GTCompare_ih rtConstB_ADAS.GTu /end REF_MEASUREMENT /end GROUP
/begin GROUP ADAS_FuncLevel_MLIA_PROJECTION_Left_HL_Compare_To_Constant3 "ADAS/FuncLevel/MLIA/PROJECTION/Left HL/Compare
To Constant3" /begin REF_MEASUREMENT rtConstB_ADAS.GTCompare_cw rtConstB_ADAS.GTu /end REF_MEASUREMENT /end GROUP
/begin GROUP ADAS_FuncLevel_MLIA_PROJECTION_Left_HL_Enabled_Subsystem "ADAS/FuncLevel/MLIA/PROJECTION/Left HL/Enabled
Subsystem" /begin REF_MEASUREMENT rtDW_ADAS.GTIn_gp4lvew /end REF_MEASUREMENT /end GROUP
/begin GROUP ADAS_FuncLevel_MLIA_PROJECTION_Left_HL_Enabled_Subsystem1 "ADAS/FuncLevel/MLIA/PROJECTION/Left HL/Enabled
Subsystem1" /begin REF_MEASUREMENT rtDW_ADAS.GTIn_gp4lve /end REF_MEASUREMENT /end GROUP
/begin GROUP ADAS_FuncLevel_MLIA_PROJECTION_Left_HL_Enabled_Subsystem2 "ADAS/FuncLevel/MLIA/PROJECTION/Left HL/Enabled
Subsystem2" /begin REF_MEASUREMENT rtDW_ADAS.GTIn_gp4lv /end REF_MEASUREMENT /end GROUP
/begin GROUP ADAS_FuncLevel_MLIA_PROJECTION_Left_HL_Enabled_Subsystem3 "ADAS/FuncLevel/MLIA/PROJECTION/Left HL/Enabled
Subsystem3" /begin REF_MEASUREMENT rtDW_ADAS.GTIn_gp4l /end REF_MEASUREMENT /end GROUP
/begin GROUP ADAS_FuncLevel_MLIA_PROJECTION_Right_HL "ADAS/FuncLevel/MLIA/PROJECTION/Right HL"
 /begin SUB_GROUP ADAS_FuncLevel_MLIA_PROJECTION_Right_HL_Compare_To_Constant ADAS_FuncLevel_MLIA_PROJECTION_Right_HL_Compare_To_Constant1 ADAS_FuncLevel_MLIA_PROJECTION_Right_HL_Compare_To_Constant2 ADAS_FuncLevel_MLIA_PROJECTION_Right_HL_Compare_To_Constant3 ADAS_FuncLevel_MLIA_PROJECTION_Right_HL_Enabled_Subsystem ADAS_FuncLevel_MLIA_PROJECTION_Right_HL_Enabled_Subsystem1 ADAS_FuncLevel_MLIA_PROJECTION_Right_HL_Enabled_Subsystem2 ADAS_FuncLevel_MLIA_PROJECTION_Right_HL_Enabled_Subsystem3 /end SUB_GROUP
 /begin REF_MEASUREMENT rtConstB_ADAS.GTMultiportSwitch_i rtConstB_ADAS.GTuDLookupTable1_j rtConstB_ADAS.GTuDLookupTable2_b rtConstB_ADAS.GTu_m rtConstB_ADAS.GTu_n /end REF_MEASUREMENT
/end GROUP
/begin GROUP ADAS_FuncLevel_MLIA_PROJECTION_Right_HL_Compare_To_Constant "ADAS/FuncLevel/MLIA/PROJECTION/Right HL/Compare
To Constant" /begin REF_MEASUREMENT rtConstB_ADAS.GTCompare_b rtConstB_ADAS.GTu_m /end REF_MEASUREMENT /end GROUP
/begin GROUP ADAS_FuncLevel_MLIA_PROJECTION_Right_HL_Compare_To_Constant1 "ADAS/FuncLevel/MLIA/PROJECTION/Right HL/Compare
To Constant1" /begin REF_MEASUREMENT rtConstB_ADAS.GTCompare_m rtConstB_ADAS.GTu_m /end REF_MEASUREMENT /end GROUP
/begin GROUP ADAS_FuncLevel_MLIA_PROJECTION_Right_HL_Compare_To_Constant2 "ADAS/FuncLevel/MLIA/PROJECTION/Right HL/Compare
To Constant2" /begin REF_MEASUREMENT rtConstB_ADAS.GTCompare_cz rtConstB_ADAS.GTu_m /end REF_MEASUREMENT /end GROUP
/begin GROUP ADAS_FuncLevel_MLIA_PROJECTION_Right_HL_Compare_To_Constant3 "ADAS/FuncLevel/MLIA/PROJECTION/Right HL/Compare
To Constant3" /begin REF_MEASUREMENT rtConstB_ADAS.GTCompare_a rtConstB_ADAS.GTu_m /end REF_MEASUREMENT /end GROUP
/begin GROUP ADAS_FuncLevel_MLIA_PROJECTION_Right_HL_Enabled_Subsystem "ADAS/FuncLevel/MLIA/PROJECTION/Right HL/Enabled
Subsystem" /begin REF_MEASUREMENT rtDW_ADAS.GTIn_gp4 /end REF_MEASUREMENT /end GROUP
/begin GROUP ADAS_FuncLevel_MLIA_PROJECTION_Right_HL_Enabled_Subsystem1 "ADAS/FuncLevel/MLIA/PROJECTION/Right HL/Enabled
Subsystem1" /begin REF_MEASUREMENT rtDW_ADAS.GTIn_gp /end REF_MEASUREMENT /end GROUP
/begin GROUP ADAS_FuncLevel_MLIA_PROJECTION_Right_HL_Enabled_Subsystem2 "ADAS/FuncLevel/MLIA/PROJECTION/Right HL/Enabled
Subsystem2" /begin REF_MEASUREMENT rtDW_ADAS.GTIn_g /end REF_MEASUREMENT /end GROUP
/begin GROUP ADAS_FuncLevel_MLIA_PROJECTION_Right_HL_Enabled_Subsystem3 "ADAS/FuncLevel/MLIA/PROJECTION/Right HL/Enabled
Subsystem3" /begin REF_MEASUREMENT rtDW_ADAS.GTIn /end REF_MEASUREMENT /end GROUP
/begin GROUP ADAS_FuncLevel_MLIA_PROJECTION_Sign_display_duration "ADAS/FuncLevel/MLIA/PROJECTION/Sign display duration"
 /begin SUB_GROUP ADAS_FuncLevel_MLIA_PROJECTION_Sign_display_duration_Compare_To_Zero ADAS_FuncLevel_MLIA_PROJECTION_Sign_display_duration_Detect_Change /end SUB_GROUP
/end GROUP
/begin GROUP ADAS_FuncLevel_MLIA_PROJECTION_Sign_display_duration1 "ADAS/FuncLevel/MLIA/PROJECTION/Sign display duration1"
 /begin SUB_GROUP ADAS_FuncLevel_MLIA_PROJECTION_Sign_display_duration1_Compare_To_Zero ADAS_FuncLevel_MLIA_PROJECTION_Sign_display_duration1_Detect_Change /end SUB_GROUP
/end GROUP
/begin GROUP ADAS_FuncLevel_MLIA_PROJECTION_Sign_display_duration1_Detect_Change "ADAS/FuncLevel/MLIA/PROJECTION/Sign display duration1/Detect
Change" /begin REF_MEASUREMENT rtDW_ADAS.GTDelayInput1_DSTATE_e /end REF_MEASUREMENT /end GROUP
/begin GROUP ADAS_FuncLevel_MLIA_PROJECTION_Sign_display_duration_Detect_Change "ADAS/FuncLevel/MLIA/PROJECTION/Sign display duration/Detect
Change" /begin REF_MEASUREMENT rtDW_ADAS.GTDelayInput1_DSTATE /end REF_MEASUREMENT /end GROUP
/begin GROUP ADAS_FuncLevel_NV "ADAS/FuncLevel/NV"
 /begin REF_MEASUREMENT rtDW_ADAS.GTCnt_p rtDW_ADAS.GTNvHeatFlag rtDW_ADAS.GTNvMode rtDW_ADAS.GTTicuBlk rtDW_ADAS.GTis_On rtDW_ADAS.GTis_active_c675_ADAS rtDW_ADAS.GTis_active_c676_ADAS rtDW_ADAS.GTis_c675_ADAS rtDW_ADAS.GTis_c676_ADAS rtDW_ADAS.GTtemporalCounter_i1_cq /end REF_MEASUREMENT
/end GROUP
/begin GROUP ADAS_FuncLevel_RCW "ADAS/FuncLevel/RCW"
 /begin SUB_GROUP ADAS_FuncLevel_RCW_Compare_To_Constant ADAS_FuncLevel_RCW_Logic_23_04_2024 ADAS_FuncLevel_RCW_MRRX_RCW_Prototype ADAS_FuncLevel_RCW_Solver_23_04_2024 /end SUB_GROUP
/end GROUP
/begin GROUP ADAS_FuncLevel_RCW_Logic_23_04_2024 "ADAS/FuncLevel/RCW/Logic
23_04_2024"
 /begin SUB_GROUP ADAS_FuncLevel_RCW_Logic_23_04_2024_Compare_To_Constant1 ADAS_FuncLevel_RCW_Logic_23_04_2024_Compare_To_Constant4 ADAS_FuncLevel_RCW_Logic_23_04_2024_Compare_To_Constant5 ADAS_FuncLevel_RCW_Logic_23_04_2024_Compare_To_Constant6 ADAS_FuncLevel_RCW_Logic_23_04_2024_Compare_To_Constant7 ADAS_FuncLevel_RCW_Logic_23_04_2024_Obj12 ADAS_FuncLevel_RCW_Logic_23_04_2024_Obj13 ADAS_FuncLevel_RCW_Logic_23_04_2024_Obj14 ADAS_FuncLevel_RCW_Logic_23_04_2024_Obj17 ADAS_FuncLevel_RCW_Logic_23_04_2024_Obj18 /end SUB_GROUP
 /begin REF_MEASUREMENT rtDW_ADAS.GTis_active_c641_ADAS rtDW_ADAS.GTis_c641_ADAS rtDW_ADAS.GTsts_k rtDW_ADAS.GTtemporalCounter_i1_m /end REF_MEASUREMENT
/end GROUP
/begin GROUP ADAS_FuncLevel_RCW_Logic_23_04_2024_Obj12 "ADAS/FuncLevel/RCW/Logic
23_04_2024/Obj12"
 /begin SUB_GROUP ADAS_FuncLevel_RCW_Logic_23_04_2024_Obj12_CalcDst1 ADAS_FuncLevel_RCW_Logic_23_04_2024_Obj12_trajectory1 /end SUB_GROUP
 /begin REF_MEASUREMENT rtConstB_ADAS.GTEgoWh_Gap_i rtDW_ADAS.GTAdd_c rtDW_ADAS.GTCastToBoolean2_gd rtDW_ADAS.GTRelationalOperator1_n /end REF_MEASUREMENT
/end GROUP
/begin GROUP ADAS_FuncLevel_RCW_Logic_23_04_2024_Obj12_CalcDst1 "ADAS/FuncLevel/RCW/Logic
23_04_2024/Obj12/CalcDst1"
 /begin SUB_GROUP ADAS_FuncLevel_RCW_Logic_23_04_2024_Obj12_CalcDst1_Saturation_Dynamic ADAS_FuncLevel_RCW_Logic_23_04_2024_Obj12_CalcDst1_TargetTrajectoryPredict /end SUB_GROUP
 /begin REF_MEASUREMENT rtConstB_ADAS.GTESC_AX_p rtConstB_ADAS.GTESC_AY_m rtConstB_ADAS.GTEgoWh_Gap_i rtConstB_ADAS.GTGain2_e rtConstB_ADAS.GTGain_m rtDW_ADAS.GTAdd5_j rtDW_ADAS.GTMemory_PreviousInput_al rtDW_ADAS.GTSwitch_l /end REF_MEASUREMENT
/end GROUP
/begin GROUP ADAS_FuncLevel_RCW_Logic_23_04_2024_Obj12_CalcDst1_Saturation_Dynamic "ADAS/FuncLevel/RCW/Logic
23_04_2024/Obj12/CalcDst1/Saturation
Dynamic" /begin REF_MEASUREMENT rtConstB_ADAS.GTGain_m /end REF_MEASUREMENT /end GROUP
/begin GROUP ADAS_FuncLevel_RCW_Logic_23_04_2024_Obj12_CalcDst1_TargetTrajectoryPredict "ADAS/FuncLevel/RCW/Logic
23_04_2024/Obj12/CalcDst1/TargetTrajectoryPredict"
 /begin REF_MEASUREMENT rtConstB_ADAS.GTESC_AX_p rtDW_ADAS.GTMemory_PreviousInput_a /end REF_MEASUREMENT
/end GROUP
/begin GROUP ADAS_FuncLevel_RCW_Logic_23_04_2024_Obj12_trajectory1 "ADAS/FuncLevel/RCW/Logic
23_04_2024/Obj12/trajectory1"
 /begin SUB_GROUP ADAS_FuncLevel_RCW_Logic_23_04_2024_Obj12_trajectory1_Compare_To_Constant ADAS_FuncLevel_RCW_Logic_23_04_2024_Obj12_trajectory1_Compare_To_Constant1 ADAS_FuncLevel_RCW_Logic_23_04_2024_Obj12_trajectory1_TargetTrajectoryPredict1 /end SUB_GROUP
 /begin REF_MEASUREMENT rtConstB_ADAS.GTGain4_j rtDW_ADAS.GTPrevY_n /end REF_MEASUREMENT
/end GROUP
/begin GROUP ADAS_FuncLevel_RCW_Logic_23_04_2024_Obj12_trajectory1_TargetTrajectoryPredict1 "ADAS/FuncLevel/RCW/Logic
23_04_2024/Obj12/trajectory1/TargetTrajectoryPredict1" /begin REF_MEASUREMENT rtDW_ADAS.GTMemory1_PreviousInput_a rtDW_ADAS.GTSwitch_l /end REF_MEASUREMENT /end GROUP
/begin GROUP ADAS_FuncLevel_RCW_Logic_23_04_2024_Obj13 "ADAS/FuncLevel/RCW/Logic
23_04_2024/Obj13"
 /begin SUB_GROUP ADAS_FuncLevel_RCW_Logic_23_04_2024_Obj13_CalcDst ADAS_FuncLevel_RCW_Logic_23_04_2024_Obj13_trajectory /end SUB_GROUP
 /begin REF_MEASUREMENT rtDW_ADAS.GTPrevY_g rtDW_ADAS.GTPrevY_id rtDW_ADAS.GTRelay_Mode rtDW_ADAS.GTprevSmoothedVy rtDW_ADAS.GTprevSmoothedVy_not_empty /end REF_MEASUREMENT
/end GROUP
/begin GROUP ADAS_FuncLevel_RCW_Logic_23_04_2024_Obj13_CalcDst "ADAS/FuncLevel/RCW/Logic
23_04_2024/Obj13/CalcDst"
 /begin SUB_GROUP ADAS_FuncLevel_RCW_Logic_23_04_2024_Obj13_CalcDst_Saturation_Dynamic ADAS_FuncLevel_RCW_Logic_23_04_2024_Obj13_CalcDst_TargetTrajectoryPredict /end SUB_GROUP
 /begin REF_MEASUREMENT rtDW_ADAS.GTMemory_PreviousInput_f /end REF_MEASUREMENT
/end GROUP
/begin GROUP ADAS_FuncLevel_RCW_Logic_23_04_2024_Obj13_CalcDst_TargetTrajectoryPredict "ADAS/FuncLevel/RCW/Logic
23_04_2024/Obj13/CalcDst/TargetTrajectoryPredict"
 /begin REF_MEASUREMENT rtDW_ADAS.GTMemory2_PreviousInput_l rtDW_ADAS.GTMemory_PreviousInput rtDW_ADAS.GTPrevY_c /end REF_MEASUREMENT
/end GROUP
/begin GROUP ADAS_FuncLevel_RCW_Logic_23_04_2024_Obj13_trajectory "ADAS/FuncLevel/RCW/Logic
23_04_2024/Obj13/trajectory" /begin REF_MEASUREMENT rtConstB_ADAS.GTGain4 rtDW_ADAS.GTPrevY /end REF_MEASUREMENT /end GROUP
/begin GROUP ADAS_FuncLevel_RCW_Logic_23_04_2024_Obj14 "ADAS/FuncLevel/RCW/Logic
23_04_2024/Obj14"
 /begin SUB_GROUP ADAS_FuncLevel_RCW_Logic_23_04_2024_Obj14_CalcDst1 ADAS_FuncLevel_RCW_Logic_23_04_2024_Obj14_trajectory1 /end SUB_GROUP
 /begin REF_MEASUREMENT rtConstB_ADAS.GTEgoWh_Gap rtDW_ADAS.GTAdd_py rtDW_ADAS.GTCastToBoolean2_g rtDW_ADAS.GTRelationalOperator1 /end REF_MEASUREMENT
/end GROUP
/begin GROUP ADAS_FuncLevel_RCW_Logic_23_04_2024_Obj14_CalcDst1 "ADAS/FuncLevel/RCW/Logic
23_04_2024/Obj14/CalcDst1"
 /begin SUB_GROUP ADAS_FuncLevel_RCW_Logic_23_04_2024_Obj14_CalcDst1_Saturation_Dynamic ADAS_FuncLevel_RCW_Logic_23_04_2024_Obj14_CalcDst1_TargetTrajectoryPredict /end SUB_GROUP
 /begin REF_MEASUREMENT rtConstB_ADAS.GTESC_AX rtConstB_ADAS.GTESC_AY rtConstB_ADAS.GTEgoWh_Gap rtConstB_ADAS.GTGain2_c rtConstB_ADAS.GTGain_n rtDW_ADAS.GTAdd5_e rtDW_ADAS.GTMemory_PreviousInput_hw rtDW_ADAS.GTSwitch_o /end REF_MEASUREMENT
/end GROUP
/begin GROUP ADAS_FuncLevel_RCW_Logic_23_04_2024_Obj14_CalcDst1_Saturation_Dynamic "ADAS/FuncLevel/RCW/Logic
23_04_2024/Obj14/CalcDst1/Saturation
Dynamic" /begin REF_MEASUREMENT rtConstB_ADAS.GTGain_n /end REF_MEASUREMENT /end GROUP
/begin GROUP ADAS_FuncLevel_RCW_Logic_23_04_2024_Obj14_CalcDst1_TargetTrajectoryPredict "ADAS/FuncLevel/RCW/Logic
23_04_2024/Obj14/CalcDst1/TargetTrajectoryPredict" /begin REF_MEASUREMENT rtConstB_ADAS.GTESC_AX rtDW_ADAS.GTMemory_PreviousInput_h /end REF_MEASUREMENT /end GROUP
/begin GROUP ADAS_FuncLevel_RCW_Logic_23_04_2024_Obj14_trajectory1 "ADAS/FuncLevel/RCW/Logic
23_04_2024/Obj14/trajectory1"
 /begin SUB_GROUP ADAS_FuncLevel_RCW_Logic_23_04_2024_Obj14_trajectory1_Compare_To_Constant ADAS_FuncLevel_RCW_Logic_23_04_2024_Obj14_trajectory1_Compare_To_Constant1 ADAS_FuncLevel_RCW_Logic_23_04_2024_Obj14_trajectory1_TargetTrajectoryPredict1 /end SUB_GROUP
 /begin REF_MEASUREMENT rtConstB_ADAS.GTGain4_p rtDW_ADAS.GTPrevY_p /end REF_MEASUREMENT
/end GROUP
/begin GROUP ADAS_FuncLevel_RCW_Logic_23_04_2024_Obj14_trajectory1_TargetTrajectoryPredict1 "ADAS/FuncLevel/RCW/Logic
23_04_2024/Obj14/trajectory1/TargetTrajectoryPredict1" /begin REF_MEASUREMENT rtDW_ADAS.GTMemory1_PreviousInput_c rtDW_ADAS.GTSwitch_o /end REF_MEASUREMENT /end GROUP
/begin GROUP ADAS_FuncLevel_RCW_Logic_23_04_2024_Obj17 "ADAS/FuncLevel/RCW/Logic
23_04_2024/Obj17" /begin SUB_GROUP ADAS_FuncLevel_RCW_Logic_23_04_2024_Obj17_CalcDst /end SUB_GROUP /begin REF_MEASUREMENT rtDW_ADAS.GTCastToBoolean2_m /end REF_MEASUREMENT /end GROUP
/begin GROUP ADAS_FuncLevel_RCW_Logic_23_04_2024_Obj17_CalcDst "ADAS/FuncLevel/RCW/Logic
23_04_2024/Obj17/CalcDst" /begin REF_MEASUREMENT rtDW_ADAS.GTAbs1_g rtDW_ADAS.GTAdd5_o rtDW_ADAS.GTAdd_k /end REF_MEASUREMENT /end GROUP
/begin GROUP ADAS_FuncLevel_RCW_Logic_23_04_2024_Obj18 "ADAS/FuncLevel/RCW/Logic
23_04_2024/Obj18" /begin SUB_GROUP ADAS_FuncLevel_RCW_Logic_23_04_2024_Obj18_CalcDst /end SUB_GROUP /begin REF_MEASUREMENT rtDW_ADAS.GTCastToBoolean2 /end REF_MEASUREMENT /end GROUP
/begin GROUP ADAS_FuncLevel_RCW_Logic_23_04_2024_Obj18_CalcDst "ADAS/FuncLevel/RCW/Logic
23_04_2024/Obj18/CalcDst" /begin REF_MEASUREMENT rtDW_ADAS.GTAbs1 rtDW_ADAS.GTAdd5_m rtDW_ADAS.GTAdd_d /end REF_MEASUREMENT /end GROUP
/begin GROUP ADAS_FuncLevel_RCW_MRRX_RCW_Prototype "ADAS/FuncLevel/RCW/MRRX_RCW_Prototype"
 /begin REF_MEASUREMENT rtDW_ADAS.GTis_active_c642_ADAS rtDW_ADAS.GTis_c642_ADAS rtDW_ADAS.GTtemporalCounter_i1_b /end REF_MEASUREMENT
/end GROUP
/begin GROUP ADAS_FuncLevel_RCW_Solver_23_04_2024 "ADAS/FuncLevel/RCW/Solver
23_04_2024"
 /begin REF_MEASUREMENT rtDW_ADAS.GTAbs1 rtDW_ADAS.GTAbs1_g rtDW_ADAS.GTAdd1 rtDW_ADAS.GTAdd2 rtDW_ADAS.GTAdd5_e rtDW_ADAS.GTAdd5_j rtDW_ADAS.GTAdd5_m rtDW_ADAS.GTAdd5_o rtDW_ADAS.GTAdd_c rtDW_ADAS.GTAdd_d rtDW_ADAS.GTAdd_k rtDW_ADAS.GTAdd_p rtDW_ADAS.GTAdd_py rtDW_ADAS.GTCastToBoolean2 rtDW_ADAS.GTCastToBoolean2_g rtDW_ADAS.GTCastToBoolean2_gd rtDW_ADAS.GTCastToBoolean2_m rtDW_ADAS.GTDstRealRear18X_m rtDW_ADAS.GTObjBack rtDW_ADAS.GTObjBack12 rtDW_ADAS.GTObjBack14 rtDW_ADAS.GTObjBack17 rtDW_ADAS.GTObjBack18 rtDW_ADAS.GTRelationalOperator1 rtDW_ADAS.GTRelationalOperator1_n rtDW_ADAS.GTSwitch_l rtDW_ADAS.GTSwitch_o rtDW_ADAS.GTTarHonk12 rtDW_ADAS.GTTarHonk13 rtDW_ADAS.GTTarHonk14 rtDW_ADAS.GTTarHonk17 rtDW_ADAS.GTTarHonk18 rtDW_ADAS.GTTestDataWarnTar_g rtDW_ADAS.GTTimeOver12 rtDW_ADAS.GTTimeOver14 rtDW_ADAS.GTTimeOver17 rtDW_ADAS.GTTimeOver18 rtDW_ADAS.GTis_Rcw12 rtDW_ADAS.GTis_Rcw13 rtDW_ADAS.GTis_Rcw14 rtDW_ADAS.GTis_Rcw17 rtDW_ADAS.GTis_Rcw18 rtDW_ADAS.GTis_TargetDone rtDW_ADAS.GTis_TargetDone_i rtDW_ADAS.GTis_TargetDone_j rtDW_ADAS.GTis_TargetDone_l rtDW_ADAS.GTis_TargetDone_o rtDW_ADAS.GTis_active_c643_ADAS rtDW_ADAS.GTis_active_c646_ADAS rtDW_ADAS.GTis_active_c647_ADAS rtDW_ADAS.GTis_c646_ADAS rtDW_ADAS.GTis_c647_ADAS rtDW_ADAS.GTsts rtDW_ADAS.GTsts_m rtDW_ADAS.GTtemporalCounter_i1_gn rtDW_ADAS.GTtemporalCounter_i1_h5 /end REF_MEASUREMENT
/end GROUP
/begin GROUP ADAS_FuncLevel_RDA_RCTC "ADAS/FuncLevel/RDA_RCTC"
 /begin SUB_GROUP ADAS_FuncLevel_RDA_RCTC_Compare_To_Constant ADAS_FuncLevel_RDA_RCTC_Compare_To_Constant1 ADAS_FuncLevel_RDA_RCTC_Logic_RCTC ADAS_FuncLevel_RDA_RCTC_Logic_RDA ADAS_FuncLevel_RDA_RCTC_MRRX_RCTC_Prototype ADAS_FuncLevel_RDA_RCTC_Solver_RCTC ADAS_FuncLevel_RDA_RCTC_Solver_RDA /end SUB_GROUP
/end GROUP
/begin GROUP ADAS_FuncLevel_RDA_RCTC_Logic_RCTC "ADAS/FuncLevel/RDA_RCTC/Logic
RCTC"
 /begin SUB_GROUP ADAS_FuncLevel_RDA_RCTC_Logic_RCTC_Compare_To_Constant ADAS_FuncLevel_RDA_RCTC_Logic_RCTC_Compare_To_Constant1 ADAS_FuncLevel_RDA_RCTC_Logic_RCTC_Compare_To_Constant2 ADAS_FuncLevel_RDA_RCTC_Logic_RCTC_Compare_To_Constant3 ADAS_FuncLevel_RDA_RCTC_Logic_RCTC_Compare_To_Constant6 ADAS_FuncLevel_RDA_RCTC_Logic_RCTC_EgoTrajectoryPredict ADAS_FuncLevel_RDA_RCTC_Logic_RCTC_EgoTrajectoryPredictHalfTime ADAS_FuncLevel_RDA_RCTC_Logic_RCTC_Subsystem ADAS_FuncLevel_RDA_RCTC_Logic_RCTC_TargetTrajectoryPredict ADAS_FuncLevel_RDA_RCTC_Logic_RCTC_TargetTrajectoryPredictRear /end SUB_GROUP
 /begin REF_MEASUREMENT rtDW_ADAS.GTAdd1_e rtDW_ADAS.GTAdd1_l rtDW_ADAS.GTAdd4 rtDW_ADAS.GTAdd4_c rtDW_ADAS.GTAdd5_k rtDW_ADAS.GTAdd5_mf rtDW_ADAS.GTAdd_cp rtDW_ADAS.GTAdd_cv rtDW_ADAS.GTis_active_c231_ADAS rtDW_ADAS.GTis_c231_ADAS rtDW_ADAS.GTtemporalCounter_i1_ch /end REF_MEASUREMENT
/end GROUP
/begin GROUP ADAS_FuncLevel_RDA_RCTC_Logic_RCTC_EgoTrajectoryPredict "ADAS/FuncLevel/RDA_RCTC/Logic
RCTC/EgoTrajectoryPredict" /begin REF_MEASUREMENT rtConstB_ADAS.GTFront_L rtConstB_ADAS.GTGain /end REF_MEASUREMENT /end GROUP
/begin GROUP ADAS_FuncLevel_RDA_RCTC_Logic_RCTC_TargetTrajectoryPredict "ADAS/FuncLevel/RDA_RCTC/Logic
RCTC/TargetTrajectoryPredict"
 /begin REF_MEASUREMENT rtDW_ADAS.GTAdd1_l rtDW_ADAS.GTAdd4_c rtDW_ADAS.GTAdd5_k rtDW_ADAS.GTAdd_cp rtDW_ADAS.GTMemory1_PreviousInput_n rtDW_ADAS.GTMemory_PreviousInput_c /end REF_MEASUREMENT
/end GROUP
/begin GROUP ADAS_FuncLevel_RDA_RCTC_Logic_RCTC_TargetTrajectoryPredictRear "ADAS/FuncLevel/RDA_RCTC/Logic
RCTC/TargetTrajectoryPredictRear"
 /begin REF_MEASUREMENT rtDW_ADAS.GTAdd1_e rtDW_ADAS.GTAdd4 rtDW_ADAS.GTAdd5_mf rtDW_ADAS.GTAdd_cv rtDW_ADAS.GTMemory1_PreviousInput rtDW_ADAS.GTMemory_PreviousInput_n /end REF_MEASUREMENT
/end GROUP
/begin GROUP ADAS_FuncLevel_RDA_RCTC_Logic_RDA "ADAS/FuncLevel/RDA_RCTC/Logic
RDA"
 /begin SUB_GROUP ADAS_FuncLevel_RDA_RCTC_Logic_RDA_Compare_To_Constant ADAS_FuncLevel_RDA_RCTC_Logic_RDA_Compare_To_Constant1 ADAS_FuncLevel_RDA_RCTC_Logic_RDA_Compare_To_Constant2 ADAS_FuncLevel_RDA_RCTC_Logic_RDA_Compare_To_Constant3 ADAS_FuncLevel_RDA_RCTC_Logic_RDA_Compare_To_Constant4 ADAS_FuncLevel_RDA_RCTC_Logic_RDA_Enabled_Subsystem ADAS_FuncLevel_RDA_RCTC_Logic_RDA_Enabled_Subsystem1 /end SUB_GROUP
/end GROUP
/begin GROUP ADAS_FuncLevel_RDA_RCTC_Logic_RDA_Enabled_Subsystem "ADAS/FuncLevel/RDA_RCTC/Logic
RDA/Enabled
Subsystem"
 /begin SUB_GROUP ADAS_FuncLevel_RDA_RCTC_Logic_RDA_Enabled_Subsystem_CalcDst ADAS_FuncLevel_RDA_RCTC_Logic_RDA_Enabled_Subsystem_CalcDst1 /end SUB_GROUP
 /begin REF_MEASUREMENT rtConstB_ADAS.GTGain2_j /end REF_MEASUREMENT
/end GROUP
/begin GROUP ADAS_FuncLevel_RDA_RCTC_Logic_RDA_Enabled_Subsystem1 "ADAS/FuncLevel/RDA_RCTC/Logic
RDA/Enabled
Subsystem1"
 /begin SUB_GROUP ADAS_FuncLevel_RDA_RCTC_Logic_RDA_Enabled_Subsystem1_CalcDst ADAS_FuncLevel_RDA_RCTC_Logic_RDA_Enabled_Subsystem1_CalcDst1 /end SUB_GROUP
 /begin REF_MEASUREMENT rtConstB_ADAS.GTGain2 /end REF_MEASUREMENT
/end GROUP
/begin GROUP ADAS_FuncLevel_RDA_RCTC_Logic_RDA_Enabled_Subsystem1_CalcDst "ADAS/FuncLevel/RDA_RCTC/Logic
RDA/Enabled
Subsystem1/CalcDst"
 /begin REF_MEASUREMENT rtConstB_ADAS.GTAdd2 rtConstB_ADAS.GTAdd4 rtConstB_ADAS.GTProduct4 /end REF_MEASUREMENT
/end GROUP
/begin GROUP ADAS_FuncLevel_RDA_RCTC_Logic_RDA_Enabled_Subsystem1_CalcDst1 "ADAS/FuncLevel/RDA_RCTC/Logic
RDA/Enabled
Subsystem1/CalcDst1" /begin REF_MEASUREMENT rtConstB_ADAS.GTAdd4_g rtConstB_ADAS.GTProduct4_b /end REF_MEASUREMENT /end GROUP
/begin GROUP ADAS_FuncLevel_RDA_RCTC_Logic_RDA_Enabled_Subsystem_CalcDst "ADAS/FuncLevel/RDA_RCTC/Logic
RDA/Enabled
Subsystem/CalcDst"
 /begin REF_MEASUREMENT rtConstB_ADAS.GTAdd4_b rtConstB_ADAS.GTProduct4_h rtDW_ADAS.GTProduct1 /end REF_MEASUREMENT
/end GROUP
/begin GROUP ADAS_FuncLevel_RDA_RCTC_Logic_RDA_Enabled_Subsystem_CalcDst1 "ADAS/FuncLevel/RDA_RCTC/Logic
RDA/Enabled
Subsystem/CalcDst1"
 /begin REF_MEASUREMENT rtConstB_ADAS.GTAdd4_j rtConstB_ADAS.GTProduct4_k rtDW_ADAS.GTProduct1_b /end REF_MEASUREMENT
/end GROUP
/begin GROUP ADAS_FuncLevel_RDA_RCTC_MRRX_RCTC_Prototype "ADAS/FuncLevel/RDA_RCTC/MRRX_RCTC_Prototype"
 /begin SUB_GROUP ADAS_FuncLevel_RDA_RCTC_MRRX_RCTC_Prototype_Compare_To_Constant1 ADAS_FuncLevel_RDA_RCTC_MRRX_RCTC_Prototype_Compare_To_Constant3 /end SUB_GROUP
 /begin REF_MEASUREMENT rtDW_ADAS.GTis_active_c247_ADAS rtDW_ADAS.GTis_c247_ADAS rtDW_ADAS.GTtemporalCounter_i1_d /end REF_MEASUREMENT
/end GROUP
/begin GROUP ADAS_FuncLevel_RDA_RCTC_Solver_RCTC "ADAS/FuncLevel/RDA_RCTC/Solver
RCTC"
 /begin REF_MEASUREMENT rtDW_ADAS.GTRctcLogicTrans_l rtDW_ADAS.GTis_RctcOn rtDW_ADAS.GTis_TargetOn rtDW_ADAS.GTis_active_c233_ADAS rtDW_ADAS.GTis_active_c234_ADAS rtDW_ADAS.GTis_c233_ADAS rtDW_ADAS.GTis_c234_ADAS rtDW_ADAS.GTtemporalCounter_i1_h /end REF_MEASUREMENT
/end GROUP
/begin GROUP ADAS_FuncLevel_RDA_RCTC_Solver_RDA "ADAS/FuncLevel/RDA_RCTC/Solver
RDA"
 /begin REF_MEASUREMENT rtConstB_ADAS.GTAdd2 rtDW_ADAS.GTProduct1 rtDW_ADAS.GTProduct1_b rtDW_ADAS.GTis_RdaMain rtDW_ADAS.GTis_active_c236_ADAS rtDW_ADAS.GTis_c236_ADAS /end REF_MEASUREMENT
/end GROUP
/begin GROUP ADAS_FuncLevel_REC "ADAS/FuncLevel/REC"
 /begin REF_MEASUREMENT rtDW_ADAS.GTOut_c rtDW_ADAS.GTRecMode rtDW_ADAS.GTRecToInc rtDW_ADAS.GTStartRec rtDW_ADAS.GTis_Request_to_save_in_inceden rtDW_ADAS.GTis_Request_to_start_recording rtDW_ADAS.GTis_active_c648_ADAS rtDW_ADAS.GTis_active_c649_ADAS rtDW_ADAS.GTis_c648_ADAS rtDW_ADAS.GTis_c649_ADAS rtDW_ADAS.GTtemporalCounter_i1_av rtDW_ADAS.GTtemporalCounter_i1_j rtDW_ADAS.GTtemporalCounter_i2_f /end REF_MEASUREMENT
/end GROUP
/begin GROUP ADAS_FuncLevel_TSR "ADAS/FuncLevel/TSR" /begin SUB_GROUP ADAS_FuncLevel_TSR_Logic /end SUB_GROUP /end GROUP
/begin GROUP ADAS_FuncLevel_TSR_Logic "ADAS/FuncLevel/TSR/Logic"
 /begin SUB_GROUP ADAS_FuncLevel_TSR_Logic_Compare_To_Constant ADAS_FuncLevel_TSR_Logic_Compare_To_Constant1 ADAS_FuncLevel_TSR_Logic_Signs_choice /end SUB_GROUP
 /begin REF_MEASUREMENT rtDW_ADAS.GTCancelAllFlag rtDW_ADAS.GTCnt rtDW_ADAS.GTCrsWlk rtDW_ADAS.GTLastRightPot rtDW_ADAS.GTLastSign rtDW_ADAS.GTMemory_PreviousInput_g rtDW_ADAS.GTOtherSigns rtDW_ADAS.GTSpdSign1 rtDW_ADAS.GTTsrMode rtDW_ADAS.GTTsrSignOverTaking rtDW_ADAS.GTTsrSignSpeed rtDW_ADAS.GTisStable rtDW_ADAS.GTis_Active_j rtDW_ADAS.GTis_LeftPot rtDW_ADAS.GTis_OtherSigns rtDW_ADAS.GTis_OverTakeTaboo rtDW_ADAS.GTis_RightPot rtDW_ADAS.GTis_SpdSignEna rtDW_ADAS.GTis_active_c650_ADAS rtDW_ADAS.GTis_c650_ADAS rtDW_ADAS.GTtemporalCounter_i1_p rtDW_ADAS.GTtemporalCounter_i2 /end REF_MEASUREMENT
/end GROUP
/begin GROUP ADAS_FuncLevel_TSR_Logic_Signs_choice "ADAS/FuncLevel/TSR/Logic/Signs choice"
 /begin REF_MEASUREMENT rtDW_ADAS.GTCancelAllFlag rtDW_ADAS.GTCrsWlk rtDW_ADAS.GTCrsWlkMem rtDW_ADAS.GTNoEntryMem rtDW_ADAS.GTOtherSigns rtDW_ADAS.GTSpdBmpMem rtDW_ADAS.GTStopMem rtDW_ADAS.GTWaitFlagCrsWlk rtDW_ADAS.GTWaitFlagNoEntry rtDW_ADAS.GTWaitFlagSpdBmp rtDW_ADAS.GTWaitFlagStop rtDW_ADAS.GTis_CrossWalk rtDW_ADAS.GTis_CrossWalk_o rtDW_ADAS.GTis_NoEntry rtDW_ADAS.GTis_NoEntry_o rtDW_ADAS.GTis_SpeedBump rtDW_ADAS.GTis_SpeedBump_e rtDW_ADAS.GTis_Stop rtDW_ADAS.GTis_Stop_h rtDW_ADAS.GTis_Working rtDW_ADAS.GTis_active_c652_ADAS rtDW_ADAS.GTis_c652_ADAS rtDW_ADAS.GTtemporalCounter_i1_du rtDW_ADAS.GTtemporalCounter_i2_j rtDW_ADAS.GTtemporalCounter_i3_f rtDW_ADAS.GTtemporalCounter_i4 rtDW_ADAS.GTtemporalCounter_i5 rtDW_ADAS.GTtemporalCounter_i6 rtDW_ADAS.GTtemporalCounter_i7 rtDW_ADAS.GTtemporalCounter_i8 /end REF_MEASUREMENT
/end GROUP
/begin GROUP ADAS_FuncLevel_VIS "ADAS/FuncLevel/VIS" /begin SUB_GROUP ADAS_FuncLevel_VIS_Solver_10_10_24 /end SUB_GROUP /end GROUP
/begin GROUP ADAS_FuncLevel_VIS_Solver_10_10_24 "ADAS/FuncLevel/VIS/Solver_10.10.24"
 /begin SUB_GROUP ADAS_FuncLevel_VIS_Solver_10_10_24_LanesCoord_07_12_23 ADAS_FuncLevel_VIS_Solver_10_10_24_ObjCoordRecalc_19_05_25 /end SUB_GROUP
/end GROUP
/begin GROUP ADAS_FuncLevel_VIS_Solver_10_10_24_LanesCoord_07_12_23 "ADAS/FuncLevel/VIS/Solver_10.10.24/LanesCoord_07.12.23"
 /begin SUB_GROUP ADAS_FuncLevel_VIS_Solver_10_10_24_LanesCoord_07_12_23_FIR_Filter /end SUB_GROUP
/end GROUP
/begin GROUP ADAS_FuncLevel_VIS_Solver_10_10_24_LanesCoord_07_12_23_FIR_Filter "ADAS/FuncLevel/VIS/Solver_10.10.24/LanesCoord_07.12.23/FIR Filter" /begin REF_MEASUREMENT rtDW_ADAS.GTDelay1_DSTATE_n rtDW_ADAS.GTDelay5_DSTATE /end REF_MEASUREMENT /end GROUP
/begin GROUP ADAS_FuncLevel_VIS_Solver_10_10_24_ObjCoordRecalc_19_05_25 "ADAS/FuncLevel/VIS/Solver_10.10.24/ObjCoordRecalc_19.05.25"
 /begin SUB_GROUP ADAS_FuncLevel_VIS_Solver_10_10_24_ObjCoordRecalc_19_05_25_FIR_Filter ADAS_FuncLevel_VIS_Solver_10_10_24_ObjCoordRecalc_19_05_25_Main_calculation /end SUB_GROUP
/end GROUP
/begin GROUP ADAS_FuncLevel_VIS_Solver_10_10_24_ObjCoordRecalc_19_05_25_FIR_Filter "ADAS/FuncLevel/VIS/Solver_10.10.24/ObjCoordRecalc_19.05.25/FIR Filter"
 /begin REF_MEASUREMENT rtDW_ADAS.GTDelay2_DSTATE_d rtDW_ADAS.GTDelay3_DSTATE_p rtDW_ADAS.GTDelay_DSTATE_p /end REF_MEASUREMENT
/end GROUP
/begin GROUP ADAS_FuncLevel_VIS_Solver_10_10_24_ObjCoordRecalc_19_05_25_Main_calculation "ADAS/FuncLevel/VIS/Solver_10.10.24/ObjCoordRecalc_19.05.25/Main calculation"
 /begin REF_MEASUREMENT rtDW_ADAS.GTAngLvl rtDW_ADAS.GTis_active_c660_ADAS rtDW_ADAS.GTis_c660_ADAS rtDW_ADAS.GTtemporalCounter_i1_e /end REF_MEASUREMENT
/end GROUP
/begin GROUP ADAS_Input "ADAS/Input"
 /begin SUB_GROUP ADAS_Input_CarData ADAS_Input_DiagConfData ADAS_Input_DiagErrorData ADAS_Input_DiagMemData ADAS_Input_FrontPercData ADAS_Input_LanePercData ADAS_Input_MLIAPercData ADAS_Input_MainPercData ADAS_Input_MrrxPercData ADAS_Input_RearCrossPercData ADAS_Input_RearPercData ADAS_Input_SignPercData ADAS_Input_VlcData /end SUB_GROUP
/end GROUP
/begin GROUP ADAS_Input_CarData "ADAS/Input/CarData"
 /begin SUB_GROUP ADAS_Input_CarData_Acu ADAS_Input_CarData_Bcm ADAS_Input_CarData_DAS_STATUS ADAS_Input_CarData_DMF ADAS_Input_CarData_Dms ADAS_Input_CarData_ESC ADAS_Input_CarData_Ems ADAS_Input_CarData_Epb ADAS_Input_CarData_Erag ADAS_Input_CarData_Fiu ADAS_Input_CarData_HLL__HLR ADAS_Input_CarData_Ic ADAS_Input_CarData_MAS ADAS_Input_CarData_Pacu ADAS_Input_CarData_SWM ADAS_Input_CarData_Sas ADAS_Input_CarData_Tcu ADAS_Input_CarData_Yrs /end SUB_GROUP
/end GROUP
/begin GROUP ADAS_Input_CarData_Acu "ADAS/Input/CarData/Acu" /begin REF_MEASUREMENT CrashEveDetd SeatBeltStatus /end REF_MEASUREMENT /end GROUP
/begin GROUP ADAS_Input_CarData_Bcm "ADAS/Input/CarData/Bcm"
 /begin REF_MEASUREMENT AdasSensCleanSt AmbTemp FanSpeed HighBeamReq IgnSt LccBt LdwBt LightAmbient_Val LightFront_Val LightSwReason_Val LockSt MliaStartReq ProjAnimationStat RainDens RainDetd SensTermSt SolarSnsrLeVal SolarSnsrRiVal TargetLvlALS TurnLeftSt TurnRightSt VehBody VehicleMode WashFluidLvl WindscreenHeat WindscreenHum WindscreenTemp WiprSt rtDW_ADAS.GTBcmSensCleanSt rtDW_ADAS.GTis_active_c29_ADAS rtDW_ADAS.GTis_c29_ADAS rtDW_ADAS.GTtemporalCounter_i1_hkpb /end REF_MEASUREMENT
/end GROUP
/begin GROUP ADAS_Input_CarData_DAS_STATUS "ADAS/Input/CarData/DAS_STATUS"
 /begin REF_MEASUREMENT AebDecelReqFlag AebPreCrash CcAfsDecelReq CcBrakeReleaseReq CcBrakeStandStReq CcDecelReqFlag CcEmsMotInc CcMode CcSetSpeed CcType FcwActivNotif FcwSoundWarnReq LkaMode TsrSignSpeed /end REF_MEASUREMENT
/end GROUP
/begin GROUP ADAS_Input_CarData_DMF "ADAS/Input/CarData/DMF"
 /begin REF_MEASUREMENT DoorFrontLeftHandleReq DoorFrontLeftSt DoorFrontRightHandleReq DoorFrontRightSt DoorRearLeftHandleReq DoorRearLeftSt DoorRearRightHandleReq DoorRearRightSt rtDW_ADAS.GTis_active_c24_ADAS rtDW_ADAS.GTis_c24_ADAS /end REF_MEASUREMENT
/end GROUP
/begin GROUP ADAS_Input_CarData_Dms "ADAS/Input/CarData/Dms" /begin REF_MEASUREMENT DriveOperMode /end REF_MEASUREMENT /end GROUP
/begin GROUP ADAS_Input_CarData_ESC "ADAS/Input/CarData/ESC"
 /begin REF_MEASUREMENT AbsActive AebAvl BlaActive BlsActive CddActv CddAvl CddSkiddingDetd CddStandstillSt CddTempSwitchOff EbdActive HdcActive McBrakePressure TcsActive VdcActive VehicleSpd WheelBrakePressureFrontLeft WheelBrakePressureFrontRight WheelBrakePressureRearLeft WheelBrakePressureRearRight WheelDirectionFL WheelDirectionFR WheelSpdFrontLeft WheelSpdFrontRight WheelSpdRearLeft WheelSpdRearRight /end REF_MEASUREMENT
/end GROUP
/begin GROUP ADAS_Input_CarData_Ems "ADAS/Input/CarData/Ems"
 /begin REF_MEASUREMENT AccelPedalPos DriverTorqueDmd EngineSpeed KickDownSt TrqClutch /end REF_MEASUREMENT
/end GROUP
/begin GROUP ADAS_Input_CarData_Epb "ADAS/Input/CarData/Epb" /begin REF_MEASUREMENT DynamicEmergActive EpbSt /end REF_MEASUREMENT /end GROUP
/begin GROUP ADAS_Input_CarData_Erag "ADAS/Input/CarData/Erag" /begin REF_MEASUREMENT EragSt /end REF_MEASUREMENT /end GROUP
/begin GROUP ADAS_Input_CarData_Fiu "ADAS/Input/CarData/Fiu"
 /begin REF_MEASUREMENT ISettAaActReq ISettAaModeReq ISettAebActReq ISettAfsActReq ISettAlccActReq ISettAslaActReq ISettAslaDeltaReq ISettCcAutoSpeedReq ISettCcTypeReq ISettCcmodeReq ISettCleanSensorReq ISettDowActReq ISettDowSoundWarnReq ISettFcwActReq ISettFcwModeReq ISettFcwVibrWarnReq ISettLccActReq ISettLccModeReq ISettLccSoundAlertReq ISettLccVibrationWarnReq ISettLdpActReq ISettLdwActReq ISettLdwModeReq ISettLdwSoundReq ISettLdwVibrReq ISettLkaActReq ISettNavigStsReq ISettOtherObjStsReq ISettProjectionOnARoadReq ISettRDAAutoBrake_Req ISettRctcActReq ISettRdaActReq ISettRecActReq ISettRoadSignStsReq ISettStartSettReq ISettTsrActReq /end REF_MEASUREMENT
/end GROUP
/begin GROUP ADAS_Input_CarData_HLL__HLR "ADAS/Input/CarData/HLL, HLR" /begin REF_MEASUREMENT CorrectorActValLeft CorrectorActValRight /end REF_MEASUREMENT /end GROUP
/begin GROUP ADAS_Input_CarData_Ic "ADAS/Input/CarData/Ic"
 /begin REF_MEASUREMENT AbsoluteDateAndTime DmsCentrWindArea DmsCillArea DmsDistractLvl DmsEyeClosed DmsFatiqueLvl DmsLeftWindArea DmsOtherArea DmsRecognition DmsReliability DmsRightWindArea DmsViewRoadSide NvActReq SpdFromIc VisualActReq /end REF_MEASUREMENT
/end GROUP
/begin GROUP ADAS_Input_CarData_MAS "ADAS/Input/CarData/MAS"
 /begin REF_MEASUREMENT MasActivReq MasApaDistReq MasDrivingSt MasErrSt MasGearReq MasNegTrq MasParkSt MasPosTrq /end REF_MEASUREMENT
/end GROUP
/begin GROUP ADAS_Input_CarData_Pacu "ADAS/Input/CarData/Pacu"
 /begin REF_MEASUREMENT DfDiagValidDataMAS_Front DfDiagValidDataMAS_Rear DfDiagValidDataMAS_Side ParkDistFront1 ParkDistFront2 ParkDistFront3 ParkDistFront4 ParkDistFrontLeftSide ParkDistFrontRightSide ParkDistRear1 ParkDistRear2 ParkDistRear3 ParkDistRear4 ParkDistRearLeftSide ParkDistRearRightSide /end REF_MEASUREMENT
/end GROUP
/begin GROUP ADAS_Input_CarData_SWM "ADAS/Input/CarData/SWM"
 /begin REF_MEASUREMENT BtActivMode BtCncl BtDist BtRes BtSet BtSpdDec BtSpdInc BtStar PosHandSt rtDW_ADAS.GTis_active_c25_ADAS rtDW_ADAS.GTis_active_c447_ADAS rtDW_ADAS.GTis_c25_ADAS rtDW_ADAS.GTis_c447_ADAS rtDW_ADAS.GTtemporalCounter_i1_c rtDW_ADAS.GTtemporalCounter_i1_cs /end REF_MEASUREMENT
/end GROUP
/begin GROUP ADAS_Input_CarData_Sas "ADAS/Input/CarData/Sas" /begin REF_MEASUREMENT SasAng SasCalSt SasOKSt SasSpd /end REF_MEASUREMENT /end GROUP
/begin GROUP ADAS_Input_CarData_Tcu "ADAS/Input/CarData/Tcu" /begin REF_MEASUREMENT GearManualModeSt GearSt /end REF_MEASUREMENT /end GROUP
/begin GROUP ADAS_Input_CarData_Yrs "ADAS/Input/CarData/Yrs" /begin REF_MEASUREMENT LateralAccel LongAccel YawRate YawRateValidSts /end REF_MEASUREMENT /end GROUP
/begin GROUP ADAS_Input_DiagConfData "ADAS/Input/DiagConfData"
 /begin REF_MEASUREMENT DfConfAccAutoStandBy DfConfAccColumnMode DfConfAccParadMode DfConfAccReversOrder DfConfAccSeatBeltIgnore DfConfAccStartFromMem DfConfAebActiveEveryIgnition DfConfAebType DfConfAfsSosMode DfConfDasAvail DfConfLimSpeedMemAvail DfDiagAaAvail DfDiagAccAvail DfDiagAebAvail DfDiagAfsAvail DfDiagAlccAvail DfDiagArmorType DfDiagAslaAvail DfDiagBodyType DfDiagBrakeType DfDiagCcAvail DfDiagDowAvail DfDiagFcwAvail DfDiagHeatCamera DfDiagLccAvail DfDiagLdpAvail DfDiagLdwAvail DfDiagLidarWash DfDiagLimAvail DfDiagLkaAutoStart DfDiagLkaAvail DfDiagMliaAvail DfDiagMliaByeType DfDiagMliaHba DfDiagMliaWelcomeType DfDiagNvAvail DfDiagPowerType DfDiagRadarWash DfDiagRctcAvail DfDiagRcwAvail DfDiagRdaAvail DfDiagRearSteeringActuatorAvail DfDiagRecAvail DfDiagSteeringRackType DfDiagSteeringWheelType DfDiagSuspentionType DfDiagThermalCameraWash DfDiagTsrAvail DfDiagVisualAvail rtDW_ADAS.GTLidarWash /end REF_MEASUREMENT
/end GROUP
/begin GROUP ADAS_Input_DiagErrorData "ADAS/Input/DiagErrorData"
 /begin REF_MEASUREMENT DfDiagAAErReq DfDiagAccErReq DfDiagAebErReq DfDiagAfsErReq DfDiagAlccErReq DfDiagAslaErReq DfDiagCCErReq DfDiagDowErReq DfDiagFcwErReq DfDiagLccErReq DfDiagLdpErReq DfDiagLdwErReq DfDiagLimErReq DfDiagLkaErReq DfDiagMliaErReq DfDiagNvErReq DfDiagRctcErReq DfDiagRcwErReq DfDiagRdaErReq DfDiagRecErReq DfDiagTsrErReq DfDiagVisualErReq /end REF_MEASUREMENT
/end GROUP
/begin GROUP ADAS_Input_DiagMemData "ADAS/Input/DiagMemData"
 /begin REF_MEASUREMENT DfEragCourse DfEragDay DfEragHours DfEragLatitude DfEragLongitude DfEragMinutes DfEragMonth DfEragSeconds DfEragSpeed DfEragYear DfMemAaCoeffAtts DfMemAaStTest DfMemAaTimeIgn DfMemAaTimeSave DfMemAccDist DfMemAccSpeedKmh DfMemAnAccTimeCity DfMemAnAccTimeHighWay DfMemAnAccTimeJam DfMemAnAccTimeMedDist DfMemAnAccTimeMedMaxDist DfMemAnAccTimeMinDist DfMemAnAebActvnDst DfMemAnAebAvgDistToTar DfMemAnAebCorrnTiWarn DfMemAnAebNrOfOper DfMemAnAlccActvnDst DfMemAnAlccNrOfOper DfMemAnCcTime DfMemAnDowCorrnTiWarn DfMemAnDowNrOfOper DfMemAnDowTime DfMemAnFcwActvnDst DfMemAnFcwNrOfOper DfMemAnLccActvnDst DfMemAnLccCorrnTiWarn DfMemAnLccNrOfOper DfMemAnLdpNumOfWarn DfMemAnLdpTimeActive DfMemAnLdwNumOfWarn DfMemAnLdwTimeActive DfMemAnLkaTimeActive DfMemAnLkaTimeTotal DfMemAnMliaTimeObj DfMemAnMliaTimeTotal DfMemAnRctcAvgDistToTar DfMemAnRctcNrOfOper DfMemAnRctcaActvnDst DfMemAnRcwAvgDistToTar DfMemAnRcwNrOfOper DfMemAnRdaActvnDst DfMemAnRdaAvgDistToTar DfMemAnRdaCorrnTiWarn DfMemAnRdaNrOfOper DfMemFiuAaMode DfMemFiuAaStat DfMemFiuAebStat DfMemFiuAfsStat DfMemFiuAlccStat DfMemFiuAslaOver DfMemFiuAslaStat DfMemFiuAssistActive1Stat DfMemFiuAssistActive2Stat DfMemFiuAssistActive3Stat DfMemFiuAssistActive4Stat DfMemFiuCcMode DfMemFiuCcSpdCorrect DfMemFiuCcType DfMemFiuDowSound DfMemFiuDowStat DfMemFiuFcwMode DfMemFiuFcwStat DfMemFiuFcwVibration DfMemFiuLccMode DfMemFiuLccSound DfMemFiuLccStat DfMemFiuLccVibration DfMemFiuLdpStat DfMemFiuLdwMode DfMemFiuLdwSound DfMemFiuLdwStat DfMemFiuLdwVibration DfMemFiuLkaStat DfMemFiuNavigStat DfMemFiuOtherObjStat DfMemFiuProjectionOnARoadStat DfMemFiuRctcStat DfMemFiuRcwStat DfMemFiuRdaAutoBrakeStat DfMemFiuRdaStat DfMemFiuRecStat DfMemFiuRoadSignStat DfMemFiuSensCleanStat DfMemFiuTsrStat DfMemTypeCC /end REF_MEASUREMENT
/end GROUP
/begin GROUP ADAS_Output_new_CC__ACC__LIM "ADAS/Output_new/CC//ACC//LIM"
 /begin REF_MEASUREMENT CcAfsDecelReq CcBrakeReleaseReq CcBrakeStandStReq CcDecelReqFlag CcEmsMotInc CcMode CcSetSpeed CcType /end REF_MEASUREMENT
/end GROUP
/begin GROUP ADAS_Output_new_FCW__AEB "ADAS/Output_new/FCW//AEB" /begin REF_MEASUREMENT AebDecelReqFlag AebPreCrash FcwActivNotif FcwSoundWarnReq /end REF_MEASUREMENT /end GROUP
/begin GROUP ADAS_Output_new_LKA "ADAS/Output_new/LKA" /begin REF_MEASUREMENT LkaMode /end REF_MEASUREMENT /end GROUP
/begin GROUP ADAS_Output_new_NV "ADAS/Output_new/NV" /begin REF_MEASUREMENT rtDW_ADAS.GTNvMode /end REF_MEASUREMENT /end GROUP
/begin GROUP ADAS_Output_new_Perception_OUT "ADAS/Output_new/Perception_OUT" /begin REF_MEASUREMENT rtDW_ADAS.GTRecToInc rtDW_ADAS.GTStartRec /end REF_MEASUREMENT /end GROUP
/begin GROUP ADAS_Output_new_Rec "ADAS/Output_new/Rec" /begin REF_MEASUREMENT rtDW_ADAS.GTRecMode /end REF_MEASUREMENT /end GROUP
/begin GROUP ADAS_Output_new_SENSORS "ADAS/Output_new/SENSORS" /begin REF_MEASUREMENT rtDW_ADAS.GTTicuBlk /end REF_MEASUREMENT /end GROUP
/begin GROUP ADAS_Output_new_TSR "ADAS/Output_new/TSR"
 /begin REF_MEASUREMENT TsrSignSpeed rtDW_ADAS.GTTsrMode rtDW_ADAS.GTTsrSignOverTaking rtDW_ADAS.GTTsrSignSpeed /end REF_MEASUREMENT
/end GROUP
/begin GROUP ADAS_ServiceManager_SensManager_Sens_08_05_24_WFS_08_05_24 "ADAS/ServiceManager/SensManager/Sens_08.05.24/WFS_08.05.24"
 /begin REF_MEASUREMENT rtDW_ADAS.GTBcmSensCleanSt rtDW_ADAS.GTLidarWash rtDW_ADAS.GTTicuBlk /end REF_MEASUREMENT
/end GROUP
/begin GROUP ADAS_ServiceManager_SensManager_Sens_08_05_24_WFS_08_05_24_Wash_Degradation_23_10_24 "ADAS/ServiceManager/SensManager/Sens_08.05.24/WFS_08.05.24/Wash Degradation_23.10.24" /begin REF_MEASUREMENT rtDW_ADAS.GTTicuBlk /end REF_MEASUREMENT /end GROUP
/end MODULE
/end PROJECT
