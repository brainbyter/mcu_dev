ASAP2_VERSION 1 71
/begin PROJECT ProjectName "Project Comment Goes Here"
/begin HEADER "Header Comments go here" /end HEADER
/begin MODULE ModuleName "Module Comment Goes Here"
/begin MOD_COMMON "Mod Common Comment Here" BYTE_ORDER MSB_LAST ALIGNMENT_BYTE 1 ALIGNMENT_WORD 2 ALIGNMENT_LONG 4 ALIGNMENT_FLOAT32_IEEE 4 ALIGNMENT_FLOAT64_IEEE 8 ALIGNMENT_INT64 8 /end MOD_COMMON
/begin MEASUREMENT ALccMode "" UBYTE ADAS_CM_uint8 0 0 0.000000 1.000000 ECU_ADDRESS 0x0000 /* @ECU_Address@ALccMode@ */ /end MEASUREMENT
/begin MEASUREMENT ALccNotifError "" UBYTE ADAS_CM_uint8 0 0 0.000000 1.000000 ECU_ADDRESS 0x0000 /* @ECU_Address@ALccNotifError@ */ /end MEASUREMENT
/begin MEASUREMENT AccTrqAvailable "" UBYTE ADAS_CM_uint8 0 0 0.000000 1.000000 ECU_ADDRESS 0x0000 /* @ECU_Address@AccTrqAvailable@ */ /end MEASUREMENT
/begin MEASUREMENT AccTrqReq "" FLOAT32_IEEE ADAS_CM_single 0 0 -30000.000000 30000.000000 ECU_ADDRESS 0x0000 /* @ECU_Address@AccTrqReq@ */ /end MEASUREMENT
/begin MEASUREMENT AebBoostReq "" UBYTE ADAS_CM_uint8 0 0 0.000000 1.000000 ECU_ADDRESS 0x0000 /* @ECU_Address@AebBoostReq@ */ /end MEASUREMENT
/begin MEASUREMENT AebDeactivNotif "" UBYTE ADAS_CM_uint8 0 0 0.000000 1.000000 ECU_ADDRESS 0x0000 /* @ECU_Address@AebDeactivNotif@ */ /end MEASUREMENT
/begin MEASUREMENT AebDecelReq "" FLOAT32_IEEE ADAS_CM_single 0 0 -20.000000 20.000000 ECU_ADDRESS 0x0000 /* @ECU_Address@AebDecelReq@ */ /end MEASUREMENT
/begin MEASUREMENT AebFuncError "" UBYTE ADAS_CM_uint8 0 0 0.000000 1.000000 ECU_ADDRESS 0x0000 /* @ECU_Address@AebFuncError@ */ /end MEASUREMENT
/begin MEASUREMENT AebMode "" UBYTE ADAS_CM_uint8 0 0 0.000000 1.000000 ECU_ADDRESS 0x0000 /* @ECU_Address@AebMode@ */ /end MEASUREMENT
/begin MEASUREMENT AebNotifError "" UBYTE ADAS_CM_uint8 0 0 0.000000 1.000000 ECU_ADDRESS 0x0000 /* @ECU_Address@AebNotifError@ */ /end MEASUREMENT
/begin MEASUREMENT AebPrefillReq "" UBYTE ADAS_CM_uint8 0 0 0.000000 1.000000 ECU_ADDRESS 0x0000 /* @ECU_Address@AebPrefillReq@ */ /end MEASUREMENT
/begin MEASUREMENT AebRdaStandReq "" UBYTE ADAS_CM_uint8 0 0 0.000000 1.000000 ECU_ADDRESS 0x0000 /* @ECU_Address@AebRdaStandReq@ */ /end MEASUREMENT
/begin MEASUREMENT AebUnAvaliable "" UBYTE ADAS_CM_uint8 0 0 0.000000 1.000000 ECU_ADDRESS 0x0000 /* @ECU_Address@AebUnAvaliable@ */ /end MEASUREMENT
/begin MEASUREMENT AfsFuncError "" UBYTE ADAS_CM_uint8 0 0 0.000000 1.000000 ECU_ADDRESS 0x0000 /* @ECU_Address@AfsFuncError@ */ /end MEASUREMENT
/begin MEASUREMENT AlccAngleReqFlag "" UBYTE ADAS_CM_uint8 0 0 0.000000 1.000000 ECU_ADDRESS 0x0000 /* @ECU_Address@AlccAngleReqFlag@ */ /end MEASUREMENT
/begin MEASUREMENT AngEstimate "" FLOAT32_IEEE ADAS_CM_single 0 0 -2.000000 2.000000 ECU_ADDRESS 0x0000 /* @ECU_Address@AngEstimate@ */ /end MEASUREMENT
/begin MEASUREMENT AslaChSpdReq "" UBYTE ADAS_CM_uint8 0 0 0.000000 254.000000 ECU_ADDRESS 0x0000 /* @ECU_Address@AslaChSpdReq@ */ /end MEASUREMENT
/begin MEASUREMENT AslaMode "" UBYTE ADAS_CM_uint8 0 0 0.000000 1.000000 ECU_ADDRESS 0x0000 /* @ECU_Address@AslaMode@ */ /end MEASUREMENT
/begin MEASUREMENT BrakeReleaseReq "" UBYTE ADAS_CM_uint8 0 0 0.000000 1.000000 ECU_ADDRESS 0x0000 /* @ECU_Address@BrakeReleaseReq@ */ /end MEASUREMENT
/begin MEASUREMENT CcBrakeLightReq "" UBYTE ADAS_CM_uint8 0 0 0.000000 1.000000 ECU_ADDRESS 0x0000 /* @ECU_Address@CcBrakeLightReq@ */ /end MEASUREMENT
/begin MEASUREMENT CcEmsEngagement_Stat "" UBYTE ADAS_CM_uint8 0 0 0.000000 3.000000 ECU_ADDRESS 0x0000 /* @ECU_Address@CcEmsEngagement_Stat@ */ /end MEASUREMENT
/begin MEASUREMENT CcEmsMotIncFlag "" UBYTE ADAS_CM_uint8 0 0 0.000000 1.000000 ECU_ADDRESS 0x0000 /* @ECU_Address@CcEmsMotIncFlag@ */ /end MEASUREMENT
/begin MEASUREMENT CcEmsState_Stat "" UBYTE ADAS_CM_uint8 0 0 0.000000 1.000000 ECU_ADDRESS 0x0000 /* @ECU_Address@CcEmsState_Stat@ */ /end MEASUREMENT
/begin MEASUREMENT CcFuncError "" UBYTE ADAS_CM_uint8 0 0 0.000000 1.000000 ECU_ADDRESS 0x0000 /* @ECU_Address@CcFuncError@ */ /end MEASUREMENT
/begin MEASUREMENT CcHudSetDist "" UBYTE ADAS_CM_uint8 0 0 0.000000 7.000000 ECU_ADDRESS 0x0000 /* @ECU_Address@CcHudSetDist@ */ /end MEASUREMENT
/begin MEASUREMENT CcHudSetSpeed "" UBYTE ADAS_CM_uint8 0 0 0.000000 255.000000 ECU_ADDRESS 0x0000 /* @ECU_Address@CcHudSetSpeed@ */ /end MEASUREMENT
/begin MEASUREMENT CcHudTargDetect "" UBYTE ADAS_CM_uint8 0 0 0.000000 1.000000 ECU_ADDRESS 0x0000 /* @ECU_Address@CcHudTargDetect@ */ /end MEASUREMENT
/begin MEASUREMENT CcNotifError "" UBYTE ADAS_CM_uint8 0 0 0.000000 1.000000 ECU_ADDRESS 0x0000 /* @ECU_Address@CcNotifError@ */ /end MEASUREMENT
/begin MEASUREMENT CcReject "" UBYTE ADAS_CM_uint8 0 0 0.000000 6.000000 ECU_ADDRESS 0x0000 /* @ECU_Address@CcReject@ */ /end MEASUREMENT
/begin MEASUREMENT CcSetDist "" UBYTE ADAS_CM_uint8 0 0 0.000000 3.000000 ECU_ADDRESS 0x0000 /* @ECU_Address@CcSetDist@ */ /end MEASUREMENT
/begin MEASUREMENT CcSleepSt "" UBYTE ADAS_CM_uint8 0 0 0.000000 1.000000 ECU_ADDRESS 0x0000 /* @ECU_Address@CcSleepSt@ */ /end MEASUREMENT
/begin MEASUREMENT CcTargetId "" UBYTE ADAS_CM_uint8 0 0 0.000000 1.000000 ECU_ADDRESS 0x0000 /* @ECU_Address@CcTargetId@ */ /end MEASUREMENT
/begin MEASUREMENT CcVcuEngagement_Stat "" UBYTE ADAS_CM_uint8 0 0 0.000000 3.000000 ECU_ADDRESS 0x0000 /* @ECU_Address@CcVcuEngagement_Stat@ */ /end MEASUREMENT
/begin MEASUREMENT CcVcuMotInc "" FLOAT32_IEEE ADAS_CM_single 0 0 0.000000 1000.000000 ECU_ADDRESS 0x0000 /* @ECU_Address@CcVcuMotInc@ */ /end MEASUREMENT
/begin MEASUREMENT CcVcuMotIncFlag "" UBYTE ADAS_CM_uint8 0 0 0.000000 1.000000 ECU_ADDRESS 0x0000 /* @ECU_Address@CcVcuMotIncFlag@ */ /end MEASUREMENT
/begin MEASUREMENT CcVcuState_Stat "" UBYTE ADAS_CM_uint8 0 0 0.000000 3.000000 ECU_ADDRESS 0x0000 /* @ECU_Address@CcVcuState_Stat@ */ /end MEASUREMENT
/begin MEASUREMENT DecelPlausblCount "" UBYTE ADAS_CM_uint8 0 0 0.000000 100.000000 ECU_ADDRESS 0x0000 /* @ECU_Address@DecelPlausblCount@ */ /end MEASUREMENT
/begin MEASUREMENT DfDiagFrontRadarAvail "" UBYTE ADAS_CM_uint8 0 0 0.000000 1.000000 ECU_ADDRESS 0x0000 /* @ECU_Address@DfDiagFrontRadarAvail@ */ /end MEASUREMENT
/begin MEASUREMENT DfDiagLidarAvail "" UBYTE ADAS_CM_uint8 0 0 0.000000 1.000000 ECU_ADDRESS 0x0000 /* @ECU_Address@DfDiagLidarAvail@ */ /end MEASUREMENT
/begin MEASUREMENT DfDiagRearRadarAvail "" UBYTE ADAS_CM_uint8 0 0 0.000000 1.000000 ECU_ADDRESS 0x0000 /* @ECU_Address@DfDiagRearRadarAvail@ */ /end MEASUREMENT
/begin MEASUREMENT DfDiagThermalCameraAvail "" UBYTE ADAS_CM_uint8 0 0 0.000000 1.000000 ECU_ADDRESS 0x0000 /* @ECU_Address@DfDiagThermalCameraAvail@ */ /end MEASUREMENT
/begin MEASUREMENT DfFPObj10DynamID "" UBYTE ADAS_CM_uint8 0 0 0.000000 40.000000 ECU_ADDRESS 0x0000 /* @ECU_Address@DfFPObj10DynamID@ */ /end MEASUREMENT
/begin MEASUREMENT DfFPObj10Orient "" FLOAT32_IEEE ADAS_CM_single 0 0 -180.000000 180.000000 ECU_ADDRESS 0x0000 /* @ECU_Address@DfFPObj10Orient@ */ /end MEASUREMENT
/begin MEASUREMENT DfFPObj10Probabil "" UBYTE ADAS_CM_uint8 0 0 0.000000 100.000000 ECU_ADDRESS 0x0000 /* @ECU_Address@DfFPObj10Probabil@ */ /end MEASUREMENT
/begin MEASUREMENT DfFPObj10Sx1 "" FLOAT32_IEEE ADAS_CM_single 0 0 0.000000 204.000000 ECU_ADDRESS 0x0000 /* @ECU_Address@DfFPObj10Sx1@ */ /end MEASUREMENT
/begin MEASUREMENT DfFPObj10Sx2 "" FLOAT32_IEEE ADAS_CM_single 0 0 0.000000 204.000000 ECU_ADDRESS 0x0000 /* @ECU_Address@DfFPObj10Sx2@ */ /end MEASUREMENT
/begin MEASUREMENT DfFPObj10Sy1 "" FLOAT32_IEEE ADAS_CM_single 0 0 -102.000000 102.000000 ECU_ADDRESS 0x0000 /* @ECU_Address@DfFPObj10Sy1@ */ /end MEASUREMENT
/begin MEASUREMENT DfFPObj10Sy2 "" FLOAT32_IEEE ADAS_CM_single 0 0 -102.000000 102.000000 ECU_ADDRESS 0x0000 /* @ECU_Address@DfFPObj10Sy2@ */ /end MEASUREMENT
/begin MEASUREMENT DfFPObj10Vx "" FLOAT32_IEEE ADAS_CM_single 0 0 -102.000000 102.000000 ECU_ADDRESS 0x0000 /* @ECU_Address@DfFPObj10Vx@ */ /end MEASUREMENT
/begin MEASUREMENT DfFPObj10Vy "" FLOAT32_IEEE ADAS_CM_single 0 0 -20.000000 20.000000 ECU_ADDRESS 0x0000 /* @ECU_Address@DfFPObj10Vy@ */ /end MEASUREMENT
/begin MEASUREMENT DfFPObj10detect "" UBYTE ADAS_CM_uint8 0 0 0.000000 1.000000 ECU_ADDRESS 0x0000 /* @ECU_Address@DfFPObj10detect@ */ /end MEASUREMENT
/begin MEASUREMENT DfFPObj10type "" UBYTE ADAS_CM_uint8 0 0 0.000000 7.000000 ECU_ADDRESS 0x0000 /* @ECU_Address@DfFPObj10type@ */ /end MEASUREMENT
/begin MEASUREMENT DfFPObj11DynamID "" UBYTE ADAS_CM_uint8 0 0 0.000000 40.000000 ECU_ADDRESS 0x0000 /* @ECU_Address@DfFPObj11DynamID@ */ /end MEASUREMENT
/begin MEASUREMENT DfFPObj11Orient "" FLOAT32_IEEE ADAS_CM_single 0 0 -180.000000 180.000000 ECU_ADDRESS 0x0000 /* @ECU_Address@DfFPObj11Orient@ */ /end MEASUREMENT
/begin MEASUREMENT DfFPObj11Probabil "" UBYTE ADAS_CM_uint8 0 0 0.000000 100.000000 ECU_ADDRESS 0x0000 /* @ECU_Address@DfFPObj11Probabil@ */ /end MEASUREMENT
/begin MEASUREMENT DfFPObj11Sx1 "" FLOAT32_IEEE ADAS_CM_single 0 0 0.000000 204.000000 ECU_ADDRESS 0x0000 /* @ECU_Address@DfFPObj11Sx1@ */ /end MEASUREMENT
/begin MEASUREMENT DfFPObj11Sx2 "" FLOAT32_IEEE ADAS_CM_single 0 0 0.000000 204.000000 ECU_ADDRESS 0x0000 /* @ECU_Address@DfFPObj11Sx2@ */ /end MEASUREMENT
/begin MEASUREMENT DfFPObj11Sy1 "" FLOAT32_IEEE ADAS_CM_single 0 0 -102.000000 102.000000 ECU_ADDRESS 0x0000 /* @ECU_Address@DfFPObj11Sy1@ */ /end MEASUREMENT
/begin MEASUREMENT DfFPObj11Sy2 "" FLOAT32_IEEE ADAS_CM_single 0 0 -102.000000 102.000000 ECU_ADDRESS 0x0000 /* @ECU_Address@DfFPObj11Sy2@ */ /end MEASUREMENT
/begin MEASUREMENT DfFPObj11Vx "" FLOAT32_IEEE ADAS_CM_single 0 0 -102.000000 102.000000 ECU_ADDRESS 0x0000 /* @ECU_Address@DfFPObj11Vx@ */ /end MEASUREMENT
/begin MEASUREMENT DfFPObj11Vy "" FLOAT32_IEEE ADAS_CM_single 0 0 -20.000000 20.000000 ECU_ADDRESS 0x0000 /* @ECU_Address@DfFPObj11Vy@ */ /end MEASUREMENT
/begin MEASUREMENT DfFPObj11detect "" UBYTE ADAS_CM_uint8 0 0 0.000000 1.000000 ECU_ADDRESS 0x0000 /* @ECU_Address@DfFPObj11detect@ */ /end MEASUREMENT
/begin MEASUREMENT DfFPObj11type "" UBYTE ADAS_CM_uint8 0 0 0.000000 7.000000 ECU_ADDRESS 0x0000 /* @ECU_Address@DfFPObj11type@ */ /end MEASUREMENT
/begin MEASUREMENT DfFPObj1DynamID "" UBYTE ADAS_CM_uint8 0 0 0.000000 40.000000 ECU_ADDRESS 0x0000 /* @ECU_Address@DfFPObj1DynamID@ */ /end MEASUREMENT
/begin MEASUREMENT DfFPObj1Orient "" FLOAT32_IEEE ADAS_CM_single 0 0 -180.000000 180.000000 ECU_ADDRESS 0x0000 /* @ECU_Address@DfFPObj1Orient@ */ /end MEASUREMENT
/begin MEASUREMENT DfFPObj1Probabil "" UBYTE ADAS_CM_uint8 0 0 0.000000 100.000000 ECU_ADDRESS 0x0000 /* @ECU_Address@DfFPObj1Probabil@ */ /end MEASUREMENT
/begin MEASUREMENT DfFPObj1Sx1 "" FLOAT32_IEEE ADAS_CM_single 0 0 0.000000 204.000000 ECU_ADDRESS 0x0000 /* @ECU_Address@DfFPObj1Sx1@ */ /end MEASUREMENT
/begin MEASUREMENT DfFPObj1Sx2 "" FLOAT32_IEEE ADAS_CM_single 0 0 0.000000 204.000000 ECU_ADDRESS 0x0000 /* @ECU_Address@DfFPObj1Sx2@ */ /end MEASUREMENT
/begin MEASUREMENT DfFPObj1Sy1 "" FLOAT32_IEEE ADAS_CM_single 0 0 -102.000000 102.000000 ECU_ADDRESS 0x0000 /* @ECU_Address@DfFPObj1Sy1@ */ /end MEASUREMENT
/begin MEASUREMENT DfFPObj1Sy2 "" FLOAT32_IEEE ADAS_CM_single 0 0 -102.000000 102.000000 ECU_ADDRESS 0x0000 /* @ECU_Address@DfFPObj1Sy2@ */ /end MEASUREMENT
/begin MEASUREMENT DfFPObj1Vx "" FLOAT32_IEEE ADAS_CM_single 0 0 0.000000 102.000000 ECU_ADDRESS 0x0000 /* @ECU_Address@DfFPObj1Vx@ */ /end MEASUREMENT
/begin MEASUREMENT DfFPObj1Vy "" FLOAT32_IEEE ADAS_CM_single 0 0 -12.000000 12.000000 ECU_ADDRESS 0x0000 /* @ECU_Address@DfFPObj1Vy@ */ /end MEASUREMENT
/begin MEASUREMENT DfFPObj1detect "" UBYTE ADAS_CM_uint8 0 0 0.000000 1.000000 ECU_ADDRESS 0x0000 /* @ECU_Address@DfFPObj1detect@ */ /end MEASUREMENT
/begin MEASUREMENT DfFPObj1type "" UBYTE ADAS_CM_uint8 0 0 0.000000 7.000000 ECU_ADDRESS 0x0000 /* @ECU_Address@DfFPObj1type@ */ /end MEASUREMENT
/begin MEASUREMENT DfFPObj2DynamID "" UBYTE ADAS_CM_uint8 0 0 0.000000 40.000000 ECU_ADDRESS 0x0000 /* @ECU_Address@DfFPObj2DynamID@ */ /end MEASUREMENT
/begin MEASUREMENT DfFPObj2Orient "" FLOAT32_IEEE ADAS_CM_single 0 0 -180.000000 180.000000 ECU_ADDRESS 0x0000 /* @ECU_Address@DfFPObj2Orient@ */ /end MEASUREMENT
/begin MEASUREMENT DfFPObj2Probabil "" UBYTE ADAS_CM_uint8 0 0 0.000000 100.000000 ECU_ADDRESS 0x0000 /* @ECU_Address@DfFPObj2Probabil@ */ /end MEASUREMENT
/begin MEASUREMENT DfFPObj2Sx1 "" FLOAT32_IEEE ADAS_CM_single 0 0 0.000000 204.000000 ECU_ADDRESS 0x0000 /* @ECU_Address@DfFPObj2Sx1@ */ /end MEASUREMENT
/begin MEASUREMENT DfFPObj2Sy1 "" FLOAT32_IEEE ADAS_CM_single 0 0 -102.000000 102.000000 ECU_ADDRESS 0x0000 /* @ECU_Address@DfFPObj2Sy1@ */ /end MEASUREMENT
/begin MEASUREMENT DfFPObj2Vx "" FLOAT32_IEEE ADAS_CM_single 0 0 0.000000 102.000000 ECU_ADDRESS 0x0000 /* @ECU_Address@DfFPObj2Vx@ */ /end MEASUREMENT
/begin MEASUREMENT DfFPObj2Vy "" FLOAT32_IEEE ADAS_CM_single 0 0 -12.000000 12.000000 ECU_ADDRESS 0x0000 /* @ECU_Address@DfFPObj2Vy@ */ /end MEASUREMENT
/begin MEASUREMENT DfFPObj2detect "" UBYTE ADAS_CM_uint8 0 0 0.000000 1.000000 ECU_ADDRESS 0x0000 /* @ECU_Address@DfFPObj2detect@ */ /end MEASUREMENT
/begin MEASUREMENT DfFPObj2type "" UBYTE ADAS_CM_uint8 0 0 0.000000 7.000000 ECU_ADDRESS 0x0000 /* @ECU_Address@DfFPObj2type@ */ /end MEASUREMENT
/begin MEASUREMENT DfFPObj3DynamID "" UBYTE ADAS_CM_uint8 0 0 0.000000 40.000000 ECU_ADDRESS 0x0000 /* @ECU_Address@DfFPObj3DynamID@ */ /end MEASUREMENT
/begin MEASUREMENT DfFPObj3Orient "" FLOAT32_IEEE ADAS_CM_single 0 0 -180.000000 180.000000 ECU_ADDRESS 0x0000 /* @ECU_Address@DfFPObj3Orient@ */ /end MEASUREMENT
/begin MEASUREMENT DfFPObj3Probabil "" UBYTE ADAS_CM_uint8 0 0 0.000000 100.000000 ECU_ADDRESS 0x0000 /* @ECU_Address@DfFPObj3Probabil@ */ /end MEASUREMENT
/begin MEASUREMENT DfFPObj3Sx1 "" FLOAT32_IEEE ADAS_CM_single 0 0 0.000000 204.000000 ECU_ADDRESS 0x0000 /* @ECU_Address@DfFPObj3Sx1@ */ /end MEASUREMENT
/begin MEASUREMENT DfFPObj3Sx2 "" FLOAT32_IEEE ADAS_CM_single 0 0 0.000000 204.000000 ECU_ADDRESS 0x0000 /* @ECU_Address@DfFPObj3Sx2@ */ /end MEASUREMENT
/begin MEASUREMENT DfFPObj3Sy1 "" FLOAT32_IEEE ADAS_CM_single 0 0 -102.000000 102.000000 ECU_ADDRESS 0x0000 /* @ECU_Address@DfFPObj3Sy1@ */ /end MEASUREMENT
/begin MEASUREMENT DfFPObj3Sy2 "" FLOAT32_IEEE ADAS_CM_single 0 0 -102.000000 102.000000 ECU_ADDRESS 0x0000 /* @ECU_Address@DfFPObj3Sy2@ */ /end MEASUREMENT
/begin MEASUREMENT DfFPObj3Vx "" FLOAT32_IEEE ADAS_CM_single 0 0 0.000000 102.000000 ECU_ADDRESS 0x0000 /* @ECU_Address@DfFPObj3Vx@ */ /end MEASUREMENT
/begin MEASUREMENT DfFPObj3Vy "" FLOAT32_IEEE ADAS_CM_single 0 0 -12.000000 12.000000 ECU_ADDRESS 0x0000 /* @ECU_Address@DfFPObj3Vy@ */ /end MEASUREMENT
/begin MEASUREMENT DfFPObj3detect "" UBYTE ADAS_CM_uint8 0 0 0.000000 1.000000 ECU_ADDRESS 0x0000 /* @ECU_Address@DfFPObj3detect@ */ /end MEASUREMENT
/begin MEASUREMENT DfFPObj3type "" UBYTE ADAS_CM_uint8 0 0 0.000000 7.000000 ECU_ADDRESS 0x0000 /* @ECU_Address@DfFPObj3type@ */ /end MEASUREMENT
/begin MEASUREMENT DfFPObj4DynamID "" UBYTE ADAS_CM_uint8 0 0 0.000000 40.000000 ECU_ADDRESS 0x0000 /* @ECU_Address@DfFPObj4DynamID@ */ /end MEASUREMENT
/begin MEASUREMENT DfFPObj4Orient "" FLOAT32_IEEE ADAS_CM_single 0 0 -180.000000 180.000000 ECU_ADDRESS 0x0000 /* @ECU_Address@DfFPObj4Orient@ */ /end MEASUREMENT
/begin MEASUREMENT DfFPObj4Probabil "" UBYTE ADAS_CM_uint8 0 0 0.000000 100.000000 ECU_ADDRESS 0x0000 /* @ECU_Address@DfFPObj4Probabil@ */ /end MEASUREMENT
/begin MEASUREMENT DfFPObj4Sx1 "" FLOAT32_IEEE ADAS_CM_single 0 0 0.000000 204.000000 ECU_ADDRESS 0x0000 /* @ECU_Address@DfFPObj4Sx1@ */ /end MEASUREMENT
/begin MEASUREMENT DfFPObj4Sx2 "" FLOAT32_IEEE ADAS_CM_single 0 0 0.000000 204.000000 ECU_ADDRESS 0x0000 /* @ECU_Address@DfFPObj4Sx2@ */ /end MEASUREMENT
/begin MEASUREMENT DfFPObj4Sy1 "" FLOAT32_IEEE ADAS_CM_single 0 0 -102.000000 102.000000 ECU_ADDRESS 0x0000 /* @ECU_Address@DfFPObj4Sy1@ */ /end MEASUREMENT
/begin MEASUREMENT DfFPObj4Sy2 "" FLOAT32_IEEE ADAS_CM_single 0 0 -102.000000 102.000000 ECU_ADDRESS 0x0000 /* @ECU_Address@DfFPObj4Sy2@ */ /end MEASUREMENT
/begin MEASUREMENT DfFPObj4Vx "" FLOAT32_IEEE ADAS_CM_single 0 0 0.000000 102.000000 ECU_ADDRESS 0x0000 /* @ECU_Address@DfFPObj4Vx@ */ /end MEASUREMENT
/begin MEASUREMENT DfFPObj4Vy "" FLOAT32_IEEE ADAS_CM_single 0 0 -12.000000 12.000000 ECU_ADDRESS 0x0000 /* @ECU_Address@DfFPObj4Vy@ */ /end MEASUREMENT
/begin MEASUREMENT DfFPObj4detect "" UBYTE ADAS_CM_uint8 0 0 0.000000 1.000000 ECU_ADDRESS 0x0000 /* @ECU_Address@DfFPObj4detect@ */ /end MEASUREMENT
/begin MEASUREMENT DfFPObj4type "" UBYTE ADAS_CM_uint8 0 0 0.000000 7.000000 ECU_ADDRESS 0x0000 /* @ECU_Address@DfFPObj4type@ */ /end MEASUREMENT
/begin MEASUREMENT DfFPObj5DynamID "" UBYTE ADAS_CM_uint8 0 0 0.000000 40.000000 ECU_ADDRESS 0x0000 /* @ECU_Address@DfFPObj5DynamID@ */ /end MEASUREMENT
/begin MEASUREMENT DfFPObj5Orient "" FLOAT32_IEEE ADAS_CM_single 0 0 -180.000000 180.000000 ECU_ADDRESS 0x0000 /* @ECU_Address@DfFPObj5Orient@ */ /end MEASUREMENT
/begin MEASUREMENT DfFPObj5Probabil "" UBYTE ADAS_CM_uint8 0 0 0.000000 100.000000 ECU_ADDRESS 0x0000 /* @ECU_Address@DfFPObj5Probabil@ */ /end MEASUREMENT
/begin MEASUREMENT DfFPObj5Sx1 "" FLOAT32_IEEE ADAS_CM_single 0 0 0.000000 204.000000 ECU_ADDRESS 0x0000 /* @ECU_Address@DfFPObj5Sx1@ */ /end MEASUREMENT
/begin MEASUREMENT DfFPObj5Sx2 "" FLOAT32_IEEE ADAS_CM_single 0 0 0.000000 204.000000 ECU_ADDRESS 0x0000 /* @ECU_Address@DfFPObj5Sx2@ */ /end MEASUREMENT
/begin MEASUREMENT DfFPObj5Sy1 "" FLOAT32_IEEE ADAS_CM_single 0 0 -102.000000 102.000000 ECU_ADDRESS 0x0000 /* @ECU_Address@DfFPObj5Sy1@ */ /end MEASUREMENT
/begin MEASUREMENT DfFPObj5Sy2 "" FLOAT32_IEEE ADAS_CM_single 0 0 -102.000000 102.000000 ECU_ADDRESS 0x0000 /* @ECU_Address@DfFPObj5Sy2@ */ /end MEASUREMENT
/begin MEASUREMENT DfFPObj5Vx "" FLOAT32_IEEE ADAS_CM_single 0 0 0.000000 102.000000 ECU_ADDRESS 0x0000 /* @ECU_Address@DfFPObj5Vx@ */ /end MEASUREMENT
/begin MEASUREMENT DfFPObj5Vy "" FLOAT32_IEEE ADAS_CM_single 0 0 -12.000000 12.000000 ECU_ADDRESS 0x0000 /* @ECU_Address@DfFPObj5Vy@ */ /end MEASUREMENT
/begin MEASUREMENT DfFPObj5detect "" UBYTE ADAS_CM_uint8 0 0 0.000000 1.000000 ECU_ADDRESS 0x0000 /* @ECU_Address@DfFPObj5detect@ */ /end MEASUREMENT
/begin MEASUREMENT DfFPObj5type "" UBYTE ADAS_CM_uint8 0 0 0.000000 7.000000 ECU_ADDRESS 0x0000 /* @ECU_Address@DfFPObj5type@ */ /end MEASUREMENT
/begin MEASUREMENT DfFPObj6DynamID "" UBYTE ADAS_CM_uint8 0 0 0.000000 40.000000 ECU_ADDRESS 0x0000 /* @ECU_Address@DfFPObj6DynamID@ */ /end MEASUREMENT
/begin MEASUREMENT DfFPObj6Orient "" FLOAT32_IEEE ADAS_CM_single 0 0 -180.000000 180.000000 ECU_ADDRESS 0x0000 /* @ECU_Address@DfFPObj6Orient@ */ /end MEASUREMENT
/begin MEASUREMENT DfFPObj6Probabil "" UBYTE ADAS_CM_uint8 0 0 0.000000 100.000000 ECU_ADDRESS 0x0000 /* @ECU_Address@DfFPObj6Probabil@ */ /end MEASUREMENT
/begin MEASUREMENT DfFPObj6Sx1 "" FLOAT32_IEEE ADAS_CM_single 0 0 0.000000 204.000000 ECU_ADDRESS 0x0000 /* @ECU_Address@DfFPObj6Sx1@ */ /end MEASUREMENT
/begin MEASUREMENT DfFPObj6Sx2 "" FLOAT32_IEEE ADAS_CM_single 0 0 0.000000 204.000000 ECU_ADDRESS 0x0000 /* @ECU_Address@DfFPObj6Sx2@ */ /end MEASUREMENT
/begin MEASUREMENT DfFPObj6Sy1 "" FLOAT32_IEEE ADAS_CM_single 0 0 -102.000000 102.000000 ECU_ADDRESS 0x0000 /* @ECU_Address@DfFPObj6Sy1@ */ /end MEASUREMENT
/begin MEASUREMENT DfFPObj6Sy2 "" FLOAT32_IEEE ADAS_CM_single 0 0 -102.000000 102.000000 ECU_ADDRESS 0x0000 /* @ECU_Address@DfFPObj6Sy2@ */ /end MEASUREMENT
/begin MEASUREMENT DfFPObj6Vx "" FLOAT32_IEEE ADAS_CM_single 0 0 0.000000 102.000000 ECU_ADDRESS 0x0000 /* @ECU_Address@DfFPObj6Vx@ */ /end MEASUREMENT
/begin MEASUREMENT DfFPObj6Vy "" FLOAT32_IEEE ADAS_CM_single 0 0 -12.000000 12.000000 ECU_ADDRESS 0x0000 /* @ECU_Address@DfFPObj6Vy@ */ /end MEASUREMENT
/begin MEASUREMENT DfFPObj6detect "" UBYTE ADAS_CM_uint8 0 0 0.000000 1.000000 ECU_ADDRESS 0x0000 /* @ECU_Address@DfFPObj6detect@ */ /end MEASUREMENT
/begin MEASUREMENT DfFPObj6type "" UBYTE ADAS_CM_uint8 0 0 0.000000 7.000000 ECU_ADDRESS 0x0000 /* @ECU_Address@DfFPObj6type@ */ /end MEASUREMENT
/begin MEASUREMENT DfFPObj7DynamID "" UBYTE ADAS_CM_uint8 0 0 0.000000 40.000000 ECU_ADDRESS 0x0000 /* @ECU_Address@DfFPObj7DynamID@ */ /end MEASUREMENT
/begin MEASUREMENT DfFPObj7Orient "" FLOAT32_IEEE ADAS_CM_single 0 0 -180.000000 180.000000 ECU_ADDRESS 0x0000 /* @ECU_Address@DfFPObj7Orient@ */ /end MEASUREMENT
/begin MEASUREMENT DfFPObj7Probabil "" UBYTE ADAS_CM_uint8 0 0 0.000000 100.000000 ECU_ADDRESS 0x0000 /* @ECU_Address@DfFPObj7Probabil@ */ /end MEASUREMENT
/begin MEASUREMENT DfFPObj7Sx1 "" FLOAT32_IEEE ADAS_CM_single 0 0 0.000000 204.000000 ECU_ADDRESS 0x0000 /* @ECU_Address@DfFPObj7Sx1@ */ /end MEASUREMENT
/begin MEASUREMENT DfFPObj7Sx2 "" FLOAT32_IEEE ADAS_CM_single 0 0 0.000000 204.000000 ECU_ADDRESS 0x0000 /* @ECU_Address@DfFPObj7Sx2@ */ /end MEASUREMENT
/begin MEASUREMENT DfFPObj7Sy1 "" FLOAT32_IEEE ADAS_CM_single 0 0 -102.000000 102.000000 ECU_ADDRESS 0x0000 /* @ECU_Address@DfFPObj7Sy1@ */ /end MEASUREMENT
/begin MEASUREMENT DfFPObj7Sy2 "" FLOAT32_IEEE ADAS_CM_single 0 0 -102.000000 102.000000 ECU_ADDRESS 0x0000 /* @ECU_Address@DfFPObj7Sy2@ */ /end MEASUREMENT
/begin MEASUREMENT DfFPObj7Vx "" FLOAT32_IEEE ADAS_CM_single 0 0 -102.000000 10.000000 ECU_ADDRESS 0x0000 /* @ECU_Address@DfFPObj7Vx@ */ /end MEASUREMENT
/begin MEASUREMENT DfFPObj7Vy "" FLOAT32_IEEE ADAS_CM_single 0 0 -20.000000 20.000000 ECU_ADDRESS 0x0000 /* @ECU_Address@DfFPObj7Vy@ */ /end MEASUREMENT
/begin MEASUREMENT DfFPObj7detect "" UBYTE ADAS_CM_uint8 0 0 0.000000 1.000000 ECU_ADDRESS 0x0000 /* @ECU_Address@DfFPObj7detect@ */ /end MEASUREMENT
/begin MEASUREMENT DfFPObj7type "" UBYTE ADAS_CM_uint8 0 0 0.000000 7.000000 ECU_ADDRESS 0x0000 /* @ECU_Address@DfFPObj7type@ */ /end MEASUREMENT
/begin MEASUREMENT DfFPObj8DynamID "" UBYTE ADAS_CM_uint8 0 0 0.000000 40.000000 ECU_ADDRESS 0x0000 /* @ECU_Address@DfFPObj8DynamID@ */ /end MEASUREMENT
/begin MEASUREMENT DfFPObj8Orient "" FLOAT32_IEEE ADAS_CM_single 0 0 -180.000000 180.000000 ECU_ADDRESS 0x0000 /* @ECU_Address@DfFPObj8Orient@ */ /end MEASUREMENT
/begin MEASUREMENT DfFPObj8Probabil "" UBYTE ADAS_CM_uint8 0 0 0.000000 100.000000 ECU_ADDRESS 0x0000 /* @ECU_Address@DfFPObj8Probabil@ */ /end MEASUREMENT
/begin MEASUREMENT DfFPObj8Sx1 "" FLOAT32_IEEE ADAS_CM_single 0 0 0.000000 204.000000 ECU_ADDRESS 0x0000 /* @ECU_Address@DfFPObj8Sx1@ */ /end MEASUREMENT
/begin MEASUREMENT DfFPObj8Sx2 "" FLOAT32_IEEE ADAS_CM_single 0 0 0.000000 204.000000 ECU_ADDRESS 0x0000 /* @ECU_Address@DfFPObj8Sx2@ */ /end MEASUREMENT
/begin MEASUREMENT DfFPObj8Sy1 "" FLOAT32_IEEE ADAS_CM_single 0 0 -102.000000 102.000000 ECU_ADDRESS 0x0000 /* @ECU_Address@DfFPObj8Sy1@ */ /end MEASUREMENT
/begin MEASUREMENT DfFPObj8Sy2 "" FLOAT32_IEEE ADAS_CM_single 0 0 -102.000000 102.000000 ECU_ADDRESS 0x0000 /* @ECU_Address@DfFPObj8Sy2@ */ /end MEASUREMENT
/begin MEASUREMENT DfFPObj8Vx "" FLOAT32_IEEE ADAS_CM_single 0 0 -15.000000 15.000000 ECU_ADDRESS 0x0000 /* @ECU_Address@DfFPObj8Vx@ */ /end MEASUREMENT
/begin MEASUREMENT DfFPObj8Vy "" FLOAT32_IEEE ADAS_CM_single 0 0 -20.000000 20.000000 ECU_ADDRESS 0x0000 /* @ECU_Address@DfFPObj8Vy@ */ /end MEASUREMENT
/begin MEASUREMENT DfFPObj8detect "" UBYTE ADAS_CM_uint8 0 0 0.000000 1.000000 ECU_ADDRESS 0x0000 /* @ECU_Address@DfFPObj8detect@ */ /end MEASUREMENT
/begin MEASUREMENT DfFPObj8type "" UBYTE ADAS_CM_uint8 0 0 0.000000 7.000000 ECU_ADDRESS 0x0000 /* @ECU_Address@DfFPObj8type@ */ /end MEASUREMENT
/begin MEASUREMENT DfFPObj9DynamID "" UBYTE ADAS_CM_uint8 0 0 0.000000 40.000000 ECU_ADDRESS 0x0000 /* @ECU_Address@DfFPObj9DynamID@ */ /end MEASUREMENT
/begin MEASUREMENT DfFPObj9Orient "" FLOAT32_IEEE ADAS_CM_single 0 0 -180.000000 180.000000 ECU_ADDRESS 0x0000 /* @ECU_Address@DfFPObj9Orient@ */ /end MEASUREMENT
/begin MEASUREMENT DfFPObj9Probabil "" UBYTE ADAS_CM_uint8 0 0 0.000000 100.000000 ECU_ADDRESS 0x0000 /* @ECU_Address@DfFPObj9Probabil@ */ /end MEASUREMENT
/begin MEASUREMENT DfFPObj9Sx1 "" FLOAT32_IEEE ADAS_CM_single 0 0 0.000000 204.000000 ECU_ADDRESS 0x0000 /* @ECU_Address@DfFPObj9Sx1@ */ /end MEASUREMENT
/begin MEASUREMENT DfFPObj9Sx2 "" FLOAT32_IEEE ADAS_CM_single 0 0 0.000000 204.000000 ECU_ADDRESS 0x0000 /* @ECU_Address@DfFPObj9Sx2@ */ /end MEASUREMENT
/begin MEASUREMENT DfFPObj9Sy1 "" FLOAT32_IEEE ADAS_CM_single 0 0 -102.000000 102.000000 ECU_ADDRESS 0x0000 /* @ECU_Address@DfFPObj9Sy1@ */ /end MEASUREMENT
/begin MEASUREMENT DfFPObj9Sy2 "" FLOAT32_IEEE ADAS_CM_single 0 0 -102.000000 102.000000 ECU_ADDRESS 0x0000 /* @ECU_Address@DfFPObj9Sy2@ */ /end MEASUREMENT
/begin MEASUREMENT DfFPObj9Vx "" FLOAT32_IEEE ADAS_CM_single 0 0 -102.000000 102.000000 ECU_ADDRESS 0x0000 /* @ECU_Address@DfFPObj9Vx@ */ /end MEASUREMENT
/begin MEASUREMENT DfFPObj9Vy "" FLOAT32_IEEE ADAS_CM_single 0 0 -20.000000 20.000000 ECU_ADDRESS 0x0000 /* @ECU_Address@DfFPObj9Vy@ */ /end MEASUREMENT
/begin MEASUREMENT DfFPObj9detect "" UBYTE ADAS_CM_uint8 0 0 0.000000 1.000000 ECU_ADDRESS 0x0000 /* @ECU_Address@DfFPObj9detect@ */ /end MEASUREMENT
/begin MEASUREMENT DfFPObj9type "" UBYTE ADAS_CM_uint8 0 0 0.000000 7.000000 ECU_ADDRESS 0x0000 /* @ECU_Address@DfFPObj9type@ */ /end MEASUREMENT
/begin MEASUREMENT DfLanePFrontLColor "" UBYTE ADAS_CM_uint8 0 0 0.000000 1.000000 ECU_ADDRESS 0x0000 /* @ECU_Address@DfLanePFrontLColor@ */ /end MEASUREMENT
/begin MEASUREMENT DfLanePFrontLSx0 "" FLOAT32_IEEE ADAS_CM_single 0 0 -5.000000 5.000000 ECU_ADDRESS 0x0000 /* @ECU_Address@DfLanePFrontLSx0@ */ /end MEASUREMENT
/begin MEASUREMENT DfLanePFrontLSx10 "" FLOAT32_IEEE ADAS_CM_single 0 0 -20.000000 20.000000 ECU_ADDRESS 0x0000 /* @ECU_Address@DfLanePFrontLSx10@ */ /end MEASUREMENT
/begin MEASUREMENT DfLanePFrontLSx100 "" FLOAT32_IEEE ADAS_CM_single 0 0 -200.000000 200.000000 ECU_ADDRESS 0x0000 /* @ECU_Address@DfLanePFrontLSx100@ */ /end MEASUREMENT
/begin MEASUREMENT DfLanePFrontLSx15 "" FLOAT32_IEEE ADAS_CM_single 0 0 -30.000000 30.000000 ECU_ADDRESS 0x0000 /* @ECU_Address@DfLanePFrontLSx15@ */ /end MEASUREMENT
/begin MEASUREMENT DfLanePFrontLSx20 "" FLOAT32_IEEE ADAS_CM_single 0 0 -40.000000 40.000000 ECU_ADDRESS 0x0000 /* @ECU_Address@DfLanePFrontLSx20@ */ /end MEASUREMENT
/begin MEASUREMENT DfLanePFrontLSx25 "" FLOAT32_IEEE ADAS_CM_single 0 0 -50.000000 50.000000 ECU_ADDRESS 0x0000 /* @ECU_Address@DfLanePFrontLSx25@ */ /end MEASUREMENT
/begin MEASUREMENT DfLanePFrontLSx30 "" FLOAT32_IEEE ADAS_CM_single 0 0 -60.000000 60.000000 ECU_ADDRESS 0x0000 /* @ECU_Address@DfLanePFrontLSx30@ */ /end MEASUREMENT
/begin MEASUREMENT DfLanePFrontLSx40 "" FLOAT32_IEEE ADAS_CM_single 0 0 -80.000000 80.000000 ECU_ADDRESS 0x0000 /* @ECU_Address@DfLanePFrontLSx40@ */ /end MEASUREMENT
/begin MEASUREMENT DfLanePFrontLSx50 "" FLOAT32_IEEE ADAS_CM_single 0 0 -100.000000 100.000000 ECU_ADDRESS 0x0000 /* @ECU_Address@DfLanePFrontLSx50@ */ /end MEASUREMENT
/begin MEASUREMENT DfLanePFrontLSx60 "" FLOAT32_IEEE ADAS_CM_single 0 0 -120.000000 120.000000 ECU_ADDRESS 0x0000 /* @ECU_Address@DfLanePFrontLSx60@ */ /end MEASUREMENT
/begin MEASUREMENT DfLanePFrontLSx70 "" FLOAT32_IEEE ADAS_CM_single 0 0 -140.000000 140.000000 ECU_ADDRESS 0x0000 /* @ECU_Address@DfLanePFrontLSx70@ */ /end MEASUREMENT
/begin MEASUREMENT DfLanePFrontLSx80 "" FLOAT32_IEEE ADAS_CM_single 0 0 -160.000000 160.000000 ECU_ADDRESS 0x0000 /* @ECU_Address@DfLanePFrontLSx80@ */ /end MEASUREMENT
/begin MEASUREMENT DfLanePFrontLSx90 "" FLOAT32_IEEE ADAS_CM_single 0 0 -180.000000 180.000000 ECU_ADDRESS 0x0000 /* @ECU_Address@DfLanePFrontLSx90@ */ /end MEASUREMENT
/begin MEASUREMENT DfLanePFrontLSxFA "" FLOAT32_IEEE ADAS_CM_single 0 0 -10.000000 10.000000 ECU_ADDRESS 0x0000 /* @ECU_Address@DfLanePFrontLSxFA@ */ /end MEASUREMENT
/begin MEASUREMENT DfLanePFrontLType "" UBYTE ADAS_CM_uint8 0 0 0.000000 4.000000 ECU_ADDRESS 0x0000 /* @ECU_Address@DfLanePFrontLType@ */ /end MEASUREMENT
/begin MEASUREMENT DfLanePFrontRColor "" UBYTE ADAS_CM_uint8 0 0 0.000000 1.000000 ECU_ADDRESS 0x0000 /* @ECU_Address@DfLanePFrontRColor@ */ /end MEASUREMENT
/begin MEASUREMENT DfLanePFrontRSx0 "" FLOAT32_IEEE ADAS_CM_single 0 0 -5.000000 5.000000 ECU_ADDRESS 0x0000 /* @ECU_Address@DfLanePFrontRSx0@ */ /end MEASUREMENT
/begin MEASUREMENT DfLanePFrontRSx10 "" FLOAT32_IEEE ADAS_CM_single 0 0 -20.000000 20.000000 ECU_ADDRESS 0x0000 /* @ECU_Address@DfLanePFrontRSx10@ */ /end MEASUREMENT
/begin MEASUREMENT DfLanePFrontRSx100 "" FLOAT32_IEEE ADAS_CM_single 0 0 -200.000000 200.000000 ECU_ADDRESS 0x0000 /* @ECU_Address@DfLanePFrontRSx100@ */ /end MEASUREMENT
/begin MEASUREMENT DfLanePFrontRSx15 "" FLOAT32_IEEE ADAS_CM_single 0 0 -30.000000 30.000000 ECU_ADDRESS 0x0000 /* @ECU_Address@DfLanePFrontRSx15@ */ /end MEASUREMENT
/begin MEASUREMENT DfLanePFrontRSx20 "" FLOAT32_IEEE ADAS_CM_single 0 0 -40.000000 40.000000 ECU_ADDRESS 0x0000 /* @ECU_Address@DfLanePFrontRSx20@ */ /end MEASUREMENT
/begin MEASUREMENT DfLanePFrontRSx25 "" FLOAT32_IEEE ADAS_CM_single 0 0 -50.000000 50.000000 ECU_ADDRESS 0x0000 /* @ECU_Address@DfLanePFrontRSx25@ */ /end MEASUREMENT
/begin MEASUREMENT DfLanePFrontRSx30 "" FLOAT32_IEEE ADAS_CM_single 0 0 -60.000000 60.000000 ECU_ADDRESS 0x0000 /* @ECU_Address@DfLanePFrontRSx30@ */ /end MEASUREMENT
/begin MEASUREMENT DfLanePFrontRSx40 "" FLOAT32_IEEE ADAS_CM_single 0 0 -80.000000 80.000000 ECU_ADDRESS 0x0000 /* @ECU_Address@DfLanePFrontRSx40@ */ /end MEASUREMENT
/begin MEASUREMENT DfLanePFrontRSx50 "" FLOAT32_IEEE ADAS_CM_single 0 0 -100.000000 100.000000 ECU_ADDRESS 0x0000 /* @ECU_Address@DfLanePFrontRSx50@ */ /end MEASUREMENT
/begin MEASUREMENT DfLanePFrontRSx60 "" FLOAT32_IEEE ADAS_CM_single 0 0 -120.000000 120.000000 ECU_ADDRESS 0x0000 /* @ECU_Address@DfLanePFrontRSx60@ */ /end MEASUREMENT
/begin MEASUREMENT DfLanePFrontRSx70 "" FLOAT32_IEEE ADAS_CM_single 0 0 -140.000000 140.000000 ECU_ADDRESS 0x0000 /* @ECU_Address@DfLanePFrontRSx70@ */ /end MEASUREMENT
/begin MEASUREMENT DfLanePFrontRSx80 "" FLOAT32_IEEE ADAS_CM_single 0 0 -160.000000 160.000000 ECU_ADDRESS 0x0000 /* @ECU_Address@DfLanePFrontRSx80@ */ /end MEASUREMENT
/begin MEASUREMENT DfLanePFrontRSx90 "" FLOAT32_IEEE ADAS_CM_single 0 0 -180.000000 180.000000 ECU_ADDRESS 0x0000 /* @ECU_Address@DfLanePFrontRSx90@ */ /end MEASUREMENT
/begin MEASUREMENT DfLanePFrontRSxFA "" FLOAT32_IEEE ADAS_CM_single 0 0 -10.000000 10.000000 ECU_ADDRESS 0x0000 /* @ECU_Address@DfLanePFrontRSxFA@ */ /end MEASUREMENT
/begin MEASUREMENT DfLanePFrontRType "" UBYTE ADAS_CM_uint8 0 0 0.000000 4.000000 ECU_ADDRESS 0x0000 /* @ECU_Address@DfLanePFrontRType@ */ /end MEASUREMENT
/begin MEASUREMENT DfLanePRearLSx10 "" FLOAT32_IEEE ADAS_CM_single 0 0 -20.000000 20.000000 ECU_ADDRESS 0x0000 /* @ECU_Address@DfLanePRearLSx10@ */ /end MEASUREMENT
/begin MEASUREMENT DfLanePRearLSx100 "" FLOAT32_IEEE ADAS_CM_single 0 0 -200.000000 200.000000 ECU_ADDRESS 0x0000 /* @ECU_Address@DfLanePRearLSx100@ */ /end MEASUREMENT
/begin MEASUREMENT DfLanePRearLSx20 "" FLOAT32_IEEE ADAS_CM_single 0 0 -40.000000 40.000000 ECU_ADDRESS 0x0000 /* @ECU_Address@DfLanePRearLSx20@ */ /end MEASUREMENT
/begin MEASUREMENT DfLanePRearLSx30 "" FLOAT32_IEEE ADAS_CM_single 0 0 -60.000000 60.000000 ECU_ADDRESS 0x0000 /* @ECU_Address@DfLanePRearLSx30@ */ /end MEASUREMENT
/begin MEASUREMENT DfLanePRearLSx40 "" FLOAT32_IEEE ADAS_CM_single 0 0 -80.000000 80.000000 ECU_ADDRESS 0x0000 /* @ECU_Address@DfLanePRearLSx40@ */ /end MEASUREMENT
/begin MEASUREMENT DfLanePRearLSx5 "" FLOAT32_IEEE ADAS_CM_single 0 0 -10.000000 10.000000 ECU_ADDRESS 0x0000 /* @ECU_Address@DfLanePRearLSx5@ */ /end MEASUREMENT
/begin MEASUREMENT DfLanePRearLSx50 "" FLOAT32_IEEE ADAS_CM_single 0 0 -100.000000 100.000000 ECU_ADDRESS 0x0000 /* @ECU_Address@DfLanePRearLSx50@ */ /end MEASUREMENT
/begin MEASUREMENT DfLanePRearLSx60 "" FLOAT32_IEEE ADAS_CM_single 0 0 -120.000000 120.000000 ECU_ADDRESS 0x0000 /* @ECU_Address@DfLanePRearLSx60@ */ /end MEASUREMENT
/begin MEASUREMENT DfLanePRearLSx70 "" FLOAT32_IEEE ADAS_CM_single 0 0 -140.000000 140.000000 ECU_ADDRESS 0x0000 /* @ECU_Address@DfLanePRearLSx70@ */ /end MEASUREMENT
/begin MEASUREMENT DfLanePRearLSx80 "" FLOAT32_IEEE ADAS_CM_single 0 0 -160.000000 160.000000 ECU_ADDRESS 0x0000 /* @ECU_Address@DfLanePRearLSx80@ */ /end MEASUREMENT
/begin MEASUREMENT DfLanePRearLSx90 "" FLOAT32_IEEE ADAS_CM_single 0 0 -180.000000 180.000000 ECU_ADDRESS 0x0000 /* @ECU_Address@DfLanePRearLSx90@ */ /end MEASUREMENT
/begin MEASUREMENT DfLanePRearRSx10 "" FLOAT32_IEEE ADAS_CM_single 0 0 -20.000000 20.000000 ECU_ADDRESS 0x0000 /* @ECU_Address@DfLanePRearRSx10@ */ /end MEASUREMENT
/begin MEASUREMENT DfLanePRearRSx20 "" FLOAT32_IEEE ADAS_CM_single 0 0 -40.000000 40.000000 ECU_ADDRESS 0x0000 /* @ECU_Address@DfLanePRearRSx20@ */ /end MEASUREMENT
/begin MEASUREMENT DfLanePRearRSx30 "" FLOAT32_IEEE ADAS_CM_single 0 0 -60.000000 60.000000 ECU_ADDRESS 0x0000 /* @ECU_Address@DfLanePRearRSx30@ */ /end MEASUREMENT
/begin MEASUREMENT DfLanePRearRSx40 "" FLOAT32_IEEE ADAS_CM_single 0 0 -80.000000 80.000000 ECU_ADDRESS 0x0000 /* @ECU_Address@DfLanePRearRSx40@ */ /end MEASUREMENT
/begin MEASUREMENT DfLanePRearRSx5 "" FLOAT32_IEEE ADAS_CM_single 0 0 -10.000000 10.000000 ECU_ADDRESS 0x0000 /* @ECU_Address@DfLanePRearRSx5@ */ /end MEASUREMENT
/begin MEASUREMENT DfLanePRearRSx50 "" FLOAT32_IEEE ADAS_CM_single 0 0 -100.000000 100.000000 ECU_ADDRESS 0x0000 /* @ECU_Address@DfLanePRearRSx50@ */ /end MEASUREMENT
/begin MEASUREMENT DfLanePRearRSx60 "" FLOAT32_IEEE ADAS_CM_single 0 0 -120.000000 120.000000 ECU_ADDRESS 0x0000 /* @ECU_Address@DfLanePRearRSx60@ */ /end MEASUREMENT
/begin MEASUREMENT DfLanePRearRSx70 "" FLOAT32_IEEE ADAS_CM_single 0 0 -140.000000 140.000000 ECU_ADDRESS 0x0000 /* @ECU_Address@DfLanePRearRSx70@ */ /end MEASUREMENT
/begin MEASUREMENT DfLanePTrgtLineS0 "" FLOAT32_IEEE ADAS_CM_single 0 0 -5.000000 5.000000 ECU_ADDRESS 0x0000 /* @ECU_Address@DfLanePTrgtLineS0@ */ /end MEASUREMENT
/begin MEASUREMENT DfLanePTrgtLineS1 "" FLOAT32_IEEE ADAS_CM_single 0 0 -20.000000 20.000000 ECU_ADDRESS 0x0000 /* @ECU_Address@DfLanePTrgtLineS1@ */ /end MEASUREMENT
/begin MEASUREMENT DfLanePTrgtLineS2 "" FLOAT32_IEEE ADAS_CM_single 0 0 -40.000000 40.000000 ECU_ADDRESS 0x0000 /* @ECU_Address@DfLanePTrgtLineS2@ */ /end MEASUREMENT
/begin MEASUREMENT DfLanePTrgtLineS3 "" FLOAT32_IEEE ADAS_CM_single 0 0 -60.000000 60.000000 ECU_ADDRESS 0x0000 /* @ECU_Address@DfLanePTrgtLineS3@ */ /end MEASUREMENT
/begin MEASUREMENT DfLanePTrgtLineS4 "" FLOAT32_IEEE ADAS_CM_single 0 0 -80.000000 80.000000 ECU_ADDRESS 0x0000 /* @ECU_Address@DfLanePTrgtLineS4@ */ /end MEASUREMENT
/begin MEASUREMENT DfMliaPercObj10Detect "" UBYTE ADAS_CM_uint8 0 0 0.000000 1.000000 ECU_ADDRESS 0x0000 /* @ECU_Address@DfMliaPercObj10Detect@ */ /end MEASUREMENT
/begin MEASUREMENT DfMliaPercObj10LightSts "" UBYTE ADAS_CM_uint8 0 0 0.000000 1.000000 ECU_ADDRESS 0x0000 /* @ECU_Address@DfMliaPercObj10LightSts@ */ /end MEASUREMENT
/begin MEASUREMENT DfMliaPercObj10Precision "" UBYTE ADAS_CM_uint8 0 0 0.000000 1.000000 ECU_ADDRESS 0x0000 /* @ECU_Address@DfMliaPercObj10Precision@ */ /end MEASUREMENT
/begin MEASUREMENT DfMliaPercObj10Sx1 "" FLOAT32_IEEE ADAS_CM_single 0 0 0.000000 500.000000 ECU_ADDRESS 0x0000 /* @ECU_Address@DfMliaPercObj10Sx1@ */ /end MEASUREMENT
/begin MEASUREMENT DfMliaPercObj10Sx2 "" FLOAT32_IEEE ADAS_CM_single 0 0 0.000000 500.000000 ECU_ADDRESS 0x0000 /* @ECU_Address@DfMliaPercObj10Sx2@ */ /end MEASUREMENT
/begin MEASUREMENT DfMliaPercObj10Sy1 "" FLOAT32_IEEE ADAS_CM_single 0 0 -290.000000 290.000000 ECU_ADDRESS 0x0000 /* @ECU_Address@DfMliaPercObj10Sy1@ */ /end MEASUREMENT
/begin MEASUREMENT DfMliaPercObj10Sy2 "" FLOAT32_IEEE ADAS_CM_single 0 0 -290.000000 290.000000 ECU_ADDRESS 0x0000 /* @ECU_Address@DfMliaPercObj10Sy2@ */ /end MEASUREMENT
/begin MEASUREMENT DfMliaPercObj10Sz "" FLOAT32_IEEE ADAS_CM_single 0 0 -50.000000 50.000000 ECU_ADDRESS 0x0000 /* @ECU_Address@DfMliaPercObj10Sz@ */ /end MEASUREMENT
/begin MEASUREMENT DfMliaPercObj10Vel "" FLOAT32_IEEE ADAS_CM_single 0 0 0.000000 102.000000 ECU_ADDRESS 0x0000 /* @ECU_Address@DfMliaPercObj10Vel@ */ /end MEASUREMENT
/begin MEASUREMENT DfMliaPercObj11Detect "" UBYTE ADAS_CM_uint8 0 0 0.000000 1.000000 ECU_ADDRESS 0x0000 /* @ECU_Address@DfMliaPercObj11Detect@ */ /end MEASUREMENT
/begin MEASUREMENT DfMliaPercObj11LightSts "" UBYTE ADAS_CM_uint8 0 0 0.000000 1.000000 ECU_ADDRESS 0x0000 /* @ECU_Address@DfMliaPercObj11LightSts@ */ /end MEASUREMENT
/begin MEASUREMENT DfMliaPercObj11Precision "" UBYTE ADAS_CM_uint8 0 0 0.000000 1.000000 ECU_ADDRESS 0x0000 /* @ECU_Address@DfMliaPercObj11Precision@ */ /end MEASUREMENT
/begin MEASUREMENT DfMliaPercObj11Sx1 "" FLOAT32_IEEE ADAS_CM_single 0 0 0.000000 500.000000 ECU_ADDRESS 0x0000 /* @ECU_Address@DfMliaPercObj11Sx1@ */ /end MEASUREMENT
/begin MEASUREMENT DfMliaPercObj11Sx2 "" FLOAT32_IEEE ADAS_CM_single 0 0 0.000000 500.000000 ECU_ADDRESS 0x0000 /* @ECU_Address@DfMliaPercObj11Sx2@ */ /end MEASUREMENT
/begin MEASUREMENT DfMliaPercObj11Sy1 "" FLOAT32_IEEE ADAS_CM_single 0 0 -290.000000 290.000000 ECU_ADDRESS 0x0000 /* @ECU_Address@DfMliaPercObj11Sy1@ */ /end MEASUREMENT
/begin MEASUREMENT DfMliaPercObj11Sy2 "" FLOAT32_IEEE ADAS_CM_single 0 0 -290.000000 290.000000 ECU_ADDRESS 0x0000 /* @ECU_Address@DfMliaPercObj11Sy2@ */ /end MEASUREMENT
/begin MEASUREMENT DfMliaPercObj11Sz "" FLOAT32_IEEE ADAS_CM_single 0 0 -50.000000 50.000000 ECU_ADDRESS 0x0000 /* @ECU_Address@DfMliaPercObj11Sz@ */ /end MEASUREMENT
/begin MEASUREMENT DfMliaPercObj11Vel "" FLOAT32_IEEE ADAS_CM_single 0 0 0.000000 102.000000 ECU_ADDRESS 0x0000 /* @ECU_Address@DfMliaPercObj11Vel@ */ /end MEASUREMENT
/begin MEASUREMENT DfMliaPercObj12Detect "" UBYTE ADAS_CM_uint8 0 0 0.000000 1.000000 ECU_ADDRESS 0x0000 /* @ECU_Address@DfMliaPercObj12Detect@ */ /end MEASUREMENT
/begin MEASUREMENT DfMliaPercObj12LightSts "" UBYTE ADAS_CM_uint8 0 0 0.000000 1.000000 ECU_ADDRESS 0x0000 /* @ECU_Address@DfMliaPercObj12LightSts@ */ /end MEASUREMENT
/begin MEASUREMENT DfMliaPercObj12Precision "" UBYTE ADAS_CM_uint8 0 0 0.000000 1.000000 ECU_ADDRESS 0x0000 /* @ECU_Address@DfMliaPercObj12Precision@ */ /end MEASUREMENT
/begin MEASUREMENT DfMliaPercObj12Sx1 "" FLOAT32_IEEE ADAS_CM_single 0 0 0.000000 500.000000 ECU_ADDRESS 0x0000 /* @ECU_Address@DfMliaPercObj12Sx1@ */ /end MEASUREMENT
/begin MEASUREMENT DfMliaPercObj12Sx2 "" FLOAT32_IEEE ADAS_CM_single 0 0 0.000000 500.000000 ECU_ADDRESS 0x0000 /* @ECU_Address@DfMliaPercObj12Sx2@ */ /end MEASUREMENT
/begin MEASUREMENT DfMliaPercObj12Sy1 "" FLOAT32_IEEE ADAS_CM_single 0 0 -290.000000 290.000000 ECU_ADDRESS 0x0000 /* @ECU_Address@DfMliaPercObj12Sy1@ */ /end MEASUREMENT
/begin MEASUREMENT DfMliaPercObj12Sy2 "" FLOAT32_IEEE ADAS_CM_single 0 0 -290.000000 290.000000 ECU_ADDRESS 0x0000 /* @ECU_Address@DfMliaPercObj12Sy2@ */ /end MEASUREMENT
/begin MEASUREMENT DfMliaPercObj12Sz "" FLOAT32_IEEE ADAS_CM_single 0 0 -50.000000 50.000000 ECU_ADDRESS 0x0000 /* @ECU_Address@DfMliaPercObj12Sz@ */ /end MEASUREMENT
/begin MEASUREMENT DfMliaPercObj12Vel "" FLOAT32_IEEE ADAS_CM_single 0 0 0.000000 102.000000 ECU_ADDRESS 0x0000 /* @ECU_Address@DfMliaPercObj12Vel@ */ /end MEASUREMENT
/begin MEASUREMENT DfMliaPercObj13Detect "" UBYTE ADAS_CM_uint8 0 0 0.000000 1.000000 ECU_ADDRESS 0x0000 /* @ECU_Address@DfMliaPercObj13Detect@ */ /end MEASUREMENT
/begin MEASUREMENT DfMliaPercObj13LightSts "" UBYTE ADAS_CM_uint8 0 0 0.000000 1.000000 ECU_ADDRESS 0x0000 /* @ECU_Address@DfMliaPercObj13LightSts@ */ /end MEASUREMENT
/begin MEASUREMENT DfMliaPercObj13Precision "" UBYTE ADAS_CM_uint8 0 0 0.000000 1.000000 ECU_ADDRESS 0x0000 /* @ECU_Address@DfMliaPercObj13Precision@ */ /end MEASUREMENT
/begin MEASUREMENT DfMliaPercObj13Sx1 "" FLOAT32_IEEE ADAS_CM_single 0 0 0.000000 500.000000 ECU_ADDRESS 0x0000 /* @ECU_Address@DfMliaPercObj13Sx1@ */ /end MEASUREMENT
/begin MEASUREMENT DfMliaPercObj13Sx2 "" FLOAT32_IEEE ADAS_CM_single 0 0 0.000000 500.000000 ECU_ADDRESS 0x0000 /* @ECU_Address@DfMliaPercObj13Sx2@ */ /end MEASUREMENT
/begin MEASUREMENT DfMliaPercObj13Sy1 "" FLOAT32_IEEE ADAS_CM_single 0 0 -290.000000 290.000000 ECU_ADDRESS 0x0000 /* @ECU_Address@DfMliaPercObj13Sy1@ */ /end MEASUREMENT
/begin MEASUREMENT DfMliaPercObj13Sy2 "" FLOAT32_IEEE ADAS_CM_single 0 0 -290.000000 290.000000 ECU_ADDRESS 0x0000 /* @ECU_Address@DfMliaPercObj13Sy2@ */ /end MEASUREMENT
/begin MEASUREMENT DfMliaPercObj13Sz "" FLOAT32_IEEE ADAS_CM_single 0 0 -50.000000 50.000000 ECU_ADDRESS 0x0000 /* @ECU_Address@DfMliaPercObj13Sz@ */ /end MEASUREMENT
/begin MEASUREMENT DfMliaPercObj13Vel "" FLOAT32_IEEE ADAS_CM_single 0 0 0.000000 102.000000 ECU_ADDRESS 0x0000 /* @ECU_Address@DfMliaPercObj13Vel@ */ /end MEASUREMENT
/begin MEASUREMENT DfMliaPercObj14Detect "" UBYTE ADAS_CM_uint8 0 0 0.000000 1.000000 ECU_ADDRESS 0x0000 /* @ECU_Address@DfMliaPercObj14Detect@ */ /end MEASUREMENT
/begin MEASUREMENT DfMliaPercObj14LightSts "" UBYTE ADAS_CM_uint8 0 0 0.000000 1.000000 ECU_ADDRESS 0x0000 /* @ECU_Address@DfMliaPercObj14LightSts@ */ /end MEASUREMENT
/begin MEASUREMENT DfMliaPercObj14Precision "" UBYTE ADAS_CM_uint8 0 0 0.000000 1.000000 ECU_ADDRESS 0x0000 /* @ECU_Address@DfMliaPercObj14Precision@ */ /end MEASUREMENT
/begin MEASUREMENT DfMliaPercObj14Sx1 "" FLOAT32_IEEE ADAS_CM_single 0 0 0.000000 500.000000 ECU_ADDRESS 0x0000 /* @ECU_Address@DfMliaPercObj14Sx1@ */ /end MEASUREMENT
/begin MEASUREMENT DfMliaPercObj14Sx2 "" FLOAT32_IEEE ADAS_CM_single 0 0 0.000000 500.000000 ECU_ADDRESS 0x0000 /* @ECU_Address@DfMliaPercObj14Sx2@ */ /end MEASUREMENT
/begin MEASUREMENT DfMliaPercObj14Sy1 "" FLOAT32_IEEE ADAS_CM_single 0 0 -290.000000 290.000000 ECU_ADDRESS 0x0000 /* @ECU_Address@DfMliaPercObj14Sy1@ */ /end MEASUREMENT
/begin MEASUREMENT DfMliaPercObj14Sy2 "" FLOAT32_IEEE ADAS_CM_single 0 0 -290.000000 290.000000 ECU_ADDRESS 0x0000 /* @ECU_Address@DfMliaPercObj14Sy2@ */ /end MEASUREMENT
/begin MEASUREMENT DfMliaPercObj14Sz "" FLOAT32_IEEE ADAS_CM_single 0 0 -50.000000 50.000000 ECU_ADDRESS 0x0000 /* @ECU_Address@DfMliaPercObj14Sz@ */ /end MEASUREMENT
/begin MEASUREMENT DfMliaPercObj14Vel "" FLOAT32_IEEE ADAS_CM_single 0 0 0.000000 102.000000 ECU_ADDRESS 0x0000 /* @ECU_Address@DfMliaPercObj14Vel@ */ /end MEASUREMENT
/begin MEASUREMENT DfMliaPercObj15Detect "" UBYTE ADAS_CM_uint8 0 0 0.000000 1.000000 ECU_ADDRESS 0x0000 /* @ECU_Address@DfMliaPercObj15Detect@ */ /end MEASUREMENT
/begin MEASUREMENT DfMliaPercObj15LightSts "" UBYTE ADAS_CM_uint8 0 0 0.000000 1.000000 ECU_ADDRESS 0x0000 /* @ECU_Address@DfMliaPercObj15LightSts@ */ /end MEASUREMENT
/begin MEASUREMENT DfMliaPercObj15Precision "" UBYTE ADAS_CM_uint8 0 0 0.000000 1.000000 ECU_ADDRESS 0x0000 /* @ECU_Address@DfMliaPercObj15Precision@ */ /end MEASUREMENT
/begin MEASUREMENT DfMliaPercObj15Sx1 "" FLOAT32_IEEE ADAS_CM_single 0 0 0.000000 500.000000 ECU_ADDRESS 0x0000 /* @ECU_Address@DfMliaPercObj15Sx1@ */ /end MEASUREMENT
/begin MEASUREMENT DfMliaPercObj15Sx2 "" FLOAT32_IEEE ADAS_CM_single 0 0 0.000000 500.000000 ECU_ADDRESS 0x0000 /* @ECU_Address@DfMliaPercObj15Sx2@ */ /end MEASUREMENT
/begin MEASUREMENT DfMliaPercObj15Sy1 "" FLOAT32_IEEE ADAS_CM_single 0 0 -290.000000 290.000000 ECU_ADDRESS 0x0000 /* @ECU_Address@DfMliaPercObj15Sy1@ */ /end MEASUREMENT
/begin MEASUREMENT DfMliaPercObj15Sy2 "" FLOAT32_IEEE ADAS_CM_single 0 0 -290.000000 290.000000 ECU_ADDRESS 0x0000 /* @ECU_Address@DfMliaPercObj15Sy2@ */ /end MEASUREMENT
/begin MEASUREMENT DfMliaPercObj15Sz "" FLOAT32_IEEE ADAS_CM_single 0 0 -50.000000 50.000000 ECU_ADDRESS 0x0000 /* @ECU_Address@DfMliaPercObj15Sz@ */ /end MEASUREMENT
/begin MEASUREMENT DfMliaPercObj15Vel "" FLOAT32_IEEE ADAS_CM_single 0 0 0.000000 102.000000 ECU_ADDRESS 0x0000 /* @ECU_Address@DfMliaPercObj15Vel@ */ /end MEASUREMENT
/begin MEASUREMENT DfMliaPercObj16Detect "" UBYTE ADAS_CM_uint8 0 0 0.000000 1.000000 ECU_ADDRESS 0x0000 /* @ECU_Address@DfMliaPercObj16Detect@ */ /end MEASUREMENT
/begin MEASUREMENT DfMliaPercObj16LightSts "" UBYTE ADAS_CM_uint8 0 0 0.000000 1.000000 ECU_ADDRESS 0x0000 /* @ECU_Address@DfMliaPercObj16LightSts@ */ /end MEASUREMENT
/begin MEASUREMENT DfMliaPercObj16Precision "" UBYTE ADAS_CM_uint8 0 0 0.000000 1.000000 ECU_ADDRESS 0x0000 /* @ECU_Address@DfMliaPercObj16Precision@ */ /end MEASUREMENT
/begin MEASUREMENT DfMliaPercObj16Sx1 "" FLOAT32_IEEE ADAS_CM_single 0 0 0.000000 500.000000 ECU_ADDRESS 0x0000 /* @ECU_Address@DfMliaPercObj16Sx1@ */ /end MEASUREMENT
/begin MEASUREMENT DfMliaPercObj16Sx2 "" FLOAT32_IEEE ADAS_CM_single 0 0 0.000000 500.000000 ECU_ADDRESS 0x0000 /* @ECU_Address@DfMliaPercObj16Sx2@ */ /end MEASUREMENT
/begin MEASUREMENT DfMliaPercObj16Sy1 "" FLOAT32_IEEE ADAS_CM_single 0 0 -290.000000 290.000000 ECU_ADDRESS 0x0000 /* @ECU_Address@DfMliaPercObj16Sy1@ */ /end MEASUREMENT
/begin MEASUREMENT DfMliaPercObj16Sy2 "" FLOAT32_IEEE ADAS_CM_single 0 0 -290.000000 290.000000 ECU_ADDRESS 0x0000 /* @ECU_Address@DfMliaPercObj16Sy2@ */ /end MEASUREMENT
/begin MEASUREMENT DfMliaPercObj16Sz "" FLOAT32_IEEE ADAS_CM_single 0 0 -50.000000 50.000000 ECU_ADDRESS 0x0000 /* @ECU_Address@DfMliaPercObj16Sz@ */ /end MEASUREMENT
/begin MEASUREMENT DfMliaPercObj16Vel "" FLOAT32_IEEE ADAS_CM_single 0 0 0.000000 102.000000 ECU_ADDRESS 0x0000 /* @ECU_Address@DfMliaPercObj16Vel@ */ /end MEASUREMENT
/begin MEASUREMENT DfMliaPercObj17Detect "" UBYTE ADAS_CM_uint8 0 0 0.000000 1.000000 ECU_ADDRESS 0x0000 /* @ECU_Address@DfMliaPercObj17Detect@ */ /end MEASUREMENT
/begin MEASUREMENT DfMliaPercObj17LightSts "" UBYTE ADAS_CM_uint8 0 0 0.000000 1.000000 ECU_ADDRESS 0x0000 /* @ECU_Address@DfMliaPercObj17LightSts@ */ /end MEASUREMENT
/begin MEASUREMENT DfMliaPercObj17Precision "" UBYTE ADAS_CM_uint8 0 0 0.000000 1.000000 ECU_ADDRESS 0x0000 /* @ECU_Address@DfMliaPercObj17Precision@ */ /end MEASUREMENT
/begin MEASUREMENT DfMliaPercObj17Sx1 "" FLOAT32_IEEE ADAS_CM_single 0 0 0.000000 500.000000 ECU_ADDRESS 0x0000 /* @ECU_Address@DfMliaPercObj17Sx1@ */ /end MEASUREMENT
/begin MEASUREMENT DfMliaPercObj17Sx2 "" FLOAT32_IEEE ADAS_CM_single 0 0 0.000000 500.000000 ECU_ADDRESS 0x0000 /* @ECU_Address@DfMliaPercObj17Sx2@ */ /end MEASUREMENT
/begin MEASUREMENT DfMliaPercObj17Sy1 "" FLOAT32_IEEE ADAS_CM_single 0 0 -290.000000 290.000000 ECU_ADDRESS 0x0000 /* @ECU_Address@DfMliaPercObj17Sy1@ */ /end MEASUREMENT
/begin MEASUREMENT DfMliaPercObj17Sy2 "" FLOAT32_IEEE ADAS_CM_single 0 0 -290.000000 290.000000 ECU_ADDRESS 0x0000 /* @ECU_Address@DfMliaPercObj17Sy2@ */ /end MEASUREMENT
/begin MEASUREMENT DfMliaPercObj17Sz "" FLOAT32_IEEE ADAS_CM_single 0 0 -50.000000 50.000000 ECU_ADDRESS 0x0000 /* @ECU_Address@DfMliaPercObj17Sz@ */ /end MEASUREMENT
/begin MEASUREMENT DfMliaPercObj17Vel "" FLOAT32_IEEE ADAS_CM_single 0 0 0.000000 102.000000 ECU_ADDRESS 0x0000 /* @ECU_Address@DfMliaPercObj17Vel@ */ /end MEASUREMENT
/begin MEASUREMENT DfMliaPercObj18Detect "" UBYTE ADAS_CM_uint8 0 0 0.000000 1.000000 ECU_ADDRESS 0x0000 /* @ECU_Address@DfMliaPercObj18Detect@ */ /end MEASUREMENT
/begin MEASUREMENT DfMliaPercObj18LightSts "" UBYTE ADAS_CM_uint8 0 0 0.000000 1.000000 ECU_ADDRESS 0x0000 /* @ECU_Address@DfMliaPercObj18LightSts@ */ /end MEASUREMENT
/begin MEASUREMENT DfMliaPercObj18Precision "" UBYTE ADAS_CM_uint8 0 0 0.000000 1.000000 ECU_ADDRESS 0x0000 /* @ECU_Address@DfMliaPercObj18Precision@ */ /end MEASUREMENT
/begin MEASUREMENT DfMliaPercObj18Sx1 "" FLOAT32_IEEE ADAS_CM_single 0 0 0.000000 500.000000 ECU_ADDRESS 0x0000 /* @ECU_Address@DfMliaPercObj18Sx1@ */ /end MEASUREMENT
/begin MEASUREMENT DfMliaPercObj18Sx2 "" FLOAT32_IEEE ADAS_CM_single 0 0 0.000000 500.000000 ECU_ADDRESS 0x0000 /* @ECU_Address@DfMliaPercObj18Sx2@ */ /end MEASUREMENT
/begin MEASUREMENT DfMliaPercObj18Sy1 "" FLOAT32_IEEE ADAS_CM_single 0 0 -290.000000 290.000000 ECU_ADDRESS 0x0000 /* @ECU_Address@DfMliaPercObj18Sy1@ */ /end MEASUREMENT
/begin MEASUREMENT DfMliaPercObj18Sy2 "" FLOAT32_IEEE ADAS_CM_single 0 0 -290.000000 290.000000 ECU_ADDRESS 0x0000 /* @ECU_Address@DfMliaPercObj18Sy2@ */ /end MEASUREMENT
/begin MEASUREMENT DfMliaPercObj18Sz "" FLOAT32_IEEE ADAS_CM_single 0 0 -50.000000 50.000000 ECU_ADDRESS 0x0000 /* @ECU_Address@DfMliaPercObj18Sz@ */ /end MEASUREMENT
/begin MEASUREMENT DfMliaPercObj18Vel "" FLOAT32_IEEE ADAS_CM_single 0 0 0.000000 102.000000 ECU_ADDRESS 0x0000 /* @ECU_Address@DfMliaPercObj18Vel@ */ /end MEASUREMENT
/begin MEASUREMENT DfMliaPercObj19Detect "" UBYTE ADAS_CM_uint8 0 0 0.000000 1.000000 ECU_ADDRESS 0x0000 /* @ECU_Address@DfMliaPercObj19Detect@ */ /end MEASUREMENT
/begin MEASUREMENT DfMliaPercObj19LightSts "" UBYTE ADAS_CM_uint8 0 0 0.000000 1.000000 ECU_ADDRESS 0x0000 /* @ECU_Address@DfMliaPercObj19LightSts@ */ /end MEASUREMENT
/begin MEASUREMENT DfMliaPercObj19Precision "" UBYTE ADAS_CM_uint8 0 0 0.000000 1.000000 ECU_ADDRESS 0x0000 /* @ECU_Address@DfMliaPercObj19Precision@ */ /end MEASUREMENT
/begin MEASUREMENT DfMliaPercObj19Sx1 "" FLOAT32_IEEE ADAS_CM_single 0 0 0.000000 500.000000 ECU_ADDRESS 0x0000 /* @ECU_Address@DfMliaPercObj19Sx1@ */ /end MEASUREMENT
/begin MEASUREMENT DfMliaPercObj19Sx2 "" FLOAT32_IEEE ADAS_CM_single 0 0 0.000000 500.000000 ECU_ADDRESS 0x0000 /* @ECU_Address@DfMliaPercObj19Sx2@ */ /end MEASUREMENT
/begin MEASUREMENT DfMliaPercObj19Sy1 "" FLOAT32_IEEE ADAS_CM_single 0 0 -290.000000 290.000000 ECU_ADDRESS 0x0000 /* @ECU_Address@DfMliaPercObj19Sy1@ */ /end MEASUREMENT
/begin MEASUREMENT DfMliaPercObj19Sy2 "" FLOAT32_IEEE ADAS_CM_single 0 0 -290.000000 290.000000 ECU_ADDRESS 0x0000 /* @ECU_Address@DfMliaPercObj19Sy2@ */ /end MEASUREMENT
/begin MEASUREMENT DfMliaPercObj19Sz "" FLOAT32_IEEE ADAS_CM_single 0 0 -50.000000 50.000000 ECU_ADDRESS 0x0000 /* @ECU_Address@DfMliaPercObj19Sz@ */ /end MEASUREMENT
/begin MEASUREMENT DfMliaPercObj19Vel "" FLOAT32_IEEE ADAS_CM_single 0 0 0.000000 102.000000 ECU_ADDRESS 0x0000 /* @ECU_Address@DfMliaPercObj19Vel@ */ /end MEASUREMENT
/begin MEASUREMENT DfMliaPercObj1Detect "" UBYTE ADAS_CM_uint8 0 0 0.000000 1.000000 ECU_ADDRESS 0x0000 /* @ECU_Address@DfMliaPercObj1Detect@ */ /end MEASUREMENT
/begin MEASUREMENT DfMliaPercObj1LightSts "" UBYTE ADAS_CM_uint8 0 0 0.000000 1.000000 ECU_ADDRESS 0x0000 /* @ECU_Address@DfMliaPercObj1LightSts@ */ /end MEASUREMENT
/begin MEASUREMENT DfMliaPercObj1Precision "" UBYTE ADAS_CM_uint8 0 0 0.000000 1.000000 ECU_ADDRESS 0x0000 /* @ECU_Address@DfMliaPercObj1Precision@ */ /end MEASUREMENT
/begin MEASUREMENT DfMliaPercObj1Sx1 "" FLOAT32_IEEE ADAS_CM_single 0 0 0.000000 500.000000 ECU_ADDRESS 0x0000 /* @ECU_Address@DfMliaPercObj1Sx1@ */ /end MEASUREMENT
/begin MEASUREMENT DfMliaPercObj1Sx2 "" FLOAT32_IEEE ADAS_CM_single 0 0 0.000000 500.000000 ECU_ADDRESS 0x0000 /* @ECU_Address@DfMliaPercObj1Sx2@ */ /end MEASUREMENT
/begin MEASUREMENT DfMliaPercObj1Sy1 "" FLOAT32_IEEE ADAS_CM_single 0 0 -290.000000 290.000000 ECU_ADDRESS 0x0000 /* @ECU_Address@DfMliaPercObj1Sy1@ */ /end MEASUREMENT
/begin MEASUREMENT DfMliaPercObj1Sy2 "" FLOAT32_IEEE ADAS_CM_single 0 0 -290.000000 290.000000 ECU_ADDRESS 0x0000 /* @ECU_Address@DfMliaPercObj1Sy2@ */ /end MEASUREMENT
/begin MEASUREMENT DfMliaPercObj1Sz "" FLOAT32_IEEE ADAS_CM_single 0 0 -50.000000 50.000000 ECU_ADDRESS 0x0000 /* @ECU_Address@DfMliaPercObj1Sz@ */ /end MEASUREMENT
/begin MEASUREMENT DfMliaPercObj1Vel "" FLOAT32_IEEE ADAS_CM_single 0 0 0.000000 102.000000 ECU_ADDRESS 0x0000 /* @ECU_Address@DfMliaPercObj1Vel@ */ /end MEASUREMENT
/begin MEASUREMENT DfMliaPercObj20Detect "" UBYTE ADAS_CM_uint8 0 0 0.000000 1.000000 ECU_ADDRESS 0x0000 /* @ECU_Address@DfMliaPercObj20Detect@ */ /end MEASUREMENT
/begin MEASUREMENT DfMliaPercObj20LightSts "" UBYTE ADAS_CM_uint8 0 0 0.000000 1.000000 ECU_ADDRESS 0x0000 /* @ECU_Address@DfMliaPercObj20LightSts@ */ /end MEASUREMENT
/begin MEASUREMENT DfMliaPercObj20Precision "" UBYTE ADAS_CM_uint8 0 0 0.000000 1.000000 ECU_ADDRESS 0x0000 /* @ECU_Address@DfMliaPercObj20Precision@ */ /end MEASUREMENT
/begin MEASUREMENT DfMliaPercObj20Sx1 "" FLOAT32_IEEE ADAS_CM_single 0 0 0.000000 500.000000 ECU_ADDRESS 0x0000 /* @ECU_Address@DfMliaPercObj20Sx1@ */ /end MEASUREMENT
/begin MEASUREMENT DfMliaPercObj20Sx2 "" FLOAT32_IEEE ADAS_CM_single 0 0 0.000000 500.000000 ECU_ADDRESS 0x0000 /* @ECU_Address@DfMliaPercObj20Sx2@ */ /end MEASUREMENT
/begin MEASUREMENT DfMliaPercObj20Sy1 "" FLOAT32_IEEE ADAS_CM_single 0 0 -290.000000 290.000000 ECU_ADDRESS 0x0000 /* @ECU_Address@DfMliaPercObj20Sy1@ */ /end MEASUREMENT
/begin MEASUREMENT DfMliaPercObj20Sy2 "" FLOAT32_IEEE ADAS_CM_single 0 0 -290.000000 290.000000 ECU_ADDRESS 0x0000 /* @ECU_Address@DfMliaPercObj20Sy2@ */ /end MEASUREMENT
/begin MEASUREMENT DfMliaPercObj20Sz "" FLOAT32_IEEE ADAS_CM_single 0 0 -50.000000 50.000000 ECU_ADDRESS 0x0000 /* @ECU_Address@DfMliaPercObj20Sz@ */ /end MEASUREMENT
/begin MEASUREMENT DfMliaPercObj20Vel "" FLOAT32_IEEE ADAS_CM_single 0 0 0.000000 102.000000 ECU_ADDRESS 0x0000 /* @ECU_Address@DfMliaPercObj20Vel@ */ /end MEASUREMENT
/begin MEASUREMENT DfMliaPercObj21Detect "" UBYTE ADAS_CM_uint8 0 0 0.000000 1.000000 ECU_ADDRESS 0x0000 /* @ECU_Address@DfMliaPercObj21Detect@ */ /end MEASUREMENT
/begin MEASUREMENT DfMliaPercObj21LightSts "" UBYTE ADAS_CM_uint8 0 0 0.000000 1.000000 ECU_ADDRESS 0x0000 /* @ECU_Address@DfMliaPercObj21LightSts@ */ /end MEASUREMENT
/begin MEASUREMENT DfMliaPercObj21Precision "" UBYTE ADAS_CM_uint8 0 0 0.000000 1.000000 ECU_ADDRESS 0x0000 /* @ECU_Address@DfMliaPercObj21Precision@ */ /end MEASUREMENT
/begin MEASUREMENT DfMliaPercObj21Sx1 "" FLOAT32_IEEE ADAS_CM_single 0 0 0.000000 500.000000 ECU_ADDRESS 0x0000 /* @ECU_Address@DfMliaPercObj21Sx1@ */ /end MEASUREMENT
/begin MEASUREMENT DfMliaPercObj21Sx2 "" FLOAT32_IEEE ADAS_CM_single 0 0 0.000000 500.000000 ECU_ADDRESS 0x0000 /* @ECU_Address@DfMliaPercObj21Sx2@ */ /end MEASUREMENT
/begin MEASUREMENT DfMliaPercObj21Sy1 "" FLOAT32_IEEE ADAS_CM_single 0 0 -290.000000 290.000000 ECU_ADDRESS 0x0000 /* @ECU_Address@DfMliaPercObj21Sy1@ */ /end MEASUREMENT
/begin MEASUREMENT DfMliaPercObj21Sy2 "" FLOAT32_IEEE ADAS_CM_single 0 0 -290.000000 290.000000 ECU_ADDRESS 0x0000 /* @ECU_Address@DfMliaPercObj21Sy2@ */ /end MEASUREMENT
/begin MEASUREMENT DfMliaPercObj21Sz "" FLOAT32_IEEE ADAS_CM_single 0 0 -50.000000 50.000000 ECU_ADDRESS 0x0000 /* @ECU_Address@DfMliaPercObj21Sz@ */ /end MEASUREMENT
/begin MEASUREMENT DfMliaPercObj21Vel "" FLOAT32_IEEE ADAS_CM_single 0 0 0.000000 102.000000 ECU_ADDRESS 0x0000 /* @ECU_Address@DfMliaPercObj21Vel@ */ /end MEASUREMENT
/begin MEASUREMENT DfMliaPercObj2Detect "" UBYTE ADAS_CM_uint8 0 0 0.000000 1.000000 ECU_ADDRESS 0x0000 /* @ECU_Address@DfMliaPercObj2Detect@ */ /end MEASUREMENT
/begin MEASUREMENT DfMliaPercObj2LightSts "" UBYTE ADAS_CM_uint8 0 0 0.000000 1.000000 ECU_ADDRESS 0x0000 /* @ECU_Address@DfMliaPercObj2LightSts@ */ /end MEASUREMENT
/begin MEASUREMENT DfMliaPercObj2Precision "" UBYTE ADAS_CM_uint8 0 0 0.000000 1.000000 ECU_ADDRESS 0x0000 /* @ECU_Address@DfMliaPercObj2Precision@ */ /end MEASUREMENT
/begin MEASUREMENT DfMliaPercObj2Sx1 "" FLOAT32_IEEE ADAS_CM_single 0 0 0.000000 500.000000 ECU_ADDRESS 0x0000 /* @ECU_Address@DfMliaPercObj2Sx1@ */ /end MEASUREMENT
/begin MEASUREMENT DfMliaPercObj2Sx2 "" FLOAT32_IEEE ADAS_CM_single 0 0 0.000000 500.000000 ECU_ADDRESS 0x0000 /* @ECU_Address@DfMliaPercObj2Sx2@ */ /end MEASUREMENT
/begin MEASUREMENT DfMliaPercObj2Sy1 "" FLOAT32_IEEE ADAS_CM_single 0 0 -290.000000 290.000000 ECU_ADDRESS 0x0000 /* @ECU_Address@DfMliaPercObj2Sy1@ */ /end MEASUREMENT
/begin MEASUREMENT DfMliaPercObj2Sy2 "" FLOAT32_IEEE ADAS_CM_single 0 0 -290.000000 290.000000 ECU_ADDRESS 0x0000 /* @ECU_Address@DfMliaPercObj2Sy2@ */ /end MEASUREMENT
/begin MEASUREMENT DfMliaPercObj2Sz "" FLOAT32_IEEE ADAS_CM_single 0 0 -50.000000 50.000000 ECU_ADDRESS 0x0000 /* @ECU_Address@DfMliaPercObj2Sz@ */ /end MEASUREMENT
/begin MEASUREMENT DfMliaPercObj2Vel "" FLOAT32_IEEE ADAS_CM_single 0 0 0.000000 102.000000 ECU_ADDRESS 0x0000 /* @ECU_Address@DfMliaPercObj2Vel@ */ /end MEASUREMENT
/begin MEASUREMENT DfMliaPercObj3Detect "" UBYTE ADAS_CM_uint8 0 0 0.000000 1.000000 ECU_ADDRESS 0x0000 /* @ECU_Address@DfMliaPercObj3Detect@ */ /end MEASUREMENT
/begin MEASUREMENT DfMliaPercObj3LightSts "" UBYTE ADAS_CM_uint8 0 0 0.000000 1.000000 ECU_ADDRESS 0x0000 /* @ECU_Address@DfMliaPercObj3LightSts@ */ /end MEASUREMENT
/begin MEASUREMENT DfMliaPercObj3Precision "" UBYTE ADAS_CM_uint8 0 0 0.000000 1.000000 ECU_ADDRESS 0x0000 /* @ECU_Address@DfMliaPercObj3Precision@ */ /end MEASUREMENT
/begin MEASUREMENT DfMliaPercObj3Sx1 "" FLOAT32_IEEE ADAS_CM_single 0 0 0.000000 500.000000 ECU_ADDRESS 0x0000 /* @ECU_Address@DfMliaPercObj3Sx1@ */ /end MEASUREMENT
/begin MEASUREMENT DfMliaPercObj3Sx2 "" FLOAT32_IEEE ADAS_CM_single 0 0 0.000000 500.000000 ECU_ADDRESS 0x0000 /* @ECU_Address@DfMliaPercObj3Sx2@ */ /end MEASUREMENT
/begin MEASUREMENT DfMliaPercObj3Sy1 "" FLOAT32_IEEE ADAS_CM_single 0 0 -290.000000 290.000000 ECU_ADDRESS 0x0000 /* @ECU_Address@DfMliaPercObj3Sy1@ */ /end MEASUREMENT
/begin MEASUREMENT DfMliaPercObj3Sy2 "" FLOAT32_IEEE ADAS_CM_single 0 0 -290.000000 290.000000 ECU_ADDRESS 0x0000 /* @ECU_Address@DfMliaPercObj3Sy2@ */ /end MEASUREMENT
/begin MEASUREMENT DfMliaPercObj3Sz "" FLOAT32_IEEE ADAS_CM_single 0 0 -50.000000 50.000000 ECU_ADDRESS 0x0000 /* @ECU_Address@DfMliaPercObj3Sz@ */ /end MEASUREMENT
/begin MEASUREMENT DfMliaPercObj3Vel "" FLOAT32_IEEE ADAS_CM_single 0 0 0.000000 102.000000 ECU_ADDRESS 0x0000 /* @ECU_Address@DfMliaPercObj3Vel@ */ /end MEASUREMENT
/begin MEASUREMENT DfMliaPercObj4Detect "" UBYTE ADAS_CM_uint8 0 0 0.000000 1.000000 ECU_ADDRESS 0x0000 /* @ECU_Address@DfMliaPercObj4Detect@ */ /end MEASUREMENT
/begin MEASUREMENT DfMliaPercObj4LightSts "" UBYTE ADAS_CM_uint8 0 0 0.000000 1.000000 ECU_ADDRESS 0x0000 /* @ECU_Address@DfMliaPercObj4LightSts@ */ /end MEASUREMENT
/begin MEASUREMENT DfMliaPercObj4Precision "" UBYTE ADAS_CM_uint8 0 0 0.000000 1.000000 ECU_ADDRESS 0x0000 /* @ECU_Address@DfMliaPercObj4Precision@ */ /end MEASUREMENT
/begin MEASUREMENT DfMliaPercObj4Sx1 "" FLOAT32_IEEE ADAS_CM_single 0 0 0.000000 500.000000 ECU_ADDRESS 0x0000 /* @ECU_Address@DfMliaPercObj4Sx1@ */ /end MEASUREMENT
/begin MEASUREMENT DfMliaPercObj4Sx2 "" FLOAT32_IEEE ADAS_CM_single 0 0 0.000000 500.000000 ECU_ADDRESS 0x0000 /* @ECU_Address@DfMliaPercObj4Sx2@ */ /end MEASUREMENT
/begin MEASUREMENT DfMliaPercObj4Sy1 "" FLOAT32_IEEE ADAS_CM_single 0 0 -290.000000 290.000000 ECU_ADDRESS 0x0000 /* @ECU_Address@DfMliaPercObj4Sy1@ */ /end MEASUREMENT
/begin MEASUREMENT DfMliaPercObj4Sy2 "" FLOAT32_IEEE ADAS_CM_single 0 0 -290.000000 290.000000 ECU_ADDRESS 0x0000 /* @ECU_Address@DfMliaPercObj4Sy2@ */ /end MEASUREMENT
/begin MEASUREMENT DfMliaPercObj4Sz "" FLOAT32_IEEE ADAS_CM_single 0 0 -50.000000 50.000000 ECU_ADDRESS 0x0000 /* @ECU_Address@DfMliaPercObj4Sz@ */ /end MEASUREMENT
/begin MEASUREMENT DfMliaPercObj4Vel "" FLOAT32_IEEE ADAS_CM_single 0 0 0.000000 102.000000 ECU_ADDRESS 0x0000 /* @ECU_Address@DfMliaPercObj4Vel@ */ /end MEASUREMENT
/begin MEASUREMENT DfMliaPercObj5Detect "" UBYTE ADAS_CM_uint8 0 0 0.000000 1.000000 ECU_ADDRESS 0x0000 /* @ECU_Address@DfMliaPercObj5Detect@ */ /end MEASUREMENT
/begin MEASUREMENT DfMliaPercObj5LightSts "" UBYTE ADAS_CM_uint8 0 0 0.000000 1.000000 ECU_ADDRESS 0x0000 /* @ECU_Address@DfMliaPercObj5LightSts@ */ /end MEASUREMENT
/begin MEASUREMENT DfMliaPercObj5Precision "" UBYTE ADAS_CM_uint8 0 0 0.000000 1.000000 ECU_ADDRESS 0x0000 /* @ECU_Address@DfMliaPercObj5Precision@ */ /end MEASUREMENT
/begin MEASUREMENT DfMliaPercObj5Sx1 "" FLOAT32_IEEE ADAS_CM_single 0 0 0.000000 500.000000 ECU_ADDRESS 0x0000 /* @ECU_Address@DfMliaPercObj5Sx1@ */ /end MEASUREMENT
/begin MEASUREMENT DfMliaPercObj5Sx2 "" FLOAT32_IEEE ADAS_CM_single 0 0 0.000000 500.000000 ECU_ADDRESS 0x0000 /* @ECU_Address@DfMliaPercObj5Sx2@ */ /end MEASUREMENT
/begin MEASUREMENT DfMliaPercObj5Sy1 "" FLOAT32_IEEE ADAS_CM_single 0 0 -290.000000 290.000000 ECU_ADDRESS 0x0000 /* @ECU_Address@DfMliaPercObj5Sy1@ */ /end MEASUREMENT
/begin MEASUREMENT DfMliaPercObj5Sy2 "" FLOAT32_IEEE ADAS_CM_single 0 0 -290.000000 290.000000 ECU_ADDRESS 0x0000 /* @ECU_Address@DfMliaPercObj5Sy2@ */ /end MEASUREMENT
/begin MEASUREMENT DfMliaPercObj5Sz "" FLOAT32_IEEE ADAS_CM_single 0 0 -50.000000 50.000000 ECU_ADDRESS 0x0000 /* @ECU_Address@DfMliaPercObj5Sz@ */ /end MEASUREMENT
/begin MEASUREMENT DfMliaPercObj5Vel "" FLOAT32_IEEE ADAS_CM_single 0 0 0.000000 102.000000 ECU_ADDRESS 0x0000 /* @ECU_Address@DfMliaPercObj5Vel@ */ /end MEASUREMENT
/begin MEASUREMENT DfMliaPercObj6Detect "" UBYTE ADAS_CM_uint8 0 0 0.000000 1.000000 ECU_ADDRESS 0x0000 /* @ECU_Address@DfMliaPercObj6Detect@ */ /end MEASUREMENT
/begin MEASUREMENT DfMliaPercObj6LightSts "" UBYTE ADAS_CM_uint8 0 0 0.000000 1.000000 ECU_ADDRESS 0x0000 /* @ECU_Address@DfMliaPercObj6LightSts@ */ /end MEASUREMENT
/begin MEASUREMENT DfMliaPercObj6Precision "" UBYTE ADAS_CM_uint8 0 0 0.000000 1.000000 ECU_ADDRESS 0x0000 /* @ECU_Address@DfMliaPercObj6Precision@ */ /end MEASUREMENT
/begin MEASUREMENT DfMliaPercObj6Sx1 "" FLOAT32_IEEE ADAS_CM_single 0 0 0.000000 500.000000 ECU_ADDRESS 0x0000 /* @ECU_Address@DfMliaPercObj6Sx1@ */ /end MEASUREMENT
/begin MEASUREMENT DfMliaPercObj6Sx2 "" FLOAT32_IEEE ADAS_CM_single 0 0 0.000000 500.000000 ECU_ADDRESS 0x0000 /* @ECU_Address@DfMliaPercObj6Sx2@ */ /end MEASUREMENT
/begin MEASUREMENT DfMliaPercObj6Sy1 "" FLOAT32_IEEE ADAS_CM_single 0 0 -290.000000 290.000000 ECU_ADDRESS 0x0000 /* @ECU_Address@DfMliaPercObj6Sy1@ */ /end MEASUREMENT
/begin MEASUREMENT DfMliaPercObj6Sy2 "" FLOAT32_IEEE ADAS_CM_single 0 0 -290.000000 290.000000 ECU_ADDRESS 0x0000 /* @ECU_Address@DfMliaPercObj6Sy2@ */ /end MEASUREMENT
/begin MEASUREMENT DfMliaPercObj6Sz "" FLOAT32_IEEE ADAS_CM_single 0 0 -50.000000 50.000000 ECU_ADDRESS 0x0000 /* @ECU_Address@DfMliaPercObj6Sz@ */ /end MEASUREMENT
/begin MEASUREMENT DfMliaPercObj6Vel "" FLOAT32_IEEE ADAS_CM_single 0 0 0.000000 102.000000 ECU_ADDRESS 0x0000 /* @ECU_Address@DfMliaPercObj6Vel@ */ /end MEASUREMENT
/begin MEASUREMENT DfMliaPercObj7Detect "" UBYTE ADAS_CM_uint8 0 0 0.000000 1.000000 ECU_ADDRESS 0x0000 /* @ECU_Address@DfMliaPercObj7Detect@ */ /end MEASUREMENT
/begin MEASUREMENT DfMliaPercObj7LightSts "" UBYTE ADAS_CM_uint8 0 0 0.000000 1.000000 ECU_ADDRESS 0x0000 /* @ECU_Address@DfMliaPercObj7LightSts@ */ /end MEASUREMENT
/begin MEASUREMENT DfMliaPercObj7Precision "" UBYTE ADAS_CM_uint8 0 0 0.000000 1.000000 ECU_ADDRESS 0x0000 /* @ECU_Address@DfMliaPercObj7Precision@ */ /end MEASUREMENT
/begin MEASUREMENT DfMliaPercObj7Sx1 "" FLOAT32_IEEE ADAS_CM_single 0 0 0.000000 500.000000 ECU_ADDRESS 0x0000 /* @ECU_Address@DfMliaPercObj7Sx1@ */ /end MEASUREMENT
/begin MEASUREMENT DfMliaPercObj7Sx2 "" FLOAT32_IEEE ADAS_CM_single 0 0 0.000000 500.000000 ECU_ADDRESS 0x0000 /* @ECU_Address@DfMliaPercObj7Sx2@ */ /end MEASUREMENT
/begin MEASUREMENT DfMliaPercObj7Sy1 "" FLOAT32_IEEE ADAS_CM_single 0 0 -290.000000 290.000000 ECU_ADDRESS 0x0000 /* @ECU_Address@DfMliaPercObj7Sy1@ */ /end MEASUREMENT
/begin MEASUREMENT DfMliaPercObj7Sy2 "" FLOAT32_IEEE ADAS_CM_single 0 0 -290.000000 290.000000 ECU_ADDRESS 0x0000 /* @ECU_Address@DfMliaPercObj7Sy2@ */ /end MEASUREMENT
/begin MEASUREMENT DfMliaPercObj7Sz "" FLOAT32_IEEE ADAS_CM_single 0 0 -50.000000 50.000000 ECU_ADDRESS 0x0000 /* @ECU_Address@DfMliaPercObj7Sz@ */ /end MEASUREMENT
/begin MEASUREMENT DfMliaPercObj7Vel "" FLOAT32_IEEE ADAS_CM_single 0 0 0.000000 102.000000 ECU_ADDRESS 0x0000 /* @ECU_Address@DfMliaPercObj7Vel@ */ /end MEASUREMENT
/begin MEASUREMENT DfMliaPercObj8Detect "" UBYTE ADAS_CM_uint8 0 0 0.000000 1.000000 ECU_ADDRESS 0x0000 /* @ECU_Address@DfMliaPercObj8Detect@ */ /end MEASUREMENT
/begin MEASUREMENT DfMliaPercObj8LightSts "" UBYTE ADAS_CM_uint8 0 0 0.000000 1.000000 ECU_ADDRESS 0x0000 /* @ECU_Address@DfMliaPercObj8LightSts@ */ /end MEASUREMENT
/begin MEASUREMENT DfMliaPercObj8Precision "" UBYTE ADAS_CM_uint8 0 0 0.000000 1.000000 ECU_ADDRESS 0x0000 /* @ECU_Address@DfMliaPercObj8Precision@ */ /end MEASUREMENT
/begin MEASUREMENT DfMliaPercObj8Sx1 "" FLOAT32_IEEE ADAS_CM_single 0 0 0.000000 500.000000 ECU_ADDRESS 0x0000 /* @ECU_Address@DfMliaPercObj8Sx1@ */ /end MEASUREMENT
/begin MEASUREMENT DfMliaPercObj8Sx2 "" FLOAT32_IEEE ADAS_CM_single 0 0 0.000000 500.000000 ECU_ADDRESS 0x0000 /* @ECU_Address@DfMliaPercObj8Sx2@ */ /end MEASUREMENT
/begin MEASUREMENT DfMliaPercObj8Sy1 "" FLOAT32_IEEE ADAS_CM_single 0 0 -290.000000 290.000000 ECU_ADDRESS 0x0000 /* @ECU_Address@DfMliaPercObj8Sy1@ */ /end MEASUREMENT
/begin MEASUREMENT DfMliaPercObj8Sy2 "" FLOAT32_IEEE ADAS_CM_single 0 0 -290.000000 290.000000 ECU_ADDRESS 0x0000 /* @ECU_Address@DfMliaPercObj8Sy2@ */ /end MEASUREMENT
/begin MEASUREMENT DfMliaPercObj8Sz "" FLOAT32_IEEE ADAS_CM_single 0 0 -50.000000 50.000000 ECU_ADDRESS 0x0000 /* @ECU_Address@DfMliaPercObj8Sz@ */ /end MEASUREMENT
/begin MEASUREMENT DfMliaPercObj8Vel "" FLOAT32_IEEE ADAS_CM_single 0 0 0.000000 102.000000 ECU_ADDRESS 0x0000 /* @ECU_Address@DfMliaPercObj8Vel@ */ /end MEASUREMENT
/begin MEASUREMENT DfMliaPercObj9Detect "" UBYTE ADAS_CM_uint8 0 0 0.000000 1.000000 ECU_ADDRESS 0x0000 /* @ECU_Address@DfMliaPercObj9Detect@ */ /end MEASUREMENT
/begin MEASUREMENT DfMliaPercObj9LightSts "" UBYTE ADAS_CM_uint8 0 0 0.000000 1.000000 ECU_ADDRESS 0x0000 /* @ECU_Address@DfMliaPercObj9LightSts@ */ /end MEASUREMENT
/begin MEASUREMENT DfMliaPercObj9Precision "" UBYTE ADAS_CM_uint8 0 0 0.000000 1.000000 ECU_ADDRESS 0x0000 /* @ECU_Address@DfMliaPercObj9Precision@ */ /end MEASUREMENT
/begin MEASUREMENT DfMliaPercObj9Sx1 "" FLOAT32_IEEE ADAS_CM_single 0 0 0.000000 500.000000 ECU_ADDRESS 0x0000 /* @ECU_Address@DfMliaPercObj9Sx1@ */ /end MEASUREMENT
/begin MEASUREMENT DfMliaPercObj9Sx2 "" FLOAT32_IEEE ADAS_CM_single 0 0 0.000000 500.000000 ECU_ADDRESS 0x0000 /* @ECU_Address@DfMliaPercObj9Sx2@ */ /end MEASUREMENT
/begin MEASUREMENT DfMliaPercObj9Sy1 "" FLOAT32_IEEE ADAS_CM_single 0 0 -290.000000 290.000000 ECU_ADDRESS 0x0000 /* @ECU_Address@DfMliaPercObj9Sy1@ */ /end MEASUREMENT
/begin MEASUREMENT DfMliaPercObj9Sy2 "" FLOAT32_IEEE ADAS_CM_single 0 0 -290.000000 290.000000 ECU_ADDRESS 0x0000 /* @ECU_Address@DfMliaPercObj9Sy2@ */ /end MEASUREMENT
/begin MEASUREMENT DfMliaPercObj9Sz "" FLOAT32_IEEE ADAS_CM_single 0 0 -50.000000 50.000000 ECU_ADDRESS 0x0000 /* @ECU_Address@DfMliaPercObj9Sz@ */ /end MEASUREMENT
/begin MEASUREMENT DfMliaPercObj9Vel "" FLOAT32_IEEE ADAS_CM_single 0 0 0.000000 102.000000 ECU_ADDRESS 0x0000 /* @ECU_Address@DfMliaPercObj9Vel@ */ /end MEASUREMENT
/begin MEASUREMENT DfMliaPercStreetLightDetect "" UBYTE ADAS_CM_uint8 0 0 0.000000 1.000000 ECU_ADDRESS 0x0000 /* @ECU_Address@DfMliaPercStreetLightDetect@ */ /end MEASUREMENT
/begin MEASUREMENT DfMrrxPercBSD_L_W "" UBYTE ADAS_CM_uint8 0 0 0.000000 2.000000 ECU_ADDRESS 0x0000 /* @ECU_Address@DfMrrxPercBSD_L_W@ */ /end MEASUREMENT
/begin MEASUREMENT DfMrrxPercBSD_R_W "" UBYTE ADAS_CM_uint8 0 0 0.000000 2.000000 ECU_ADDRESS 0x0000 /* @ECU_Address@DfMrrxPercBSD_R_W@ */ /end MEASUREMENT
/begin MEASUREMENT DfMrrxPercDOW_L_W "" UBYTE ADAS_CM_uint8 0 0 0.000000 2.000000 ECU_ADDRESS 0x0000 /* @ECU_Address@DfMrrxPercDOW_L_W@ */ /end MEASUREMENT
/begin MEASUREMENT DfMrrxPercDOW_R_W "" UBYTE ADAS_CM_uint8 0 0 0.000000 2.000000 ECU_ADDRESS 0x0000 /* @ECU_Address@DfMrrxPercDOW_R_W@ */ /end MEASUREMENT
/begin MEASUREMENT DfMrrxPercLCA_L_W "" UBYTE ADAS_CM_uint8 0 0 0.000000 2.000000 ECU_ADDRESS 0x0000 /* @ECU_Address@DfMrrxPercLCA_L_W@ */ /end MEASUREMENT
/begin MEASUREMENT DfMrrxPercLCA_R_W "" UBYTE ADAS_CM_uint8 0 0 0.000000 2.000000 ECU_ADDRESS 0x0000 /* @ECU_Address@DfMrrxPercLCA_R_W@ */ /end MEASUREMENT
/begin MEASUREMENT DfMrrxPercRCTA_L_W "" UBYTE ADAS_CM_uint8 0 0 0.000000 2.000000 ECU_ADDRESS 0x0000 /* @ECU_Address@DfMrrxPercRCTA_L_W@ */ /end MEASUREMENT
/begin MEASUREMENT DfMrrxPercRCTA_R_W "" UBYTE ADAS_CM_uint8 0 0 0.000000 2.000000 ECU_ADDRESS 0x0000 /* @ECU_Address@DfMrrxPercRCTA_R_W@ */ /end MEASUREMENT
/begin MEASUREMENT DfMrrxPercRCTB_L_W "" UBYTE ADAS_CM_uint8 0 0 0.000000 2.000000 ECU_ADDRESS 0x0000 /* @ECU_Address@DfMrrxPercRCTB_L_W@ */ /end MEASUREMENT
/begin MEASUREMENT DfMrrxPercRCTB_R_W "" UBYTE ADAS_CM_uint8 0 0 0.000000 2.000000 ECU_ADDRESS 0x0000 /* @ECU_Address@DfMrrxPercRCTB_R_W@ */ /end MEASUREMENT
/begin MEASUREMENT DfMrrxPercRCW_W "" UBYTE ADAS_CM_uint8 0 0 0.000000 2.000000 ECU_ADDRESS 0x0000 /* @ECU_Address@DfMrrxPercRCW_W@ */ /end MEASUREMENT
/begin MEASUREMENT DfPercFcuDirtSts "" UBYTE ADAS_CM_uint8 0 0 0.000000 1.000000 ECU_ADDRESS 0x0000 /* @ECU_Address@DfPercFcuDirtSts@ */ /end MEASUREMENT
/begin MEASUREMENT DfPercFrcuDirtSts "" UBYTE ADAS_CM_uint8 0 0 0.000000 1.000000 ECU_ADDRESS 0x0000 /* @ECU_Address@DfPercFrcuDirtSts@ */ /end MEASUREMENT
/begin MEASUREMENT DfPercLidarDirtSts "" UBYTE ADAS_CM_uint8 0 0 0.000000 1.000000 ECU_ADDRESS 0x0000 /* @ECU_Address@DfPercLidarDirtSts@ */ /end MEASUREMENT
/begin MEASUREMENT DfPercMrrxDirtSts "" UBYTE ADAS_CM_uint8 0 0 0.000000 1.000000 ECU_ADDRESS 0x0000 /* @ECU_Address@DfPercMrrxDirtSts@ */ /end MEASUREMENT
/begin MEASUREMENT DfPercTicuDirtSts "" UBYTE ADAS_CM_uint8 0 0 0.000000 1.000000 ECU_ADDRESS 0x0000 /* @ECU_Address@DfPercTicuDirtSts@ */ /end MEASUREMENT
/begin MEASUREMENT DfPercValidDataFront "" UBYTE ADAS_CM_uint8 0 0 0.000000 1.000000 ECU_ADDRESS 0x0000 /* @ECU_Address@DfPercValidDataFront@ */ /end MEASUREMENT
/begin MEASUREMENT DfPercValidDataLane "" UBYTE ADAS_CM_uint8 0 0 0.000000 1.000000 ECU_ADDRESS 0x0000 /* @ECU_Address@DfPercValidDataLane@ */ /end MEASUREMENT
/begin MEASUREMENT DfPercValidDataMlia "" UBYTE ADAS_CM_uint8 0 0 0.000000 1.000000 ECU_ADDRESS 0x0000 /* @ECU_Address@DfPercValidDataMlia@ */ /end MEASUREMENT
/begin MEASUREMENT DfPercValidDataRear "" UBYTE ADAS_CM_uint8 0 0 0.000000 1.000000 ECU_ADDRESS 0x0000 /* @ECU_Address@DfPercValidDataRear@ */ /end MEASUREMENT
/begin MEASUREMENT DfPercValidDataSign "" UBYTE ADAS_CM_uint8 0 0 0.000000 1.000000 ECU_ADDRESS 0x0000 /* @ECU_Address@DfPercValidDataSign@ */ /end MEASUREMENT
/begin MEASUREMENT DfRPObj12DynamID "" UBYTE ADAS_CM_uint8 0 0 0.000000 40.000000 ECU_ADDRESS 0x0000 /* @ECU_Address@DfRPObj12DynamID@ */ /end MEASUREMENT
/begin MEASUREMENT DfRPObj12Probabil "" UBYTE ADAS_CM_uint8 0 0 0.000000 100.000000 ECU_ADDRESS 0x0000 /* @ECU_Address@DfRPObj12Probabil@ */ /end MEASUREMENT
/begin MEASUREMENT DfRPObj12Sx1 "" FLOAT32_IEEE ADAS_CM_single 0 0 -204.000000 0.000000 ECU_ADDRESS 0x0000 /* @ECU_Address@DfRPObj12Sx1@ */ /end MEASUREMENT
/begin MEASUREMENT DfRPObj12Sx2 "" FLOAT32_IEEE ADAS_CM_single 0 0 -204.000000 0.000000 ECU_ADDRESS 0x0000 /* @ECU_Address@DfRPObj12Sx2@ */ /end MEASUREMENT
/begin MEASUREMENT DfRPObj12Sy1 "" FLOAT32_IEEE ADAS_CM_single 0 0 -102.000000 102.000000 ECU_ADDRESS 0x0000 /* @ECU_Address@DfRPObj12Sy1@ */ /end MEASUREMENT
/begin MEASUREMENT DfRPObj12Sy2 "" FLOAT32_IEEE ADAS_CM_single 0 0 -102.000000 102.000000 ECU_ADDRESS 0x0000 /* @ECU_Address@DfRPObj12Sy2@ */ /end MEASUREMENT
/begin MEASUREMENT DfRPObj12Vx "" FLOAT32_IEEE ADAS_CM_single 0 0 -102.000000 102.000000 ECU_ADDRESS 0x0000 /* @ECU_Address@DfRPObj12Vx@ */ /end MEASUREMENT
/begin MEASUREMENT DfRPObj12Vy "" FLOAT32_IEEE ADAS_CM_single 0 0 -20.000000 20.000000 ECU_ADDRESS 0x0000 /* @ECU_Address@DfRPObj12Vy@ */ /end MEASUREMENT
/begin MEASUREMENT DfRPObj12detect "" UBYTE ADAS_CM_uint8 0 0 0.000000 1.000000 ECU_ADDRESS 0x0000 /* @ECU_Address@DfRPObj12detect@ */ /end MEASUREMENT
/begin MEASUREMENT DfRPObj13DynamID "" UBYTE ADAS_CM_uint8 0 0 0.000000 40.000000 ECU_ADDRESS 0x0000 /* @ECU_Address@DfRPObj13DynamID@ */ /end MEASUREMENT
/begin MEASUREMENT DfRPObj13Probabil "" UBYTE ADAS_CM_uint8 0 0 0.000000 100.000000 ECU_ADDRESS 0x0000 /* @ECU_Address@DfRPObj13Probabil@ */ /end MEASUREMENT
/begin MEASUREMENT DfRPObj13Sx1 "" FLOAT32_IEEE ADAS_CM_single 0 0 -204.000000 0.000000 ECU_ADDRESS 0x0000 /* @ECU_Address@DfRPObj13Sx1@ */ /end MEASUREMENT
/begin MEASUREMENT DfRPObj13Sx2 "" FLOAT32_IEEE ADAS_CM_single 0 0 -204.000000 0.000000 ECU_ADDRESS 0x0000 /* @ECU_Address@DfRPObj13Sx2@ */ /end MEASUREMENT
/begin MEASUREMENT DfRPObj13Sy1 "" FLOAT32_IEEE ADAS_CM_single 0 0 -102.000000 102.000000 ECU_ADDRESS 0x0000 /* @ECU_Address@DfRPObj13Sy1@ */ /end MEASUREMENT
/begin MEASUREMENT DfRPObj13Sy2 "" FLOAT32_IEEE ADAS_CM_single 0 0 -102.000000 102.000000 ECU_ADDRESS 0x0000 /* @ECU_Address@DfRPObj13Sy2@ */ /end MEASUREMENT
/begin MEASUREMENT DfRPObj13Vx "" FLOAT32_IEEE ADAS_CM_single 0 0 -102.000000 102.000000 ECU_ADDRESS 0x0000 /* @ECU_Address@DfRPObj13Vx@ */ /end MEASUREMENT
/begin MEASUREMENT DfRPObj13Vy "" FLOAT32_IEEE ADAS_CM_single 0 0 -20.000000 20.000000 ECU_ADDRESS 0x0000 /* @ECU_Address@DfRPObj13Vy@ */ /end MEASUREMENT
/begin MEASUREMENT DfRPObj13detect "" UBYTE ADAS_CM_uint8 0 0 0.000000 1.000000 ECU_ADDRESS 0x0000 /* @ECU_Address@DfRPObj13detect@ */ /end MEASUREMENT
/begin MEASUREMENT DfRPObj14DynamID "" UBYTE ADAS_CM_uint8 0 0 0.000000 40.000000 ECU_ADDRESS 0x0000 /* @ECU_Address@DfRPObj14DynamID@ */ /end MEASUREMENT
/begin MEASUREMENT DfRPObj14Probabil "" UBYTE ADAS_CM_uint8 0 0 0.000000 100.000000 ECU_ADDRESS 0x0000 /* @ECU_Address@DfRPObj14Probabil@ */ /end MEASUREMENT
/begin MEASUREMENT DfRPObj14Sx1 "" FLOAT32_IEEE ADAS_CM_single 0 0 -204.000000 0.000000 ECU_ADDRESS 0x0000 /* @ECU_Address@DfRPObj14Sx1@ */ /end MEASUREMENT
/begin MEASUREMENT DfRPObj14Sx2 "" FLOAT32_IEEE ADAS_CM_single 0 0 -204.000000 0.000000 ECU_ADDRESS 0x0000 /* @ECU_Address@DfRPObj14Sx2@ */ /end MEASUREMENT
/begin MEASUREMENT DfRPObj14Sy1 "" FLOAT32_IEEE ADAS_CM_single 0 0 -102.000000 102.000000 ECU_ADDRESS 0x0000 /* @ECU_Address@DfRPObj14Sy1@ */ /end MEASUREMENT
/begin MEASUREMENT DfRPObj14Sy2 "" FLOAT32_IEEE ADAS_CM_single 0 0 -102.000000 102.000000 ECU_ADDRESS 0x0000 /* @ECU_Address@DfRPObj14Sy2@ */ /end MEASUREMENT
/begin MEASUREMENT DfRPObj14Vx "" FLOAT32_IEEE ADAS_CM_single 0 0 -102.000000 102.000000 ECU_ADDRESS 0x0000 /* @ECU_Address@DfRPObj14Vx@ */ /end MEASUREMENT
/begin MEASUREMENT DfRPObj14Vy "" FLOAT32_IEEE ADAS_CM_single 0 0 -20.000000 20.000000 ECU_ADDRESS 0x0000 /* @ECU_Address@DfRPObj14Vy@ */ /end MEASUREMENT
/begin MEASUREMENT DfRPObj14detect "" UBYTE ADAS_CM_uint8 0 0 0.000000 1.000000 ECU_ADDRESS 0x0000 /* @ECU_Address@DfRPObj14detect@ */ /end MEASUREMENT
/begin MEASUREMENT DfRPObj15DynamID "" UBYTE ADAS_CM_uint8 0 0 0.000000 40.000000 ECU_ADDRESS 0x0000 /* @ECU_Address@DfRPObj15DynamID@ */ /end MEASUREMENT
/begin MEASUREMENT DfRPObj15Probabil "" UBYTE ADAS_CM_uint8 0 0 0.000000 100.000000 ECU_ADDRESS 0x0000 /* @ECU_Address@DfRPObj15Probabil@ */ /end MEASUREMENT
/begin MEASUREMENT DfRPObj15Sx1 "" FLOAT32_IEEE ADAS_CM_single 0 0 -204.000000 0.000000 ECU_ADDRESS 0x0000 /* @ECU_Address@DfRPObj15Sx1@ */ /end MEASUREMENT
/begin MEASUREMENT DfRPObj15Sx2 "" FLOAT32_IEEE ADAS_CM_single 0 0 -204.000000 0.000000 ECU_ADDRESS 0x0000 /* @ECU_Address@DfRPObj15Sx2@ */ /end MEASUREMENT
/begin MEASUREMENT DfRPObj15Sy1 "" FLOAT32_IEEE ADAS_CM_single 0 0 -102.000000 102.000000 ECU_ADDRESS 0x0000 /* @ECU_Address@DfRPObj15Sy1@ */ /end MEASUREMENT
/begin MEASUREMENT DfRPObj15Sy2 "" FLOAT32_IEEE ADAS_CM_single 0 0 -102.000000 102.000000 ECU_ADDRESS 0x0000 /* @ECU_Address@DfRPObj15Sy2@ */ /end MEASUREMENT
/begin MEASUREMENT DfRPObj15Vx "" FLOAT32_IEEE ADAS_CM_single 0 0 -102.000000 102.000000 ECU_ADDRESS 0x0000 /* @ECU_Address@DfRPObj15Vx@ */ /end MEASUREMENT
/begin MEASUREMENT DfRPObj15Vy "" FLOAT32_IEEE ADAS_CM_single 0 0 -20.000000 20.000000 ECU_ADDRESS 0x0000 /* @ECU_Address@DfRPObj15Vy@ */ /end MEASUREMENT
/begin MEASUREMENT DfRPObj15detect "" UBYTE ADAS_CM_uint8 0 0 0.000000 1.000000 ECU_ADDRESS 0x0000 /* @ECU_Address@DfRPObj15detect@ */ /end MEASUREMENT
/begin MEASUREMENT DfRPObj16DynamID "" UBYTE ADAS_CM_uint8 0 0 0.000000 40.000000 ECU_ADDRESS 0x0000 /* @ECU_Address@DfRPObj16DynamID@ */ /end MEASUREMENT
/begin MEASUREMENT DfRPObj16Probabil "" UBYTE ADAS_CM_uint8 0 0 0.000000 100.000000 ECU_ADDRESS 0x0000 /* @ECU_Address@DfRPObj16Probabil@ */ /end MEASUREMENT
/begin MEASUREMENT DfRPObj16Sx1 "" FLOAT32_IEEE ADAS_CM_single 0 0 -204.000000 0.000000 ECU_ADDRESS 0x0000 /* @ECU_Address@DfRPObj16Sx1@ */ /end MEASUREMENT
/begin MEASUREMENT DfRPObj16Sx2 "" FLOAT32_IEEE ADAS_CM_single 0 0 -204.000000 0.000000 ECU_ADDRESS 0x0000 /* @ECU_Address@DfRPObj16Sx2@ */ /end MEASUREMENT
/begin MEASUREMENT DfRPObj16Sy1 "" FLOAT32_IEEE ADAS_CM_single 0 0 -102.000000 102.000000 ECU_ADDRESS 0x0000 /* @ECU_Address@DfRPObj16Sy1@ */ /end MEASUREMENT
/begin MEASUREMENT DfRPObj16Sy2 "" FLOAT32_IEEE ADAS_CM_single 0 0 -102.000000 102.000000 ECU_ADDRESS 0x0000 /* @ECU_Address@DfRPObj16Sy2@ */ /end MEASUREMENT
/begin MEASUREMENT DfRPObj16Vx "" FLOAT32_IEEE ADAS_CM_single 0 0 -102.000000 102.000000 ECU_ADDRESS 0x0000 /* @ECU_Address@DfRPObj16Vx@ */ /end MEASUREMENT
/begin MEASUREMENT DfRPObj16Vy "" FLOAT32_IEEE ADAS_CM_single 0 0 -20.000000 20.000000 ECU_ADDRESS 0x0000 /* @ECU_Address@DfRPObj16Vy@ */ /end MEASUREMENT
/begin MEASUREMENT DfRPObj16detect "" UBYTE ADAS_CM_uint8 0 0 0.000000 1.000000 ECU_ADDRESS 0x0000 /* @ECU_Address@DfRPObj16detect@ */ /end MEASUREMENT
/begin MEASUREMENT DfRPObj17DynamID "" UBYTE ADAS_CM_uint8 0 0 0.000000 40.000000 ECU_ADDRESS 0x0000 /* @ECU_Address@DfRPObj17DynamID@ */ /end MEASUREMENT
/begin MEASUREMENT DfRPObj17Probabil "" UBYTE ADAS_CM_uint8 0 0 0.000000 100.000000 ECU_ADDRESS 0x0000 /* @ECU_Address@DfRPObj17Probabil@ */ /end MEASUREMENT
/begin MEASUREMENT DfRPObj17Sx1 "" FLOAT32_IEEE ADAS_CM_single 0 0 -204.000000 0.000000 ECU_ADDRESS 0x0000 /* @ECU_Address@DfRPObj17Sx1@ */ /end MEASUREMENT
/begin MEASUREMENT DfRPObj17Sx2 "" FLOAT32_IEEE ADAS_CM_single 0 0 -204.000000 0.000000 ECU_ADDRESS 0x0000 /* @ECU_Address@DfRPObj17Sx2@ */ /end MEASUREMENT
/begin MEASUREMENT DfRPObj17Sy1 "" FLOAT32_IEEE ADAS_CM_single 0 0 -102.000000 102.000000 ECU_ADDRESS 0x0000 /* @ECU_Address@DfRPObj17Sy1@ */ /end MEASUREMENT
/begin MEASUREMENT DfRPObj17Sy2 "" FLOAT32_IEEE ADAS_CM_single 0 0 -102.000000 102.000000 ECU_ADDRESS 0x0000 /* @ECU_Address@DfRPObj17Sy2@ */ /end MEASUREMENT
/begin MEASUREMENT DfRPObj17Vx "" FLOAT32_IEEE ADAS_CM_single 0 0 -102.000000 102.000000 ECU_ADDRESS 0x0000 /* @ECU_Address@DfRPObj17Vx@ */ /end MEASUREMENT
/begin MEASUREMENT DfRPObj17Vy "" FLOAT32_IEEE ADAS_CM_single 0 0 -20.000000 20.000000 ECU_ADDRESS 0x0000 /* @ECU_Address@DfRPObj17Vy@ */ /end MEASUREMENT
/begin MEASUREMENT DfRPObj17detect "" UBYTE ADAS_CM_uint8 0 0 0.000000 1.000000 ECU_ADDRESS 0x0000 /* @ECU_Address@DfRPObj17detect@ */ /end MEASUREMENT
/begin MEASUREMENT DfRPObj18DynamID "" UBYTE ADAS_CM_uint8 0 0 0.000000 40.000000 ECU_ADDRESS 0x0000 /* @ECU_Address@DfRPObj18DynamID@ */ /end MEASUREMENT
/begin MEASUREMENT DfRPObj18Probabil "" UBYTE ADAS_CM_uint8 0 0 0.000000 100.000000 ECU_ADDRESS 0x0000 /* @ECU_Address@DfRPObj18Probabil@ */ /end MEASUREMENT
/begin MEASUREMENT DfRPObj18Sx1 "" FLOAT32_IEEE ADAS_CM_single 0 0 -204.000000 0.000000 ECU_ADDRESS 0x0000 /* @ECU_Address@DfRPObj18Sx1@ */ /end MEASUREMENT
/begin MEASUREMENT DfRPObj18Sx2 "" FLOAT32_IEEE ADAS_CM_single 0 0 -204.000000 0.000000 ECU_ADDRESS 0x0000 /* @ECU_Address@DfRPObj18Sx2@ */ /end MEASUREMENT
/begin MEASUREMENT DfRPObj18Sy1 "" FLOAT32_IEEE ADAS_CM_single 0 0 -102.000000 102.000000 ECU_ADDRESS 0x0000 /* @ECU_Address@DfRPObj18Sy1@ */ /end MEASUREMENT
/begin MEASUREMENT DfRPObj18Sy2 "" FLOAT32_IEEE ADAS_CM_single 0 0 -102.000000 102.000000 ECU_ADDRESS 0x0000 /* @ECU_Address@DfRPObj18Sy2@ */ /end MEASUREMENT
/begin MEASUREMENT DfRPObj18Vx "" FLOAT32_IEEE ADAS_CM_single 0 0 -102.000000 102.000000 ECU_ADDRESS 0x0000 /* @ECU_Address@DfRPObj18Vx@ */ /end MEASUREMENT
/begin MEASUREMENT DfRPObj18Vy "" FLOAT32_IEEE ADAS_CM_single 0 0 -20.000000 20.000000 ECU_ADDRESS 0x0000 /* @ECU_Address@DfRPObj18Vy@ */ /end MEASUREMENT
/begin MEASUREMENT DfRPObj18detect "" UBYTE ADAS_CM_uint8 0 0 0.000000 1.000000 ECU_ADDRESS 0x0000 /* @ECU_Address@DfRPObj18detect@ */ /end MEASUREMENT
/begin MEASUREMENT DfSignPerc1Color "" UBYTE ADAS_CM_uint8 0 0 0.000000 3.000000 ECU_ADDRESS 0x0000 /* @ECU_Address@DfSignPerc1Color@ */ /end MEASUREMENT
/begin MEASUREMENT DfSignPerc1CurrSpeed "" UBYTE ADAS_CM_uint8 0 0 0.000000 170.000000 ECU_ADDRESS 0x0000 /* @ECU_Address@DfSignPerc1CurrSpeed@ */ /end MEASUREMENT
/begin MEASUREMENT DfSignPerc1Obj_detect "" UBYTE ADAS_CM_uint8 0 0 0.000000 1.000000 ECU_ADDRESS 0x0000 /* @ECU_Address@DfSignPerc1Obj_detect@ */ /end MEASUREMENT
/begin MEASUREMENT DfSignPerc1Sx "" FLOAT32_IEEE ADAS_CM_single 0 0 0.000000 102.000000 ECU_ADDRESS 0x0000 /* @ECU_Address@DfSignPerc1Sx@ */ /end MEASUREMENT
/begin MEASUREMENT DfSignPerc1Sy "" FLOAT32_IEEE ADAS_CM_single 0 0 -31.000000 31.000000 ECU_ADDRESS 0x0000 /* @ECU_Address@DfSignPerc1Sy@ */ /end MEASUREMENT
/begin MEASUREMENT DfSignPerc1Type "" UBYTE ADAS_CM_uint8 0 0 0.000000 15.000000 ECU_ADDRESS 0x0000 /* @ECU_Address@DfSignPerc1Type@ */ /end MEASUREMENT
/begin MEASUREMENT DfSignPerc2Color "" UBYTE ADAS_CM_uint8 0 0 0.000000 3.000000 ECU_ADDRESS 0x0000 /* @ECU_Address@DfSignPerc2Color@ */ /end MEASUREMENT
/begin MEASUREMENT DfSignPerc2CurrSpeed "" UBYTE ADAS_CM_uint8 0 0 0.000000 170.000000 ECU_ADDRESS 0x0000 /* @ECU_Address@DfSignPerc2CurrSpeed@ */ /end MEASUREMENT
/begin MEASUREMENT DfSignPerc2Obj_detect "" UBYTE ADAS_CM_uint8 0 0 0.000000 1.000000 ECU_ADDRESS 0x0000 /* @ECU_Address@DfSignPerc2Obj_detect@ */ /end MEASUREMENT
/begin MEASUREMENT DfSignPerc2Sx "" FLOAT32_IEEE ADAS_CM_single 0 0 0.000000 102.000000 ECU_ADDRESS 0x0000 /* @ECU_Address@DfSignPerc2Sx@ */ /end MEASUREMENT
/begin MEASUREMENT DfSignPerc2Sy "" FLOAT32_IEEE ADAS_CM_single 0 0 -51.000000 51.000000 ECU_ADDRESS 0x0000 /* @ECU_Address@DfSignPerc2Sy@ */ /end MEASUREMENT
/begin MEASUREMENT DfSignPerc2Type "" UBYTE ADAS_CM_uint8 0 0 0.000000 15.000000 ECU_ADDRESS 0x0000 /* @ECU_Address@DfSignPerc2Type@ */ /end MEASUREMENT
/begin MEASUREMENT DfSignPerc3Color "" UBYTE ADAS_CM_uint8 0 0 0.000000 3.000000 ECU_ADDRESS 0x0000 /* @ECU_Address@DfSignPerc3Color@ */ /end MEASUREMENT
/begin MEASUREMENT DfSignPerc3CurrSpeed "" UBYTE ADAS_CM_uint8 0 0 0.000000 170.000000 ECU_ADDRESS 0x0000 /* @ECU_Address@DfSignPerc3CurrSpeed@ */ /end MEASUREMENT
/begin MEASUREMENT DfSignPerc3Obj_detect "" UBYTE ADAS_CM_uint8 0 0 0.000000 1.000000 ECU_ADDRESS 0x0000 /* @ECU_Address@DfSignPerc3Obj_detect@ */ /end MEASUREMENT
/begin MEASUREMENT DfSignPerc3Sx "" FLOAT32_IEEE ADAS_CM_single 0 0 0.000000 102.000000 ECU_ADDRESS 0x0000 /* @ECU_Address@DfSignPerc3Sx@ */ /end MEASUREMENT
/begin MEASUREMENT DfSignPerc3Sy "" FLOAT32_IEEE ADAS_CM_single 0 0 -51.000000 51.000000 ECU_ADDRESS 0x0000 /* @ECU_Address@DfSignPerc3Sy@ */ /end MEASUREMENT
/begin MEASUREMENT DfSignPerc3Type "" UBYTE ADAS_CM_uint8 0 0 0.000000 15.000000 ECU_ADDRESS 0x0000 /* @ECU_Address@DfSignPerc3Type@ */ /end MEASUREMENT
/begin MEASUREMENT DfSignPerc4Color "" UBYTE ADAS_CM_uint8 0 0 0.000000 3.000000 ECU_ADDRESS 0x0000 /* @ECU_Address@DfSignPerc4Color@ */ /end MEASUREMENT
/begin MEASUREMENT DfSignPerc4CurrSpeed "" UBYTE ADAS_CM_uint8 0 0 0.000000 170.000000 ECU_ADDRESS 0x0000 /* @ECU_Address@DfSignPerc4CurrSpeed@ */ /end MEASUREMENT
/begin MEASUREMENT DfSignPerc4Obj_detect "" UBYTE ADAS_CM_uint8 0 0 0.000000 1.000000 ECU_ADDRESS 0x0000 /* @ECU_Address@DfSignPerc4Obj_detect@ */ /end MEASUREMENT
/begin MEASUREMENT DfSignPerc4Sx "" FLOAT32_IEEE ADAS_CM_single 0 0 0.000000 102.000000 ECU_ADDRESS 0x0000 /* @ECU_Address@DfSignPerc4Sx@ */ /end MEASUREMENT
/begin MEASUREMENT DfSignPerc4Sy "" FLOAT32_IEEE ADAS_CM_single 0 0 -51.000000 51.000000 ECU_ADDRESS 0x0000 /* @ECU_Address@DfSignPerc4Sy@ */ /end MEASUREMENT
/begin MEASUREMENT DfSignPerc4Type "" UBYTE ADAS_CM_uint8 0 0 0.000000 15.000000 ECU_ADDRESS 0x0000 /* @ECU_Address@DfSignPerc4Type@ */ /end MEASUREMENT
/begin MEASUREMENT DowMode "" UBYTE ADAS_CM_uint8 0 0 0.000000 1.000000 ECU_ADDRESS 0x0000 /* @ECU_Address@DowMode@ */ /end MEASUREMENT
/begin MEASUREMENT DowNotifError "" UBYTE ADAS_CM_uint8 0 0 0.000000 1.000000 ECU_ADDRESS 0x0000 /* @ECU_Address@DowNotifError@ */ /end MEASUREMENT
/begin MEASUREMENT DtAnalyticAccTimeCity "" FLOAT32_IEEE ADAS_CM_single 0 0 0.000000 65535.000000 ECU_ADDRESS 0x0000 /* @ECU_Address@DtAnalyticAccTimeCity@ */ /end MEASUREMENT
/begin MEASUREMENT DtAnalyticAccTimeHighWay "" FLOAT32_IEEE ADAS_CM_single 0 0 0.000000 65535.000000 ECU_ADDRESS 0x0000 /* @ECU_Address@DtAnalyticAccTimeHighWay@ */ /end MEASUREMENT
/begin MEASUREMENT DtAnalyticAccTimeJam "" FLOAT32_IEEE ADAS_CM_single 0 0 0.000000 65535.000000 ECU_ADDRESS 0x0000 /* @ECU_Address@DtAnalyticAccTimeJam@ */ /end MEASUREMENT
/begin MEASUREMENT DtAnalyticAccTimeMaxDist "" FLOAT32_IEEE ADAS_CM_single 0 0 0.000000 65535.000000 ECU_ADDRESS 0x0000 /* @ECU_Address@DtAnalyticAccTimeMaxDist@ */ /end MEASUREMENT
/begin MEASUREMENT DtAnalyticAccTimeMedDist "" FLOAT32_IEEE ADAS_CM_single 0 0 0.000000 65535.000000 ECU_ADDRESS 0x0000 /* @ECU_Address@DtAnalyticAccTimeMedDist@ */ /end MEASUREMENT
/begin MEASUREMENT DtAnalyticAccTimeMedMaxDist "" FLOAT32_IEEE ADAS_CM_single 0 0 0.000000 65535.000000 ECU_ADDRESS 0x0000 /* @ECU_Address@DtAnalyticAccTimeMedMaxDist@ */ /end MEASUREMENT
/begin MEASUREMENT DtAnalyticAccTimeMinDist "" FLOAT32_IEEE ADAS_CM_single 0 0 0.000000 65535.000000 ECU_ADDRESS 0x0000 /* @ECU_Address@DtAnalyticAccTimeMinDist@ */ /end MEASUREMENT
/begin MEASUREMENT DtAnalyticAebActvnDst "" FLOAT32_IEEE ADAS_CM_single 0 0 0.000000 65535.000000 ECU_ADDRESS 0x0000 /* @ECU_Address@DtAnalyticAebActvnDst@ */ /end MEASUREMENT
/begin MEASUREMENT DtAnalyticAebAvgDistToTar "" FLOAT32_IEEE ADAS_CM_single 0 0 0.000000 65535.000000 ECU_ADDRESS 0x0000 /* @ECU_Address@DtAnalyticAebAvgDistToTar@ */ /end MEASUREMENT
/begin MEASUREMENT DtAnalyticAebNrOfOper "" UBYTE ADAS_CM_uint8 0 0 0.000000 255.000000 ECU_ADDRESS 0x0000 /* @ECU_Address@DtAnalyticAebNrOfOper@ */ /end MEASUREMENT
/begin MEASUREMENT DtAnalyticAlccActvnDst "" FLOAT32_IEEE ADAS_CM_single 0 0 0.000000 65535.000000 ECU_ADDRESS 0x0000 /* @ECU_Address@DtAnalyticAlccActvnDst@ */ /end MEASUREMENT
/begin MEASUREMENT DtAnalyticAlccNrOfOper "" FLOAT32_IEEE ADAS_CM_single 0 0 0.000000 65535.000000 ECU_ADDRESS 0x0000 /* @ECU_Address@DtAnalyticAlccNrOfOper@ */ /end MEASUREMENT
/begin MEASUREMENT DtAnalyticCcTime "" FLOAT32_IEEE ADAS_CM_single 0 0 0.000000 65535.000000 ECU_ADDRESS 0x0000 /* @ECU_Address@DtAnalyticCcTime@ */ /end MEASUREMENT
/begin MEASUREMENT DtAnalyticDowNrOfOper "" FLOAT32_IEEE ADAS_CM_single 0 0 0.000000 65535.000000 ECU_ADDRESS 0x0000 /* @ECU_Address@DtAnalyticDowNrOfOper@ */ /end MEASUREMENT
/begin MEASUREMENT DtAnalyticDowTime "" FLOAT32_IEEE ADAS_CM_single 0 0 0.000000 65535.000000 ECU_ADDRESS 0x0000 /* @ECU_Address@DtAnalyticDowTime@ */ /end MEASUREMENT
/begin MEASUREMENT DtAnalyticFcwActvnDst "" FLOAT32_IEEE ADAS_CM_single 0 0 0.000000 65535.000000 ECU_ADDRESS 0x0000 /* @ECU_Address@DtAnalyticFcwActvnDst@ */ /end MEASUREMENT
/begin MEASUREMENT DtAnalyticFcwNrOfOper "" UBYTE ADAS_CM_uint8 0 0 0.000000 255.000000 ECU_ADDRESS 0x0000 /* @ECU_Address@DtAnalyticFcwNrOfOper@ */ /end MEASUREMENT
/begin MEASUREMENT DtAnalyticLccActvnDst "" FLOAT32_IEEE ADAS_CM_single 0 0 0.000000 65535.000000 ECU_ADDRESS 0x0000 /* @ECU_Address@DtAnalyticLccActvnDst@ */ /end MEASUREMENT
/begin MEASUREMENT DtAnalyticLccNrOfOper "" FLOAT32_IEEE ADAS_CM_single 0 0 0.000000 65535.000000 ECU_ADDRESS 0x0000 /* @ECU_Address@DtAnalyticLccNrOfOper@ */ /end MEASUREMENT
/begin MEASUREMENT DtAnalyticLdpNumOfWarn "" FLOAT32_IEEE ADAS_CM_single 0 0 0.000000 65535.000000 ECU_ADDRESS 0x0000 /* @ECU_Address@DtAnalyticLdpNumOfWarn@ */ /end MEASUREMENT
/begin MEASUREMENT DtAnalyticLdpTimeActive "" FLOAT32_IEEE ADAS_CM_single 0 0 0.000000 65535.000000 ECU_ADDRESS 0x0000 /* @ECU_Address@DtAnalyticLdpTimeActive@ */ /end MEASUREMENT
/begin MEASUREMENT DtAnalyticLdwNumOfWarn "" FLOAT32_IEEE ADAS_CM_single 0 0 0.000000 65535.000000 ECU_ADDRESS 0x0000 /* @ECU_Address@DtAnalyticLdwNumOfWarn@ */ /end MEASUREMENT
/begin MEASUREMENT DtAnalyticLdwTimeActive "" FLOAT32_IEEE ADAS_CM_single 0 0 0.000000 65535.000000 ECU_ADDRESS 0x0000 /* @ECU_Address@DtAnalyticLdwTimeActive@ */ /end MEASUREMENT
/begin MEASUREMENT DtAnalyticLkaTimeActive "" FLOAT32_IEEE ADAS_CM_single 0 0 0.000000 65535.000000 ECU_ADDRESS 0x0000 /* @ECU_Address@DtAnalyticLkaTimeActive@ */ /end MEASUREMENT
/begin MEASUREMENT DtAnalyticLkaTimeTotal "" FLOAT32_IEEE ADAS_CM_single 0 0 0.000000 65535.000000 ECU_ADDRESS 0x0000 /* @ECU_Address@DtAnalyticLkaTimeTotal@ */ /end MEASUREMENT
/begin MEASUREMENT DtAnalyticMliaTimeObj "" FLOAT32_IEEE ADAS_CM_single 0 0 0.000000 65535.000000 ECU_ADDRESS 0x0000 /* @ECU_Address@DtAnalyticMliaTimeObj@ */ /end MEASUREMENT
/begin MEASUREMENT DtAnalyticMliaTimeTotal "" FLOAT32_IEEE ADAS_CM_single 0 0 0.000000 65535.000000 ECU_ADDRESS 0x0000 /* @ECU_Address@DtAnalyticMliaTimeTotal@ */ /end MEASUREMENT
/begin MEASUREMENT DtAnalyticRctcAvgDistToTar "" UBYTE ADAS_CM_uint8 0 0 0.000000 255.000000 ECU_ADDRESS 0x0000 /* @ECU_Address@DtAnalyticRctcAvgDistToTar@ */ /end MEASUREMENT
/begin MEASUREMENT DtAnalyticRctcNrOfOper "" UBYTE ADAS_CM_uint8 0 0 0.000000 255.000000 ECU_ADDRESS 0x0000 /* @ECU_Address@DtAnalyticRctcNrOfOper@ */ /end MEASUREMENT
/begin MEASUREMENT DtAnalyticRctcaActvnDst "" FLOAT32_IEEE ADAS_CM_single 0 0 0.000000 65535.000000 ECU_ADDRESS 0x0000 /* @ECU_Address@DtAnalyticRctcaActvnDst@ */ /end MEASUREMENT
/begin MEASUREMENT DtAnalyticRcwAvgDistToTar "" UBYTE ADAS_CM_uint8 0 0 0.000000 255.000000 ECU_ADDRESS 0x0000 /* @ECU_Address@DtAnalyticRcwAvgDistToTar@ */ /end MEASUREMENT
/begin MEASUREMENT DtAnalyticRcwNrOfOper "" UBYTE ADAS_CM_uint8 0 0 0.000000 255.000000 ECU_ADDRESS 0x0000 /* @ECU_Address@DtAnalyticRcwNrOfOper@ */ /end MEASUREMENT
/begin MEASUREMENT DtAnalyticRdaActvnDst "" FLOAT32_IEEE ADAS_CM_single 0 0 0.000000 65535.000000 ECU_ADDRESS 0x0000 /* @ECU_Address@DtAnalyticRdaActvnDst@ */ /end MEASUREMENT
/begin MEASUREMENT DtAnalyticRdaAvgDistToTar "" FLOAT32_IEEE ADAS_CM_single 0 0 0.000000 65535.000000 ECU_ADDRESS 0x0000 /* @ECU_Address@DtAnalyticRdaAvgDistToTar@ */ /end MEASUREMENT
/begin MEASUREMENT DtAnalyticRdaNrOfOper "" FLOAT32_IEEE ADAS_CM_single 0 0 0.000000 65535.000000 ECU_ADDRESS 0x0000 /* @ECU_Address@DtAnalyticRdaNrOfOper@ */ /end MEASUREMENT
/begin MEASUREMENT DtDiagDtcAccRadarGlitch "" UBYTE ADAS_CM_uint8 0 0 0.000000 255.000000 ECU_ADDRESS 0x0000 /* @ECU_Address@DtDiagDtcAccRadarGlitch@ */ /end MEASUREMENT
/begin MEASUREMENT DtDiagDtcAccRadarZero "" UBYTE ADAS_CM_uint8 0 0 0.000000 255.000000 ECU_ADDRESS 0x0000 /* @ECU_Address@DtDiagDtcAccRadarZero@ */ /end MEASUREMENT
/begin MEASUREMENT DtDiagDtcAccSwuStuck "" UBYTE ADAS_CM_uint8 0 0 0.000000 255.000000 ECU_ADDRESS 0x0000 /* @ECU_Address@DtDiagDtcAccSwuStuck@ */ /end MEASUREMENT
/begin MEASUREMENT DtDiagVerDateModelACC "" FLOAT32_IEEE ADAS_CM_single 0 0 0.000000 320000.000000 ECU_ADDRESS 0x0000 /* @ECU_Address@DtDiagVerDateModelACC@ */ /end MEASUREMENT
/begin MEASUREMENT DtDiagVerDateModelAEB "" FLOAT32_IEEE ADAS_CM_single 0 0 0.000000 320000.000000 ECU_ADDRESS 0x0000 /* @ECU_Address@DtDiagVerDateModelAEB@ */ /end MEASUREMENT
/begin MEASUREMENT DtDiagVerDateModelFIU "" FLOAT32_IEEE ADAS_CM_single 0 0 0.000000 320000.000000 ECU_ADDRESS 0x0000 /* @ECU_Address@DtDiagVerDateModelFIU@ */ /end MEASUREMENT
/begin MEASUREMENT DtDiagVerDateModelLCC "" FLOAT32_IEEE ADAS_CM_single 0 0 0.000000 320000.000000 ECU_ADDRESS 0x0000 /* @ECU_Address@DtDiagVerDateModelLCC@ */ /end MEASUREMENT
/begin MEASUREMENT DtDiagVerDateModelLDP "" FLOAT32_IEEE ADAS_CM_single 0 0 0.000000 320000.000000 ECU_ADDRESS 0x0000 /* @ECU_Address@DtDiagVerDateModelLDP@ */ /end MEASUREMENT
/begin MEASUREMENT DtDiagVerDateModelLDW "" FLOAT32_IEEE ADAS_CM_single 0 0 0.000000 320000.000000 ECU_ADDRESS 0x0000 /* @ECU_Address@DtDiagVerDateModelLDW@ */ /end MEASUREMENT
/begin MEASUREMENT DtDiagVerDateModelLKA "" FLOAT32_IEEE ADAS_CM_single 0 0 0.000000 320000.000000 ECU_ADDRESS 0x0000 /* @ECU_Address@DtDiagVerDateModelLKA@ */ /end MEASUREMENT
/begin MEASUREMENT DtDiagVerDateModelMLIA "" FLOAT32_IEEE ADAS_CM_single 0 0 0.000000 320000.000000 ECU_ADDRESS 0x0000 /* @ECU_Address@DtDiagVerDateModelMLIA@ */ /end MEASUREMENT
/begin MEASUREMENT DtDiagVerDateModelRCW "" FLOAT32_IEEE ADAS_CM_single 0 0 0.000000 320000.000000 ECU_ADDRESS 0x0000 /* @ECU_Address@DtDiagVerDateModelRCW@ */ /end MEASUREMENT
/begin MEASUREMENT DtDiagVerDateModelRDA "" FLOAT32_IEEE ADAS_CM_single 0 0 0.000000 320000.000000 ECU_ADDRESS 0x0000 /* @ECU_Address@DtDiagVerDateModelRDA@ */ /end MEASUREMENT
/begin MEASUREMENT DtDiagVerNumModelACC "" UBYTE ADAS_CM_uint8 0 0 0.000000 255.000000 ECU_ADDRESS 0x0000 /* @ECU_Address@DtDiagVerNumModelACC@ */ /end MEASUREMENT
/begin MEASUREMENT DtDiagVerNumModelAEB "" UBYTE ADAS_CM_uint8 0 0 0.000000 255.000000 ECU_ADDRESS 0x0000 /* @ECU_Address@DtDiagVerNumModelAEB@ */ /end MEASUREMENT
/begin MEASUREMENT DtDiagVerNumModelFIU "" UBYTE ADAS_CM_uint8 0 0 0.000000 255.000000 ECU_ADDRESS 0x0000 /* @ECU_Address@DtDiagVerNumModelFIU@ */ /end MEASUREMENT
/begin MEASUREMENT DtDiagVerNumModelLCC "" UBYTE ADAS_CM_uint8 0 0 0.000000 255.000000 ECU_ADDRESS 0x0000 /* @ECU_Address@DtDiagVerNumModelLCC@ */ /end MEASUREMENT
/begin MEASUREMENT DtDiagVerNumModelLDP "" UBYTE ADAS_CM_uint8 0 0 0.000000 255.000000 ECU_ADDRESS 0x0000 /* @ECU_Address@DtDiagVerNumModelLDP@ */ /end MEASUREMENT
/begin MEASUREMENT DtDiagVerNumModelLDW "" UBYTE ADAS_CM_uint8 0 0 0.000000 255.000000 ECU_ADDRESS 0x0000 /* @ECU_Address@DtDiagVerNumModelLDW@ */ /end MEASUREMENT
/begin MEASUREMENT DtDiagVerNumModelLKA "" UBYTE ADAS_CM_uint8 0 0 0.000000 255.000000 ECU_ADDRESS 0x0000 /* @ECU_Address@DtDiagVerNumModelLKA@ */ /end MEASUREMENT
/begin MEASUREMENT DtDiagVerNumModelMLIA "" UBYTE ADAS_CM_uint8 0 0 0.000000 255.000000 ECU_ADDRESS 0x0000 /* @ECU_Address@DtDiagVerNumModelMLIA@ */ /end MEASUREMENT
/begin MEASUREMENT DtDiagVerNumModelRCW "" UBYTE ADAS_CM_uint8 0 0 0.000000 255.000000 ECU_ADDRESS 0x0000 /* @ECU_Address@DtDiagVerNumModelRCW@ */ /end MEASUREMENT
/begin MEASUREMENT DtDiagVerNumModelRDA "" UBYTE ADAS_CM_uint8 0 0 0.000000 255.000000 ECU_ADDRESS 0x0000 /* @ECU_Address@DtDiagVerNumModelRDA@ */ /end MEASUREMENT
/begin MEASUREMENT DtLogAccDistRealm "" FLOAT32_IEEE ADAS_CM_single 0 0 0.000000 200.000000 ECU_ADDRESS 0x0000 /* @ECU_Address@DtLogAccDistRealm@ */ /end MEASUREMENT
/begin MEASUREMENT DtLogAccDistSetm "" FLOAT32_IEEE ADAS_CM_single 0 0 0.000000 100.000000 ECU_ADDRESS 0x0000 /* @ECU_Address@DtLogAccDistSetm@ */ /end MEASUREMENT
/begin MEASUREMENT DtLogAccErrCode "" UBYTE ADAS_CM_uint8 0 0 0.000000 31.000000 ECU_ADDRESS 0x0000 /* @ECU_Address@DtLogAccErrCode@ */ /end MEASUREMENT
/begin MEASUREMENT DtLogAccErrFlag "" UBYTE ADAS_CM_uint8 0 0 0.000000 1.000000 ECU_ADDRESS 0x0000 /* @ECU_Address@DtLogAccErrFlag@ */ /end MEASUREMENT
/begin MEASUREMENT DtLogAccLeadAccelReal "" FLOAT32_IEEE ADAS_CM_single 0 0 -10.000000 5.000000 ECU_ADDRESS 0x0000 /* @ECU_Address@DtLogAccLeadAccelReal@ */ /end MEASUREMENT
/begin MEASUREMENT DtLogAccLeadSpeedReal_kmh "" FLOAT32_IEEE ADAS_CM_single 0 0 -10.000000 245.000000 ECU_ADDRESS 0x0000 /* @ECU_Address@DtLogAccLeadSpeedReal_kmh@ */ /end MEASUREMENT
/begin MEASUREMENT DtLogAccLogicTrans "" UBYTE ADAS_CM_uint8 0 0 0.000000 255.000000 ECU_ADDRESS 0x0000 /* @ECU_Address@DtLogAccLogicTrans@ */ /end MEASUREMENT
/begin MEASUREMENT DtLogAccSolverTrans "" UBYTE ADAS_CM_uint8 0 0 0.000000 127.000000 ECU_ADDRESS 0x0000 /* @ECU_Address@DtLogAccSolverTrans@ */ /end MEASUREMENT
/begin MEASUREMENT DtLogAccTargetDetect "" UBYTE ADAS_CM_uint8 0 0 0.000000 15.000000 ECU_ADDRESS 0x0000 /* @ECU_Address@DtLogAccTargetDetect@ */ /end MEASUREMENT
/begin MEASUREMENT DtLogAccVlcTrans "" UBYTE ADAS_CM_uint8 0 0 0.000000 31.000000 ECU_ADDRESS 0x0000 /* @ECU_Address@DtLogAccVlcTrans@ */ /end MEASUREMENT
/begin MEASUREMENT DtLogAebDistRealm "" FLOAT32_IEEE ADAS_CM_single 0 0 0.000000 200.000000 ECU_ADDRESS 0x0000 /* @ECU_Address@DtLogAebDistRealm@ */ /end MEASUREMENT
/begin MEASUREMENT DtLogAebErrCode "" UBYTE ADAS_CM_uint8 0 0 0.000000 31.000000 ECU_ADDRESS 0x0000 /* @ECU_Address@DtLogAebErrCode@ */ /end MEASUREMENT
/begin MEASUREMENT DtLogAebErrFlag "" UBYTE ADAS_CM_uint8 0 0 0.000000 255.000000 ECU_ADDRESS 0x0000 /* @ECU_Address@DtLogAebErrFlag@ */ /end MEASUREMENT
/begin MEASUREMENT DtLogAebLeadSpeedRealKmh "" FLOAT32_IEEE ADAS_CM_single 0 0 -10.000000 245.000000 ECU_ADDRESS 0x0000 /* @ECU_Address@DtLogAebLeadSpeedRealKmh@ */ /end MEASUREMENT
/begin MEASUREMENT DtLogAebLogicTrans "" UBYTE ADAS_CM_uint8 0 0 0.000000 127.000000 ECU_ADDRESS 0x0000 /* @ECU_Address@DtLogAebLogicTrans@ */ /end MEASUREMENT
/begin MEASUREMENT DtLogAebSolverTrans "" UBYTE ADAS_CM_uint8 0 0 0.000000 127.000000 ECU_ADDRESS 0x0000 /* @ECU_Address@DtLogAebSolverTrans@ */ /end MEASUREMENT
/begin MEASUREMENT DtLogAebTargetDetect "" UBYTE ADAS_CM_uint8 0 0 0.000000 15.000000 ECU_ADDRESS 0x0000 /* @ECU_Address@DtLogAebTargetDetect@ */ /end MEASUREMENT
/begin MEASUREMENT DtLogAlccEnaSts "" UBYTE ADAS_CM_uint8 0 0 0.000000 1.000000 ECU_ADDRESS 0x0000 /* @ECU_Address@DtLogAlccEnaSts@ */ /end MEASUREMENT
/begin MEASUREMENT DtLogDowIsObjInLeftZone "" UBYTE ADAS_CM_uint8 0 0 0.000000 1.000000 ECU_ADDRESS 0x0000 /* @ECU_Address@DtLogDowIsObjInLeftZone@ */ /end MEASUREMENT
/begin MEASUREMENT DtLogDowIsObjInRightZone "" UBYTE ADAS_CM_uint8 0 0 0.000000 1.000000 ECU_ADDRESS 0x0000 /* @ECU_Address@DtLogDowIsObjInRightZone@ */ /end MEASUREMENT
/begin MEASUREMENT DtLogDowLogicTrans "" UBYTE ADAS_CM_uint8 0 0 0.000000 255.000000 ECU_ADDRESS 0x0000 /* @ECU_Address@DtLogDowLogicTrans@ */ /end MEASUREMENT
/begin MEASUREMENT DtLogDowWarnReqTransLeft "" UBYTE ADAS_CM_uint8 0 0 0.000000 255.000000 ECU_ADDRESS 0x0000 /* @ECU_Address@DtLogDowWarnReqTransLeft@ */ /end MEASUREMENT
/begin MEASUREMENT DtLogDowWarnReqTransRight "" UBYTE ADAS_CM_uint8 0 0 0.000000 255.000000 ECU_ADDRESS 0x0000 /* @ECU_Address@DtLogDowWarnReqTransRight@ */ /end MEASUREMENT
/begin MEASUREMENT DtLogFiuLogicTrans "" UBYTE ADAS_CM_uint8 0 0 0.000000 255.000000 ECU_ADDRESS 0x0000 /* @ECU_Address@DtLogFiuLogicTrans@ */ /end MEASUREMENT
/begin MEASUREMENT DtLogFiuSolverTrans "" UBYTE ADAS_CM_uint8 0 0 0.000000 255.000000 ECU_ADDRESS 0x0000 /* @ECU_Address@DtLogFiuSolverTrans@ */ /end MEASUREMENT
/begin MEASUREMENT DtLogLccEnaSts "" UBYTE ADAS_CM_uint8 0 0 0.000000 1.000000 ECU_ADDRESS 0x0000 /* @ECU_Address@DtLogLccEnaSts@ */ /end MEASUREMENT
/begin MEASUREMENT DtLogLccErrCode "" UBYTE ADAS_CM_uint8 0 0 0.000000 255.000000 ECU_ADDRESS 0x0000 /* @ECU_Address@DtLogLccErrCode@ */ /end MEASUREMENT
/begin MEASUREMENT DtLogLccErrFlag "" UBYTE ADAS_CM_uint8 0 0 0.000000 255.000000 ECU_ADDRESS 0x0000 /* @ECU_Address@DtLogLccErrFlag@ */ /end MEASUREMENT
/begin MEASUREMENT DtLogLccIsObjInLeftCvwZone "" UBYTE ADAS_CM_uint8 0 0 0.000000 1.000000 ECU_ADDRESS 0x0000 /* @ECU_Address@DtLogLccIsObjInLeftCvwZone@ */ /end MEASUREMENT
/begin MEASUREMENT DtLogLccIsObjInRightCvwZone "" UBYTE ADAS_CM_uint8 0 0 0.000000 1.000000 ECU_ADDRESS 0x0000 /* @ECU_Address@DtLogLccIsObjInRightCvwZone@ */ /end MEASUREMENT
/begin MEASUREMENT DtLogLccLogicTrans "" UBYTE ADAS_CM_uint8 0 0 0.000000 255.000000 ECU_ADDRESS 0x0000 /* @ECU_Address@DtLogLccLogicTrans@ */ /end MEASUREMENT
/begin MEASUREMENT DtLogLccSetMode "" UBYTE ADAS_CM_uint8 0 0 0.000000 2.000000 ECU_ADDRESS 0x0000 /* @ECU_Address@DtLogLccSetMode@ */ /end MEASUREMENT
/begin MEASUREMENT DtLogLccSetSound "" UBYTE ADAS_CM_uint8 0 0 0.000000 1.000000 ECU_ADDRESS 0x0000 /* @ECU_Address@DtLogLccSetSound@ */ /end MEASUREMENT
/begin MEASUREMENT DtLogLccSetVibration "" UBYTE ADAS_CM_uint8 0 0 0.000000 1.000000 ECU_ADDRESS 0x0000 /* @ECU_Address@DtLogLccSetVibration@ */ /end MEASUREMENT
/begin MEASUREMENT DtLogLccWarnReqTransLeft "" UBYTE ADAS_CM_uint8 0 0 0.000000 255.000000 ECU_ADDRESS 0x0000 /* @ECU_Address@DtLogLccWarnReqTransLeft@ */ /end MEASUREMENT
/begin MEASUREMENT DtLogLccWarnReqTransRight "" UBYTE ADAS_CM_uint8 0 0 0.000000 255.000000 ECU_ADDRESS 0x0000 /* @ECU_Address@DtLogLccWarnReqTransRight@ */ /end MEASUREMENT
/begin MEASUREMENT DtLogLdwLogicTrans "" UBYTE ADAS_CM_uint8 0 0 0.000000 31.000000 ECU_ADDRESS 0x0000 /* @ECU_Address@DtLogLdwLogicTrans@ */ /end MEASUREMENT
/begin MEASUREMENT DtLogLdwSolverTransLeft "" UBYTE ADAS_CM_uint8 0 0 0.000000 31.000000 ECU_ADDRESS 0x0000 /* @ECU_Address@DtLogLdwSolverTransLeft@ */ /end MEASUREMENT
/begin MEASUREMENT DtLogLdwSolverTransRight "" UBYTE ADAS_CM_uint8 0 0 0.000000 31.000000 ECU_ADDRESS 0x0000 /* @ECU_Address@DtLogLdwSolverTransRight@ */ /end MEASUREMENT
/begin MEASUREMENT DtLogLdwTTLCLeft "" FLOAT32_IEEE ADAS_CM_single 0 0 0.000000 5.000000 ECU_ADDRESS 0x0000 /* @ECU_Address@DtLogLdwTTLCLeft@ */ /end MEASUREMENT
/begin MEASUREMENT DtLogLdwTTLCTransLeft "" UBYTE ADAS_CM_uint8 0 0 0.000000 15.000000 ECU_ADDRESS 0x0000 /* @ECU_Address@DtLogLdwTTLCTransLeft@ */ /end MEASUREMENT
/begin MEASUREMENT DtLogLdwTurnRadiusLeft "" FLOAT32_IEEE ADAS_CM_single 0 0 0.000000 1275.000000 ECU_ADDRESS 0x0000 /* @ECU_Address@DtLogLdwTurnRadiusLeft@ */ /end MEASUREMENT
/begin MEASUREMENT DtLogLdwVdepartureLeft "" FLOAT32_IEEE ADAS_CM_single 0 0 -3.000000 3.000000 ECU_ADDRESS 0x0000 /* @ECU_Address@DtLogLdwVdepartureLeft@ */ /end MEASUREMENT
/begin MEASUREMENT DtLogLdwWarnBlockTransLeft "" UBYTE ADAS_CM_uint8 0 0 0.000000 15.000000 ECU_ADDRESS 0x0000 /* @ECU_Address@DtLogLdwWarnBlockTransLeft@ */ /end MEASUREMENT
/begin MEASUREMENT DtLogLdwWarnDistLeft "" UBYTE ADAS_CM_uint8 0 0 0.000000 1.000000 ECU_ADDRESS 0x0000 /* @ECU_Address@DtLogLdwWarnDistLeft@ */ /end MEASUREMENT
/begin MEASUREMENT DtLogLdwWarnDistRight "" UBYTE ADAS_CM_uint8 0 0 0.000000 1.000000 ECU_ADDRESS 0x0000 /* @ECU_Address@DtLogLdwWarnDistRight@ */ /end MEASUREMENT
/begin MEASUREMENT DtLogLdwWarnPredictLeft "" UBYTE ADAS_CM_uint8 0 0 0.000000 1.000000 ECU_ADDRESS 0x0000 /* @ECU_Address@DtLogLdwWarnPredictLeft@ */ /end MEASUREMENT
/begin MEASUREMENT DtLogLdwWarnPredictRight "" UBYTE ADAS_CM_uint8 0 0 0.000000 1.000000 ECU_ADDRESS 0x0000 /* @ECU_Address@DtLogLdwWarnPredictRight@ */ /end MEASUREMENT
/begin MEASUREMENT DtLogLdwWarnTimeLeft "" UBYTE ADAS_CM_uint8 0 0 0.000000 1.000000 ECU_ADDRESS 0x0000 /* @ECU_Address@DtLogLdwWarnTimeLeft@ */ /end MEASUREMENT
/begin MEASUREMENT DtLogLdwWarnTimeRight "" UBYTE ADAS_CM_uint8 0 0 0.000000 1.000000 ECU_ADDRESS 0x0000 /* @ECU_Address@DtLogLdwWarnTimeRight@ */ /end MEASUREMENT
/begin MEASUREMENT DtLogLdwYawRate_dtLeft "" FLOAT32_IEEE ADAS_CM_single 0 0 -10.000000 10.000000 ECU_ADDRESS 0x0000 /* @ECU_Address@DtLogLdwYawRate_dtLeft@ */ /end MEASUREMENT
/begin MEASUREMENT DtLogLkaErrCode "" UBYTE ADAS_CM_uint8 0 0 0.000000 255.000000 ECU_ADDRESS 0x0000 /* @ECU_Address@DtLogLkaErrCode@ */ /end MEASUREMENT
/begin MEASUREMENT DtLogLkaErrFlag "" UBYTE ADAS_CM_uint8 0 0 0.000000 255.000000 ECU_ADDRESS 0x0000 /* @ECU_Address@DtLogLkaErrFlag@ */ /end MEASUREMENT
/begin MEASUREMENT DtLogLkaLogicTrans "" UBYTE ADAS_CM_uint8 0 0 0.000000 255.000000 ECU_ADDRESS 0x0000 /* @ECU_Address@DtLogLkaLogicTrans@ */ /end MEASUREMENT
/begin MEASUREMENT DtLogLkaSolverTrans "" UBYTE ADAS_CM_uint8 0 0 0.000000 255.000000 ECU_ADDRESS 0x0000 /* @ECU_Address@DtLogLkaSolverTrans@ */ /end MEASUREMENT
/begin MEASUREMENT DtLogLkaTargetAngle "" FLOAT32_IEEE ADAS_CM_single 0 0 -180.000000 180.000000 ECU_ADDRESS 0x0000 /* @ECU_Address@DtLogLkaTargetAngle@ */ /end MEASUREMENT
/begin MEASUREMENT DtLogMliaDistToObj1 "" UBYTE ADAS_CM_uint8 0 0 0.000000 255.000000 ECU_ADDRESS 0x0000 /* @ECU_Address@DtLogMliaDistToObj1@ */ /end MEASUREMENT
/begin MEASUREMENT DtLogMliaDistToObj2 "" UBYTE ADAS_CM_uint8 0 0 0.000000 255.000000 ECU_ADDRESS 0x0000 /* @ECU_Address@DtLogMliaDistToObj2@ */ /end MEASUREMENT
/begin MEASUREMENT DtLogMliaDistToObj3 "" UBYTE ADAS_CM_uint8 0 0 0.000000 255.000000 ECU_ADDRESS 0x0000 /* @ECU_Address@DtLogMliaDistToObj3@ */ /end MEASUREMENT
/begin MEASUREMENT DtLogMliaDistToObj4 "" UBYTE ADAS_CM_uint8 0 0 0.000000 255.000000 ECU_ADDRESS 0x0000 /* @ECU_Address@DtLogMliaDistToObj4@ */ /end MEASUREMENT
/begin MEASUREMENT DtLogMliaErrCode "" UBYTE ADAS_CM_uint8 0 0 0.000000 255.000000 ECU_ADDRESS 0x0000 /* @ECU_Address@DtLogMliaErrCode@ */ /end MEASUREMENT
/begin MEASUREMENT DtLogMliaErrFlag "" UBYTE ADAS_CM_uint8 0 0 0.000000 255.000000 ECU_ADDRESS 0x0000 /* @ECU_Address@DtLogMliaErrFlag@ */ /end MEASUREMENT
/begin MEASUREMENT DtLogMliaLogicTrans "" UBYTE ADAS_CM_uint8 0 0 0.000000 255.000000 ECU_ADDRESS 0x0000 /* @ECU_Address@DtLogMliaLogicTrans@ */ /end MEASUREMENT
/begin MEASUREMENT DtLogMliaSolverTrans "" UBYTE ADAS_CM_uint8 0 0 0.000000 255.000000 ECU_ADDRESS 0x0000 /* @ECU_Address@DtLogMliaSolverTrans@ */ /end MEASUREMENT
/begin MEASUREMENT DtLogRcwDimanWh "" FLOAT32_IEEE ADAS_CM_single 0 0 0.000000 255.000000 ECU_ADDRESS 0x0000 /* @ECU_Address@DtLogRcwDimanWh@ */ /end MEASUREMENT
/begin MEASUREMENT DtLogRcwDistToObjRear "" FLOAT32_IEEE ADAS_CM_single 0 0 0.000000 255.000000 ECU_ADDRESS 0x0000 /* @ECU_Address@DtLogRcwDistToObjRear@ */ /end MEASUREMENT
/begin MEASUREMENT DtLogRcwLatObj "" FLOAT32_IEEE ADAS_CM_single 0 0 -255.000000 255.000000 ECU_ADDRESS 0x0000 /* @ECU_Address@DtLogRcwLatObj@ */ /end MEASUREMENT
/begin MEASUREMENT DtLogRcwLogicTrans "" UBYTE ADAS_CM_uint8 0 0 0.000000 255.000000 ECU_ADDRESS 0x0000 /* @ECU_Address@DtLogRcwLogicTrans@ */ /end MEASUREMENT
/begin MEASUREMENT DtLogRcwTimeCrash "" FLOAT32_IEEE ADAS_CM_single 0 0 0.000000 255.000000 ECU_ADDRESS 0x0000 /* @ECU_Address@DtLogRcwTimeCrash@ */ /end MEASUREMENT
/begin MEASUREMENT DtLogRcwVelRel "" UBYTE ADAS_CM_uint8 0 0 0.000000 1.000000 ECU_ADDRESS 0x0000 /* @ECU_Address@DtLogRcwVelRel@ */ /end MEASUREMENT
/begin MEASUREMENT DtLogRdaDistToObjRear "" FLOAT32_IEEE ADAS_CM_single 0 0 0.000000 25.000000 ECU_ADDRESS 0x0000 /* @ECU_Address@DtLogRdaDistToObjRear@ */ /end MEASUREMENT
/begin MEASUREMENT DtLogRdaErrCode "" UBYTE ADAS_CM_uint8 0 0 0.000000 255.000000 ECU_ADDRESS 0x0000 /* @ECU_Address@DtLogRdaErrCode@ */ /end MEASUREMENT
/begin MEASUREMENT DtLogRdaErrFlag "" UBYTE ADAS_CM_uint8 0 0 0.000000 255.000000 ECU_ADDRESS 0x0000 /* @ECU_Address@DtLogRdaErrFlag@ */ /end MEASUREMENT
/begin MEASUREMENT DtLogRdaLogicTrans "" UBYTE ADAS_CM_uint8 0 0 0.000000 255.000000 ECU_ADDRESS 0x0000 /* @ECU_Address@DtLogRdaLogicTrans@ */ /end MEASUREMENT
/begin MEASUREMENT DtLogRdaSolverTrans "" UBYTE ADAS_CM_uint8 0 0 0.000000 255.000000 ECU_ADDRESS 0x0000 /* @ECU_Address@DtLogRdaSolverTrans@ */ /end MEASUREMENT
/begin MEASUREMENT DtPercRecToInc_Req "" UBYTE ADAS_CM_uint8 0 0 0.000000 1.000000 ECU_ADDRESS 0x0000 /* @ECU_Address@DtPercRecToInc_Req@ */ /end MEASUREMENT
/begin MEASUREMENT DtPercStartFrontOncomObj "" UBYTE ADAS_CM_uint8 0 0 0.000000 1.000000 ECU_ADDRESS 0x0000 /* @ECU_Address@DtPercStartFrontOncomObj@ */ /end MEASUREMENT
/begin MEASUREMENT DtPercStartFrontPasObj "" UBYTE ADAS_CM_uint8 0 0 0.000000 1.000000 ECU_ADDRESS 0x0000 /* @ECU_Address@DtPercStartFrontPasObj@ */ /end MEASUREMENT
/begin MEASUREMENT DtPercStartLane "" UBYTE ADAS_CM_uint8 0 0 0.000000 1.000000 ECU_ADDRESS 0x0000 /* @ECU_Address@DtPercStartLane@ */ /end MEASUREMENT
/begin MEASUREMENT DtPercStartMlia "" UBYTE ADAS_CM_uint8 0 0 0.000000 1.000000 ECU_ADDRESS 0x0000 /* @ECU_Address@DtPercStartMlia@ */ /end MEASUREMENT
/begin MEASUREMENT DtPercStartRearObj "" UBYTE ADAS_CM_uint8 0 0 0.000000 1.000000 ECU_ADDRESS 0x0000 /* @ECU_Address@DtPercStartRearObj@ */ /end MEASUREMENT
/begin MEASUREMENT DtPercStartRec "" UBYTE ADAS_CM_uint8 0 0 0.000000 1.000000 ECU_ADDRESS 0x0000 /* @ECU_Address@DtPercStartRec@ */ /end MEASUREMENT
/begin MEASUREMENT DtPercStartSign "" UBYTE ADAS_CM_uint8 0 0 0.000000 1.000000 ECU_ADDRESS 0x0000 /* @ECU_Address@DtPercStartSign@ */ /end MEASUREMENT
/begin MEASUREMENT FcwMode "" UBYTE ADAS_CM_uint8 0 0 0.000000 1.000000 ECU_ADDRESS 0x0000 /* @ECU_Address@FcwMode@ */ /end MEASUREMENT
/begin MEASUREMENT FcwNotifError "" UBYTE ADAS_CM_uint8 0 0 0.000000 1.000000 ECU_ADDRESS 0x0000 /* @ECU_Address@FcwNotifError@ */ /end MEASUREMENT
/begin MEASUREMENT LccFuncError "" UBYTE ADAS_CM_uint8 0 0 0.000000 1.000000 ECU_ADDRESS 0x0000 /* @ECU_Address@LccFuncError@ */ /end MEASUREMENT
/begin MEASUREMENT LccLeftLedReq "" UBYTE ADAS_CM_uint8 0 0 0.000000 1.000000 ECU_ADDRESS 0x0000 /* @ECU_Address@LccLeftLedReq@ */ /end MEASUREMENT
/begin MEASUREMENT LccLeftWarnReq "" UBYTE ADAS_CM_uint8 0 0 0.000000 1.000000 ECU_ADDRESS 0x0000 /* @ECU_Address@LccLeftWarnReq@ */ /end MEASUREMENT
/begin MEASUREMENT LccMode "" UBYTE ADAS_CM_uint8 0 0 0.000000 2.000000 ECU_ADDRESS 0x0000 /* @ECU_Address@LccMode@ */ /end MEASUREMENT
/begin MEASUREMENT LccNotifError "" UBYTE ADAS_CM_uint8 0 0 0.000000 1.000000 ECU_ADDRESS 0x0000 /* @ECU_Address@LccNotifError@ */ /end MEASUREMENT
/begin MEASUREMENT LccRightLedReq "" UBYTE ADAS_CM_uint8 0 0 0.000000 1.000000 ECU_ADDRESS 0x0000 /* @ECU_Address@LccRightLedReq@ */ /end MEASUREMENT
/begin MEASUREMENT LccRightWarnReq "" UBYTE ADAS_CM_uint8 0 0 0.000000 1.000000 ECU_ADDRESS 0x0000 /* @ECU_Address@LccRightWarnReq@ */ /end MEASUREMENT
/begin MEASUREMENT LccSoundReq "" UBYTE ADAS_CM_uint8 0 0 0.000000 1.000000 ECU_ADDRESS 0x0000 /* @ECU_Address@LccSoundReq@ */ /end MEASUREMENT
/begin MEASUREMENT LdpAngleReqFlag "" UBYTE ADAS_CM_uint8 0 0 0.000000 1.000000 ECU_ADDRESS 0x0000 /* @ECU_Address@LdpAngleReqFlag@ */ /end MEASUREMENT
/begin MEASUREMENT LdpLeftLaneWarnReq "" UBYTE ADAS_CM_uint8 0 0 0.000000 1.000000 ECU_ADDRESS 0x0000 /* @ECU_Address@LdpLeftLaneWarnReq@ */ /end MEASUREMENT
/begin MEASUREMENT LdpMode "" UBYTE ADAS_CM_uint8 0 0 0.000000 1.000000 ECU_ADDRESS 0x0000 /* @ECU_Address@LdpMode@ */ /end MEASUREMENT
/begin MEASUREMENT LdpNotifError "" UBYTE ADAS_CM_uint8 0 0 0.000000 1.000000 ECU_ADDRESS 0x0000 /* @ECU_Address@LdpNotifError@ */ /end MEASUREMENT
/begin MEASUREMENT LdpRightLaneWarnReq "" UBYTE ADAS_CM_uint8 0 0 0.000000 1.000000 ECU_ADDRESS 0x0000 /* @ECU_Address@LdpRightLaneWarnReq@ */ /end MEASUREMENT
/begin MEASUREMENT LdwFuncError "" UBYTE ADAS_CM_uint8 0 0 0.000000 1.000000 ECU_ADDRESS 0x0000 /* @ECU_Address@LdwFuncError@ */ /end MEASUREMENT
/begin MEASUREMENT LdwHudActSt "" UBYTE ADAS_CM_uint8 0 0 0.000000 1.000000 ECU_ADDRESS 0x0000 /* @ECU_Address@LdwHudActSt@ */ /end MEASUREMENT
/begin MEASUREMENT LdwHudMultiLaneAddres "" UBYTE ADAS_CM_uint8 0 0 0.000000 1.000000 ECU_ADDRESS 0x0000 /* @ECU_Address@LdwHudMultiLaneAddres@ */ /end MEASUREMENT
/begin MEASUREMENT LdwHudMultiLaneWarnReq "" UBYTE ADAS_CM_uint8 0 0 0.000000 1.000000 ECU_ADDRESS 0x0000 /* @ECU_Address@LdwHudMultiLaneWarnReq@ */ /end MEASUREMENT
/begin MEASUREMENT LdwLeftLaneWarnReq "" UBYTE ADAS_CM_uint8 0 0 0.000000 1.000000 ECU_ADDRESS 0x0000 /* @ECU_Address@LdwLeftLaneWarnReq@ */ /end MEASUREMENT
/begin MEASUREMENT LdwMode "" UBYTE ADAS_CM_uint8 0 0 0.000000 4.000000 ECU_ADDRESS 0x0000 /* @ECU_Address@LdwMode@ */ /end MEASUREMENT
/begin MEASUREMENT LdwNotifError "" UBYTE ADAS_CM_uint8 0 0 0.000000 1.000000 ECU_ADDRESS 0x0000 /* @ECU_Address@LdwNotifError@ */ /end MEASUREMENT
/begin MEASUREMENT LdwRightLaneWarnReq "" UBYTE ADAS_CM_uint8 0 0 0.000000 1.000000 ECU_ADDRESS 0x0000 /* @ECU_Address@LdwRightLaneWarnReq@ */ /end MEASUREMENT
/begin MEASUREMENT LdwSoundReq "" UBYTE ADAS_CM_uint8 0 0 0.000000 1.000000 ECU_ADDRESS 0x0000 /* @ECU_Address@LdwSoundReq@ */ /end MEASUREMENT
/begin MEASUREMENT LkaAngleReq "" FLOAT32_IEEE ADAS_CM_single 0 0 -540.000000 540.000000 ECU_ADDRESS 0x0000 /* @ECU_Address@LkaAngleReq@ */ /end MEASUREMENT
/begin MEASUREMENT LkaAngleReqFlag "" UBYTE ADAS_CM_uint8 0 0 0.000000 1.000000 ECU_ADDRESS 0x0000 /* @ECU_Address@LkaAngleReqFlag@ */ /end MEASUREMENT
/begin MEASUREMENT LkaFuncError "" UBYTE ADAS_CM_uint8 0 0 0.000000 1.000000 ECU_ADDRESS 0x0000 /* @ECU_Address@LkaFuncError@ */ /end MEASUREMENT
/begin MEASUREMENT LkaNotifError "" UBYTE ADAS_CM_uint8 0 0 0.000000 1.000000 ECU_ADDRESS 0x0000 /* @ECU_Address@LkaNotifError@ */ /end MEASUREMENT
/begin MEASUREMENT LkaShotdownSoundReq "" UBYTE ADAS_CM_uint8 0 0 0.000000 1.000000 ECU_ADDRESS 0x0000 /* @ECU_Address@LkaShotdownSoundReq@ */ /end MEASUREMENT
/begin MEASUREMENT LkaWarnNotifReq "" UBYTE ADAS_CM_uint8 0 0 0.000000 1.000000 ECU_ADDRESS 0x0000 /* @ECU_Address@LkaWarnNotifReq@ */ /end MEASUREMENT
/begin MEASUREMENT LkaWarnSoundReq "" UBYTE ADAS_CM_uint8 0 0 0.000000 1.000000 ECU_ADDRESS 0x0000 /* @ECU_Address@LkaWarnSoundReq@ */ /end MEASUREMENT
/begin MEASUREMENT MliaFuncError "" UBYTE ADAS_CM_uint8 0 0 0.000000 1.000000 ECU_ADDRESS 0x0000 /* @ECU_Address@MliaFuncError@ */ /end MEASUREMENT
/begin MEASUREMENT MliaLADBLED10Req "" UBYTE ADAS_CM_uint8 0 0 0.000000 1.000000 ECU_ADDRESS 0x0000 /* @ECU_Address@MliaLADBLED10Req@ */ /end MEASUREMENT
/begin MEASUREMENT MliaLADBLED11Req "" UBYTE ADAS_CM_uint8 0 0 0.000000 1.000000 ECU_ADDRESS 0x0000 /* @ECU_Address@MliaLADBLED11Req@ */ /end MEASUREMENT
/begin MEASUREMENT MliaLADBLED12Req "" UBYTE ADAS_CM_uint8 0 0 0.000000 1.000000 ECU_ADDRESS 0x0000 /* @ECU_Address@MliaLADBLED12Req@ */ /end MEASUREMENT
/begin MEASUREMENT MliaLADBLED13Req "" UBYTE ADAS_CM_uint8 0 0 0.000000 1.000000 ECU_ADDRESS 0x0000 /* @ECU_Address@MliaLADBLED13Req@ */ /end MEASUREMENT
/begin MEASUREMENT MliaLADBLED14Req "" UBYTE ADAS_CM_uint8 0 0 0.000000 1.000000 ECU_ADDRESS 0x0000 /* @ECU_Address@MliaLADBLED14Req@ */ /end MEASUREMENT
/begin MEASUREMENT MliaLADBLED15Req "" UBYTE ADAS_CM_uint8 0 0 0.000000 1.000000 ECU_ADDRESS 0x0000 /* @ECU_Address@MliaLADBLED15Req@ */ /end MEASUREMENT
/begin MEASUREMENT MliaLADBLED16Req "" UBYTE ADAS_CM_uint8 0 0 0.000000 1.000000 ECU_ADDRESS 0x0000 /* @ECU_Address@MliaLADBLED16Req@ */ /end MEASUREMENT
/begin MEASUREMENT MliaLADBLED17Req "" UBYTE ADAS_CM_uint8 0 0 0.000000 1.000000 ECU_ADDRESS 0x0000 /* @ECU_Address@MliaLADBLED17Req@ */ /end MEASUREMENT
/begin MEASUREMENT MliaLADBLED18Req "" UBYTE ADAS_CM_uint8 0 0 0.000000 1.000000 ECU_ADDRESS 0x0000 /* @ECU_Address@MliaLADBLED18Req@ */ /end MEASUREMENT
/begin MEASUREMENT MliaLADBLED1Req "" UBYTE ADAS_CM_uint8 0 0 0.000000 1.000000 ECU_ADDRESS 0x0000 /* @ECU_Address@MliaLADBLED1Req@ */ /end MEASUREMENT
/begin MEASUREMENT MliaLADBLED2Req "" UBYTE ADAS_CM_uint8 0 0 0.000000 1.000000 ECU_ADDRESS 0x0000 /* @ECU_Address@MliaLADBLED2Req@ */ /end MEASUREMENT
/begin MEASUREMENT MliaLADBLED3Req "" UBYTE ADAS_CM_uint8 0 0 0.000000 1.000000 ECU_ADDRESS 0x0000 /* @ECU_Address@MliaLADBLED3Req@ */ /end MEASUREMENT
/begin MEASUREMENT MliaLADBLED4Req "" UBYTE ADAS_CM_uint8 0 0 0.000000 1.000000 ECU_ADDRESS 0x0000 /* @ECU_Address@MliaLADBLED4Req@ */ /end MEASUREMENT
/begin MEASUREMENT MliaLADBLED5Req "" UBYTE ADAS_CM_uint8 0 0 0.000000 1.000000 ECU_ADDRESS 0x0000 /* @ECU_Address@MliaLADBLED5Req@ */ /end MEASUREMENT
/begin MEASUREMENT MliaLADBLED6Req "" UBYTE ADAS_CM_uint8 0 0 0.000000 1.000000 ECU_ADDRESS 0x0000 /* @ECU_Address@MliaLADBLED6Req@ */ /end MEASUREMENT
/begin MEASUREMENT MliaLADBLED7Req "" UBYTE ADAS_CM_uint8 0 0 0.000000 1.000000 ECU_ADDRESS 0x0000 /* @ECU_Address@MliaLADBLED7Req@ */ /end MEASUREMENT
/begin MEASUREMENT MliaLADBLED8Req "" UBYTE ADAS_CM_uint8 0 0 0.000000 1.000000 ECU_ADDRESS 0x0000 /* @ECU_Address@MliaLADBLED8Req@ */ /end MEASUREMENT
/begin MEASUREMENT MliaLADBLED9Req "" UBYTE ADAS_CM_uint8 0 0 0.000000 1.000000 ECU_ADDRESS 0x0000 /* @ECU_Address@MliaLADBLED9Req@ */ /end MEASUREMENT
/begin MEASUREMENT MliaLeftObj10Y1Val "" FLOAT32_IEEE ADAS_CM_single 0 0 0.000000 321.000000 ECU_ADDRESS 0x0000 /* @ECU_Address@MliaLeftObj10Y1Val@ */ /end MEASUREMENT
/begin MEASUREMENT MliaLeftObj10Y2Val "" FLOAT32_IEEE ADAS_CM_single 0 0 0.000000 321.000000 ECU_ADDRESS 0x0000 /* @ECU_Address@MliaLeftObj10Y2Val@ */ /end MEASUREMENT
/begin MEASUREMENT MliaLeftObj10Z1Val "" UBYTE ADAS_CM_uint8 0 0 0.000000 81.000000 ECU_ADDRESS 0x0000 /* @ECU_Address@MliaLeftObj10Z1Val@ */ /end MEASUREMENT
/begin MEASUREMENT MliaLeftObj10Z2Val "" UBYTE ADAS_CM_uint8 0 0 0.000000 81.000000 ECU_ADDRESS 0x0000 /* @ECU_Address@MliaLeftObj10Z2Val@ */ /end MEASUREMENT
/begin MEASUREMENT MliaLeftObj1Y1Val "" FLOAT32_IEEE ADAS_CM_single 0 0 0.000000 511.000000 ECU_ADDRESS 0x0000 /* @ECU_Address@MliaLeftObj1Y1Val@ */ /end MEASUREMENT
/begin MEASUREMENT MliaLeftObj1Y2Val "" FLOAT32_IEEE ADAS_CM_single 0 0 0.000000 321.000000 ECU_ADDRESS 0x0000 /* @ECU_Address@MliaLeftObj1Y2Val@ */ /end MEASUREMENT
/begin MEASUREMENT MliaLeftObj1Z1Val "" UBYTE ADAS_CM_uint8 0 0 0.000000 81.000000 ECU_ADDRESS 0x0000 /* @ECU_Address@MliaLeftObj1Z1Val@ */ /end MEASUREMENT
/begin MEASUREMENT MliaLeftObj1Z2Val "" UBYTE ADAS_CM_uint8 0 0 0.000000 81.000000 ECU_ADDRESS 0x0000 /* @ECU_Address@MliaLeftObj1Z2Val@ */ /end MEASUREMENT
/begin MEASUREMENT MliaLeftObj2Y1Val "" FLOAT32_IEEE ADAS_CM_single 0 0 0.000000 321.000000 ECU_ADDRESS 0x0000 /* @ECU_Address@MliaLeftObj2Y1Val@ */ /end MEASUREMENT
/begin MEASUREMENT MliaLeftObj2Y2Val "" FLOAT32_IEEE ADAS_CM_single 0 0 0.000000 321.000000 ECU_ADDRESS 0x0000 /* @ECU_Address@MliaLeftObj2Y2Val@ */ /end MEASUREMENT
/begin MEASUREMENT MliaLeftObj2Z1Val "" UBYTE ADAS_CM_uint8 0 0 0.000000 81.000000 ECU_ADDRESS 0x0000 /* @ECU_Address@MliaLeftObj2Z1Val@ */ /end MEASUREMENT
/begin MEASUREMENT MliaLeftObj2Z2Val "" UBYTE ADAS_CM_uint8 0 0 0.000000 81.000000 ECU_ADDRESS 0x0000 /* @ECU_Address@MliaLeftObj2Z2Val@ */ /end MEASUREMENT
/begin MEASUREMENT MliaLeftObj3Y1Val "" FLOAT32_IEEE ADAS_CM_single 0 0 0.000000 321.000000 ECU_ADDRESS 0x0000 /* @ECU_Address@MliaLeftObj3Y1Val@ */ /end MEASUREMENT
/begin MEASUREMENT MliaLeftObj3Y2Val "" FLOAT32_IEEE ADAS_CM_single 0 0 0.000000 321.000000 ECU_ADDRESS 0x0000 /* @ECU_Address@MliaLeftObj3Y2Val@ */ /end MEASUREMENT
/begin MEASUREMENT MliaLeftObj3Z1Val "" UBYTE ADAS_CM_uint8 0 0 0.000000 81.000000 ECU_ADDRESS 0x0000 /* @ECU_Address@MliaLeftObj3Z1Val@ */ /end MEASUREMENT
/begin MEASUREMENT MliaLeftObj3Z2Val "" UBYTE ADAS_CM_uint8 0 0 0.000000 81.000000 ECU_ADDRESS 0x0000 /* @ECU_Address@MliaLeftObj3Z2Val@ */ /end MEASUREMENT
/begin MEASUREMENT MliaLeftObj4Y1Val "" FLOAT32_IEEE ADAS_CM_single 0 0 0.000000 321.000000 ECU_ADDRESS 0x0000 /* @ECU_Address@MliaLeftObj4Y1Val@ */ /end MEASUREMENT
/begin MEASUREMENT MliaLeftObj4Y2Val "" FLOAT32_IEEE ADAS_CM_single 0 0 0.000000 321.000000 ECU_ADDRESS 0x0000 /* @ECU_Address@MliaLeftObj4Y2Val@ */ /end MEASUREMENT
/begin MEASUREMENT MliaLeftObj4Z1Val "" UBYTE ADAS_CM_uint8 0 0 0.000000 81.000000 ECU_ADDRESS 0x0000 /* @ECU_Address@MliaLeftObj4Z1Val@ */ /end MEASUREMENT
/begin MEASUREMENT MliaLeftObj4Z2Val "" UBYTE ADAS_CM_uint8 0 0 0.000000 81.000000 ECU_ADDRESS 0x0000 /* @ECU_Address@MliaLeftObj4Z2Val@ */ /end MEASUREMENT
/begin MEASUREMENT MliaLeftObj5Y1Val "" FLOAT32_IEEE ADAS_CM_single 0 0 0.000000 321.000000 ECU_ADDRESS 0x0000 /* @ECU_Address@MliaLeftObj5Y1Val@ */ /end MEASUREMENT
/begin MEASUREMENT MliaLeftObj5Y2Val "" FLOAT32_IEEE ADAS_CM_single 0 0 0.000000 321.000000 ECU_ADDRESS 0x0000 /* @ECU_Address@MliaLeftObj5Y2Val@ */ /end MEASUREMENT
/begin MEASUREMENT MliaLeftObj5Z1Val "" UBYTE ADAS_CM_uint8 0 0 0.000000 81.000000 ECU_ADDRESS 0x0000 /* @ECU_Address@MliaLeftObj5Z1Val@ */ /end MEASUREMENT
/begin MEASUREMENT MliaLeftObj5Z2Val "" UBYTE ADAS_CM_uint8 0 0 0.000000 81.000000 ECU_ADDRESS 0x0000 /* @ECU_Address@MliaLeftObj5Z2Val@ */ /end MEASUREMENT
/begin MEASUREMENT MliaLeftObj6Y1Val "" FLOAT32_IEEE ADAS_CM_single 0 0 0.000000 321.000000 ECU_ADDRESS 0x0000 /* @ECU_Address@MliaLeftObj6Y1Val@ */ /end MEASUREMENT
/begin MEASUREMENT MliaLeftObj6Y2Val "" FLOAT32_IEEE ADAS_CM_single 0 0 0.000000 321.000000 ECU_ADDRESS 0x0000 /* @ECU_Address@MliaLeftObj6Y2Val@ */ /end MEASUREMENT
/begin MEASUREMENT MliaLeftObj6Z1Val "" UBYTE ADAS_CM_uint8 0 0 0.000000 81.000000 ECU_ADDRESS 0x0000 /* @ECU_Address@MliaLeftObj6Z1Val@ */ /end MEASUREMENT
/begin MEASUREMENT MliaLeftObj6Z2Val "" UBYTE ADAS_CM_uint8 0 0 0.000000 81.000000 ECU_ADDRESS 0x0000 /* @ECU_Address@MliaLeftObj6Z2Val@ */ /end MEASUREMENT
/begin MEASUREMENT MliaLeftObj7Y1Val "" FLOAT32_IEEE ADAS_CM_single 0 0 0.000000 321.000000 ECU_ADDRESS 0x0000 /* @ECU_Address@MliaLeftObj7Y1Val@ */ /end MEASUREMENT
/begin MEASUREMENT MliaLeftObj7Y2Val "" FLOAT32_IEEE ADAS_CM_single 0 0 0.000000 321.000000 ECU_ADDRESS 0x0000 /* @ECU_Address@MliaLeftObj7Y2Val@ */ /end MEASUREMENT
/begin MEASUREMENT MliaLeftObj7Z1Val "" UBYTE ADAS_CM_uint8 0 0 0.000000 81.000000 ECU_ADDRESS 0x0000 /* @ECU_Address@MliaLeftObj7Z1Val@ */ /end MEASUREMENT
/begin MEASUREMENT MliaLeftObj7Z2Val "" UBYTE ADAS_CM_uint8 0 0 0.000000 81.000000 ECU_ADDRESS 0x0000 /* @ECU_Address@MliaLeftObj7Z2Val@ */ /end MEASUREMENT
/begin MEASUREMENT MliaLeftObj8Y1Val "" FLOAT32_IEEE ADAS_CM_single 0 0 0.000000 321.000000 ECU_ADDRESS 0x0000 /* @ECU_Address@MliaLeftObj8Y1Val@ */ /end MEASUREMENT
/begin MEASUREMENT MliaLeftObj8Y2Val "" FLOAT32_IEEE ADAS_CM_single 0 0 0.000000 321.000000 ECU_ADDRESS 0x0000 /* @ECU_Address@MliaLeftObj8Y2Val@ */ /end MEASUREMENT
/begin MEASUREMENT MliaLeftObj8Z1Val "" UBYTE ADAS_CM_uint8 0 0 0.000000 81.000000 ECU_ADDRESS 0x0000 /* @ECU_Address@MliaLeftObj8Z1Val@ */ /end MEASUREMENT
/begin MEASUREMENT MliaLeftObj8Z2Val "" UBYTE ADAS_CM_uint8 0 0 0.000000 81.000000 ECU_ADDRESS 0x0000 /* @ECU_Address@MliaLeftObj8Z2Val@ */ /end MEASUREMENT
/begin MEASUREMENT MliaLeftObj9Y1Val "" FLOAT32_IEEE ADAS_CM_single 0 0 0.000000 321.000000 ECU_ADDRESS 0x0000 /* @ECU_Address@MliaLeftObj9Y1Val@ */ /end MEASUREMENT
/begin MEASUREMENT MliaLeftObj9Y2Val "" FLOAT32_IEEE ADAS_CM_single 0 0 0.000000 321.000000 ECU_ADDRESS 0x0000 /* @ECU_Address@MliaLeftObj9Y2Val@ */ /end MEASUREMENT
/begin MEASUREMENT MliaLeftObj9Z1Val "" UBYTE ADAS_CM_uint8 0 0 0.000000 81.000000 ECU_ADDRESS 0x0000 /* @ECU_Address@MliaLeftObj9Z1Val@ */ /end MEASUREMENT
/begin MEASUREMENT MliaLeftObj9Z2Val "" UBYTE ADAS_CM_uint8 0 0 0.000000 81.000000 ECU_ADDRESS 0x0000 /* @ECU_Address@MliaLeftObj9Z2Val@ */ /end MEASUREMENT
/begin MEASUREMENT MliaLeftProjBrightSlot1Req "" UBYTE ADAS_CM_uint8 0 0 0.000000 7.000000 ECU_ADDRESS 0x0000 /* @ECU_Address@MliaLeftProjBrightSlot1Req@ */ /end MEASUREMENT
/begin MEASUREMENT MliaLeftProjBrightSlot2Req "" UBYTE ADAS_CM_uint8 0 0 0.000000 7.000000 ECU_ADDRESS 0x0000 /* @ECU_Address@MliaLeftProjBrightSlot2Req@ */ /end MEASUREMENT
/begin MEASUREMENT MliaLeftProjBrightSlot3Req "" UBYTE ADAS_CM_uint8 0 0 0.000000 7.000000 ECU_ADDRESS 0x0000 /* @ECU_Address@MliaLeftProjBrightSlot3Req@ */ /end MEASUREMENT
/begin MEASUREMENT MliaLeftProjBrightSlot4Req "" UBYTE ADAS_CM_uint8 0 0 0.000000 7.000000 ECU_ADDRESS 0x0000 /* @ECU_Address@MliaLeftProjBrightSlot4Req@ */ /end MEASUREMENT
/begin MEASUREMENT MliaLeftProjSlot1Req "" UBYTE ADAS_CM_uint8 0 0 0.000000 65.000000 ECU_ADDRESS 0x0000 /* @ECU_Address@MliaLeftProjSlot1Req@ */ /end MEASUREMENT
/begin MEASUREMENT MliaLeftProjSlot2Req "" UBYTE ADAS_CM_uint8 0 0 0.000000 15.000000 ECU_ADDRESS 0x0000 /* @ECU_Address@MliaLeftProjSlot2Req@ */ /end MEASUREMENT
/begin MEASUREMENT MliaLeftProjSlot3Req "" UBYTE ADAS_CM_uint8 0 0 0.000000 7.000000 ECU_ADDRESS 0x0000 /* @ECU_Address@MliaLeftProjSlot3Req@ */ /end MEASUREMENT
/begin MEASUREMENT MliaLeftProjSlot4Req "" UBYTE ADAS_CM_uint8 0 0 0.000000 7.000000 ECU_ADDRESS 0x0000 /* @ECU_Address@MliaLeftProjSlot4Req@ */ /end MEASUREMENT
/begin MEASUREMENT MliaMode "" UBYTE ADAS_CM_uint8 0 0 0.000000 3.000000 ECU_ADDRESS 0x0000 /* @ECU_Address@MliaMode@ */ /end MEASUREMENT
/begin MEASUREMENT MliaRADBLED10Req "" UBYTE ADAS_CM_uint8 0 0 0.000000 1.000000 ECU_ADDRESS 0x0000 /* @ECU_Address@MliaRADBLED10Req@ */ /end MEASUREMENT
/begin MEASUREMENT MliaRADBLED11Req "" UBYTE ADAS_CM_uint8 0 0 0.000000 1.000000 ECU_ADDRESS 0x0000 /* @ECU_Address@MliaRADBLED11Req@ */ /end MEASUREMENT
/begin MEASUREMENT MliaRADBLED12Req "" UBYTE ADAS_CM_uint8 0 0 0.000000 1.000000 ECU_ADDRESS 0x0000 /* @ECU_Address@MliaRADBLED12Req@ */ /end MEASUREMENT
/begin MEASUREMENT MliaRADBLED13Req "" UBYTE ADAS_CM_uint8 0 0 0.000000 1.000000 ECU_ADDRESS 0x0000 /* @ECU_Address@MliaRADBLED13Req@ */ /end MEASUREMENT
/begin MEASUREMENT MliaRADBLED14Req "" UBYTE ADAS_CM_uint8 0 0 0.000000 1.000000 ECU_ADDRESS 0x0000 /* @ECU_Address@MliaRADBLED14Req@ */ /end MEASUREMENT
/begin MEASUREMENT MliaRADBLED15Req "" UBYTE ADAS_CM_uint8 0 0 0.000000 1.000000 ECU_ADDRESS 0x0000 /* @ECU_Address@MliaRADBLED15Req@ */ /end MEASUREMENT
/begin MEASUREMENT MliaRADBLED16Req "" UBYTE ADAS_CM_uint8 0 0 0.000000 1.000000 ECU_ADDRESS 0x0000 /* @ECU_Address@MliaRADBLED16Req@ */ /end MEASUREMENT
/begin MEASUREMENT MliaRADBLED17Req "" UBYTE ADAS_CM_uint8 0 0 0.000000 1.000000 ECU_ADDRESS 0x0000 /* @ECU_Address@MliaRADBLED17Req@ */ /end MEASUREMENT
/begin MEASUREMENT MliaRADBLED18Req "" UBYTE ADAS_CM_uint8 0 0 0.000000 1.000000 ECU_ADDRESS 0x0000 /* @ECU_Address@MliaRADBLED18Req@ */ /end MEASUREMENT
/begin MEASUREMENT MliaRADBLED1Req "" UBYTE ADAS_CM_uint8 0 0 0.000000 1.000000 ECU_ADDRESS 0x0000 /* @ECU_Address@MliaRADBLED1Req@ */ /end MEASUREMENT
/begin MEASUREMENT MliaRADBLED2Req "" UBYTE ADAS_CM_uint8 0 0 0.000000 1.000000 ECU_ADDRESS 0x0000 /* @ECU_Address@MliaRADBLED2Req@ */ /end MEASUREMENT
/begin MEASUREMENT MliaRADBLED3Req "" UBYTE ADAS_CM_uint8 0 0 0.000000 1.000000 ECU_ADDRESS 0x0000 /* @ECU_Address@MliaRADBLED3Req@ */ /end MEASUREMENT
/begin MEASUREMENT MliaRADBLED4Req "" UBYTE ADAS_CM_uint8 0 0 0.000000 1.000000 ECU_ADDRESS 0x0000 /* @ECU_Address@MliaRADBLED4Req@ */ /end MEASUREMENT
/begin MEASUREMENT MliaRADBLED5Req "" UBYTE ADAS_CM_uint8 0 0 0.000000 1.000000 ECU_ADDRESS 0x0000 /* @ECU_Address@MliaRADBLED5Req@ */ /end MEASUREMENT
/begin MEASUREMENT MliaRADBLED6Req "" UBYTE ADAS_CM_uint8 0 0 0.000000 1.000000 ECU_ADDRESS 0x0000 /* @ECU_Address@MliaRADBLED6Req@ */ /end MEASUREMENT
/begin MEASUREMENT MliaRADBLED7Req "" UBYTE ADAS_CM_uint8 0 0 0.000000 1.000000 ECU_ADDRESS 0x0000 /* @ECU_Address@MliaRADBLED7Req@ */ /end MEASUREMENT
/begin MEASUREMENT MliaRADBLED8Req "" UBYTE ADAS_CM_uint8 0 0 0.000000 1.000000 ECU_ADDRESS 0x0000 /* @ECU_Address@MliaRADBLED8Req@ */ /end MEASUREMENT
/begin MEASUREMENT MliaRADBLED9Req "" UBYTE ADAS_CM_uint8 0 0 0.000000 1.000000 ECU_ADDRESS 0x0000 /* @ECU_Address@MliaRADBLED9Req@ */ /end MEASUREMENT
/begin MEASUREMENT MliaRightObj10Y1Val "" FLOAT32_IEEE ADAS_CM_single 0 0 0.000000 321.000000 ECU_ADDRESS 0x0000 /* @ECU_Address@MliaRightObj10Y1Val@ */ /end MEASUREMENT
/begin MEASUREMENT MliaRightObj10Y2Val "" FLOAT32_IEEE ADAS_CM_single 0 0 0.000000 321.000000 ECU_ADDRESS 0x0000 /* @ECU_Address@MliaRightObj10Y2Val@ */ /end MEASUREMENT
/begin MEASUREMENT MliaRightObj10Z1Val "" UBYTE ADAS_CM_uint8 0 0 0.000000 81.000000 ECU_ADDRESS 0x0000 /* @ECU_Address@MliaRightObj10Z1Val@ */ /end MEASUREMENT
/begin MEASUREMENT MliaRightObj10Z2Val "" UBYTE ADAS_CM_uint8 0 0 0.000000 81.000000 ECU_ADDRESS 0x0000 /* @ECU_Address@MliaRightObj10Z2Val@ */ /end MEASUREMENT
/begin MEASUREMENT MliaRightObj1Y1Val "" FLOAT32_IEEE ADAS_CM_single 0 0 0.000000 511.000000 ECU_ADDRESS 0x0000 /* @ECU_Address@MliaRightObj1Y1Val@ */ /end MEASUREMENT
/begin MEASUREMENT MliaRightObj1Y2Val "" FLOAT32_IEEE ADAS_CM_single 0 0 0.000000 321.000000 ECU_ADDRESS 0x0000 /* @ECU_Address@MliaRightObj1Y2Val@ */ /end MEASUREMENT
/begin MEASUREMENT MliaRightObj1Z1Val "" UBYTE ADAS_CM_uint8 0 0 0.000000 81.000000 ECU_ADDRESS 0x0000 /* @ECU_Address@MliaRightObj1Z1Val@ */ /end MEASUREMENT
/begin MEASUREMENT MliaRightObj1Z2Val "" UBYTE ADAS_CM_uint8 0 0 0.000000 81.000000 ECU_ADDRESS 0x0000 /* @ECU_Address@MliaRightObj1Z2Val@ */ /end MEASUREMENT
/begin MEASUREMENT MliaRightObj2Y1Val "" FLOAT32_IEEE ADAS_CM_single 0 0 0.000000 321.000000 ECU_ADDRESS 0x0000 /* @ECU_Address@MliaRightObj2Y1Val@ */ /end MEASUREMENT
/begin MEASUREMENT MliaRightObj2Y2Val "" FLOAT32_IEEE ADAS_CM_single 0 0 0.000000 321.000000 ECU_ADDRESS 0x0000 /* @ECU_Address@MliaRightObj2Y2Val@ */ /end MEASUREMENT
/begin MEASUREMENT MliaRightObj2Z1Val "" UBYTE ADAS_CM_uint8 0 0 0.000000 81.000000 ECU_ADDRESS 0x0000 /* @ECU_Address@MliaRightObj2Z1Val@ */ /end MEASUREMENT
/begin MEASUREMENT MliaRightObj2Z2Val "" UBYTE ADAS_CM_uint8 0 0 0.000000 81.000000 ECU_ADDRESS 0x0000 /* @ECU_Address@MliaRightObj2Z2Val@ */ /end MEASUREMENT
/begin MEASUREMENT MliaRightObj3Y1Val "" FLOAT32_IEEE ADAS_CM_single 0 0 0.000000 321.000000 ECU_ADDRESS 0x0000 /* @ECU_Address@MliaRightObj3Y1Val@ */ /end MEASUREMENT
/begin MEASUREMENT MliaRightObj3Y2Val "" FLOAT32_IEEE ADAS_CM_single 0 0 0.000000 321.000000 ECU_ADDRESS 0x0000 /* @ECU_Address@MliaRightObj3Y2Val@ */ /end MEASUREMENT
/begin MEASUREMENT MliaRightObj3Z1Val "" UBYTE ADAS_CM_uint8 0 0 0.000000 81.000000 ECU_ADDRESS 0x0000 /* @ECU_Address@MliaRightObj3Z1Val@ */ /end MEASUREMENT
/begin MEASUREMENT MliaRightObj3Z2Val "" UBYTE ADAS_CM_uint8 0 0 0.000000 81.000000 ECU_ADDRESS 0x0000 /* @ECU_Address@MliaRightObj3Z2Val@ */ /end MEASUREMENT
/begin MEASUREMENT MliaRightObj4Y1Val "" FLOAT32_IEEE ADAS_CM_single 0 0 0.000000 321.000000 ECU_ADDRESS 0x0000 /* @ECU_Address@MliaRightObj4Y1Val@ */ /end MEASUREMENT
/begin MEASUREMENT MliaRightObj4Y2Val "" FLOAT32_IEEE ADAS_CM_single 0 0 0.000000 321.000000 ECU_ADDRESS 0x0000 /* @ECU_Address@MliaRightObj4Y2Val@ */ /end MEASUREMENT
/begin MEASUREMENT MliaRightObj4Z1Val "" UBYTE ADAS_CM_uint8 0 0 0.000000 81.000000 ECU_ADDRESS 0x0000 /* @ECU_Address@MliaRightObj4Z1Val@ */ /end MEASUREMENT
/begin MEASUREMENT MliaRightObj4Z2Val "" UBYTE ADAS_CM_uint8 0 0 0.000000 81.000000 ECU_ADDRESS 0x0000 /* @ECU_Address@MliaRightObj4Z2Val@ */ /end MEASUREMENT
/begin MEASUREMENT MliaRightObj5Y1Val "" FLOAT32_IEEE ADAS_CM_single 0 0 0.000000 321.000000 ECU_ADDRESS 0x0000 /* @ECU_Address@MliaRightObj5Y1Val@ */ /end MEASUREMENT
/begin MEASUREMENT MliaRightObj5Y2Val "" FLOAT32_IEEE ADAS_CM_single 0 0 0.000000 321.000000 ECU_ADDRESS 0x0000 /* @ECU_Address@MliaRightObj5Y2Val@ */ /end MEASUREMENT
/begin MEASUREMENT MliaRightObj5Z1Val "" UBYTE ADAS_CM_uint8 0 0 0.000000 81.000000 ECU_ADDRESS 0x0000 /* @ECU_Address@MliaRightObj5Z1Val@ */ /end MEASUREMENT
/begin MEASUREMENT MliaRightObj5Z2Val "" UBYTE ADAS_CM_uint8 0 0 0.000000 81.000000 ECU_ADDRESS 0x0000 /* @ECU_Address@MliaRightObj5Z2Val@ */ /end MEASUREMENT
/begin MEASUREMENT MliaRightObj6Y1Val "" FLOAT32_IEEE ADAS_CM_single 0 0 0.000000 321.000000 ECU_ADDRESS 0x0000 /* @ECU_Address@MliaRightObj6Y1Val@ */ /end MEASUREMENT
/begin MEASUREMENT MliaRightObj6Y2Val "" FLOAT32_IEEE ADAS_CM_single 0 0 0.000000 321.000000 ECU_ADDRESS 0x0000 /* @ECU_Address@MliaRightObj6Y2Val@ */ /end MEASUREMENT
/begin MEASUREMENT MliaRightObj6Z1Val "" UBYTE ADAS_CM_uint8 0 0 0.000000 81.000000 ECU_ADDRESS 0x0000 /* @ECU_Address@MliaRightObj6Z1Val@ */ /end MEASUREMENT
/begin MEASUREMENT MliaRightObj6Z2Val "" UBYTE ADAS_CM_uint8 0 0 0.000000 81.000000 ECU_ADDRESS 0x0000 /* @ECU_Address@MliaRightObj6Z2Val@ */ /end MEASUREMENT
/begin MEASUREMENT MliaRightObj7Y1Val "" FLOAT32_IEEE ADAS_CM_single 0 0 0.000000 321.000000 ECU_ADDRESS 0x0000 /* @ECU_Address@MliaRightObj7Y1Val@ */ /end MEASUREMENT
/begin MEASUREMENT MliaRightObj7Y2Val "" FLOAT32_IEEE ADAS_CM_single 0 0 0.000000 321.000000 ECU_ADDRESS 0x0000 /* @ECU_Address@MliaRightObj7Y2Val@ */ /end MEASUREMENT
/begin MEASUREMENT MliaRightObj7Z1Val "" UBYTE ADAS_CM_uint8 0 0 0.000000 81.000000 ECU_ADDRESS 0x0000 /* @ECU_Address@MliaRightObj7Z1Val@ */ /end MEASUREMENT
/begin MEASUREMENT MliaRightObj7Z2Val "" UBYTE ADAS_CM_uint8 0 0 0.000000 81.000000 ECU_ADDRESS 0x0000 /* @ECU_Address@MliaRightObj7Z2Val@ */ /end MEASUREMENT
/begin MEASUREMENT MliaRightObj8Y1Val "" FLOAT32_IEEE ADAS_CM_single 0 0 0.000000 321.000000 ECU_ADDRESS 0x0000 /* @ECU_Address@MliaRightObj8Y1Val@ */ /end MEASUREMENT
/begin MEASUREMENT MliaRightObj8Y2Val "" FLOAT32_IEEE ADAS_CM_single 0 0 0.000000 321.000000 ECU_ADDRESS 0x0000 /* @ECU_Address@MliaRightObj8Y2Val@ */ /end MEASUREMENT
/begin MEASUREMENT MliaRightObj8Z1Val "" UBYTE ADAS_CM_uint8 0 0 0.000000 81.000000 ECU_ADDRESS 0x0000 /* @ECU_Address@MliaRightObj8Z1Val@ */ /end MEASUREMENT
/begin MEASUREMENT MliaRightObj8Z2Val "" UBYTE ADAS_CM_uint8 0 0 0.000000 81.000000 ECU_ADDRESS 0x0000 /* @ECU_Address@MliaRightObj8Z2Val@ */ /end MEASUREMENT
/begin MEASUREMENT MliaRightObj9Y1Val "" FLOAT32_IEEE ADAS_CM_single 0 0 0.000000 321.000000 ECU_ADDRESS 0x0000 /* @ECU_Address@MliaRightObj9Y1Val@ */ /end MEASUREMENT
/begin MEASUREMENT MliaRightObj9Y2Val "" FLOAT32_IEEE ADAS_CM_single 0 0 0.000000 321.000000 ECU_ADDRESS 0x0000 /* @ECU_Address@MliaRightObj9Y2Val@ */ /end MEASUREMENT
/begin MEASUREMENT MliaRightObj9Z1Val "" UBYTE ADAS_CM_uint8 0 0 0.000000 81.000000 ECU_ADDRESS 0x0000 /* @ECU_Address@MliaRightObj9Z1Val@ */ /end MEASUREMENT
/begin MEASUREMENT MliaRightObj9Z2Val "" UBYTE ADAS_CM_uint8 0 0 0.000000 81.000000 ECU_ADDRESS 0x0000 /* @ECU_Address@MliaRightObj9Z2Val@ */ /end MEASUREMENT
/begin MEASUREMENT MliaRightProjBrightSlot1Req "" UBYTE ADAS_CM_uint8 0 0 0.000000 7.000000 ECU_ADDRESS 0x0000 /* @ECU_Address@MliaRightProjBrightSlot1Req@ */ /end MEASUREMENT
/begin MEASUREMENT MliaRightProjBrightSlot2Req "" UBYTE ADAS_CM_uint8 0 0 0.000000 7.000000 ECU_ADDRESS 0x0000 /* @ECU_Address@MliaRightProjBrightSlot2Req@ */ /end MEASUREMENT
/begin MEASUREMENT MliaRightProjBrightSlot3Req "" UBYTE ADAS_CM_uint8 0 0 0.000000 7.000000 ECU_ADDRESS 0x0000 /* @ECU_Address@MliaRightProjBrightSlot3Req@ */ /end MEASUREMENT
/begin MEASUREMENT MliaRightProjBrightSlot4Req "" UBYTE ADAS_CM_uint8 0 0 0.000000 7.000000 ECU_ADDRESS 0x0000 /* @ECU_Address@MliaRightProjBrightSlot4Req@ */ /end MEASUREMENT
/begin MEASUREMENT MliaRightProjSlot1Req "" UBYTE ADAS_CM_uint8 0 0 0.000000 65.000000 ECU_ADDRESS 0x0000 /* @ECU_Address@MliaRightProjSlot1Req@ */ /end MEASUREMENT
/begin MEASUREMENT MliaRightProjSlot2Req "" UBYTE ADAS_CM_uint8 0 0 0.000000 15.000000 ECU_ADDRESS 0x0000 /* @ECU_Address@MliaRightProjSlot2Req@ */ /end MEASUREMENT
/begin MEASUREMENT MliaRightProjSlot3Req "" UBYTE ADAS_CM_uint8 0 0 0.000000 7.000000 ECU_ADDRESS 0x0000 /* @ECU_Address@MliaRightProjSlot3Req@ */ /end MEASUREMENT
/begin MEASUREMENT MliaRightProjSlot4Req "" UBYTE ADAS_CM_uint8 0 0 0.000000 7.000000 ECU_ADDRESS 0x0000 /* @ECU_Address@MliaRightProjSlot4Req@ */ /end MEASUREMENT
/begin MEASUREMENT MliaStreetLightStat "" UBYTE ADAS_CM_uint8 0 0 0.000000 1.000000 ECU_ADDRESS 0x0000 /* @ECU_Address@MliaStreetLightStat@ */ /end MEASUREMENT
/begin MEASUREMENT NvFuncError "" UBYTE ADAS_CM_uint8 0 0 0.000000 1.000000 ECU_ADDRESS 0x0000 /* @ECU_Address@NvFuncError@ */ /end MEASUREMENT
/begin MEASUREMENT NvMode "" UBYTE ADAS_CM_uint8 0 0 0.000000 2.000000 ECU_ADDRESS 0x0000 /* @ECU_Address@NvMode@ */ /end MEASUREMENT
/begin MEASUREMENT OSettAaModeSts "" UBYTE ADAS_CM_uint8 0 0 0.000000 2.000000 ECU_ADDRESS 0x0000 /* @ECU_Address@OSettAaModeSts@ */ /end MEASUREMENT
/begin MEASUREMENT OSettAaSts "" UBYTE ADAS_CM_uint8 0 0 0.000000 1.000000 ECU_ADDRESS 0x0000 /* @ECU_Address@OSettAaSts@ */ /end MEASUREMENT
/begin MEASUREMENT OSettAebSts "" UBYTE ADAS_CM_uint8 0 0 0.000000 1.000000 ECU_ADDRESS 0x0000 /* @ECU_Address@OSettAebSts@ */ /end MEASUREMENT
/begin MEASUREMENT OSettAfsSts "" UBYTE ADAS_CM_uint8 0 0 0.000000 1.000000 ECU_ADDRESS 0x0000 /* @ECU_Address@OSettAfsSts@ */ /end MEASUREMENT
/begin MEASUREMENT OSettAlccSts "" UBYTE ADAS_CM_uint8 0 0 0.000000 1.000000 ECU_ADDRESS 0x0000 /* @ECU_Address@OSettAlccSts@ */ /end MEASUREMENT
/begin MEASUREMENT OSettAslaOverCmd "" UBYTE ADAS_CM_uint8 0 0 0.000000 60.000000 ECU_ADDRESS 0x0000 /* @ECU_Address@OSettAslaOverCmd@ */ /end MEASUREMENT
/begin MEASUREMENT OSettAslaSts "" UBYTE ADAS_CM_uint8 0 0 0.000000 1.000000 ECU_ADDRESS 0x0000 /* @ECU_Address@OSettAslaSts@ */ /end MEASUREMENT
/begin MEASUREMENT OSettCcModeSts "" UBYTE ADAS_CM_uint8 0 0 0.000000 2.000000 ECU_ADDRESS 0x0000 /* @ECU_Address@OSettCcModeSts@ */ /end MEASUREMENT
/begin MEASUREMENT OSettCcSpdCorrectSts "" UBYTE ADAS_CM_uint8 0 0 0.000000 1.000000 ECU_ADDRESS 0x0000 /* @ECU_Address@OSettCcSpdCorrectSts@ */ /end MEASUREMENT
/begin MEASUREMENT OSettCcTypeSts "" UBYTE ADAS_CM_uint8 0 0 0.000000 3.000000 ECU_ADDRESS 0x0000 /* @ECU_Address@OSettCcTypeSts@ */ /end MEASUREMENT
/begin MEASUREMENT OSettDowSoundSts "" UBYTE ADAS_CM_uint8 0 0 0.000000 1.000000 ECU_ADDRESS 0x0000 /* @ECU_Address@OSettDowSoundSts@ */ /end MEASUREMENT
/begin MEASUREMENT OSettDowSts "" UBYTE ADAS_CM_uint8 0 0 0.000000 1.000000 ECU_ADDRESS 0x0000 /* @ECU_Address@OSettDowSts@ */ /end MEASUREMENT
/begin MEASUREMENT OSettFcwModeSts "" UBYTE ADAS_CM_uint8 0 0 0.000000 2.000000 ECU_ADDRESS 0x0000 /* @ECU_Address@OSettFcwModeSts@ */ /end MEASUREMENT
/begin MEASUREMENT OSettFcwSts "" UBYTE ADAS_CM_uint8 0 0 0.000000 1.000000 ECU_ADDRESS 0x0000 /* @ECU_Address@OSettFcwSts@ */ /end MEASUREMENT
/begin MEASUREMENT OSettFcwVibrationSts "" UBYTE ADAS_CM_uint8 0 0 0.000000 1.000000 ECU_ADDRESS 0x0000 /* @ECU_Address@OSettFcwVibrationSts@ */ /end MEASUREMENT
/begin MEASUREMENT OSettLccModeSts "" UBYTE ADAS_CM_uint8 0 0 0.000000 2.000000 ECU_ADDRESS 0x0000 /* @ECU_Address@OSettLccModeSts@ */ /end MEASUREMENT
/begin MEASUREMENT OSettLccSoundSts "" UBYTE ADAS_CM_uint8 0 0 0.000000 1.000000 ECU_ADDRESS 0x0000 /* @ECU_Address@OSettLccSoundSts@ */ /end MEASUREMENT
/begin MEASUREMENT OSettLccSts "" UBYTE ADAS_CM_uint8 0 0 0.000000 1.000000 ECU_ADDRESS 0x0000 /* @ECU_Address@OSettLccSts@ */ /end MEASUREMENT
/begin MEASUREMENT OSettLccVibrationSts "" UBYTE ADAS_CM_uint8 0 0 0.000000 1.000000 ECU_ADDRESS 0x0000 /* @ECU_Address@OSettLccVibrationSts@ */ /end MEASUREMENT
/begin MEASUREMENT OSettLdpSts "" UBYTE ADAS_CM_uint8 0 0 0.000000 1.000000 ECU_ADDRESS 0x0000 /* @ECU_Address@OSettLdpSts@ */ /end MEASUREMENT
/begin MEASUREMENT OSettLdwModeSts "" UBYTE ADAS_CM_uint8 0 0 0.000000 1.000000 ECU_ADDRESS 0x0000 /* @ECU_Address@OSettLdwModeSts@ */ /end MEASUREMENT
/begin MEASUREMENT OSettLdwSoundSts "" UBYTE ADAS_CM_uint8 0 0 0.000000 1.000000 ECU_ADDRESS 0x0000 /* @ECU_Address@OSettLdwSoundSts@ */ /end MEASUREMENT
/begin MEASUREMENT OSettLdwSts "" UBYTE ADAS_CM_uint8 0 0 0.000000 1.000000 ECU_ADDRESS 0x0000 /* @ECU_Address@OSettLdwSts@ */ /end MEASUREMENT
/begin MEASUREMENT OSettLdwVibrationSts "" UBYTE ADAS_CM_uint8 0 0 0.000000 1.000000 ECU_ADDRESS 0x0000 /* @ECU_Address@OSettLdwVibrationSts@ */ /end MEASUREMENT
/begin MEASUREMENT OSettLkaSts "" UBYTE ADAS_CM_uint8 0 0 0.000000 1.000000 ECU_ADDRESS 0x0000 /* @ECU_Address@OSettLkaSts@ */ /end MEASUREMENT
/begin MEASUREMENT OSettNavigSts "" UBYTE ADAS_CM_uint8 0 0 0.000000 1.000000 ECU_ADDRESS 0x0000 /* @ECU_Address@OSettNavigSts@ */ /end MEASUREMENT
/begin MEASUREMENT OSettOtherObjSts "" UBYTE ADAS_CM_uint8 0 0 0.000000 1.000000 ECU_ADDRESS 0x0000 /* @ECU_Address@OSettOtherObjSts@ */ /end MEASUREMENT
/begin MEASUREMENT OSettProjectionOnARoadSts "" UBYTE ADAS_CM_uint8 0 0 0.000000 1.000000 ECU_ADDRESS 0x0000 /* @ECU_Address@OSettProjectionOnARoadSts@ */ /end MEASUREMENT
/begin MEASUREMENT OSettRctcSts "" UBYTE ADAS_CM_uint8 0 0 0.000000 1.000000 ECU_ADDRESS 0x0000 /* @ECU_Address@OSettRctcSts@ */ /end MEASUREMENT
/begin MEASUREMENT OSettRdaSts "" UBYTE ADAS_CM_uint8 0 0 0.000000 1.000000 ECU_ADDRESS 0x0000 /* @ECU_Address@OSettRdaSts@ */ /end MEASUREMENT
/begin MEASUREMENT OSettRecSts "" UBYTE ADAS_CM_uint8 0 0 0.000000 1.000000 ECU_ADDRESS 0x0000 /* @ECU_Address@OSettRecSts@ */ /end MEASUREMENT
/begin MEASUREMENT OSettRoadSignSts "" UBYTE ADAS_CM_uint8 0 0 0.000000 1.000000 ECU_ADDRESS 0x0000 /* @ECU_Address@OSettRoadSignSts@ */ /end MEASUREMENT
/begin MEASUREMENT OSettSensCleanSts "" UBYTE ADAS_CM_uint8 0 0 0.000000 1.000000 ECU_ADDRESS 0x0000 /* @ECU_Address@OSettSensCleanSts@ */ /end MEASUREMENT
/begin MEASUREMENT OSettTsrSts "" UBYTE ADAS_CM_uint8 0 0 0.000000 1.000000 ECU_ADDRESS 0x0000 /* @ECU_Address@OSettTsrSts@ */ /end MEASUREMENT
/begin MEASUREMENT RctcWarnReq "" UBYTE ADAS_CM_uint8 0 0 0.000000 1.000000 ECU_ADDRESS 0x0000 /* @ECU_Address@RctcWarnReq@ */ /end MEASUREMENT
/begin MEASUREMENT RcwMode "" UBYTE ADAS_CM_uint8 0 0 0.000000 1.000000 ECU_ADDRESS 0x0000 /* @ECU_Address@RcwMode@ */ /end MEASUREMENT
/begin MEASUREMENT RcwWarnReq "" UBYTE ADAS_CM_uint8 0 0 0.000000 1.000000 ECU_ADDRESS 0x0000 /* @ECU_Address@RcwWarnReq@ */ /end MEASUREMENT
/begin MEASUREMENT RdaDecelReqFalg "" UBYTE ADAS_CM_uint8 0 0 0.000000 1.000000 ECU_ADDRESS 0x0000 /* @ECU_Address@RdaDecelReqFalg@ */ /end MEASUREMENT
/begin MEASUREMENT RdaFuncError "" UBYTE ADAS_CM_uint8 0 0 0.000000 1.000000 ECU_ADDRESS 0x0000 /* @ECU_Address@RdaFuncError@ */ /end MEASUREMENT
/begin MEASUREMENT RdaMode "" UBYTE ADAS_CM_uint8 0 0 0.000000 1.000000 ECU_ADDRESS 0x0000 /* @ECU_Address@RdaMode@ */ /end MEASUREMENT
/begin MEASUREMENT RdaNotifError "" UBYTE ADAS_CM_uint8 0 0 0.000000 1.000000 ECU_ADDRESS 0x0000 /* @ECU_Address@RdaNotifError@ */ /end MEASUREMENT
/begin MEASUREMENT RdaWarnReq "" UBYTE ADAS_CM_uint8 0 0 0.000000 1.000000 ECU_ADDRESS 0x0000 /* @ECU_Address@RdaWarnReq@ */ /end MEASUREMENT
/begin MEASUREMENT RecMode "" UBYTE ADAS_CM_uint8 0 0 0.000000 2.000000 ECU_ADDRESS 0x0000 /* @ECU_Address@RecMode@ */ /end MEASUREMENT
/begin MEASUREMENT SensAllDirty_Stat "" UBYTE ADAS_CM_uint8 0 0 0.000000 1.000000 ECU_ADDRESS 0x0000 /* @ECU_Address@SensAllDirty_Stat@ */ /end MEASUREMENT
/begin MEASUREMENT SensClearReq "" UBYTE ADAS_CM_uint8 0 0 0.000000 4.000000 ECU_ADDRESS 0x0000 /* @ECU_Address@SensClearReq@ */ /end MEASUREMENT
/begin MEASUREMENT SensFrcuDirty_Stat "" UBYTE ADAS_CM_uint8 0 0 0.000000 1.000000 ECU_ADDRESS 0x0000 /* @ECU_Address@SensFrcuDirty_Stat@ */ /end MEASUREMENT
/begin MEASUREMENT SensLidarDirty_Stat "" UBYTE ADAS_CM_uint8 0 0 0.000000 1.000000 ECU_ADDRESS 0x0000 /* @ECU_Address@SensLidarDirty_Stat@ */ /end MEASUREMENT
/begin MEASUREMENT SensMrrxDirty_Stat "" UBYTE ADAS_CM_uint8 0 0 0.000000 3.000000 ECU_ADDRESS 0x0000 /* @ECU_Address@SensMrrxDirty_Stat@ */ /end MEASUREMENT
/begin MEASUREMENT SensTicuDirty_Stat "" UBYTE ADAS_CM_uint8 0 0 0.000000 1.000000 ECU_ADDRESS 0x0000 /* @ECU_Address@SensTicuDirty_Stat@ */ /end MEASUREMENT
/begin MEASUREMENT SensWSHeatReq "" UBYTE ADAS_CM_uint8 0 0 0.000000 3.000000 ECU_ADDRESS 0x0000 /* @ECU_Address@SensWSHeatReq@ */ /end MEASUREMENT
/begin MEASUREMENT TsrHudMultSignAddres "" UBYTE ADAS_CM_uint8 0 0 0.000000 1.000000 ECU_ADDRESS 0x0000 /* @ECU_Address@TsrHudMultSignAddres@ */ /end MEASUREMENT
/begin MEASUREMENT TsrHudMultiSign "" UBYTE ADAS_CM_uint8 0 0 0.000000 20.000000 ECU_ADDRESS 0x0000 /* @ECU_Address@TsrHudMultiSign@ */ /end MEASUREMENT
/begin MEASUREMENT TsrMode "" UBYTE ADAS_CM_uint8 0 0 0.000000 1.000000 ECU_ADDRESS 0x0000 /* @ECU_Address@TsrMode@ */ /end MEASUREMENT
/begin MEASUREMENT TsrSignError "" UBYTE ADAS_CM_uint8 0 0 0.000000 1.000000 ECU_ADDRESS 0x0000 /* @ECU_Address@TsrSignError@ */ /end MEASUREMENT
/begin MEASUREMENT TsrSignNotifError "" UBYTE ADAS_CM_uint8 0 0 0.000000 1.000000 ECU_ADDRESS 0x0000 /* @ECU_Address@TsrSignNotifError@ */ /end MEASUREMENT
/begin MEASUREMENT TsrSignOverTaking "" UBYTE ADAS_CM_uint8 0 0 0.000000 11.000000 ECU_ADDRESS 0x0000 /* @ECU_Address@TsrSignOverTaking@ */ /end MEASUREMENT
/begin MEASUREMENT USSFrontReq "" UBYTE ADAS_CM_uint8 0 0 0.000000 1.000000 ECU_ADDRESS 0x0000 /* @ECU_Address@USSFrontReq@ */ /end MEASUREMENT
/begin MEASUREMENT USSRearReq "" UBYTE ADAS_CM_uint8 0 0 0.000000 1.000000 ECU_ADDRESS 0x0000 /* @ECU_Address@USSRearReq@ */ /end MEASUREMENT
/begin MEASUREMENT USSSideReq "" UBYTE ADAS_CM_uint8 0 0 0.000000 1.000000 ECU_ADDRESS 0x0000 /* @ECU_Address@USSSideReq@ */ /end MEASUREMENT
/begin MEASUREMENT rtDW_ADAS.GTBrightness "" UBYTE ADAS_CM_uint8 0 0 0 255 ECU_ADDRESS 0x0000 /* @ECU_Address@rtDW_ADAS.GTBrightness@ */ /end MEASUREMENT
/begin MEASUREMENT rtDW_ADAS.GTHudActSts "" UBYTE ADAS_CM_uint8 0 0 0 255 ECU_ADDRESS 0x0000 /* @ECU_Address@rtDW_ADAS.GTHudActSts@ */ /end MEASUREMENT
/begin MEASUREMENT rtDW_ADAS.GTLdwLeftLineWarnReq "" UBYTE ADAS_CM_uint8 0 0 0 255 ECU_ADDRESS 0x0000 /* @ECU_Address@rtDW_ADAS.GTLdwLeftLineWarnReq@ */ /end MEASUREMENT
/begin MEASUREMENT rtDW_ADAS.GTLdwMode_d "" UBYTE ADAS_CM_uint8 0 0 0 255 ECU_ADDRESS 0x0000 /* @ECU_Address@rtDW_ADAS.GTLdwMode_d@ */ /end MEASUREMENT
/begin MEASUREMENT rtDW_ADAS.GTLdwRightLineWarnReq "" UBYTE ADAS_CM_uint8 0 0 0 255 ECU_ADDRESS 0x0000 /* @ECU_Address@rtDW_ADAS.GTLdwRightLineWarnReq@ */ /end MEASUREMENT
/begin MEASUREMENT rtDW_ADAS.GTLdwSoundReq_k "" UBYTE ADAS_CM_uint8 0 0 0 255 ECU_ADDRESS 0x0000 /* @ECU_Address@rtDW_ADAS.GTLdwSoundReq_k@ */ /end MEASUREMENT
/begin MEASUREMENT rtDW_ADAS.GTLidarBlk "" UBYTE ADAS_CM_uint8 0 0 0 255 ECU_ADDRESS 0x0000 /* @ECU_Address@rtDW_ADAS.GTLidarBlk@ */ /end MEASUREMENT
/begin MEASUREMENT rtDW_ADAS.GTLidarDirtSts "" UBYTE ADAS_CM_uint8 0 0 0 255 ECU_ADDRESS 0x0000 /* @ECU_Address@rtDW_ADAS.GTLidarDirtSts@ */ /end MEASUREMENT
/begin MEASUREMENT rtDW_ADAS.GTLineAdress "" UBYTE ADAS_CM_uint8 0 0 0 255 ECU_ADDRESS 0x0000 /* @ECU_Address@rtDW_ADAS.GTLineAdress@ */ /end MEASUREMENT
/begin MEASUREMENT rtDW_ADAS.GTNumOfWarnLDW "" FLOAT32_IEEE ADAS_CM_single_h 0 0 -3.4E+38 3.4E+38 ECU_ADDRESS 0x0000 /* @ECU_Address@rtDW_ADAS.GTNumOfWarnLDW@ */ /end MEASUREMENT
/begin MEASUREMENT rtDW_ADAS.GTOutportBufferForEnblFcw "" UBYTE ADAS_CM_uint8 0 0 0 255 ECU_ADDRESS 0x0000 /* @ECU_Address@rtDW_ADAS.GTOutportBufferForEnblFcw@ */ /end MEASUREMENT
/begin MEASUREMENT rtDW_ADAS.GTRctcActive "" UBYTE ADAS_CM_uint8 0 0 0 255 ECU_ADDRESS 0x0000 /* @ECU_Address@rtDW_ADAS.GTRctcActive@ */ /end MEASUREMENT
/begin MEASUREMENT rtDW_ADAS.GTRctcLogicTrans "" UBYTE ADAS_CM_uint8 0 0 0 255 ECU_ADDRESS 0x0000 /* @ECU_Address@rtDW_ADAS.GTRctcLogicTrans@ */ /end MEASUREMENT
/begin MEASUREMENT rtDW_ADAS.GTRctcWarn "" UBYTE ADAS_CM_uint8 0 0 0 255 ECU_ADDRESS 0x0000 /* @ECU_Address@rtDW_ADAS.GTRctcWarn@ */ /end MEASUREMENT
/begin MEASUREMENT rtDW_ADAS.GTSensCleanReq "" UBYTE ADAS_CM_uint8 0 0 0 255 ECU_ADDRESS 0x0000 /* @ECU_Address@rtDW_ADAS.GTSensCleanReq@ */ /end MEASUREMENT
/begin MEASUREMENT rtDW_ADAS.GTSensWSHeatReq "" UBYTE ADAS_CM_uint8 0 0 0 255 ECU_ADDRESS 0x0000 /* @ECU_Address@rtDW_ADAS.GTSensWSHeatReq@ */ /end MEASUREMENT
/begin MEASUREMENT rtDW_ADAS.GTSlot_1 "" UBYTE ADAS_CM_uint8 0 0 0 255 ECU_ADDRESS 0x0000 /* @ECU_Address@rtDW_ADAS.GTSlot_1@ */ /end MEASUREMENT
/begin MEASUREMENT rtDW_ADAS.GTSlot_1_p "" UBYTE ADAS_CM_uint8 0 0 0 255 ECU_ADDRESS 0x0000 /* @ECU_Address@rtDW_ADAS.GTSlot_1_p@ */ /end MEASUREMENT
/begin MEASUREMENT rtDW_ADAS.GTSlot_2 "" UBYTE ADAS_CM_uint8 0 0 0 255 ECU_ADDRESS 0x0000 /* @ECU_Address@rtDW_ADAS.GTSlot_2@ */ /end MEASUREMENT
/begin MEASUREMENT rtDW_ADAS.GTSlot_2_p "" UBYTE ADAS_CM_uint8 0 0 0 255 ECU_ADDRESS 0x0000 /* @ECU_Address@rtDW_ADAS.GTSlot_2_p@ */ /end MEASUREMENT
/begin MEASUREMENT rtDW_ADAS.GTSlot_3 "" UBYTE ADAS_CM_uint8 0 0 0 255 ECU_ADDRESS 0x0000 /* @ECU_Address@rtDW_ADAS.GTSlot_3@ */ /end MEASUREMENT
/begin MEASUREMENT rtDW_ADAS.GTSlot_3_l "" UBYTE ADAS_CM_uint8 0 0 0 255 ECU_ADDRESS 0x0000 /* @ECU_Address@rtDW_ADAS.GTSlot_3_l@ */ /end MEASUREMENT
/begin MEASUREMENT rtDW_ADAS.GTSlot_4 "" UBYTE ADAS_CM_uint8 0 0 0 255 ECU_ADDRESS 0x0000 /* @ECU_Address@rtDW_ADAS.GTSlot_4@ */ /end MEASUREMENT
/begin MEASUREMENT rtDW_ADAS.GTSlot_4_e "" UBYTE ADAS_CM_uint8 0 0 0 255 ECU_ADDRESS 0x0000 /* @ECU_Address@rtDW_ADAS.GTSlot_4_e@ */ /end MEASUREMENT
/begin MEASUREMENT rtDW_ADAS.GTTTLC "" FLOAT32_IEEE ADAS_CM_single 0 0 -3.4E+38 3.4E+38 ECU_ADDRESS 0x0000 /* @ECU_Address@rtDW_ADAS.GTTTLC@ */ /end MEASUREMENT
/begin MEASUREMENT rtDW_ADAS.GTTarHonk "" UBYTE ADAS_CM_uint8 0 0 0 255 ECU_ADDRESS 0x0000 /* @ECU_Address@rtDW_ADAS.GTTarHonk@ */ /end MEASUREMENT
/begin MEASUREMENT rtDW_ADAS.GTTestDataWarnTar "" UBYTE ADAS_CM_uint8 0 0 0 255 ECU_ADDRESS 0x0000 /* @ECU_Address@rtDW_ADAS.GTTestDataWarnTar@ */ /end MEASUREMENT
/begin MEASUREMENT rtDW_ADAS.GTTransTTLC "" UBYTE ADAS_CM_uint8 0 0 0 255 ECU_ADDRESS 0x0000 /* @ECU_Address@rtDW_ADAS.GTTransTTLC@ */ /end MEASUREMENT
/begin MEASUREMENT rtDW_ADAS.GTTransVehPosition "" UBYTE ADAS_CM_uint8 0 0 0 255 ECU_ADDRESS 0x0000 /* @ECU_Address@rtDW_ADAS.GTTransVehPosition@ */ /end MEASUREMENT
/begin MEASUREMENT rtDW_ADAS.GTTransVehPosition_b "" UBYTE ADAS_CM_uint8 0 0 0 255 ECU_ADDRESS 0x0000 /* @ECU_Address@rtDW_ADAS.GTTransVehPosition_b@ */ /end MEASUREMENT
/begin MEASUREMENT rtDW_ADAS.GTTransWarnBlock "" UBYTE ADAS_CM_uint8 0 0 0 255 ECU_ADDRESS 0x0000 /* @ECU_Address@rtDW_ADAS.GTTransWarnBlock@ */ /end MEASUREMENT
/begin MEASUREMENT rtDW_ADAS.GTTurnRadius "" FLOAT32_IEEE ADAS_CM_single 0 0 -3.4E+38 3.4E+38 ECU_ADDRESS 0x0000 /* @ECU_Address@rtDW_ADAS.GTTurnRadius@ */ /end MEASUREMENT
/begin MEASUREMENT rtDW_ADAS.GTVdepart "" FLOAT32_IEEE ADAS_CM_single 0 0 -3.4E+38 3.4E+38 ECU_ADDRESS 0x0000 /* @ECU_Address@rtDW_ADAS.GTVdepart@ */ /end MEASUREMENT
/begin MEASUREMENT rtDW_ADAS.GTWarnDist "" UBYTE ADAS_CM_uint8 0 0 0 255 ECU_ADDRESS 0x0000 /* @ECU_Address@rtDW_ADAS.GTWarnDist@ */ /end MEASUREMENT
/begin MEASUREMENT rtDW_ADAS.GTWarnDist_j "" UBYTE ADAS_CM_uint8 0 0 0 255 ECU_ADDRESS 0x0000 /* @ECU_Address@rtDW_ADAS.GTWarnDist_j@ */ /end MEASUREMENT
/begin MEASUREMENT rtDW_ADAS.GTWarnPredict "" UBYTE ADAS_CM_uint8 0 0 0 255 ECU_ADDRESS 0x0000 /* @ECU_Address@rtDW_ADAS.GTWarnPredict@ */ /end MEASUREMENT
/begin MEASUREMENT rtDW_ADAS.GTWarnPredict_i "" UBYTE ADAS_CM_uint8 0 0 0 255 ECU_ADDRESS 0x0000 /* @ECU_Address@rtDW_ADAS.GTWarnPredict_i@ */ /end MEASUREMENT
/begin MEASUREMENT rtDW_ADAS.GTWarnReq "" UBYTE ADAS_CM_uint8 0 0 0 255 ECU_ADDRESS 0x0000 /* @ECU_Address@rtDW_ADAS.GTWarnReq@ */ /end MEASUREMENT
/begin MEASUREMENT rtDW_ADAS.GTWarnTime "" UBYTE ADAS_CM_uint8 0 0 0 255 ECU_ADDRESS 0x0000 /* @ECU_Address@rtDW_ADAS.GTWarnTime@ */ /end MEASUREMENT
/begin MEASUREMENT rtDW_ADAS.GTWarnTime_f "" UBYTE ADAS_CM_uint8 0 0 0 255 ECU_ADDRESS 0x0000 /* @ECU_Address@rtDW_ADAS.GTWarnTime_f@ */ /end MEASUREMENT
/begin MEASUREMENT rtDW_ADAS.GTYawRate_dt "" FLOAT32_IEEE ADAS_CM_single 0 0 -3.4E+38 3.4E+38 ECU_ADDRESS 0x0000 /* @ECU_Address@rtDW_ADAS.GTYawRate_dt@ */ /end MEASUREMENT
/begin MEASUREMENT rtDW_ADAS.GTis_active_c235_ADAS "" UBYTE ADAS_CM_uint8 0 0 0 255 ECU_ADDRESS 0x0000 /* @ECU_Address@rtDW_ADAS.GTis_active_c235_ADAS@ */ /end MEASUREMENT
/begin MEASUREMENT rtDW_ADAS.GTis_c235_ADAS "" UBYTE ADAS_CM_uint8 0 0 0 255 ECU_ADDRESS 0x0000 /* @ECU_Address@rtDW_ADAS.GTis_c235_ADAS@ */ /end MEASUREMENT
/begin MEASUREMENT rtDW_ADAS.GTtemporalCounter_i1_pm "" UBYTE ADAS_CM_uint8 0 0 0 255 ECU_ADDRESS 0x0000 /* @ECU_Address@rtDW_ADAS.GTtemporalCounter_i1_pm@ */ /end MEASUREMENT
/begin COMPU_METHOD ADAS_CM_single "" IDENTICAL "%8.6" "" /end COMPU_METHOD
/begin COMPU_METHOD ADAS_CM_single_h "" IDENTICAL "%8.6" "h" /end COMPU_METHOD
/begin COMPU_METHOD ADAS_CM_uint8 "" IDENTICAL "%3.0" "" /end COMPU_METHOD
/begin GROUP ADAS_Input_FrontPercData "ADAS/Input/FrontPercData"
 /begin REF_MEASUREMENT DfFPObj10DynamID DfFPObj10Orient DfFPObj10Probabil DfFPObj10Sx1 DfFPObj10Sx2 DfFPObj10Sy1 DfFPObj10Sy2 DfFPObj10Vx DfFPObj10Vy DfFPObj10detect DfFPObj10type DfFPObj11DynamID DfFPObj11Orient DfFPObj11Probabil DfFPObj11Sx1 DfFPObj11Sx2 DfFPObj11Sy1 DfFPObj11Sy2 DfFPObj11Vx DfFPObj11Vy DfFPObj11detect DfFPObj11type DfFPObj1DynamID DfFPObj1Orient DfFPObj1Probabil DfFPObj1Sx1 DfFPObj1Sx2 DfFPObj1Sy1 DfFPObj1Sy2 DfFPObj1Vx DfFPObj1Vy DfFPObj1detect DfFPObj1type DfFPObj2DynamID DfFPObj2Orient DfFPObj2Probabil DfFPObj2Sx1 DfFPObj2Sy1 DfFPObj2Vx DfFPObj2Vy DfFPObj2detect DfFPObj2type DfFPObj3DynamID DfFPObj3Orient DfFPObj3Probabil DfFPObj3Sx1 DfFPObj3Sx2 DfFPObj3Sy1 DfFPObj3Sy2 DfFPObj3Vx DfFPObj3Vy DfFPObj3detect DfFPObj3type DfFPObj4DynamID DfFPObj4Orient DfFPObj4Probabil DfFPObj4Sx1 DfFPObj4Sx2 DfFPObj4Sy1 DfFPObj4Sy2 DfFPObj4Vx DfFPObj4Vy DfFPObj4detect DfFPObj4type DfFPObj5DynamID DfFPObj5Orient DfFPObj5Probabil DfFPObj5Sx1 DfFPObj5Sx2 DfFPObj5Sy1 DfFPObj5Sy2 DfFPObj5Vx DfFPObj5Vy DfFPObj5detect DfFPObj5type DfFPObj6DynamID DfFPObj6Orient DfFPObj6Probabil DfFPObj6Sx1 DfFPObj6Sx2 DfFPObj6Sy1 DfFPObj6Sy2 DfFPObj6Vx DfFPObj6Vy DfFPObj6detect DfFPObj6type DfFPObj7DynamID DfFPObj7Orient DfFPObj7Probabil DfFPObj7Sx1 DfFPObj7Sx2 DfFPObj7Sy1 DfFPObj7Sy2 DfFPObj7Vx DfFPObj7Vy DfFPObj7detect DfFPObj7type DfFPObj8DynamID DfFPObj8Orient DfFPObj8Probabil DfFPObj8Sx1 DfFPObj8Sx2 DfFPObj8Sy1 DfFPObj8Sy2 DfFPObj8Vx DfFPObj8Vy DfFPObj8detect DfFPObj8type DfFPObj9DynamID DfFPObj9Orient DfFPObj9Probabil DfFPObj9Sx1 DfFPObj9Sx2 DfFPObj9Sy1 DfFPObj9Sy2 DfFPObj9Vx DfFPObj9Vy DfFPObj9detect DfFPObj9type /end REF_MEASUREMENT
/end GROUP
/begin GROUP ADAS_Input_LanePercData "ADAS/Input/LanePercData"
 /begin REF_MEASUREMENT DfLanePFrontLColor DfLanePFrontLSx0 DfLanePFrontLSx10 DfLanePFrontLSx100 DfLanePFrontLSx15 DfLanePFrontLSx20 DfLanePFrontLSx25 DfLanePFrontLSx30 DfLanePFrontLSx40 DfLanePFrontLSx50 DfLanePFrontLSx60 DfLanePFrontLSx70 DfLanePFrontLSx80 DfLanePFrontLSx90 DfLanePFrontLSxFA DfLanePFrontLType DfLanePFrontRColor DfLanePFrontRSx0 DfLanePFrontRSx10 DfLanePFrontRSx100 DfLanePFrontRSx15 DfLanePFrontRSx20 DfLanePFrontRSx25 DfLanePFrontRSx30 DfLanePFrontRSx40 DfLanePFrontRSx50 DfLanePFrontRSx60 DfLanePFrontRSx70 DfLanePFrontRSx80 DfLanePFrontRSx90 DfLanePFrontRSxFA DfLanePFrontRType DfLanePRearLSx10 DfLanePRearLSx100 DfLanePRearLSx20 DfLanePRearLSx30 DfLanePRearLSx40 DfLanePRearLSx5 DfLanePRearLSx50 DfLanePRearLSx60 DfLanePRearLSx70 DfLanePRearLSx80 DfLanePRearLSx90 DfLanePRearRSx10 DfLanePRearRSx20 DfLanePRearRSx30 DfLanePRearRSx40 DfLanePRearRSx5 DfLanePRearRSx50 DfLanePRearRSx60 DfLanePRearRSx70 DfLanePTrgtLineS0 DfLanePTrgtLineS1 DfLanePTrgtLineS2 DfLanePTrgtLineS3 DfLanePTrgtLineS4 /end REF_MEASUREMENT
/end GROUP
/begin GROUP ADAS_Input_MLIAPercData "ADAS/Input/MLIAPercData"
 /begin REF_MEASUREMENT DfMliaPercObj10Detect DfMliaPercObj10LightSts DfMliaPercObj10Precision DfMliaPercObj10Sx1 DfMliaPercObj10Sx2 DfMliaPercObj10Sy1 DfMliaPercObj10Sy2 DfMliaPercObj10Sz DfMliaPercObj10Vel DfMliaPercObj11Detect DfMliaPercObj11LightSts DfMliaPercObj11Precision DfMliaPercObj11Sx1 DfMliaPercObj11Sx2 DfMliaPercObj11Sy1 DfMliaPercObj11Sy2 DfMliaPercObj11Sz DfMliaPercObj11Vel DfMliaPercObj12Detect DfMliaPercObj12LightSts DfMliaPercObj12Precision DfMliaPercObj12Sx1 DfMliaPercObj12Sx2 DfMliaPercObj12Sy1 DfMliaPercObj12Sy2 DfMliaPercObj12Sz DfMliaPercObj12Vel DfMliaPercObj13Detect DfMliaPercObj13LightSts DfMliaPercObj13Precision DfMliaPercObj13Sx1 DfMliaPercObj13Sx2 DfMliaPercObj13Sy1 DfMliaPercObj13Sy2 DfMliaPercObj13Sz DfMliaPercObj13Vel DfMliaPercObj14Detect DfMliaPercObj14LightSts DfMliaPercObj14Precision DfMliaPercObj14Sx1 DfMliaPercObj14Sx2 DfMliaPercObj14Sy1 DfMliaPercObj14Sy2 DfMliaPercObj14Sz DfMliaPercObj14Vel DfMliaPercObj15Detect DfMliaPercObj15LightSts DfMliaPercObj15Precision DfMliaPercObj15Sx1 DfMliaPercObj15Sx2 DfMliaPercObj15Sy1 DfMliaPercObj15Sy2 DfMliaPercObj15Sz DfMliaPercObj15Vel DfMliaPercObj16Detect DfMliaPercObj16LightSts DfMliaPercObj16Precision DfMliaPercObj16Sx1 DfMliaPercObj16Sx2 DfMliaPercObj16Sy1 DfMliaPercObj16Sy2 DfMliaPercObj16Sz DfMliaPercObj16Vel DfMliaPercObj17Detect DfMliaPercObj17LightSts DfMliaPercObj17Precision DfMliaPercObj17Sx1 DfMliaPercObj17Sx2 DfMliaPercObj17Sy1 DfMliaPercObj17Sy2 DfMliaPercObj17Sz DfMliaPercObj17Vel DfMliaPercObj18Detect DfMliaPercObj18LightSts DfMliaPercObj18Precision DfMliaPercObj18Sx1 DfMliaPercObj18Sx2 DfMliaPercObj18Sy1 DfMliaPercObj18Sy2 DfMliaPercObj18Sz DfMliaPercObj18Vel DfMliaPercObj19Detect DfMliaPercObj19LightSts DfMliaPercObj19Precision DfMliaPercObj19Sx1 DfMliaPercObj19Sx2 DfMliaPercObj19Sy1 DfMliaPercObj19Sy2 DfMliaPercObj19Sz DfMliaPercObj19Vel DfMliaPercObj1Detect DfMliaPercObj1LightSts DfMliaPercObj1Precision DfMliaPercObj1Sx1 DfMliaPercObj1Sx2 DfMliaPercObj1Sy1 DfMliaPercObj1Sy2 DfMliaPercObj1Sz DfMliaPercObj1Vel DfMliaPercObj20Detect DfMliaPercObj20LightSts DfMliaPercObj20Precision DfMliaPercObj20Sx1 DfMliaPercObj20Sx2 DfMliaPercObj20Sy1 DfMliaPercObj20Sy2 DfMliaPercObj20Sz DfMliaPercObj20Vel DfMliaPercObj21Detect DfMliaPercObj21LightSts DfMliaPercObj21Precision DfMliaPercObj21Sx1 DfMliaPercObj21Sx2 DfMliaPercObj21Sy1 DfMliaPercObj21Sy2 DfMliaPercObj21Sz DfMliaPercObj21Vel DfMliaPercObj2Detect DfMliaPercObj2LightSts DfMliaPercObj2Precision DfMliaPercObj2Sx1 DfMliaPercObj2Sx2 DfMliaPercObj2Sy1 DfMliaPercObj2Sy2 DfMliaPercObj2Sz DfMliaPercObj2Vel DfMliaPercObj3Detect DfMliaPercObj3LightSts DfMliaPercObj3Precision DfMliaPercObj3Sx1 DfMliaPercObj3Sx2 DfMliaPercObj3Sy1 DfMliaPercObj3Sy2 DfMliaPercObj3Sz DfMliaPercObj3Vel DfMliaPercObj4Detect DfMliaPercObj4LightSts DfMliaPercObj4Precision DfMliaPercObj4Sx1 DfMliaPercObj4Sx2 DfMliaPercObj4Sy1 DfMliaPercObj4Sy2 DfMliaPercObj4Sz DfMliaPercObj4Vel DfMliaPercObj5Detect DfMliaPercObj5LightSts DfMliaPercObj5Precision DfMliaPercObj5Sx1 DfMliaPercObj5Sx2 DfMliaPercObj5Sy1 DfMliaPercObj5Sy2 DfMliaPercObj5Sz DfMliaPercObj5Vel DfMliaPercObj6Detect DfMliaPercObj6LightSts DfMliaPercObj6Precision DfMliaPercObj6Sx1 DfMliaPercObj6Sx2 DfMliaPercObj6Sy1 DfMliaPercObj6Sy2 DfMliaPercObj6Sz DfMliaPercObj6Vel DfMliaPercObj7Detect DfMliaPercObj7LightSts DfMliaPercObj7Precision DfMliaPercObj7Sx1 DfMliaPercObj7Sx2 DfMliaPercObj7Sy1 DfMliaPercObj7Sy2 DfMliaPercObj7Sz DfMliaPercObj7Vel DfMliaPercObj8Detect DfMliaPercObj8LightSts DfMliaPercObj8Precision DfMliaPercObj8Sx1 DfMliaPercObj8Sx2 DfMliaPercObj8Sy1 DfMliaPercObj8Sy2 DfMliaPercObj8Sz DfMliaPercObj8Vel DfMliaPercObj9Detect DfMliaPercObj9LightSts DfMliaPercObj9Precision DfMliaPercObj9Sx1 DfMliaPercObj9Sx2 DfMliaPercObj9Sy1 DfMliaPercObj9Sy2 DfMliaPercObj9Sz DfMliaPercObj9Vel DfMliaPercStreetLightDetect /end REF_MEASUREMENT
/end GROUP
/begin GROUP ADAS_Input_MainPercData "ADAS/Input/MainPercData"
 /begin REF_MEASUREMENT DfPercFcuDirtSts DfPercFrcuDirtSts DfPercLidarDirtSts DfPercMrrxDirtSts DfPercTicuDirtSts DfPercValidDataFront DfPercValidDataLane DfPercValidDataMlia DfPercValidDataRear DfPercValidDataSign rtDW_ADAS.GTLidarDirtSts /end REF_MEASUREMENT
/end GROUP
/begin GROUP ADAS_Input_MrrxPercData "ADAS/Input/MrrxPercData"
 /begin REF_MEASUREMENT DfMrrxPercBSD_L_W DfMrrxPercBSD_R_W DfMrrxPercDOW_L_W DfMrrxPercDOW_R_W DfMrrxPercLCA_L_W DfMrrxPercLCA_R_W DfMrrxPercRCTA_L_W DfMrrxPercRCTA_R_W DfMrrxPercRCTB_L_W DfMrrxPercRCTB_R_W DfMrrxPercRCW_W /end REF_MEASUREMENT
/end GROUP
/begin GROUP ADAS_Input_RearCrossPercData "ADAS/Input/RearCrossPercData"
 /begin REF_MEASUREMENT DfRPObj15DynamID DfRPObj15Probabil DfRPObj15Sx1 DfRPObj15Sx2 DfRPObj15Sy1 DfRPObj15Sy2 DfRPObj15Vx DfRPObj15Vy DfRPObj15detect DfRPObj16DynamID DfRPObj16Probabil DfRPObj16Sx1 DfRPObj16Sx2 DfRPObj16Sy1 DfRPObj16Sy2 DfRPObj16Vx DfRPObj16Vy DfRPObj16detect /end REF_MEASUREMENT
/end GROUP
/begin GROUP ADAS_Input_RearPercData "ADAS/Input/RearPercData"
 /begin REF_MEASUREMENT DfRPObj12DynamID DfRPObj12Probabil DfRPObj12Sx1 DfRPObj12Sx2 DfRPObj12Sy1 DfRPObj12Sy2 DfRPObj12Vx DfRPObj12Vy DfRPObj12detect DfRPObj13DynamID DfRPObj13Probabil DfRPObj13Sx1 DfRPObj13Sx2 DfRPObj13Sy1 DfRPObj13Sy2 DfRPObj13Vx DfRPObj13Vy DfRPObj13detect DfRPObj14DynamID DfRPObj14Probabil DfRPObj14Sx1 DfRPObj14Sx2 DfRPObj14Sy1 DfRPObj14Sy2 DfRPObj14Vx DfRPObj14Vy DfRPObj14detect DfRPObj17DynamID DfRPObj17Probabil DfRPObj17Sx1 DfRPObj17Sx2 DfRPObj17Sy1 DfRPObj17Sy2 DfRPObj17Vx DfRPObj17Vy DfRPObj17detect DfRPObj18DynamID DfRPObj18Probabil DfRPObj18Sx1 DfRPObj18Sx2 DfRPObj18Sy1 DfRPObj18Sy2 DfRPObj18Vx DfRPObj18Vy DfRPObj18detect /end REF_MEASUREMENT
/end GROUP
/begin GROUP ADAS_Input_SignPercData "ADAS/Input/SignPercData"
 /begin REF_MEASUREMENT DfSignPerc1Color DfSignPerc1CurrSpeed DfSignPerc1Obj_detect DfSignPerc1Sx DfSignPerc1Sy DfSignPerc1Type DfSignPerc2Color DfSignPerc2CurrSpeed DfSignPerc2Obj_detect DfSignPerc2Sx DfSignPerc2Sy DfSignPerc2Type DfSignPerc3Color DfSignPerc3CurrSpeed DfSignPerc3Obj_detect DfSignPerc3Sx DfSignPerc3Sy DfSignPerc3Type DfSignPerc4Color DfSignPerc4CurrSpeed DfSignPerc4Obj_detect DfSignPerc4Sx DfSignPerc4Sy DfSignPerc4Type /end REF_MEASUREMENT
/end GROUP
/begin GROUP ADAS_Input_VlcData "ADAS/Input/VlcData"
 /begin REF_MEASUREMENT AccTrqAvailable AccTrqReq AngEstimate BrakeReleaseReq DecelPlausblCount /end REF_MEASUREMENT
/end GROUP
/begin GROUP ADAS_Output_new "ADAS/Output_new"
 /begin SUB_GROUP ADAS_Output_new_ASLA ADAS_Output_new_CC__ACC__LIM ADAS_Output_new_DTC_Data ADAS_Output_new_Error ADAS_Output_new_FCW__AEB ADAS_Output_new_FIU ADAS_Output_new_LCC__ALCC__DOW ADAS_Output_new_LDW__LDP ADAS_Output_new_LKA ADAS_Output_new_MLIA__Left ADAS_Output_new_MLIA__Right ADAS_Output_new_NV ADAS_Output_new_Perception_OUT ADAS_Output_new_RDA__RCTC ADAS_Output_new_Rcw ADAS_Output_new_Rec ADAS_Output_new_SENSORS ADAS_Output_new_TSR ADAS_Output_new_VISUAL ADAS_Output_new_VLC_OUT ADAS_Output_new_Vibration_Manager /end SUB_GROUP
 /begin REF_MEASUREMENT DfDiagFrontRadarAvail DfDiagLidarAvail DfDiagRearRadarAvail DfDiagThermalCameraAvail DtLogMliaErrCode DtLogMliaErrFlag /end REF_MEASUREMENT
/end GROUP
/begin GROUP ADAS_Output_new_ASLA "ADAS/Output_new/ASLA" /begin REF_MEASUREMENT AslaChSpdReq AslaMode /end REF_MEASUREMENT /end GROUP
/begin GROUP ADAS_Output_new_CC__ACC__LIM "ADAS/Output_new/CC//ACC//LIM"
 /begin REF_MEASUREMENT CcBrakeLightReq CcEmsEngagement_Stat CcEmsMotIncFlag CcEmsState_Stat CcHudSetDist CcHudSetSpeed CcHudTargDetect CcReject CcSetDist CcSleepSt CcTargetId CcVcuEngagement_Stat CcVcuMotInc CcVcuMotIncFlag CcVcuState_Stat DtAnalyticAccTimeCity DtAnalyticAccTimeHighWay DtAnalyticAccTimeJam DtAnalyticAccTimeMaxDist DtAnalyticAccTimeMedDist DtAnalyticAccTimeMedMaxDist DtAnalyticAccTimeMinDist DtAnalyticCcTime DtDiagVerDateModelACC DtDiagVerNumModelACC DtLogAccDistRealm DtLogAccDistSetm DtLogAccErrCode DtLogAccErrFlag DtLogAccLeadAccelReal DtLogAccLeadSpeedReal_kmh DtLogAccLogicTrans DtLogAccSolverTrans DtLogAccTargetDetect DtLogAccVlcTrans /end REF_MEASUREMENT
/end GROUP
/begin GROUP ADAS_Output_new_DTC_Data "ADAS/Output_new/DTC_Data"
 /begin REF_MEASUREMENT DtDiagDtcAccRadarGlitch DtDiagDtcAccRadarZero DtDiagDtcAccSwuStuck /end REF_MEASUREMENT
/end GROUP
/begin GROUP ADAS_Output_new_Error "ADAS/Output_new/Error"
 /begin REF_MEASUREMENT ALccNotifError AebFuncError AebNotifError AfsFuncError CcFuncError CcNotifError DowNotifError FcwNotifError LccFuncError LccNotifError LdpNotifError LdwFuncError LdwNotifError LkaFuncError LkaNotifError MliaFuncError NvFuncError RdaFuncError RdaNotifError TsrSignError TsrSignNotifError /end REF_MEASUREMENT
/end GROUP
/begin GROUP ADAS_Output_new_FCW__AEB "ADAS/Output_new/FCW//AEB" /begin SUB_GROUP ADAS_Output_new_FCW__AEB_LimDemo /end SUB_GROUP
 /begin REF_MEASUREMENT AebBoostReq AebDeactivNotif AebDecelReq AebMode AebPrefillReq AebRdaStandReq AebUnAvaliable DtAnalyticAebActvnDst DtAnalyticAebAvgDistToTar DtAnalyticAebNrOfOper DtAnalyticFcwActvnDst DtAnalyticFcwNrOfOper DtDiagVerDateModelAEB DtDiagVerNumModelAEB DtLogAebDistRealm DtLogAebErrCode DtLogAebErrFlag DtLogAebLeadSpeedRealKmh DtLogAebLogicTrans DtLogAebSolverTrans DtLogAebTargetDetect FcwMode rtDW_ADAS.GTOutportBufferForEnblFcw /end REF_MEASUREMENT
/end GROUP
/begin GROUP ADAS_Output_new_FCW__AEB_LimDemo "ADAS/Output_new/FCW//AEB/LimDemo"
 /begin SUB_GROUP ADAS_Output_new_FCW__AEB_LimDemo_Compare_To_Constant ADAS_Output_new_FCW__AEB_LimDemo_Compare_To_Constant1 /end SUB_GROUP
 /begin REF_MEASUREMENT rtDW_ADAS.GTis_active_c235_ADAS rtDW_ADAS.GTis_c235_ADAS rtDW_ADAS.GTtemporalCounter_i1_pm /end REF_MEASUREMENT
/end GROUP
/begin GROUP ADAS_Output_new_FIU "ADAS/Output_new/FIU"
 /begin REF_MEASUREMENT DtDiagVerDateModelFIU DtDiagVerNumModelFIU DtLogFiuLogicTrans DtLogFiuSolverTrans OSettAaModeSts OSettAaSts OSettAebSts OSettAfsSts OSettAlccSts OSettAslaOverCmd OSettAslaSts OSettCcModeSts OSettCcSpdCorrectSts OSettCcTypeSts OSettDowSoundSts OSettDowSts OSettFcwModeSts OSettFcwSts OSettFcwVibrationSts OSettLccModeSts OSettLccSoundSts OSettLccSts OSettLccVibrationSts OSettLdpSts OSettLdwModeSts OSettLdwSoundSts OSettLdwSts OSettLdwVibrationSts OSettLkaSts OSettNavigSts OSettOtherObjSts OSettProjectionOnARoadSts OSettRctcSts OSettRdaSts OSettRecSts OSettRoadSignSts OSettSensCleanSts OSettTsrSts /end REF_MEASUREMENT
/end GROUP
/begin GROUP ADAS_Output_new_LCC__ALCC__DOW "ADAS/Output_new/LCC//ALCC//DOW"
 /begin REF_MEASUREMENT ALccMode AlccAngleReqFlag DowMode DtAnalyticAlccActvnDst DtAnalyticAlccNrOfOper DtAnalyticDowNrOfOper DtAnalyticDowTime DtAnalyticLccActvnDst DtAnalyticLccNrOfOper DtDiagVerDateModelLCC DtDiagVerNumModelLCC DtLogAlccEnaSts DtLogDowIsObjInLeftZone DtLogDowIsObjInRightZone DtLogDowLogicTrans DtLogDowWarnReqTransLeft DtLogDowWarnReqTransRight DtLogLccEnaSts DtLogLccErrCode DtLogLccErrFlag DtLogLccIsObjInLeftCvwZone DtLogLccIsObjInRightCvwZone DtLogLccLogicTrans DtLogLccSetMode DtLogLccSetSound DtLogLccSetVibration DtLogLccWarnReqTransLeft DtLogLccWarnReqTransRight LccLeftLedReq LccLeftWarnReq LccMode LccRightLedReq LccRightWarnReq LccSoundReq rtConstB_ADAS.GTCastToBoolean5 rtConstB_ADAS.GTCastToBoolean6 /end REF_MEASUREMENT
/end GROUP
/begin GROUP ADAS_Output_new_LDW__LDP "ADAS/Output_new/LDW//LDP"
 /begin REF_MEASUREMENT DtAnalyticLdpNumOfWarn DtAnalyticLdpTimeActive DtAnalyticLdwNumOfWarn DtAnalyticLdwTimeActive DtDiagVerDateModelLDP DtDiagVerDateModelLDW DtDiagVerNumModelLDP DtDiagVerNumModelLDW DtLogLdwLogicTrans DtLogLdwSolverTransLeft DtLogLdwSolverTransRight DtLogLdwTTLCLeft DtLogLdwTTLCTransLeft DtLogLdwTurnRadiusLeft DtLogLdwVdepartureLeft DtLogLdwWarnBlockTransLeft DtLogLdwWarnDistLeft DtLogLdwWarnDistRight DtLogLdwWarnPredictLeft DtLogLdwWarnPredictRight DtLogLdwWarnTimeLeft DtLogLdwWarnTimeRight DtLogLdwYawRate_dtLeft LdpAngleReqFlag LdpLeftLaneWarnReq LdpMode LdpRightLaneWarnReq LdwHudActSt LdwHudMultiLaneAddres LdwHudMultiLaneWarnReq LdwLeftLaneWarnReq LdwMode LdwRightLaneWarnReq LdwSoundReq rtDW_ADAS.GTHudActSts rtDW_ADAS.GTLdwLeftLineWarnReq rtDW_ADAS.GTLdwMode_d rtDW_ADAS.GTLdwRightLineWarnReq rtDW_ADAS.GTLdwSoundReq_k rtDW_ADAS.GTLineAdress rtDW_ADAS.GTNumOfWarnLDW rtDW_ADAS.GTTTLC rtDW_ADAS.GTTransTTLC rtDW_ADAS.GTTransVehPosition rtDW_ADAS.GTTransVehPosition_b rtDW_ADAS.GTTransWarnBlock rtDW_ADAS.GTTurnRadius rtDW_ADAS.GTVdepart rtDW_ADAS.GTWarnDist rtDW_ADAS.GTWarnDist_j rtDW_ADAS.GTWarnPredict rtDW_ADAS.GTWarnPredict_i rtDW_ADAS.GTWarnReq rtDW_ADAS.GTWarnTime rtDW_ADAS.GTWarnTime_f rtDW_ADAS.GTYawRate_dt /end REF_MEASUREMENT
/end GROUP
/begin GROUP ADAS_Output_new_LKA "ADAS/Output_new/LKA"
 /begin REF_MEASUREMENT DtAnalyticLkaTimeActive DtAnalyticLkaTimeTotal DtDiagVerDateModelLKA DtDiagVerNumModelLKA DtLogLkaErrCode DtLogLkaErrFlag DtLogLkaLogicTrans DtLogLkaSolverTrans DtLogLkaTargetAngle LkaAngleReq LkaAngleReqFlag LkaShotdownSoundReq LkaWarnNotifReq LkaWarnSoundReq /end REF_MEASUREMENT
/end GROUP
/begin GROUP ADAS_Output_new_MLIA__Left "ADAS/Output_new/MLIA//Left"
 /begin REF_MEASUREMENT DtAnalyticMliaTimeObj DtAnalyticMliaTimeTotal DtDiagVerDateModelMLIA DtDiagVerNumModelMLIA DtLogMliaDistToObj1 DtLogMliaDistToObj2 DtLogMliaDistToObj3 DtLogMliaDistToObj4 DtLogMliaLogicTrans DtLogMliaSolverTrans MliaLADBLED10Req MliaLADBLED11Req MliaLADBLED12Req MliaLADBLED13Req MliaLADBLED14Req MliaLADBLED15Req MliaLADBLED16Req MliaLADBLED17Req MliaLADBLED18Req MliaLADBLED1Req MliaLADBLED2Req MliaLADBLED3Req MliaLADBLED4Req MliaLADBLED5Req MliaLADBLED6Req MliaLADBLED7Req MliaLADBLED8Req MliaLADBLED9Req MliaLeftObj10Y1Val MliaLeftObj10Y2Val MliaLeftObj10Z1Val MliaLeftObj10Z2Val MliaLeftObj1Y1Val MliaLeftObj1Y2Val MliaLeftObj1Z1Val MliaLeftObj1Z2Val MliaLeftObj2Y1Val MliaLeftObj2Y2Val MliaLeftObj2Z1Val MliaLeftObj2Z2Val MliaLeftObj3Y1Val MliaLeftObj3Y2Val MliaLeftObj3Z1Val MliaLeftObj3Z2Val MliaLeftObj4Y1Val MliaLeftObj4Y2Val MliaLeftObj4Z1Val MliaLeftObj4Z2Val MliaLeftObj5Y1Val MliaLeftObj5Y2Val MliaLeftObj5Z1Val MliaLeftObj5Z2Val MliaLeftObj6Y1Val MliaLeftObj6Y2Val MliaLeftObj6Z1Val MliaLeftObj6Z2Val MliaLeftObj7Y1Val MliaLeftObj7Y2Val MliaLeftObj7Z1Val MliaLeftObj7Z2Val MliaLeftObj8Y1Val MliaLeftObj8Y2Val MliaLeftObj8Z1Val MliaLeftObj8Z2Val MliaLeftObj9Y1Val MliaLeftObj9Y2Val MliaLeftObj9Z1Val MliaLeftObj9Z2Val MliaLeftProjBrightSlot1Req MliaLeftProjBrightSlot2Req MliaLeftProjBrightSlot3Req MliaLeftProjBrightSlot4Req MliaLeftProjSlot1Req MliaLeftProjSlot2Req MliaLeftProjSlot3Req MliaLeftProjSlot4Req MliaMode MliaStreetLightStat rtDW_ADAS.GTBrightness rtDW_ADAS.GTSlot_1 rtDW_ADAS.GTSlot_2 rtDW_ADAS.GTSlot_3 rtDW_ADAS.GTSlot_4 /end REF_MEASUREMENT
/end GROUP
/begin GROUP ADAS_Output_new_MLIA__Right "ADAS/Output_new/MLIA//Right"
 /begin REF_MEASUREMENT MliaRADBLED10Req MliaRADBLED11Req MliaRADBLED12Req MliaRADBLED13Req MliaRADBLED14Req MliaRADBLED15Req MliaRADBLED16Req MliaRADBLED17Req MliaRADBLED18Req MliaRADBLED1Req MliaRADBLED2Req MliaRADBLED3Req MliaRADBLED4Req MliaRADBLED5Req MliaRADBLED6Req MliaRADBLED7Req MliaRADBLED8Req MliaRADBLED9Req MliaRightObj10Y1Val MliaRightObj10Y2Val MliaRightObj10Z1Val MliaRightObj10Z2Val MliaRightObj1Y1Val MliaRightObj1Y2Val MliaRightObj1Z1Val MliaRightObj1Z2Val MliaRightObj2Y1Val MliaRightObj2Y2Val MliaRightObj2Z1Val MliaRightObj2Z2Val MliaRightObj3Y1Val MliaRightObj3Y2Val MliaRightObj3Z1Val MliaRightObj3Z2Val MliaRightObj4Y1Val MliaRightObj4Y2Val MliaRightObj4Z1Val MliaRightObj4Z2Val MliaRightObj5Y1Val MliaRightObj5Y2Val MliaRightObj5Z1Val MliaRightObj5Z2Val MliaRightObj6Y1Val MliaRightObj6Y2Val MliaRightObj6Z1Val MliaRightObj6Z2Val MliaRightObj7Y1Val MliaRightObj7Y2Val MliaRightObj7Z1Val MliaRightObj7Z2Val MliaRightObj8Y1Val MliaRightObj8Y2Val MliaRightObj8Z1Val MliaRightObj8Z2Val MliaRightObj9Y1Val MliaRightObj9Y2Val MliaRightObj9Z1Val MliaRightObj9Z2Val MliaRightProjBrightSlot1Req MliaRightProjBrightSlot2Req MliaRightProjBrightSlot3Req MliaRightProjBrightSlot4Req MliaRightProjSlot1Req MliaRightProjSlot2Req MliaRightProjSlot3Req MliaRightProjSlot4Req rtDW_ADAS.GTBrightness rtDW_ADAS.GTSlot_1_p rtDW_ADAS.GTSlot_2_p rtDW_ADAS.GTSlot_3_l rtDW_ADAS.GTSlot_4_e /end REF_MEASUREMENT
/end GROUP
/begin GROUP ADAS_Output_new_NV "ADAS/Output_new/NV" /begin REF_MEASUREMENT NvMode /end REF_MEASUREMENT /end GROUP
/begin GROUP ADAS_Output_new_Perception_OUT "ADAS/Output_new/Perception_OUT"
 /begin REF_MEASUREMENT DtPercRecToInc_Req DtPercStartFrontOncomObj DtPercStartFrontPasObj DtPercStartLane DtPercStartMlia DtPercStartRearObj DtPercStartRec DtPercStartSign /end REF_MEASUREMENT
/end GROUP
/begin GROUP ADAS_Output_new_RDA__RCTC "ADAS/Output_new/RDA//RCTC"
 /begin REF_MEASUREMENT DtAnalyticRctcAvgDistToTar DtAnalyticRctcNrOfOper DtAnalyticRctcaActvnDst DtAnalyticRdaActvnDst DtAnalyticRdaAvgDistToTar DtAnalyticRdaNrOfOper DtDiagVerDateModelRDA DtDiagVerNumModelRDA DtLogRdaDistToObjRear DtLogRdaErrCode DtLogRdaErrFlag DtLogRdaLogicTrans DtLogRdaSolverTrans RctcWarnReq RdaDecelReqFalg RdaMode RdaWarnReq rtDW_ADAS.GTRctcActive rtDW_ADAS.GTRctcLogicTrans rtDW_ADAS.GTRctcWarn /end REF_MEASUREMENT
/end GROUP
/begin GROUP ADAS_Output_new_Rcw "ADAS/Output_new/Rcw"
 /begin REF_MEASUREMENT DtAnalyticRcwAvgDistToTar DtAnalyticRcwNrOfOper DtDiagVerDateModelRCW DtDiagVerNumModelRCW DtLogRcwDimanWh DtLogRcwDistToObjRear DtLogRcwLatObj DtLogRcwLogicTrans DtLogRcwTimeCrash DtLogRcwVelRel RcwMode RcwWarnReq rtDW_ADAS.GTTarHonk rtDW_ADAS.GTTestDataWarnTar /end REF_MEASUREMENT
/end GROUP
/begin GROUP ADAS_Output_new_Rec "ADAS/Output_new/Rec" /begin REF_MEASUREMENT RecMode /end REF_MEASUREMENT /end GROUP
/begin GROUP ADAS_Output_new_SENSORS "ADAS/Output_new/SENSORS"
 /begin REF_MEASUREMENT SensAllDirty_Stat SensClearReq SensFrcuDirty_Stat SensLidarDirty_Stat SensMrrxDirty_Stat SensTicuDirty_Stat SensWSHeatReq USSFrontReq USSRearReq USSSideReq rtDW_ADAS.GTLidarBlk rtDW_ADAS.GTSensCleanReq rtDW_ADAS.GTSensWSHeatReq /end REF_MEASUREMENT
/end GROUP
/begin GROUP ADAS_Output_new_TSR "ADAS/Output_new/TSR"
 /begin REF_MEASUREMENT TsrHudMultSignAddres TsrHudMultiSign TsrMode TsrSignOverTaking /end REF_MEASUREMENT
/end GROUP
/begin GROUP ADAS_ServiceManager_SensManager_Sens_08_05_24_HCS_02_05_24 "ADAS/ServiceManager/SensManager/Sens_08.05.24/HCS_02.05.24" /begin REF_MEASUREMENT rtDW_ADAS.GTSensWSHeatReq /end REF_MEASUREMENT /end GROUP
/begin GROUP ADAS_ServiceManager_SensManager_Sens_08_05_24_WFS_08_05_24 "ADAS/ServiceManager/SensManager/Sens_08.05.24/WFS_08.05.24"
 /begin REF_MEASUREMENT rtDW_ADAS.GTLidarBlk rtDW_ADAS.GTLidarDirtSts rtDW_ADAS.GTSensCleanReq /end REF_MEASUREMENT
/end GROUP
/begin GROUP ADAS_ServiceManager_SensManager_Sens_08_05_24_WFS_08_05_24_Wash_Degradation_23_10_24 "ADAS/ServiceManager/SensManager/Sens_08.05.24/WFS_08.05.24/Wash Degradation_23.10.24" /begin REF_MEASUREMENT rtDW_ADAS.GTLidarBlk rtDW_ADAS.GTLidarDirtSts /end REF_MEASUREMENT /end GROUP
/end MODULE
/end PROJECT
