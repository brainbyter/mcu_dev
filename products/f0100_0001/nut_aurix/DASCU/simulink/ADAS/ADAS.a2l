ASAP2_VERSION 1 71
/begin PROJECT ProjectName "Project Comment Goes Here"
/begin HEADER "Header Comments go here" /end HEADER
/begin MODULE ModuleName "Module Comment Goes Here"
/begin MOD_COMMON "Mod Common Comment Here" BYTE_ORDER MSB_LAST ALIGNMENT_BYTE 1 ALIGNMENT_WORD 2 ALIGNMENT_LONG 4 ALIGNMENT_FLOAT32_IEEE 4 ALIGNMENT_FLOAT64_IEEE 8 ALIGNMENT_INT64 8 /end MOD_COMMON
/begin MEASUREMENT rtDW_ADAS.GTAngleobj17.GTDelayInput2_DSTATE_p "" FLOAT32_IEEE ADAS_CM_single 0 0 -3.4E+38 3.4E+38 ECU_ADDRESS 0x0000 /* @ECU_Address@rtDW_ADAS.GTAngleobj17.GTDelayInput2_DSTATE_p@ */ /end MEASUREMENT
/begin MEASUREMENT rtDW_ADAS.GTAngleobj17.GTis_active_c349_ADAS "" UBYTE ADAS_CM_uint8 0 0 0 255 ECU_ADDRESS 0x0000 /* @ECU_Address@rtDW_ADAS.GTAngleobj17.GTis_active_c349_ADAS@ */ /end MEASUREMENT
/begin MEASUREMENT rtDW_ADAS.GTAngleobj17.GTis_active_c354_ADAS "" UBYTE ADAS_CM_uint8 0 0 0 255 ECU_ADDRESS 0x0000 /* @ECU_Address@rtDW_ADAS.GTAngleobj17.GTis_active_c354_ADAS@ */ /end MEASUREMENT
/begin MEASUREMENT rtDW_ADAS.GTAngleobj17.GTis_c349_ADAS "" UBYTE ADAS_CM_uint8 0 0 0 255 ECU_ADDRESS 0x0000 /* @ECU_Address@rtDW_ADAS.GTAngleobj17.GTis_c349_ADAS@ */ /end MEASUREMENT
/begin MEASUREMENT rtDW_ADAS.GTAngleobj17.GTis_c354_ADAS "" UBYTE ADAS_CM_uint8 0 0 0 255 ECU_ADDRESS 0x0000 /* @ECU_Address@rtDW_ADAS.GTAngleobj17.GTis_c354_ADAS@ */ /end MEASUREMENT
/begin MEASUREMENT rtDW_ADAS.GTAngleobj17.GTtemporalCounter_i1 "" ULONG ADAS_CM_uint32 0 0 0 4294967295 ECU_ADDRESS 0x0000 /* @ECU_Address@rtDW_ADAS.GTAngleobj17.GTtemporalCounter_i1@ */ /end MEASUREMENT
/begin MEASUREMENT rtDW_ADAS.GTAngleobj18.GTAngleobj1_MODE "" UBYTE ADAS_CM_logical 0 0 0 1 ECU_ADDRESS 0x0000 /* @ECU_Address@rtDW_ADAS.GTAngleobj18.GTAngleobj1_MODE@ */ /end MEASUREMENT
/begin MEASUREMENT rtDW_ADAS.GTAngleobj18.GTDelay1_DSTATE "" FLOAT32_IEEE ADAS_CM_single 0 0 -3.4E+38 3.4E+38 ECU_ADDRESS 0x0000 /* @ECU_Address@rtDW_ADAS.GTAngleobj18.GTDelay1_DSTATE@ */ /end MEASUREMENT
/begin MEASUREMENT rtDW_ADAS.GTAngleobj18.GTDelay2_DSTATE "" FLOAT32_IEEE ADAS_CM_single 0 0 -3.4E+38 3.4E+38 ECU_ADDRESS 0x0000 /* @ECU_Address@rtDW_ADAS.GTAngleobj18.GTDelay2_DSTATE@ */ /end MEASUREMENT
/begin MEASUREMENT rtDW_ADAS.GTAngleobj18.GTDelay3_DSTATE "" FLOAT32_IEEE ADAS_CM_single 0 0 -3.4E+38 3.4E+38 ECU_ADDRESS 0x0000 /* @ECU_Address@rtDW_ADAS.GTAngleobj18.GTDelay3_DSTATE@ */ /end MEASUREMENT
/begin MEASUREMENT rtDW_ADAS.GTAngleobj18.GTDelay6_DSTATE "" FLOAT32_IEEE ADAS_CM_single 0 0 -3.4E+38 3.4E+38 ECU_ADDRESS 0x0000 /* @ECU_Address@rtDW_ADAS.GTAngleobj18.GTDelay6_DSTATE@ */ /end MEASUREMENT
/begin MEASUREMENT rtDW_ADAS.GTAngleobj18.GTDelay8_DSTATE "" FLOAT32_IEEE ADAS_CM_single 0 0 -3.4E+38 3.4E+38 ECU_ADDRESS 0x0000 /* @ECU_Address@rtDW_ADAS.GTAngleobj18.GTDelay8_DSTATE@ */ /end MEASUREMENT
/begin MEASUREMENT rtDW_ADAS.GTAngleobj18.GTDelayInput2_DSTATE "" FLOAT32_IEEE ADAS_CM_single 0 0 -3.4E+38 3.4E+38 ECU_ADDRESS 0x0000 /* @ECU_Address@rtDW_ADAS.GTAngleobj18.GTDelayInput2_DSTATE@ */ /end MEASUREMENT
/begin MEASUREMENT rtDW_ADAS.GTAngleobj18.GTDelayInput2_DSTATE_h "" FLOAT32_IEEE ADAS_CM_single 0 0 -3.4E+38 3.4E+38 ECU_ADDRESS 0x0000 /* @ECU_Address@rtDW_ADAS.GTAngleobj18.GTDelayInput2_DSTATE_h@ */ /end MEASUREMENT
/begin MEASUREMENT rtDW_ADAS.GTAngleobj18.GTDelayInput2_DSTATE_m "" FLOAT32_IEEE ADAS_CM_single 0 0 -3.4E+38 3.4E+38 ECU_ADDRESS 0x0000 /* @ECU_Address@rtDW_ADAS.GTAngleobj18.GTDelayInput2_DSTATE_m@ */ /end MEASUREMENT
/begin MEASUREMENT rtDW_ADAS.GTAngleobj18.GTDelayInput2_DSTATE_p "" FLOAT32_IEEE ADAS_CM_single 0 0 -3.4E+38 3.4E+38 ECU_ADDRESS 0x0000 /* @ECU_Address@rtDW_ADAS.GTAngleobj18.GTDelayInput2_DSTATE_p@ */ /end MEASUREMENT
/begin MEASUREMENT rtDW_ADAS.GTAngleobj18.GTis_active_c349_ADAS "" UBYTE ADAS_CM_uint8 0 0 0 255 ECU_ADDRESS 0x0000 /* @ECU_Address@rtDW_ADAS.GTAngleobj18.GTis_active_c349_ADAS@ */ /end MEASUREMENT
/begin MEASUREMENT rtDW_ADAS.GTAngleobj18.GTis_active_c354_ADAS "" UBYTE ADAS_CM_uint8 0 0 0 255 ECU_ADDRESS 0x0000 /* @ECU_Address@rtDW_ADAS.GTAngleobj18.GTis_active_c354_ADAS@ */ /end MEASUREMENT
/begin MEASUREMENT rtDW_ADAS.GTAngleobj18.GTis_c349_ADAS "" UBYTE ADAS_CM_uint8 0 0 0 255 ECU_ADDRESS 0x0000 /* @ECU_Address@rtDW_ADAS.GTAngleobj18.GTis_c349_ADAS@ */ /end MEASUREMENT
/begin MEASUREMENT rtDW_ADAS.GTAngleobj18.GTis_c354_ADAS "" UBYTE ADAS_CM_uint8 0 0 0 255 ECU_ADDRESS 0x0000 /* @ECU_Address@rtDW_ADAS.GTAngleobj18.GTis_c354_ADAS@ */ /end MEASUREMENT
/begin MEASUREMENT rtDW_ADAS.GTAngleobj18.GTtemporalCounter_i1 "" ULONG ADAS_CM_uint32 0 0 0 4294967295 ECU_ADDRESS 0x0000 /* @ECU_Address@rtDW_ADAS.GTAngleobj18.GTtemporalCounter_i1@ */ /end MEASUREMENT
/begin MEASUREMENT rtDW_ADAS.GTAngleobj19.GTAngleobj1_MODE "" UBYTE ADAS_CM_logical 0 0 0 1 ECU_ADDRESS 0x0000 /* @ECU_Address@rtDW_ADAS.GTAngleobj19.GTAngleobj1_MODE@ */ /end MEASUREMENT
/begin MEASUREMENT rtDW_ADAS.GTAngleobj19.GTDelay1_DSTATE "" FLOAT32_IEEE ADAS_CM_single 0 0 -3.4E+38 3.4E+38 ECU_ADDRESS 0x0000 /* @ECU_Address@rtDW_ADAS.GTAngleobj19.GTDelay1_DSTATE@ */ /end MEASUREMENT
/begin MEASUREMENT rtDW_ADAS.GTAngleobj19.GTDelay2_DSTATE "" FLOAT32_IEEE ADAS_CM_single 0 0 -3.4E+38 3.4E+38 ECU_ADDRESS 0x0000 /* @ECU_Address@rtDW_ADAS.GTAngleobj19.GTDelay2_DSTATE@ */ /end MEASUREMENT
/begin MEASUREMENT rtDW_ADAS.GTAngleobj19.GTDelay3_DSTATE "" FLOAT32_IEEE ADAS_CM_single 0 0 -3.4E+38 3.4E+38 ECU_ADDRESS 0x0000 /* @ECU_Address@rtDW_ADAS.GTAngleobj19.GTDelay3_DSTATE@ */ /end MEASUREMENT
/begin MEASUREMENT rtDW_ADAS.GTAngleobj19.GTDelay6_DSTATE "" FLOAT32_IEEE ADAS_CM_single 0 0 -3.4E+38 3.4E+38 ECU_ADDRESS 0x0000 /* @ECU_Address@rtDW_ADAS.GTAngleobj19.GTDelay6_DSTATE@ */ /end MEASUREMENT
/begin MEASUREMENT rtDW_ADAS.GTAngleobj19.GTDelay8_DSTATE "" FLOAT32_IEEE ADAS_CM_single 0 0 -3.4E+38 3.4E+38 ECU_ADDRESS 0x0000 /* @ECU_Address@rtDW_ADAS.GTAngleobj19.GTDelay8_DSTATE@ */ /end MEASUREMENT
/begin MEASUREMENT rtDW_ADAS.GTAngleobj19.GTDelayInput2_DSTATE "" FLOAT32_IEEE ADAS_CM_single 0 0 -3.4E+38 3.4E+38 ECU_ADDRESS 0x0000 /* @ECU_Address@rtDW_ADAS.GTAngleobj19.GTDelayInput2_DSTATE@ */ /end MEASUREMENT
/begin MEASUREMENT rtDW_ADAS.GTAngleobj19.GTDelayInput2_DSTATE_h "" FLOAT32_IEEE ADAS_CM_single 0 0 -3.4E+38 3.4E+38 ECU_ADDRESS 0x0000 /* @ECU_Address@rtDW_ADAS.GTAngleobj19.GTDelayInput2_DSTATE_h@ */ /end MEASUREMENT
/begin MEASUREMENT rtDW_ADAS.GTAngleobj19.GTDelayInput2_DSTATE_m "" FLOAT32_IEEE ADAS_CM_single 0 0 -3.4E+38 3.4E+38 ECU_ADDRESS 0x0000 /* @ECU_Address@rtDW_ADAS.GTAngleobj19.GTDelayInput2_DSTATE_m@ */ /end MEASUREMENT
/begin MEASUREMENT rtDW_ADAS.GTAngleobj19.GTDelayInput2_DSTATE_p "" FLOAT32_IEEE ADAS_CM_single 0 0 -3.4E+38 3.4E+38 ECU_ADDRESS 0x0000 /* @ECU_Address@rtDW_ADAS.GTAngleobj19.GTDelayInput2_DSTATE_p@ */ /end MEASUREMENT
/begin MEASUREMENT rtDW_ADAS.GTAngleobj19.GTis_active_c349_ADAS "" UBYTE ADAS_CM_uint8 0 0 0 255 ECU_ADDRESS 0x0000 /* @ECU_Address@rtDW_ADAS.GTAngleobj19.GTis_active_c349_ADAS@ */ /end MEASUREMENT
/begin MEASUREMENT rtDW_ADAS.GTAngleobj19.GTis_active_c354_ADAS "" UBYTE ADAS_CM_uint8 0 0 0 255 ECU_ADDRESS 0x0000 /* @ECU_Address@rtDW_ADAS.GTAngleobj19.GTis_active_c354_ADAS@ */ /end MEASUREMENT
/begin MEASUREMENT rtDW_ADAS.GTAngleobj19.GTis_c349_ADAS "" UBYTE ADAS_CM_uint8 0 0 0 255 ECU_ADDRESS 0x0000 /* @ECU_Address@rtDW_ADAS.GTAngleobj19.GTis_c349_ADAS@ */ /end MEASUREMENT
/begin MEASUREMENT rtDW_ADAS.GTAngleobj19.GTis_c354_ADAS "" UBYTE ADAS_CM_uint8 0 0 0 255 ECU_ADDRESS 0x0000 /* @ECU_Address@rtDW_ADAS.GTAngleobj19.GTis_c354_ADAS@ */ /end MEASUREMENT
/begin MEASUREMENT rtDW_ADAS.GTAngleobj19.GTtemporalCounter_i1 "" ULONG ADAS_CM_uint32 0 0 0 4294967295 ECU_ADDRESS 0x0000 /* @ECU_Address@rtDW_ADAS.GTAngleobj19.GTtemporalCounter_i1@ */ /end MEASUREMENT
/begin MEASUREMENT rtDW_ADAS.GTAngleobj2.GTAngleobj1_MODE "" UBYTE ADAS_CM_logical 0 0 0 1 ECU_ADDRESS 0x0000 /* @ECU_Address@rtDW_ADAS.GTAngleobj2.GTAngleobj1_MODE@ */ /end MEASUREMENT
/begin MEASUREMENT rtDW_ADAS.GTAngleobj2.GTDelay1_DSTATE "" FLOAT32_IEEE ADAS_CM_single 0 0 -3.4E+38 3.4E+38 ECU_ADDRESS 0x0000 /* @ECU_Address@rtDW_ADAS.GTAngleobj2.GTDelay1_DSTATE@ */ /end MEASUREMENT
/begin MEASUREMENT rtDW_ADAS.GTAngleobj2.GTDelay2_DSTATE "" FLOAT32_IEEE ADAS_CM_single 0 0 -3.4E+38 3.4E+38 ECU_ADDRESS 0x0000 /* @ECU_Address@rtDW_ADAS.GTAngleobj2.GTDelay2_DSTATE@ */ /end MEASUREMENT
/begin MEASUREMENT rtDW_ADAS.GTAngleobj2.GTDelay3_DSTATE "" FLOAT32_IEEE ADAS_CM_single 0 0 -3.4E+38 3.4E+38 ECU_ADDRESS 0x0000 /* @ECU_Address@rtDW_ADAS.GTAngleobj2.GTDelay3_DSTATE@ */ /end MEASUREMENT
/begin MEASUREMENT rtDW_ADAS.GTAngleobj2.GTDelay6_DSTATE "" FLOAT32_IEEE ADAS_CM_single 0 0 -3.4E+38 3.4E+38 ECU_ADDRESS 0x0000 /* @ECU_Address@rtDW_ADAS.GTAngleobj2.GTDelay6_DSTATE@ */ /end MEASUREMENT
/begin MEASUREMENT rtDW_ADAS.GTAngleobj2.GTDelay8_DSTATE "" FLOAT32_IEEE ADAS_CM_single 0 0 -3.4E+38 3.4E+38 ECU_ADDRESS 0x0000 /* @ECU_Address@rtDW_ADAS.GTAngleobj2.GTDelay8_DSTATE@ */ /end MEASUREMENT
/begin MEASUREMENT rtDW_ADAS.GTAngleobj2.GTDelayInput2_DSTATE "" FLOAT32_IEEE ADAS_CM_single 0 0 -3.4E+38 3.4E+38 ECU_ADDRESS 0x0000 /* @ECU_Address@rtDW_ADAS.GTAngleobj2.GTDelayInput2_DSTATE@ */ /end MEASUREMENT
/begin MEASUREMENT rtDW_ADAS.GTAngleobj2.GTDelayInput2_DSTATE_h "" FLOAT32_IEEE ADAS_CM_single 0 0 -3.4E+38 3.4E+38 ECU_ADDRESS 0x0000 /* @ECU_Address@rtDW_ADAS.GTAngleobj2.GTDelayInput2_DSTATE_h@ */ /end MEASUREMENT
/begin MEASUREMENT rtDW_ADAS.GTAngleobj2.GTDelayInput2_DSTATE_m "" FLOAT32_IEEE ADAS_CM_single 0 0 -3.4E+38 3.4E+38 ECU_ADDRESS 0x0000 /* @ECU_Address@rtDW_ADAS.GTAngleobj2.GTDelayInput2_DSTATE_m@ */ /end MEASUREMENT
/begin MEASUREMENT rtDW_ADAS.GTAngleobj2.GTDelayInput2_DSTATE_p "" FLOAT32_IEEE ADAS_CM_single 0 0 -3.4E+38 3.4E+38 ECU_ADDRESS 0x0000 /* @ECU_Address@rtDW_ADAS.GTAngleobj2.GTDelayInput2_DSTATE_p@ */ /end MEASUREMENT
/begin MEASUREMENT rtDW_ADAS.GTAngleobj2.GTis_active_c349_ADAS "" UBYTE ADAS_CM_uint8 0 0 0 255 ECU_ADDRESS 0x0000 /* @ECU_Address@rtDW_ADAS.GTAngleobj2.GTis_active_c349_ADAS@ */ /end MEASUREMENT
/begin MEASUREMENT rtDW_ADAS.GTAngleobj2.GTis_active_c354_ADAS "" UBYTE ADAS_CM_uint8 0 0 0 255 ECU_ADDRESS 0x0000 /* @ECU_Address@rtDW_ADAS.GTAngleobj2.GTis_active_c354_ADAS@ */ /end MEASUREMENT
/begin MEASUREMENT rtDW_ADAS.GTAngleobj2.GTis_c349_ADAS "" UBYTE ADAS_CM_uint8 0 0 0 255 ECU_ADDRESS 0x0000 /* @ECU_Address@rtDW_ADAS.GTAngleobj2.GTis_c349_ADAS@ */ /end MEASUREMENT
/begin MEASUREMENT rtDW_ADAS.GTAngleobj2.GTis_c354_ADAS "" UBYTE ADAS_CM_uint8 0 0 0 255 ECU_ADDRESS 0x0000 /* @ECU_Address@rtDW_ADAS.GTAngleobj2.GTis_c354_ADAS@ */ /end MEASUREMENT
/begin MEASUREMENT rtDW_ADAS.GTAngleobj2.GTtemporalCounter_i1 "" ULONG ADAS_CM_uint32 0 0 0 4294967295 ECU_ADDRESS 0x0000 /* @ECU_Address@rtDW_ADAS.GTAngleobj2.GTtemporalCounter_i1@ */ /end MEASUREMENT
/begin MEASUREMENT rtDW_ADAS.GTAngleobj20.GTAngleobj1_MODE "" UBYTE ADAS_CM_logical 0 0 0 1 ECU_ADDRESS 0x0000 /* @ECU_Address@rtDW_ADAS.GTAngleobj20.GTAngleobj1_MODE@ */ /end MEASUREMENT
/begin MEASUREMENT rtDW_ADAS.GTAngleobj20.GTDelay1_DSTATE "" FLOAT32_IEEE ADAS_CM_single 0 0 -3.4E+38 3.4E+38 ECU_ADDRESS 0x0000 /* @ECU_Address@rtDW_ADAS.GTAngleobj20.GTDelay1_DSTATE@ */ /end MEASUREMENT
/begin MEASUREMENT rtDW_ADAS.GTAngleobj20.GTDelay2_DSTATE "" FLOAT32_IEEE ADAS_CM_single 0 0 -3.4E+38 3.4E+38 ECU_ADDRESS 0x0000 /* @ECU_Address@rtDW_ADAS.GTAngleobj20.GTDelay2_DSTATE@ */ /end MEASUREMENT
/begin MEASUREMENT rtDW_ADAS.GTAngleobj20.GTDelay3_DSTATE "" FLOAT32_IEEE ADAS_CM_single 0 0 -3.4E+38 3.4E+38 ECU_ADDRESS 0x0000 /* @ECU_Address@rtDW_ADAS.GTAngleobj20.GTDelay3_DSTATE@ */ /end MEASUREMENT
/begin MEASUREMENT rtDW_ADAS.GTAngleobj20.GTDelay6_DSTATE "" FLOAT32_IEEE ADAS_CM_single 0 0 -3.4E+38 3.4E+38 ECU_ADDRESS 0x0000 /* @ECU_Address@rtDW_ADAS.GTAngleobj20.GTDelay6_DSTATE@ */ /end MEASUREMENT
/begin MEASUREMENT rtDW_ADAS.GTAngleobj20.GTDelay8_DSTATE "" FLOAT32_IEEE ADAS_CM_single 0 0 -3.4E+38 3.4E+38 ECU_ADDRESS 0x0000 /* @ECU_Address@rtDW_ADAS.GTAngleobj20.GTDelay8_DSTATE@ */ /end MEASUREMENT
/begin MEASUREMENT rtDW_ADAS.GTAngleobj20.GTDelayInput2_DSTATE "" FLOAT32_IEEE ADAS_CM_single 0 0 -3.4E+38 3.4E+38 ECU_ADDRESS 0x0000 /* @ECU_Address@rtDW_ADAS.GTAngleobj20.GTDelayInput2_DSTATE@ */ /end MEASUREMENT
/begin MEASUREMENT rtDW_ADAS.GTAngleobj20.GTDelayInput2_DSTATE_h "" FLOAT32_IEEE ADAS_CM_single 0 0 -3.4E+38 3.4E+38 ECU_ADDRESS 0x0000 /* @ECU_Address@rtDW_ADAS.GTAngleobj20.GTDelayInput2_DSTATE_h@ */ /end MEASUREMENT
/begin MEASUREMENT rtDW_ADAS.GTAngleobj20.GTDelayInput2_DSTATE_m "" FLOAT32_IEEE ADAS_CM_single 0 0 -3.4E+38 3.4E+38 ECU_ADDRESS 0x0000 /* @ECU_Address@rtDW_ADAS.GTAngleobj20.GTDelayInput2_DSTATE_m@ */ /end MEASUREMENT
/begin MEASUREMENT rtDW_ADAS.GTAngleobj20.GTDelayInput2_DSTATE_p "" FLOAT32_IEEE ADAS_CM_single 0 0 -3.4E+38 3.4E+38 ECU_ADDRESS 0x0000 /* @ECU_Address@rtDW_ADAS.GTAngleobj20.GTDelayInput2_DSTATE_p@ */ /end MEASUREMENT
/begin MEASUREMENT rtDW_ADAS.GTAngleobj20.GTis_active_c349_ADAS "" UBYTE ADAS_CM_uint8 0 0 0 255 ECU_ADDRESS 0x0000 /* @ECU_Address@rtDW_ADAS.GTAngleobj20.GTis_active_c349_ADAS@ */ /end MEASUREMENT
/begin MEASUREMENT rtDW_ADAS.GTAngleobj20.GTis_active_c354_ADAS "" UBYTE ADAS_CM_uint8 0 0 0 255 ECU_ADDRESS 0x0000 /* @ECU_Address@rtDW_ADAS.GTAngleobj20.GTis_active_c354_ADAS@ */ /end MEASUREMENT
/begin MEASUREMENT rtDW_ADAS.GTAngleobj20.GTis_c349_ADAS "" UBYTE ADAS_CM_uint8 0 0 0 255 ECU_ADDRESS 0x0000 /* @ECU_Address@rtDW_ADAS.GTAngleobj20.GTis_c349_ADAS@ */ /end MEASUREMENT
/begin MEASUREMENT rtDW_ADAS.GTAngleobj20.GTis_c354_ADAS "" UBYTE ADAS_CM_uint8 0 0 0 255 ECU_ADDRESS 0x0000 /* @ECU_Address@rtDW_ADAS.GTAngleobj20.GTis_c354_ADAS@ */ /end MEASUREMENT
/begin MEASUREMENT rtDW_ADAS.GTAngleobj20.GTtemporalCounter_i1 "" ULONG ADAS_CM_uint32 0 0 0 4294967295 ECU_ADDRESS 0x0000 /* @ECU_Address@rtDW_ADAS.GTAngleobj20.GTtemporalCounter_i1@ */ /end MEASUREMENT
/begin MEASUREMENT rtDW_ADAS.GTAngleobj3.GTAngleobj1_MODE "" UBYTE ADAS_CM_logical 0 0 0 1 ECU_ADDRESS 0x0000 /* @ECU_Address@rtDW_ADAS.GTAngleobj3.GTAngleobj1_MODE@ */ /end MEASUREMENT
/begin MEASUREMENT rtDW_ADAS.GTAngleobj3.GTDelay1_DSTATE "" FLOAT32_IEEE ADAS_CM_single 0 0 -3.4E+38 3.4E+38 ECU_ADDRESS 0x0000 /* @ECU_Address@rtDW_ADAS.GTAngleobj3.GTDelay1_DSTATE@ */ /end MEASUREMENT
/begin MEASUREMENT rtDW_ADAS.GTAngleobj3.GTDelay2_DSTATE "" FLOAT32_IEEE ADAS_CM_single 0 0 -3.4E+38 3.4E+38 ECU_ADDRESS 0x0000 /* @ECU_Address@rtDW_ADAS.GTAngleobj3.GTDelay2_DSTATE@ */ /end MEASUREMENT
/begin MEASUREMENT rtDW_ADAS.GTAngleobj3.GTDelay3_DSTATE "" FLOAT32_IEEE ADAS_CM_single 0 0 -3.4E+38 3.4E+38 ECU_ADDRESS 0x0000 /* @ECU_Address@rtDW_ADAS.GTAngleobj3.GTDelay3_DSTATE@ */ /end MEASUREMENT
/begin MEASUREMENT rtDW_ADAS.GTAngleobj3.GTDelay6_DSTATE "" FLOAT32_IEEE ADAS_CM_single 0 0 -3.4E+38 3.4E+38 ECU_ADDRESS 0x0000 /* @ECU_Address@rtDW_ADAS.GTAngleobj3.GTDelay6_DSTATE@ */ /end MEASUREMENT
/begin MEASUREMENT rtDW_ADAS.GTAngleobj3.GTDelay8_DSTATE "" FLOAT32_IEEE ADAS_CM_single 0 0 -3.4E+38 3.4E+38 ECU_ADDRESS 0x0000 /* @ECU_Address@rtDW_ADAS.GTAngleobj3.GTDelay8_DSTATE@ */ /end MEASUREMENT
/begin MEASUREMENT rtDW_ADAS.GTAngleobj3.GTDelayInput2_DSTATE "" FLOAT32_IEEE ADAS_CM_single 0 0 -3.4E+38 3.4E+38 ECU_ADDRESS 0x0000 /* @ECU_Address@rtDW_ADAS.GTAngleobj3.GTDelayInput2_DSTATE@ */ /end MEASUREMENT
/begin MEASUREMENT rtDW_ADAS.GTAngleobj3.GTDelayInput2_DSTATE_h "" FLOAT32_IEEE ADAS_CM_single 0 0 -3.4E+38 3.4E+38 ECU_ADDRESS 0x0000 /* @ECU_Address@rtDW_ADAS.GTAngleobj3.GTDelayInput2_DSTATE_h@ */ /end MEASUREMENT
/begin MEASUREMENT rtDW_ADAS.GTAngleobj3.GTDelayInput2_DSTATE_m "" FLOAT32_IEEE ADAS_CM_single 0 0 -3.4E+38 3.4E+38 ECU_ADDRESS 0x0000 /* @ECU_Address@rtDW_ADAS.GTAngleobj3.GTDelayInput2_DSTATE_m@ */ /end MEASUREMENT
/begin MEASUREMENT rtDW_ADAS.GTAngleobj3.GTDelayInput2_DSTATE_p "" FLOAT32_IEEE ADAS_CM_single 0 0 -3.4E+38 3.4E+38 ECU_ADDRESS 0x0000 /* @ECU_Address@rtDW_ADAS.GTAngleobj3.GTDelayInput2_DSTATE_p@ */ /end MEASUREMENT
/begin MEASUREMENT rtDW_ADAS.GTAngleobj3.GTis_active_c349_ADAS "" UBYTE ADAS_CM_uint8 0 0 0 255 ECU_ADDRESS 0x0000 /* @ECU_Address@rtDW_ADAS.GTAngleobj3.GTis_active_c349_ADAS@ */ /end MEASUREMENT
/begin MEASUREMENT rtDW_ADAS.GTAngleobj3.GTis_active_c354_ADAS "" UBYTE ADAS_CM_uint8 0 0 0 255 ECU_ADDRESS 0x0000 /* @ECU_Address@rtDW_ADAS.GTAngleobj3.GTis_active_c354_ADAS@ */ /end MEASUREMENT
/begin MEASUREMENT rtDW_ADAS.GTAngleobj3.GTis_c349_ADAS "" UBYTE ADAS_CM_uint8 0 0 0 255 ECU_ADDRESS 0x0000 /* @ECU_Address@rtDW_ADAS.GTAngleobj3.GTis_c349_ADAS@ */ /end MEASUREMENT
/begin MEASUREMENT rtDW_ADAS.GTAngleobj3.GTis_c354_ADAS "" UBYTE ADAS_CM_uint8 0 0 0 255 ECU_ADDRESS 0x0000 /* @ECU_Address@rtDW_ADAS.GTAngleobj3.GTis_c354_ADAS@ */ /end MEASUREMENT
/begin MEASUREMENT rtDW_ADAS.GTAngleobj3.GTtemporalCounter_i1 "" ULONG ADAS_CM_uint32 0 0 0 4294967295 ECU_ADDRESS 0x0000 /* @ECU_Address@rtDW_ADAS.GTAngleobj3.GTtemporalCounter_i1@ */ /end MEASUREMENT
/begin MEASUREMENT rtDW_ADAS.GTAngleobj4.GTAngleobj1_MODE "" UBYTE ADAS_CM_logical 0 0 0 1 ECU_ADDRESS 0x0000 /* @ECU_Address@rtDW_ADAS.GTAngleobj4.GTAngleobj1_MODE@ */ /end MEASUREMENT
/begin MEASUREMENT rtDW_ADAS.GTAngleobj4.GTDelay1_DSTATE "" FLOAT32_IEEE ADAS_CM_single 0 0 -3.4E+38 3.4E+38 ECU_ADDRESS 0x0000 /* @ECU_Address@rtDW_ADAS.GTAngleobj4.GTDelay1_DSTATE@ */ /end MEASUREMENT
/begin MEASUREMENT rtDW_ADAS.GTAngleobj4.GTDelay2_DSTATE "" FLOAT32_IEEE ADAS_CM_single 0 0 -3.4E+38 3.4E+38 ECU_ADDRESS 0x0000 /* @ECU_Address@rtDW_ADAS.GTAngleobj4.GTDelay2_DSTATE@ */ /end MEASUREMENT
/begin MEASUREMENT rtDW_ADAS.GTAngleobj4.GTDelay3_DSTATE "" FLOAT32_IEEE ADAS_CM_single 0 0 -3.4E+38 3.4E+38 ECU_ADDRESS 0x0000 /* @ECU_Address@rtDW_ADAS.GTAngleobj4.GTDelay3_DSTATE@ */ /end MEASUREMENT
/begin MEASUREMENT rtDW_ADAS.GTAngleobj4.GTDelay6_DSTATE "" FLOAT32_IEEE ADAS_CM_single 0 0 -3.4E+38 3.4E+38 ECU_ADDRESS 0x0000 /* @ECU_Address@rtDW_ADAS.GTAngleobj4.GTDelay6_DSTATE@ */ /end MEASUREMENT
/begin MEASUREMENT rtDW_ADAS.GTAngleobj4.GTDelay8_DSTATE "" FLOAT32_IEEE ADAS_CM_single 0 0 -3.4E+38 3.4E+38 ECU_ADDRESS 0x0000 /* @ECU_Address@rtDW_ADAS.GTAngleobj4.GTDelay8_DSTATE@ */ /end MEASUREMENT
/begin MEASUREMENT rtDW_ADAS.GTAngleobj4.GTDelayInput2_DSTATE "" FLOAT32_IEEE ADAS_CM_single 0 0 -3.4E+38 3.4E+38 ECU_ADDRESS 0x0000 /* @ECU_Address@rtDW_ADAS.GTAngleobj4.GTDelayInput2_DSTATE@ */ /end MEASUREMENT
/begin MEASUREMENT rtDW_ADAS.GTAngleobj4.GTDelayInput2_DSTATE_h "" FLOAT32_IEEE ADAS_CM_single 0 0 -3.4E+38 3.4E+38 ECU_ADDRESS 0x0000 /* @ECU_Address@rtDW_ADAS.GTAngleobj4.GTDelayInput2_DSTATE_h@ */ /end MEASUREMENT
/begin MEASUREMENT rtDW_ADAS.GTAngleobj4.GTDelayInput2_DSTATE_m "" FLOAT32_IEEE ADAS_CM_single 0 0 -3.4E+38 3.4E+38 ECU_ADDRESS 0x0000 /* @ECU_Address@rtDW_ADAS.GTAngleobj4.GTDelayInput2_DSTATE_m@ */ /end MEASUREMENT
/begin MEASUREMENT rtDW_ADAS.GTAngleobj4.GTDelayInput2_DSTATE_p "" FLOAT32_IEEE ADAS_CM_single 0 0 -3.4E+38 3.4E+38 ECU_ADDRESS 0x0000 /* @ECU_Address@rtDW_ADAS.GTAngleobj4.GTDelayInput2_DSTATE_p@ */ /end MEASUREMENT
/begin MEASUREMENT rtDW_ADAS.GTAngleobj4.GTis_active_c349_ADAS "" UBYTE ADAS_CM_uint8 0 0 0 255 ECU_ADDRESS 0x0000 /* @ECU_Address@rtDW_ADAS.GTAngleobj4.GTis_active_c349_ADAS@ */ /end MEASUREMENT
/begin MEASUREMENT rtDW_ADAS.GTAngleobj4.GTis_active_c354_ADAS "" UBYTE ADAS_CM_uint8 0 0 0 255 ECU_ADDRESS 0x0000 /* @ECU_Address@rtDW_ADAS.GTAngleobj4.GTis_active_c354_ADAS@ */ /end MEASUREMENT
/begin MEASUREMENT rtDW_ADAS.GTAngleobj4.GTis_c349_ADAS "" UBYTE ADAS_CM_uint8 0 0 0 255 ECU_ADDRESS 0x0000 /* @ECU_Address@rtDW_ADAS.GTAngleobj4.GTis_c349_ADAS@ */ /end MEASUREMENT
/begin MEASUREMENT rtDW_ADAS.GTAngleobj4.GTis_c354_ADAS "" UBYTE ADAS_CM_uint8 0 0 0 255 ECU_ADDRESS 0x0000 /* @ECU_Address@rtDW_ADAS.GTAngleobj4.GTis_c354_ADAS@ */ /end MEASUREMENT
/begin MEASUREMENT rtDW_ADAS.GTAngleobj4.GTtemporalCounter_i1 "" ULONG ADAS_CM_uint32 0 0 0 4294967295 ECU_ADDRESS 0x0000 /* @ECU_Address@rtDW_ADAS.GTAngleobj4.GTtemporalCounter_i1@ */ /end MEASUREMENT
/begin MEASUREMENT rtDW_ADAS.GTAngleobj5.GTAngleobj1_MODE "" UBYTE ADAS_CM_logical 0 0 0 1 ECU_ADDRESS 0x0000 /* @ECU_Address@rtDW_ADAS.GTAngleobj5.GTAngleobj1_MODE@ */ /end MEASUREMENT
/begin MEASUREMENT rtDW_ADAS.GTAngleobj5.GTDelay1_DSTATE "" FLOAT32_IEEE ADAS_CM_single 0 0 -3.4E+38 3.4E+38 ECU_ADDRESS 0x0000 /* @ECU_Address@rtDW_ADAS.GTAngleobj5.GTDelay1_DSTATE@ */ /end MEASUREMENT
/begin MEASUREMENT rtDW_ADAS.GTAngleobj5.GTDelay2_DSTATE "" FLOAT32_IEEE ADAS_CM_single 0 0 -3.4E+38 3.4E+38 ECU_ADDRESS 0x0000 /* @ECU_Address@rtDW_ADAS.GTAngleobj5.GTDelay2_DSTATE@ */ /end MEASUREMENT
/begin MEASUREMENT rtDW_ADAS.GTAngleobj5.GTDelay3_DSTATE "" FLOAT32_IEEE ADAS_CM_single 0 0 -3.4E+38 3.4E+38 ECU_ADDRESS 0x0000 /* @ECU_Address@rtDW_ADAS.GTAngleobj5.GTDelay3_DSTATE@ */ /end MEASUREMENT
/begin MEASUREMENT rtDW_ADAS.GTAngleobj5.GTDelay6_DSTATE "" FLOAT32_IEEE ADAS_CM_single 0 0 -3.4E+38 3.4E+38 ECU_ADDRESS 0x0000 /* @ECU_Address@rtDW_ADAS.GTAngleobj5.GTDelay6_DSTATE@ */ /end MEASUREMENT
/begin MEASUREMENT rtDW_ADAS.GTAngleobj5.GTDelay8_DSTATE "" FLOAT32_IEEE ADAS_CM_single 0 0 -3.4E+38 3.4E+38 ECU_ADDRESS 0x0000 /* @ECU_Address@rtDW_ADAS.GTAngleobj5.GTDelay8_DSTATE@ */ /end MEASUREMENT
/begin MEASUREMENT rtDW_ADAS.GTAngleobj5.GTDelayInput2_DSTATE "" FLOAT32_IEEE ADAS_CM_single 0 0 -3.4E+38 3.4E+38 ECU_ADDRESS 0x0000 /* @ECU_Address@rtDW_ADAS.GTAngleobj5.GTDelayInput2_DSTATE@ */ /end MEASUREMENT
/begin MEASUREMENT rtDW_ADAS.GTAngleobj5.GTDelayInput2_DSTATE_h "" FLOAT32_IEEE ADAS_CM_single 0 0 -3.4E+38 3.4E+38 ECU_ADDRESS 0x0000 /* @ECU_Address@rtDW_ADAS.GTAngleobj5.GTDelayInput2_DSTATE_h@ */ /end MEASUREMENT
/begin MEASUREMENT rtDW_ADAS.GTAngleobj5.GTDelayInput2_DSTATE_m "" FLOAT32_IEEE ADAS_CM_single 0 0 -3.4E+38 3.4E+38 ECU_ADDRESS 0x0000 /* @ECU_Address@rtDW_ADAS.GTAngleobj5.GTDelayInput2_DSTATE_m@ */ /end MEASUREMENT
/begin MEASUREMENT rtDW_ADAS.GTAngleobj5.GTDelayInput2_DSTATE_p "" FLOAT32_IEEE ADAS_CM_single 0 0 -3.4E+38 3.4E+38 ECU_ADDRESS 0x0000 /* @ECU_Address@rtDW_ADAS.GTAngleobj5.GTDelayInput2_DSTATE_p@ */ /end MEASUREMENT
/begin MEASUREMENT rtDW_ADAS.GTAngleobj5.GTis_active_c349_ADAS "" UBYTE ADAS_CM_uint8 0 0 0 255 ECU_ADDRESS 0x0000 /* @ECU_Address@rtDW_ADAS.GTAngleobj5.GTis_active_c349_ADAS@ */ /end MEASUREMENT
/begin MEASUREMENT rtDW_ADAS.GTAngleobj5.GTis_active_c354_ADAS "" UBYTE ADAS_CM_uint8 0 0 0 255 ECU_ADDRESS 0x0000 /* @ECU_Address@rtDW_ADAS.GTAngleobj5.GTis_active_c354_ADAS@ */ /end MEASUREMENT
/begin MEASUREMENT rtDW_ADAS.GTAngleobj5.GTis_c349_ADAS "" UBYTE ADAS_CM_uint8 0 0 0 255 ECU_ADDRESS 0x0000 /* @ECU_Address@rtDW_ADAS.GTAngleobj5.GTis_c349_ADAS@ */ /end MEASUREMENT
/begin MEASUREMENT rtDW_ADAS.GTAngleobj5.GTis_c354_ADAS "" UBYTE ADAS_CM_uint8 0 0 0 255 ECU_ADDRESS 0x0000 /* @ECU_Address@rtDW_ADAS.GTAngleobj5.GTis_c354_ADAS@ */ /end MEASUREMENT
/begin MEASUREMENT rtDW_ADAS.GTAngleobj5.GTtemporalCounter_i1 "" ULONG ADAS_CM_uint32 0 0 0 4294967295 ECU_ADDRESS 0x0000 /* @ECU_Address@rtDW_ADAS.GTAngleobj5.GTtemporalCounter_i1@ */ /end MEASUREMENT
/begin MEASUREMENT rtDW_ADAS.GTAngleobj6.GTAngleobj1_MODE "" UBYTE ADAS_CM_logical 0 0 0 1 ECU_ADDRESS 0x0000 /* @ECU_Address@rtDW_ADAS.GTAngleobj6.GTAngleobj1_MODE@ */ /end MEASUREMENT
/begin MEASUREMENT rtDW_ADAS.GTAngleobj6.GTDelay1_DSTATE "" FLOAT32_IEEE ADAS_CM_single 0 0 -3.4E+38 3.4E+38 ECU_ADDRESS 0x0000 /* @ECU_Address@rtDW_ADAS.GTAngleobj6.GTDelay1_DSTATE@ */ /end MEASUREMENT
/begin MEASUREMENT rtDW_ADAS.GTAngleobj6.GTDelay2_DSTATE "" FLOAT32_IEEE ADAS_CM_single 0 0 -3.4E+38 3.4E+38 ECU_ADDRESS 0x0000 /* @ECU_Address@rtDW_ADAS.GTAngleobj6.GTDelay2_DSTATE@ */ /end MEASUREMENT
/begin MEASUREMENT rtDW_ADAS.GTAngleobj6.GTDelay3_DSTATE "" FLOAT32_IEEE ADAS_CM_single 0 0 -3.4E+38 3.4E+38 ECU_ADDRESS 0x0000 /* @ECU_Address@rtDW_ADAS.GTAngleobj6.GTDelay3_DSTATE@ */ /end MEASUREMENT
/begin MEASUREMENT rtDW_ADAS.GTAngleobj6.GTDelay6_DSTATE "" FLOAT32_IEEE ADAS_CM_single 0 0 -3.4E+38 3.4E+38 ECU_ADDRESS 0x0000 /* @ECU_Address@rtDW_ADAS.GTAngleobj6.GTDelay6_DSTATE@ */ /end MEASUREMENT
/begin MEASUREMENT rtDW_ADAS.GTAngleobj6.GTDelay8_DSTATE "" FLOAT32_IEEE ADAS_CM_single 0 0 -3.4E+38 3.4E+38 ECU_ADDRESS 0x0000 /* @ECU_Address@rtDW_ADAS.GTAngleobj6.GTDelay8_DSTATE@ */ /end MEASUREMENT
/begin MEASUREMENT rtDW_ADAS.GTAngleobj6.GTDelayInput2_DSTATE "" FLOAT32_IEEE ADAS_CM_single 0 0 -3.4E+38 3.4E+38 ECU_ADDRESS 0x0000 /* @ECU_Address@rtDW_ADAS.GTAngleobj6.GTDelayInput2_DSTATE@ */ /end MEASUREMENT
/begin MEASUREMENT rtDW_ADAS.GTAngleobj6.GTDelayInput2_DSTATE_h "" FLOAT32_IEEE ADAS_CM_single 0 0 -3.4E+38 3.4E+38 ECU_ADDRESS 0x0000 /* @ECU_Address@rtDW_ADAS.GTAngleobj6.GTDelayInput2_DSTATE_h@ */ /end MEASUREMENT
/begin MEASUREMENT rtDW_ADAS.GTAngleobj6.GTDelayInput2_DSTATE_m "" FLOAT32_IEEE ADAS_CM_single 0 0 -3.4E+38 3.4E+38 ECU_ADDRESS 0x0000 /* @ECU_Address@rtDW_ADAS.GTAngleobj6.GTDelayInput2_DSTATE_m@ */ /end MEASUREMENT
/begin MEASUREMENT rtDW_ADAS.GTAngleobj6.GTDelayInput2_DSTATE_p "" FLOAT32_IEEE ADAS_CM_single 0 0 -3.4E+38 3.4E+38 ECU_ADDRESS 0x0000 /* @ECU_Address@rtDW_ADAS.GTAngleobj6.GTDelayInput2_DSTATE_p@ */ /end MEASUREMENT
/begin MEASUREMENT rtDW_ADAS.GTAngleobj6.GTis_active_c349_ADAS "" UBYTE ADAS_CM_uint8 0 0 0 255 ECU_ADDRESS 0x0000 /* @ECU_Address@rtDW_ADAS.GTAngleobj6.GTis_active_c349_ADAS@ */ /end MEASUREMENT
/begin MEASUREMENT rtDW_ADAS.GTAngleobj6.GTis_active_c354_ADAS "" UBYTE ADAS_CM_uint8 0 0 0 255 ECU_ADDRESS 0x0000 /* @ECU_Address@rtDW_ADAS.GTAngleobj6.GTis_active_c354_ADAS@ */ /end MEASUREMENT
/begin MEASUREMENT rtDW_ADAS.GTAngleobj6.GTis_c349_ADAS "" UBYTE ADAS_CM_uint8 0 0 0 255 ECU_ADDRESS 0x0000 /* @ECU_Address@rtDW_ADAS.GTAngleobj6.GTis_c349_ADAS@ */ /end MEASUREMENT
/begin MEASUREMENT rtDW_ADAS.GTAngleobj6.GTis_c354_ADAS "" UBYTE ADAS_CM_uint8 0 0 0 255 ECU_ADDRESS 0x0000 /* @ECU_Address@rtDW_ADAS.GTAngleobj6.GTis_c354_ADAS@ */ /end MEASUREMENT
/begin MEASUREMENT rtDW_ADAS.GTAngleobj6.GTtemporalCounter_i1 "" ULONG ADAS_CM_uint32 0 0 0 4294967295 ECU_ADDRESS 0x0000 /* @ECU_Address@rtDW_ADAS.GTAngleobj6.GTtemporalCounter_i1@ */ /end MEASUREMENT
/begin MEASUREMENT rtDW_ADAS.GTAngleobj7.GTAngleobj1_MODE "" UBYTE ADAS_CM_logical 0 0 0 1 ECU_ADDRESS 0x0000 /* @ECU_Address@rtDW_ADAS.GTAngleobj7.GTAngleobj1_MODE@ */ /end MEASUREMENT
/begin MEASUREMENT rtDW_ADAS.GTAngleobj7.GTDelay1_DSTATE "" FLOAT32_IEEE ADAS_CM_single 0 0 -3.4E+38 3.4E+38 ECU_ADDRESS 0x0000 /* @ECU_Address@rtDW_ADAS.GTAngleobj7.GTDelay1_DSTATE@ */ /end MEASUREMENT
/begin MEASUREMENT rtDW_ADAS.GTAngleobj7.GTDelay2_DSTATE "" FLOAT32_IEEE ADAS_CM_single 0 0 -3.4E+38 3.4E+38 ECU_ADDRESS 0x0000 /* @ECU_Address@rtDW_ADAS.GTAngleobj7.GTDelay2_DSTATE@ */ /end MEASUREMENT
/begin MEASUREMENT rtDW_ADAS.GTAngleobj7.GTDelay3_DSTATE "" FLOAT32_IEEE ADAS_CM_single 0 0 -3.4E+38 3.4E+38 ECU_ADDRESS 0x0000 /* @ECU_Address@rtDW_ADAS.GTAngleobj7.GTDelay3_DSTATE@ */ /end MEASUREMENT
/begin MEASUREMENT rtDW_ADAS.GTAngleobj7.GTDelay6_DSTATE "" FLOAT32_IEEE ADAS_CM_single 0 0 -3.4E+38 3.4E+38 ECU_ADDRESS 0x0000 /* @ECU_Address@rtDW_ADAS.GTAngleobj7.GTDelay6_DSTATE@ */ /end MEASUREMENT
/begin MEASUREMENT rtDW_ADAS.GTAngleobj7.GTDelay8_DSTATE "" FLOAT32_IEEE ADAS_CM_single 0 0 -3.4E+38 3.4E+38 ECU_ADDRESS 0x0000 /* @ECU_Address@rtDW_ADAS.GTAngleobj7.GTDelay8_DSTATE@ */ /end MEASUREMENT
/begin MEASUREMENT rtDW_ADAS.GTAngleobj7.GTDelayInput2_DSTATE "" FLOAT32_IEEE ADAS_CM_single 0 0 -3.4E+38 3.4E+38 ECU_ADDRESS 0x0000 /* @ECU_Address@rtDW_ADAS.GTAngleobj7.GTDelayInput2_DSTATE@ */ /end MEASUREMENT
/begin MEASUREMENT rtDW_ADAS.GTAngleobj7.GTDelayInput2_DSTATE_h "" FLOAT32_IEEE ADAS_CM_single 0 0 -3.4E+38 3.4E+38 ECU_ADDRESS 0x0000 /* @ECU_Address@rtDW_ADAS.GTAngleobj7.GTDelayInput2_DSTATE_h@ */ /end MEASUREMENT
/begin MEASUREMENT rtDW_ADAS.GTAngleobj7.GTDelayInput2_DSTATE_m "" FLOAT32_IEEE ADAS_CM_single 0 0 -3.4E+38 3.4E+38 ECU_ADDRESS 0x0000 /* @ECU_Address@rtDW_ADAS.GTAngleobj7.GTDelayInput2_DSTATE_m@ */ /end MEASUREMENT
/begin MEASUREMENT rtDW_ADAS.GTAngleobj7.GTDelayInput2_DSTATE_p "" FLOAT32_IEEE ADAS_CM_single 0 0 -3.4E+38 3.4E+38 ECU_ADDRESS 0x0000 /* @ECU_Address@rtDW_ADAS.GTAngleobj7.GTDelayInput2_DSTATE_p@ */ /end MEASUREMENT
/begin MEASUREMENT rtDW_ADAS.GTAngleobj7.GTis_active_c349_ADAS "" UBYTE ADAS_CM_uint8 0 0 0 255 ECU_ADDRESS 0x0000 /* @ECU_Address@rtDW_ADAS.GTAngleobj7.GTis_active_c349_ADAS@ */ /end MEASUREMENT
/begin MEASUREMENT rtDW_ADAS.GTAngleobj7.GTis_active_c354_ADAS "" UBYTE ADAS_CM_uint8 0 0 0 255 ECU_ADDRESS 0x0000 /* @ECU_Address@rtDW_ADAS.GTAngleobj7.GTis_active_c354_ADAS@ */ /end MEASUREMENT
/begin MEASUREMENT rtDW_ADAS.GTAngleobj7.GTis_c349_ADAS "" UBYTE ADAS_CM_uint8 0 0 0 255 ECU_ADDRESS 0x0000 /* @ECU_Address@rtDW_ADAS.GTAngleobj7.GTis_c349_ADAS@ */ /end MEASUREMENT
/begin MEASUREMENT rtDW_ADAS.GTAngleobj7.GTis_c354_ADAS "" UBYTE ADAS_CM_uint8 0 0 0 255 ECU_ADDRESS 0x0000 /* @ECU_Address@rtDW_ADAS.GTAngleobj7.GTis_c354_ADAS@ */ /end MEASUREMENT
/begin MEASUREMENT rtDW_ADAS.GTAngleobj7.GTtemporalCounter_i1 "" ULONG ADAS_CM_uint32 0 0 0 4294967295 ECU_ADDRESS 0x0000 /* @ECU_Address@rtDW_ADAS.GTAngleobj7.GTtemporalCounter_i1@ */ /end MEASUREMENT
/begin MEASUREMENT rtDW_ADAS.GTAngleobj8.GTAngleobj1_MODE "" UBYTE ADAS_CM_logical 0 0 0 1 ECU_ADDRESS 0x0000 /* @ECU_Address@rtDW_ADAS.GTAngleobj8.GTAngleobj1_MODE@ */ /end MEASUREMENT
/begin MEASUREMENT rtDW_ADAS.GTAngleobj8.GTDelay1_DSTATE "" FLOAT32_IEEE ADAS_CM_single 0 0 -3.4E+38 3.4E+38 ECU_ADDRESS 0x0000 /* @ECU_Address@rtDW_ADAS.GTAngleobj8.GTDelay1_DSTATE@ */ /end MEASUREMENT
/begin MEASUREMENT rtDW_ADAS.GTAngleobj8.GTDelay2_DSTATE "" FLOAT32_IEEE ADAS_CM_single 0 0 -3.4E+38 3.4E+38 ECU_ADDRESS 0x0000 /* @ECU_Address@rtDW_ADAS.GTAngleobj8.GTDelay2_DSTATE@ */ /end MEASUREMENT
/begin MEASUREMENT rtDW_ADAS.GTAngleobj8.GTDelay3_DSTATE "" FLOAT32_IEEE ADAS_CM_single 0 0 -3.4E+38 3.4E+38 ECU_ADDRESS 0x0000 /* @ECU_Address@rtDW_ADAS.GTAngleobj8.GTDelay3_DSTATE@ */ /end MEASUREMENT
/begin MEASUREMENT rtDW_ADAS.GTAngleobj8.GTDelay6_DSTATE "" FLOAT32_IEEE ADAS_CM_single 0 0 -3.4E+38 3.4E+38 ECU_ADDRESS 0x0000 /* @ECU_Address@rtDW_ADAS.GTAngleobj8.GTDelay6_DSTATE@ */ /end MEASUREMENT
/begin MEASUREMENT rtDW_ADAS.GTAngleobj8.GTDelay8_DSTATE "" FLOAT32_IEEE ADAS_CM_single 0 0 -3.4E+38 3.4E+38 ECU_ADDRESS 0x0000 /* @ECU_Address@rtDW_ADAS.GTAngleobj8.GTDelay8_DSTATE@ */ /end MEASUREMENT
/begin MEASUREMENT rtDW_ADAS.GTAngleobj8.GTDelayInput2_DSTATE "" FLOAT32_IEEE ADAS_CM_single 0 0 -3.4E+38 3.4E+38 ECU_ADDRESS 0x0000 /* @ECU_Address@rtDW_ADAS.GTAngleobj8.GTDelayInput2_DSTATE@ */ /end MEASUREMENT
/begin MEASUREMENT rtDW_ADAS.GTAngleobj8.GTDelayInput2_DSTATE_h "" FLOAT32_IEEE ADAS_CM_single 0 0 -3.4E+38 3.4E+38 ECU_ADDRESS 0x0000 /* @ECU_Address@rtDW_ADAS.GTAngleobj8.GTDelayInput2_DSTATE_h@ */ /end MEASUREMENT
/begin MEASUREMENT rtDW_ADAS.GTAngleobj8.GTDelayInput2_DSTATE_m "" FLOAT32_IEEE ADAS_CM_single 0 0 -3.4E+38 3.4E+38 ECU_ADDRESS 0x0000 /* @ECU_Address@rtDW_ADAS.GTAngleobj8.GTDelayInput2_DSTATE_m@ */ /end MEASUREMENT
/begin MEASUREMENT rtDW_ADAS.GTAngleobj8.GTDelayInput2_DSTATE_p "" FLOAT32_IEEE ADAS_CM_single 0 0 -3.4E+38 3.4E+38 ECU_ADDRESS 0x0000 /* @ECU_Address@rtDW_ADAS.GTAngleobj8.GTDelayInput2_DSTATE_p@ */ /end MEASUREMENT
/begin MEASUREMENT rtDW_ADAS.GTAngleobj8.GTis_active_c349_ADAS "" UBYTE ADAS_CM_uint8 0 0 0 255 ECU_ADDRESS 0x0000 /* @ECU_Address@rtDW_ADAS.GTAngleobj8.GTis_active_c349_ADAS@ */ /end MEASUREMENT
/begin MEASUREMENT rtDW_ADAS.GTAngleobj8.GTis_active_c354_ADAS "" UBYTE ADAS_CM_uint8 0 0 0 255 ECU_ADDRESS 0x0000 /* @ECU_Address@rtDW_ADAS.GTAngleobj8.GTis_active_c354_ADAS@ */ /end MEASUREMENT
/begin MEASUREMENT rtDW_ADAS.GTAngleobj8.GTis_c349_ADAS "" UBYTE ADAS_CM_uint8 0 0 0 255 ECU_ADDRESS 0x0000 /* @ECU_Address@rtDW_ADAS.GTAngleobj8.GTis_c349_ADAS@ */ /end MEASUREMENT
/begin MEASUREMENT rtDW_ADAS.GTAngleobj8.GTis_c354_ADAS "" UBYTE ADAS_CM_uint8 0 0 0 255 ECU_ADDRESS 0x0000 /* @ECU_Address@rtDW_ADAS.GTAngleobj8.GTis_c354_ADAS@ */ /end MEASUREMENT
/begin MEASUREMENT rtDW_ADAS.GTAngleobj8.GTtemporalCounter_i1 "" ULONG ADAS_CM_uint32 0 0 0 4294967295 ECU_ADDRESS 0x0000 /* @ECU_Address@rtDW_ADAS.GTAngleobj8.GTtemporalCounter_i1@ */ /end MEASUREMENT
/begin MEASUREMENT rtDW_ADAS.GTAngleobj9.GTAngleobj1_MODE "" UBYTE ADAS_CM_logical 0 0 0 1 ECU_ADDRESS 0x0000 /* @ECU_Address@rtDW_ADAS.GTAngleobj9.GTAngleobj1_MODE@ */ /end MEASUREMENT
/begin MEASUREMENT rtDW_ADAS.GTAngleobj9.GTDelay1_DSTATE "" FLOAT32_IEEE ADAS_CM_single 0 0 -3.4E+38 3.4E+38 ECU_ADDRESS 0x0000 /* @ECU_Address@rtDW_ADAS.GTAngleobj9.GTDelay1_DSTATE@ */ /end MEASUREMENT
/begin MEASUREMENT rtDW_ADAS.GTAngleobj9.GTDelay2_DSTATE "" FLOAT32_IEEE ADAS_CM_single 0 0 -3.4E+38 3.4E+38 ECU_ADDRESS 0x0000 /* @ECU_Address@rtDW_ADAS.GTAngleobj9.GTDelay2_DSTATE@ */ /end MEASUREMENT
/begin MEASUREMENT rtDW_ADAS.GTAngleobj9.GTDelay3_DSTATE "" FLOAT32_IEEE ADAS_CM_single 0 0 -3.4E+38 3.4E+38 ECU_ADDRESS 0x0000 /* @ECU_Address@rtDW_ADAS.GTAngleobj9.GTDelay3_DSTATE@ */ /end MEASUREMENT
/begin MEASUREMENT rtDW_ADAS.GTAngleobj9.GTDelay6_DSTATE "" FLOAT32_IEEE ADAS_CM_single 0 0 -3.4E+38 3.4E+38 ECU_ADDRESS 0x0000 /* @ECU_Address@rtDW_ADAS.GTAngleobj9.GTDelay6_DSTATE@ */ /end MEASUREMENT
/begin MEASUREMENT rtDW_ADAS.GTAngleobj9.GTDelay8_DSTATE "" FLOAT32_IEEE ADAS_CM_single 0 0 -3.4E+38 3.4E+38 ECU_ADDRESS 0x0000 /* @ECU_Address@rtDW_ADAS.GTAngleobj9.GTDelay8_DSTATE@ */ /end MEASUREMENT
/begin MEASUREMENT rtDW_ADAS.GTAngleobj9.GTDelayInput2_DSTATE "" FLOAT32_IEEE ADAS_CM_single 0 0 -3.4E+38 3.4E+38 ECU_ADDRESS 0x0000 /* @ECU_Address@rtDW_ADAS.GTAngleobj9.GTDelayInput2_DSTATE@ */ /end MEASUREMENT
/begin MEASUREMENT rtDW_ADAS.GTAngleobj9.GTDelayInput2_DSTATE_h "" FLOAT32_IEEE ADAS_CM_single 0 0 -3.4E+38 3.4E+38 ECU_ADDRESS 0x0000 /* @ECU_Address@rtDW_ADAS.GTAngleobj9.GTDelayInput2_DSTATE_h@ */ /end MEASUREMENT
/begin MEASUREMENT rtDW_ADAS.GTAngleobj9.GTDelayInput2_DSTATE_m "" FLOAT32_IEEE ADAS_CM_single 0 0 -3.4E+38 3.4E+38 ECU_ADDRESS 0x0000 /* @ECU_Address@rtDW_ADAS.GTAngleobj9.GTDelayInput2_DSTATE_m@ */ /end MEASUREMENT
/begin MEASUREMENT rtDW_ADAS.GTAngleobj9.GTDelayInput2_DSTATE_p "" FLOAT32_IEEE ADAS_CM_single 0 0 -3.4E+38 3.4E+38 ECU_ADDRESS 0x0000 /* @ECU_Address@rtDW_ADAS.GTAngleobj9.GTDelayInput2_DSTATE_p@ */ /end MEASUREMENT
/begin MEASUREMENT rtDW_ADAS.GTAngleobj9.GTis_active_c349_ADAS "" UBYTE ADAS_CM_uint8 0 0 0 255 ECU_ADDRESS 0x0000 /* @ECU_Address@rtDW_ADAS.GTAngleobj9.GTis_active_c349_ADAS@ */ /end MEASUREMENT
/begin MEASUREMENT rtDW_ADAS.GTAngleobj9.GTis_active_c354_ADAS "" UBYTE ADAS_CM_uint8 0 0 0 255 ECU_ADDRESS 0x0000 /* @ECU_Address@rtDW_ADAS.GTAngleobj9.GTis_active_c354_ADAS@ */ /end MEASUREMENT
/begin MEASUREMENT rtDW_ADAS.GTAngleobj9.GTis_c349_ADAS "" UBYTE ADAS_CM_uint8 0 0 0 255 ECU_ADDRESS 0x0000 /* @ECU_Address@rtDW_ADAS.GTAngleobj9.GTis_c349_ADAS@ */ /end MEASUREMENT
/begin MEASUREMENT rtDW_ADAS.GTAngleobj9.GTis_c354_ADAS "" UBYTE ADAS_CM_uint8 0 0 0 255 ECU_ADDRESS 0x0000 /* @ECU_Address@rtDW_ADAS.GTAngleobj9.GTis_c354_ADAS@ */ /end MEASUREMENT
/begin MEASUREMENT rtDW_ADAS.GTAngleobj9.GTtemporalCounter_i1 "" ULONG ADAS_CM_uint32 0 0 0 4294967295 ECU_ADDRESS 0x0000 /* @ECU_Address@rtDW_ADAS.GTAngleobj9.GTtemporalCounter_i1@ */ /end MEASUREMENT
/begin MEASUREMENT rtDW_ADAS.GTBSW_OneSide_Solver.GTBSW_OneSide_Solver_MODE "" UBYTE ADAS_CM_logical 0 0 0 1 ECU_ADDRESS 0x0000 /* @ECU_Address@rtDW_ADAS.GTBSW_OneSide_Solver.GTBSW_OneSide_Solver_MODE@ */ /end MEASUREMENT
/begin MEASUREMENT rtDW_ADAS.GTBSW_OneSide_Solver.GTLeftSwitchCaseActionSubsys_m3.GTMemory1_PreviousInput "" FLOAT64_IEEE ADAS_CM_double 0 0 -1.7E+308 1.7E+308 ECU_ADDRESS 0x0000 /* @ECU_Address@rtDW_ADAS.GTBSW_OneSide_Solver.GTLeftSwitchCaseActionSubsys_m3.GTMemory1_PreviousInput@ */ /end MEASUREMENT
/begin MEASUREMENT rtDW_ADAS.GTBSW_OneSide_Solver.GTLeftSwitchCaseActionSubsys_m3.GTMemory_PreviousInput "" FLOAT32_IEEE ADAS_CM_single 0 0 -3.4E+38 3.4E+38 ECU_ADDRESS 0x0000 /* @ECU_Address@rtDW_ADAS.GTBSW_OneSide_Solver.GTLeftSwitchCaseActionSubsys_m3.GTMemory_PreviousInput@ */ /end MEASUREMENT
/begin MEASUREMENT rtDW_ADAS.GTBSW_OneSide_Solver.GTLeftSwitchCaseActionSubsys_mf.GTMemory1_PreviousInput "" FLOAT64_IEEE ADAS_CM_double 0 0 -1.7E+308 1.7E+308 ECU_ADDRESS 0x0000 /* @ECU_Address@rtDW_ADAS.GTBSW_OneSide_Solver.GTLeftSwitchCaseActionSubsys_mf.GTMemory1_PreviousInput@ */ /end MEASUREMENT
/begin MEASUREMENT rtDW_ADAS.GTBSW_OneSide_Solver.GTLeftSwitchCaseActionSubsys_mf.GTMemory_PreviousInput "" FLOAT32_IEEE ADAS_CM_single 0 0 -3.4E+38 3.4E+38 ECU_ADDRESS 0x0000 /* @ECU_Address@rtDW_ADAS.GTBSW_OneSide_Solver.GTLeftSwitchCaseActionSubsys_mf.GTMemory_PreviousInput@ */ /end MEASUREMENT
/begin MEASUREMENT rtDW_ADAS.GTBSW_OneSide_Solver.GTLeftSwitchCaseActionSubsyst_a.GTMemory1_PreviousInput "" FLOAT64_IEEE ADAS_CM_double 0 0 -1.7E+308 1.7E+308 ECU_ADDRESS 0x0000 /* @ECU_Address@rtDW_ADAS.GTBSW_OneSide_Solver.GTLeftSwitchCaseActionSubsyst_a.GTMemory1_PreviousInput@ */ /end MEASUREMENT
/begin MEASUREMENT rtDW_ADAS.GTBSW_OneSide_Solver.GTLeftSwitchCaseActionSubsyst_a.GTMemory_PreviousInput "" FLOAT32_IEEE ADAS_CM_single 0 0 -3.4E+38 3.4E+38 ECU_ADDRESS 0x0000 /* @ECU_Address@rtDW_ADAS.GTBSW_OneSide_Solver.GTLeftSwitchCaseActionSubsyst_a.GTMemory_PreviousInput@ */ /end MEASUREMENT
/begin MEASUREMENT rtDW_ADAS.GTBSW_OneSide_Solver.GTLeftSwitchCaseActionSubsyst_e.GTMemory1_PreviousInput "" FLOAT64_IEEE ADAS_CM_double 0 0 -1.7E+308 1.7E+308 ECU_ADDRESS 0x0000 /* @ECU_Address@rtDW_ADAS.GTBSW_OneSide_Solver.GTLeftSwitchCaseActionSubsyst_e.GTMemory1_PreviousInput@ */ /end MEASUREMENT
/begin MEASUREMENT rtDW_ADAS.GTBSW_OneSide_Solver.GTLeftSwitchCaseActionSubsyst_e.GTMemory_PreviousInput "" FLOAT32_IEEE ADAS_CM_single 0 0 -3.4E+38 3.4E+38 ECU_ADDRESS 0x0000 /* @ECU_Address@rtDW_ADAS.GTBSW_OneSide_Solver.GTLeftSwitchCaseActionSubsyst_e.GTMemory_PreviousInput@ */ /end MEASUREMENT
/begin MEASUREMENT rtDW_ADAS.GTBSW_OneSide_Solver.GTLeftSwitchCaseActionSubsyst_h.GTMemory1_PreviousInput "" FLOAT64_IEEE ADAS_CM_double 0 0 -1.7E+308 1.7E+308 ECU_ADDRESS 0x0000 /* @ECU_Address@rtDW_ADAS.GTBSW_OneSide_Solver.GTLeftSwitchCaseActionSubsyst_h.GTMemory1_PreviousInput@ */ /end MEASUREMENT
/begin MEASUREMENT rtDW_ADAS.GTBSW_OneSide_Solver.GTLeftSwitchCaseActionSubsyst_h.GTMemory_PreviousInput "" FLOAT32_IEEE ADAS_CM_single 0 0 -3.4E+38 3.4E+38 ECU_ADDRESS 0x0000 /* @ECU_Address@rtDW_ADAS.GTBSW_OneSide_Solver.GTLeftSwitchCaseActionSubsyst_h.GTMemory_PreviousInput@ */ /end MEASUREMENT
/begin MEASUREMENT rtDW_ADAS.GTBSW_OneSide_Solver.GTLeftSwitchCaseActionSubsyst_i.GTMemory1_PreviousInput "" FLOAT64_IEEE ADAS_CM_double 0 0 -1.7E+308 1.7E+308 ECU_ADDRESS 0x0000 /* @ECU_Address@rtDW_ADAS.GTBSW_OneSide_Solver.GTLeftSwitchCaseActionSubsyst_i.GTMemory1_PreviousInput@ */ /end MEASUREMENT
/begin MEASUREMENT rtDW_ADAS.GTBSW_OneSide_Solver.GTLeftSwitchCaseActionSubsyst_i.GTMemory_PreviousInput "" FLOAT32_IEEE ADAS_CM_single 0 0 -3.4E+38 3.4E+38 ECU_ADDRESS 0x0000 /* @ECU_Address@rtDW_ADAS.GTBSW_OneSide_Solver.GTLeftSwitchCaseActionSubsyst_i.GTMemory_PreviousInput@ */ /end MEASUREMENT
/begin MEASUREMENT rtDW_ADAS.GTBSW_OneSide_Solver.GTLeftSwitchCaseActionSubsyst_l.GTMemory1_PreviousInput "" FLOAT64_IEEE ADAS_CM_double 0 0 -1.7E+308 1.7E+308 ECU_ADDRESS 0x0000 /* @ECU_Address@rtDW_ADAS.GTBSW_OneSide_Solver.GTLeftSwitchCaseActionSubsyst_l.GTMemory1_PreviousInput@ */ /end MEASUREMENT
/begin MEASUREMENT rtDW_ADAS.GTBSW_OneSide_Solver.GTLeftSwitchCaseActionSubsyst_l.GTMemory_PreviousInput "" FLOAT32_IEEE ADAS_CM_single 0 0 -3.4E+38 3.4E+38 ECU_ADDRESS 0x0000 /* @ECU_Address@rtDW_ADAS.GTBSW_OneSide_Solver.GTLeftSwitchCaseActionSubsyst_l.GTMemory_PreviousInput@ */ /end MEASUREMENT
/begin MEASUREMENT rtDW_ADAS.GTBSW_OneSide_Solver.GTLeftSwitchCaseActionSubsyst_m.GTMemory1_PreviousInput "" FLOAT64_IEEE ADAS_CM_double 0 0 -1.7E+308 1.7E+308 ECU_ADDRESS 0x0000 /* @ECU_Address@rtDW_ADAS.GTBSW_OneSide_Solver.GTLeftSwitchCaseActionSubsyst_m.GTMemory1_PreviousInput@ */ /end MEASUREMENT
/begin MEASUREMENT rtDW_ADAS.GTBSW_OneSide_Solver.GTLeftSwitchCaseActionSubsyst_m.GTMemory_PreviousInput "" FLOAT32_IEEE ADAS_CM_single 0 0 -3.4E+38 3.4E+38 ECU_ADDRESS 0x0000 /* @ECU_Address@rtDW_ADAS.GTBSW_OneSide_Solver.GTLeftSwitchCaseActionSubsyst_m.GTMemory_PreviousInput@ */ /end MEASUREMENT
/begin MEASUREMENT rtDW_ADAS.GTBSW_OneSide_Solver.GTLeftSwitchCaseActionSubsyst_p.GTMemory1_PreviousInput "" FLOAT64_IEEE ADAS_CM_double 0 0 -1.7E+308 1.7E+308 ECU_ADDRESS 0x0000 /* @ECU_Address@rtDW_ADAS.GTBSW_OneSide_Solver.GTLeftSwitchCaseActionSubsyst_p.GTMemory1_PreviousInput@ */ /end MEASUREMENT
/begin MEASUREMENT rtDW_ADAS.GTBSW_OneSide_Solver.GTLeftSwitchCaseActionSubsyst_p.GTMemory_PreviousInput "" FLOAT32_IEEE ADAS_CM_single 0 0 -3.4E+38 3.4E+38 ECU_ADDRESS 0x0000 /* @ECU_Address@rtDW_ADAS.GTBSW_OneSide_Solver.GTLeftSwitchCaseActionSubsyst_p.GTMemory_PreviousInput@ */ /end MEASUREMENT
/begin MEASUREMENT rtDW_ADAS.GTBSW_OneSide_Solver.GTLeftSwitchCaseActionSubsystem.GTMemory1_PreviousInput "" FLOAT64_IEEE ADAS_CM_double 0 0 -1.7E+308 1.7E+308 ECU_ADDRESS 0x0000 /* @ECU_Address@rtDW_ADAS.GTBSW_OneSide_Solver.GTLeftSwitchCaseActionSubsystem.GTMemory1_PreviousInput@ */ /end MEASUREMENT
/begin MEASUREMENT rtDW_ADAS.GTBSW_OneSide_Solver.GTLeftSwitchCaseActionSubsystem.GTMemory_PreviousInput "" FLOAT32_IEEE ADAS_CM_single 0 0 -3.4E+38 3.4E+38 ECU_ADDRESS 0x0000 /* @ECU_Address@rtDW_ADAS.GTBSW_OneSide_Solver.GTLeftSwitchCaseActionSubsystem.GTMemory_PreviousInput@ */ /end MEASUREMENT
/begin MEASUREMENT rtDW_ADAS.GTBSW_OneSide_Solver.GTMemory1_PreviousInput "" FLOAT64_IEEE ADAS_CM_double 0 0 -1.7E+308 1.7E+308 ECU_ADDRESS 0x0000 /* @ECU_Address@rtDW_ADAS.GTBSW_OneSide_Solver.GTMemory1_PreviousInput@ */ /end MEASUREMENT
/begin MEASUREMENT rtDW_ADAS.GTBSW_OneSide_Solver.GTMemory1_PreviousInput_b "" FLOAT64_IEEE ADAS_CM_double 0 0 -1.7E+308 1.7E+308 ECU_ADDRESS 0x0000 /* @ECU_Address@rtDW_ADAS.GTBSW_OneSide_Solver.GTMemory1_PreviousInput_b@ */ /end MEASUREMENT
/begin MEASUREMENT rtDW_ADAS.GTBSW_OneSide_Solver.GTMemory1_PreviousInput_ba "" FLOAT64_IEEE ADAS_CM_double 0 0 -1.7E+308 1.7E+308 ECU_ADDRESS 0x0000 /* @ECU_Address@rtDW_ADAS.GTBSW_OneSide_Solver.GTMemory1_PreviousInput_ba@ */ /end MEASUREMENT
/begin MEASUREMENT rtDW_ADAS.GTBSW_OneSide_Solver.GTMemory1_PreviousInput_i "" FLOAT64_IEEE ADAS_CM_double 0 0 -1.7E+308 1.7E+308 ECU_ADDRESS 0x0000 /* @ECU_Address@rtDW_ADAS.GTBSW_OneSide_Solver.GTMemory1_PreviousInput_i@ */ /end MEASUREMENT
/begin MEASUREMENT rtDW_ADAS.GTBSW_OneSide_Solver.GTMemory1_PreviousInput_it "" FLOAT64_IEEE ADAS_CM_double 0 0 -1.7E+308 1.7E+308 ECU_ADDRESS 0x0000 /* @ECU_Address@rtDW_ADAS.GTBSW_OneSide_Solver.GTMemory1_PreviousInput_it@ */ /end MEASUREMENT
/begin MEASUREMENT rtDW_ADAS.GTBSW_OneSide_Solver.GTMemory1_PreviousInput_m "" FLOAT64_IEEE ADAS_CM_double 0 0 -1.7E+308 1.7E+308 ECU_ADDRESS 0x0000 /* @ECU_Address@rtDW_ADAS.GTBSW_OneSide_Solver.GTMemory1_PreviousInput_m@ */ /end MEASUREMENT
/begin MEASUREMENT rtDW_ADAS.GTBSW_OneSide_Solver.GTMemory1_PreviousInput_n "" FLOAT64_IEEE ADAS_CM_double 0 0 -1.7E+308 1.7E+308 ECU_ADDRESS 0x0000 /* @ECU_Address@rtDW_ADAS.GTBSW_OneSide_Solver.GTMemory1_PreviousInput_n@ */ /end MEASUREMENT
/begin MEASUREMENT rtDW_ADAS.GTBSW_OneSide_Solver.GTMemory1_PreviousInput_p "" FLOAT64_IEEE ADAS_CM_double 0 0 -1.7E+308 1.7E+308 ECU_ADDRESS 0x0000 /* @ECU_Address@rtDW_ADAS.GTBSW_OneSide_Solver.GTMemory1_PreviousInput_p@ */ /end MEASUREMENT
/begin MEASUREMENT rtDW_ADAS.GTBSW_OneSide_Solver.GTMemory_PreviousInput "" FLOAT64_IEEE ADAS_CM_double 0 0 -1.7E+308 1.7E+308 ECU_ADDRESS 0x0000 /* @ECU_Address@rtDW_ADAS.GTBSW_OneSide_Solver.GTMemory_PreviousInput@ */ /end MEASUREMENT
/begin MEASUREMENT rtDW_ADAS.GTBSW_OneSide_Solver.GTMemory_PreviousInput_c "" FLOAT32_IEEE ADAS_CM_single 0 0 -3.4E+38 3.4E+38 ECU_ADDRESS 0x0000 /* @ECU_Address@rtDW_ADAS.GTBSW_OneSide_Solver.GTMemory_PreviousInput_c@ */ /end MEASUREMENT
/begin MEASUREMENT rtDW_ADAS.GTBSW_OneSide_Solver.GTMemory_PreviousInput_f "" FLOAT64_IEEE ADAS_CM_double 0 0 -1.7E+308 1.7E+308 ECU_ADDRESS 0x0000 /* @ECU_Address@rtDW_ADAS.GTBSW_OneSide_Solver.GTMemory_PreviousInput_f@ */ /end MEASUREMENT
/begin MEASUREMENT rtDW_ADAS.GTBSW_OneSide_Solver.GTMemory_PreviousInput_fo "" FLOAT32_IEEE ADAS_CM_single 0 0 -3.4E+38 3.4E+38 ECU_ADDRESS 0x0000 /* @ECU_Address@rtDW_ADAS.GTBSW_OneSide_Solver.GTMemory_PreviousInput_fo@ */ /end MEASUREMENT
/begin MEASUREMENT rtDW_ADAS.GTBSW_OneSide_Solver.GTMemory_PreviousInput_i "" FLOAT32_IEEE ADAS_CM_single 0 0 -3.4E+38 3.4E+38 ECU_ADDRESS 0x0000 /* @ECU_Address@rtDW_ADAS.GTBSW_OneSide_Solver.GTMemory_PreviousInput_i@ */ /end MEASUREMENT
/begin MEASUREMENT rtDW_ADAS.GTBSW_OneSide_Solver.GTMemory_PreviousInput_k "" FLOAT32_IEEE ADAS_CM_single 0 0 -3.4E+38 3.4E+38 ECU_ADDRESS 0x0000 /* @ECU_Address@rtDW_ADAS.GTBSW_OneSide_Solver.GTMemory_PreviousInput_k@ */ /end MEASUREMENT
/begin MEASUREMENT rtDW_ADAS.GTBSW_OneSide_Solver.GTMemory_PreviousInput_m "" FLOAT32_IEEE ADAS_CM_single 0 0 -3.4E+38 3.4E+38 ECU_ADDRESS 0x0000 /* @ECU_Address@rtDW_ADAS.GTBSW_OneSide_Solver.GTMemory_PreviousInput_m@ */ /end MEASUREMENT
/begin MEASUREMENT rtDW_ADAS.GTBSW_OneSide_Solver.GTMemory_PreviousInput_n "" FLOAT64_IEEE ADAS_CM_double 0 0 -1.7E+308 1.7E+308 ECU_ADDRESS 0x0000 /* @ECU_Address@rtDW_ADAS.GTBSW_OneSide_Solver.GTMemory_PreviousInput_n@ */ /end MEASUREMENT
/begin MEASUREMENT rtDW_ADAS.GTBSW_OneSide_Solver.GTMerge "" UBYTE ADAS_CM_logical 0 0 0 1 ECU_ADDRESS 0x0000 /* @ECU_Address@rtDW_ADAS.GTBSW_OneSide_Solver.GTMerge@ */ /end MEASUREMENT
/begin MEASUREMENT rtDW_ADAS.GTBSW_OneSide_Solver.GTMerge_b "" UBYTE ADAS_CM_logical 0 0 0 1 ECU_ADDRESS 0x0000 /* @ECU_Address@rtDW_ADAS.GTBSW_OneSide_Solver.GTMerge_b@ */ /end MEASUREMENT
/begin MEASUREMENT rtDW_ADAS.GTBSW_OneSide_Solver.GTMerge_g "" UBYTE ADAS_CM_logical 0 0 0 1 ECU_ADDRESS 0x0000 /* @ECU_Address@rtDW_ADAS.GTBSW_OneSide_Solver.GTMerge_g@ */ /end MEASUREMENT
/begin MEASUREMENT rtDW_ADAS.GTBSW_OneSide_Solver.GTMerge_h "" UBYTE ADAS_CM_logical 0 0 0 1 ECU_ADDRESS 0x0000 /* @ECU_Address@rtDW_ADAS.GTBSW_OneSide_Solver.GTMerge_h@ */ /end MEASUREMENT
/begin MEASUREMENT rtDW_ADAS.GTBSW_OneSide_Solver.GTMerge_j "" UBYTE ADAS_CM_logical 0 0 0 1 ECU_ADDRESS 0x0000 /* @ECU_Address@rtDW_ADAS.GTBSW_OneSide_Solver.GTMerge_j@ */ /end MEASUREMENT
/begin MEASUREMENT rtDW_ADAS.GTBSW_OneSide_Solver.GTMerge_k "" UBYTE ADAS_CM_logical 0 0 0 1 ECU_ADDRESS 0x0000 /* @ECU_Address@rtDW_ADAS.GTBSW_OneSide_Solver.GTMerge_k@ */ /end MEASUREMENT
/begin MEASUREMENT rtDW_ADAS.GTBSW_OneSide_Solver.GTMerge_k2 "" UBYTE ADAS_CM_logical 0 0 0 1 ECU_ADDRESS 0x0000 /* @ECU_Address@rtDW_ADAS.GTBSW_OneSide_Solver.GTMerge_k2@ */ /end MEASUREMENT
/begin MEASUREMENT rtDW_ADAS.GTBSW_OneSide_Solver.GTMerge_l "" UBYTE ADAS_CM_logical 0 0 0 1 ECU_ADDRESS 0x0000 /* @ECU_Address@rtDW_ADAS.GTBSW_OneSide_Solver.GTMerge_l@ */ /end MEASUREMENT
/begin MEASUREMENT rtDW_ADAS.GTBSW_OneSide_Solver.GTMerge_m "" UBYTE ADAS_CM_logical 0 0 0 1 ECU_ADDRESS 0x0000 /* @ECU_Address@rtDW_ADAS.GTBSW_OneSide_Solver.GTMerge_m@ */ /end MEASUREMENT
/begin MEASUREMENT rtDW_ADAS.GTBSW_OneSide_Solver.GTMerge_o "" UBYTE ADAS_CM_logical 0 0 0 1 ECU_ADDRESS 0x0000 /* @ECU_Address@rtDW_ADAS.GTBSW_OneSide_Solver.GTMerge_o@ */ /end MEASUREMENT
/begin MEASUREMENT rtDW_ADAS.GTBSW_OneSide_Solver.GTRightSwitchCaseActionSubsy_dz.GTMemory1_PreviousInput "" FLOAT64_IEEE ADAS_CM_double 0 0 -1.7E+308 1.7E+308 ECU_ADDRESS 0x0000 /* @ECU_Address@rtDW_ADAS.GTBSW_OneSide_Solver.GTRightSwitchCaseActionSubsy_dz.GTMemory1_PreviousInput@ */ /end MEASUREMENT
/begin MEASUREMENT rtDW_ADAS.GTBSW_OneSide_Solver.GTRightSwitchCaseActionSubsy_dz.GTMemory_PreviousInput "" FLOAT32_IEEE ADAS_CM_single 0 0 -3.4E+38 3.4E+38 ECU_ADDRESS 0x0000 /* @ECU_Address@rtDW_ADAS.GTBSW_OneSide_Solver.GTRightSwitchCaseActionSubsy_dz.GTMemory_PreviousInput@ */ /end MEASUREMENT
/begin MEASUREMENT rtDW_ADAS.GTBSW_OneSide_Solver.GTRightSwitchCaseActionSubsys_a.GTMemory1_PreviousInput "" FLOAT64_IEEE ADAS_CM_double 0 0 -1.7E+308 1.7E+308 ECU_ADDRESS 0x0000 /* @ECU_Address@rtDW_ADAS.GTBSW_OneSide_Solver.GTRightSwitchCaseActionSubsys_a.GTMemory1_PreviousInput@ */ /end MEASUREMENT
/begin MEASUREMENT rtDW_ADAS.GTBSW_OneSide_Solver.GTRightSwitchCaseActionSubsys_a.GTMemory_PreviousInput "" FLOAT32_IEEE ADAS_CM_single 0 0 -3.4E+38 3.4E+38 ECU_ADDRESS 0x0000 /* @ECU_Address@rtDW_ADAS.GTBSW_OneSide_Solver.GTRightSwitchCaseActionSubsys_a.GTMemory_PreviousInput@ */ /end MEASUREMENT
/begin MEASUREMENT rtDW_ADAS.GTBSW_OneSide_Solver.GTRightSwitchCaseActionSubsys_b.GTMemory1_PreviousInput "" FLOAT64_IEEE ADAS_CM_double 0 0 -1.7E+308 1.7E+308 ECU_ADDRESS 0x0000 /* @ECU_Address@rtDW_ADAS.GTBSW_OneSide_Solver.GTRightSwitchCaseActionSubsys_b.GTMemory1_PreviousInput@ */ /end MEASUREMENT
/begin MEASUREMENT rtDW_ADAS.GTBSW_OneSide_Solver.GTRightSwitchCaseActionSubsys_b.GTMemory_PreviousInput "" FLOAT32_IEEE ADAS_CM_single 0 0 -3.4E+38 3.4E+38 ECU_ADDRESS 0x0000 /* @ECU_Address@rtDW_ADAS.GTBSW_OneSide_Solver.GTRightSwitchCaseActionSubsys_b.GTMemory_PreviousInput@ */ /end MEASUREMENT
/begin MEASUREMENT rtDW_ADAS.GTBSW_OneSide_Solver.GTRightSwitchCaseActionSubsys_c.GTMemory1_PreviousInput "" FLOAT64_IEEE ADAS_CM_double 0 0 -1.7E+308 1.7E+308 ECU_ADDRESS 0x0000 /* @ECU_Address@rtDW_ADAS.GTBSW_OneSide_Solver.GTRightSwitchCaseActionSubsys_c.GTMemory1_PreviousInput@ */ /end MEASUREMENT
/begin MEASUREMENT rtDW_ADAS.GTBSW_OneSide_Solver.GTRightSwitchCaseActionSubsys_c.GTMemory_PreviousInput "" FLOAT32_IEEE ADAS_CM_single 0 0 -3.4E+38 3.4E+38 ECU_ADDRESS 0x0000 /* @ECU_Address@rtDW_ADAS.GTBSW_OneSide_Solver.GTRightSwitchCaseActionSubsys_c.GTMemory_PreviousInput@ */ /end MEASUREMENT
/begin MEASUREMENT rtDW_ADAS.GTBSW_OneSide_Solver.GTRightSwitchCaseActionSubsys_d.GTMemory1_PreviousInput "" FLOAT64_IEEE ADAS_CM_double 0 0 -1.7E+308 1.7E+308 ECU_ADDRESS 0x0000 /* @ECU_Address@rtDW_ADAS.GTBSW_OneSide_Solver.GTRightSwitchCaseActionSubsys_d.GTMemory1_PreviousInput@ */ /end MEASUREMENT
/begin MEASUREMENT rtDW_ADAS.GTBSW_OneSide_Solver.GTRightSwitchCaseActionSubsys_d.GTMemory_PreviousInput "" FLOAT32_IEEE ADAS_CM_single 0 0 -3.4E+38 3.4E+38 ECU_ADDRESS 0x0000 /* @ECU_Address@rtDW_ADAS.GTBSW_OneSide_Solver.GTRightSwitchCaseActionSubsys_d.GTMemory_PreviousInput@ */ /end MEASUREMENT
/begin MEASUREMENT rtDW_ADAS.GTBSW_OneSide_Solver.GTRightSwitchCaseActionSubsys_e.GTMemory1_PreviousInput "" FLOAT64_IEEE ADAS_CM_double 0 0 -1.7E+308 1.7E+308 ECU_ADDRESS 0x0000 /* @ECU_Address@rtDW_ADAS.GTBSW_OneSide_Solver.GTRightSwitchCaseActionSubsys_e.GTMemory1_PreviousInput@ */ /end MEASUREMENT
/begin MEASUREMENT rtDW_ADAS.GTBSW_OneSide_Solver.GTRightSwitchCaseActionSubsys_e.GTMemory_PreviousInput "" FLOAT32_IEEE ADAS_CM_single 0 0 -3.4E+38 3.4E+38 ECU_ADDRESS 0x0000 /* @ECU_Address@rtDW_ADAS.GTBSW_OneSide_Solver.GTRightSwitchCaseActionSubsys_e.GTMemory_PreviousInput@ */ /end MEASUREMENT
/begin MEASUREMENT rtDW_ADAS.GTBSW_OneSide_Solver.GTRightSwitchCaseActionSubsys_f.GTMemory1_PreviousInput "" FLOAT64_IEEE ADAS_CM_double 0 0 -1.7E+308 1.7E+308 ECU_ADDRESS 0x0000 /* @ECU_Address@rtDW_ADAS.GTBSW_OneSide_Solver.GTRightSwitchCaseActionSubsys_f.GTMemory1_PreviousInput@ */ /end MEASUREMENT
/begin MEASUREMENT rtDW_ADAS.GTBSW_OneSide_Solver.GTRightSwitchCaseActionSubsys_f.GTMemory_PreviousInput "" FLOAT32_IEEE ADAS_CM_single 0 0 -3.4E+38 3.4E+38 ECU_ADDRESS 0x0000 /* @ECU_Address@rtDW_ADAS.GTBSW_OneSide_Solver.GTRightSwitchCaseActionSubsys_f.GTMemory_PreviousInput@ */ /end MEASUREMENT
/begin MEASUREMENT rtDW_ADAS.GTBSW_OneSide_Solver.GTRightSwitchCaseActionSubsys_g.GTMemory1_PreviousInput "" FLOAT64_IEEE ADAS_CM_double 0 0 -1.7E+308 1.7E+308 ECU_ADDRESS 0x0000 /* @ECU_Address@rtDW_ADAS.GTBSW_OneSide_Solver.GTRightSwitchCaseActionSubsys_g.GTMemory1_PreviousInput@ */ /end MEASUREMENT
/begin MEASUREMENT rtDW_ADAS.GTBSW_OneSide_Solver.GTRightSwitchCaseActionSubsys_g.GTMemory_PreviousInput "" FLOAT32_IEEE ADAS_CM_single 0 0 -3.4E+38 3.4E+38 ECU_ADDRESS 0x0000 /* @ECU_Address@rtDW_ADAS.GTBSW_OneSide_Solver.GTRightSwitchCaseActionSubsys_g.GTMemory_PreviousInput@ */ /end MEASUREMENT
/begin MEASUREMENT rtDW_ADAS.GTBSW_OneSide_Solver.GTRightSwitchCaseActionSubsys_l.GTMemory1_PreviousInput "" FLOAT64_IEEE ADAS_CM_double 0 0 -1.7E+308 1.7E+308 ECU_ADDRESS 0x0000 /* @ECU_Address@rtDW_ADAS.GTBSW_OneSide_Solver.GTRightSwitchCaseActionSubsys_l.GTMemory1_PreviousInput@ */ /end MEASUREMENT
/begin MEASUREMENT rtDW_ADAS.GTBSW_OneSide_Solver.GTRightSwitchCaseActionSubsys_l.GTMemory_PreviousInput "" FLOAT32_IEEE ADAS_CM_single 0 0 -3.4E+38 3.4E+38 ECU_ADDRESS 0x0000 /* @ECU_Address@rtDW_ADAS.GTBSW_OneSide_Solver.GTRightSwitchCaseActionSubsys_l.GTMemory_PreviousInput@ */ /end MEASUREMENT
/begin MEASUREMENT rtDW_ADAS.GTBSW_OneSide_Solver.GTRightSwitchCaseActionSubsyste.GTMemory1_PreviousInput "" FLOAT64_IEEE ADAS_CM_double 0 0 -1.7E+308 1.7E+308 ECU_ADDRESS 0x0000 /* @ECU_Address@rtDW_ADAS.GTBSW_OneSide_Solver.GTRightSwitchCaseActionSubsyste.GTMemory1_PreviousInput@ */ /end MEASUREMENT
/begin MEASUREMENT rtDW_ADAS.GTBSW_OneSide_Solver.GTRightSwitchCaseActionSubsyste.GTMemory_PreviousInput "" FLOAT32_IEEE ADAS_CM_single 0 0 -3.4E+38 3.4E+38 ECU_ADDRESS 0x0000 /* @ECU_Address@rtDW_ADAS.GTBSW_OneSide_Solver.GTRightSwitchCaseActionSubsyste.GTMemory_PreviousInput@ */ /end MEASUREMENT
/begin MEASUREMENT rtDW_ADAS.GTBSW_OneSide_Solver_a.GTBSW_OneSide_Solver_MODE "" UBYTE ADAS_CM_logical 0 0 0 1 ECU_ADDRESS 0x0000 /* @ECU_Address@rtDW_ADAS.GTBSW_OneSide_Solver_a.GTBSW_OneSide_Solver_MODE@ */ /end MEASUREMENT
/begin MEASUREMENT rtDW_ADAS.GTBSW_OneSide_Solver_a.GTLeftSwitchCaseActionSubsys_m3.GTMemory1_PreviousInput "" FLOAT64_IEEE ADAS_CM_double 0 0 -1.7E+308 1.7E+308 ECU_ADDRESS 0x0000 /* @ECU_Address@rtDW_ADAS.GTBSW_OneSide_Solver_a.GTLeftSwitchCaseActionSubsys_m3.GTMemory1_PreviousInput@ */ /end MEASUREMENT
/begin MEASUREMENT rtDW_ADAS.GTBSW_OneSide_Solver_a.GTLeftSwitchCaseActionSubsys_m3.GTMemory_PreviousInput "" FLOAT32_IEEE ADAS_CM_single 0 0 -3.4E+38 3.4E+38 ECU_ADDRESS 0x0000 /* @ECU_Address@rtDW_ADAS.GTBSW_OneSide_Solver_a.GTLeftSwitchCaseActionSubsys_m3.GTMemory_PreviousInput@ */ /end MEASUREMENT
/begin MEASUREMENT rtDW_ADAS.GTBSW_OneSide_Solver_a.GTLeftSwitchCaseActionSubsys_mf.GTMemory1_PreviousInput "" FLOAT64_IEEE ADAS_CM_double 0 0 -1.7E+308 1.7E+308 ECU_ADDRESS 0x0000 /* @ECU_Address@rtDW_ADAS.GTBSW_OneSide_Solver_a.GTLeftSwitchCaseActionSubsys_mf.GTMemory1_PreviousInput@ */ /end MEASUREMENT
/begin MEASUREMENT rtDW_ADAS.GTBSW_OneSide_Solver_a.GTLeftSwitchCaseActionSubsys_mf.GTMemory_PreviousInput "" FLOAT32_IEEE ADAS_CM_single 0 0 -3.4E+38 3.4E+38 ECU_ADDRESS 0x0000 /* @ECU_Address@rtDW_ADAS.GTBSW_OneSide_Solver_a.GTLeftSwitchCaseActionSubsys_mf.GTMemory_PreviousInput@ */ /end MEASUREMENT
/begin MEASUREMENT rtDW_ADAS.GTBSW_OneSide_Solver_a.GTLeftSwitchCaseActionSubsyst_a.GTMemory1_PreviousInput "" FLOAT64_IEEE ADAS_CM_double 0 0 -1.7E+308 1.7E+308 ECU_ADDRESS 0x0000 /* @ECU_Address@rtDW_ADAS.GTBSW_OneSide_Solver_a.GTLeftSwitchCaseActionSubsyst_a.GTMemory1_PreviousInput@ */ /end MEASUREMENT
/begin MEASUREMENT rtDW_ADAS.GTBSW_OneSide_Solver_a.GTLeftSwitchCaseActionSubsyst_a.GTMemory_PreviousInput "" FLOAT32_IEEE ADAS_CM_single 0 0 -3.4E+38 3.4E+38 ECU_ADDRESS 0x0000 /* @ECU_Address@rtDW_ADAS.GTBSW_OneSide_Solver_a.GTLeftSwitchCaseActionSubsyst_a.GTMemory_PreviousInput@ */ /end MEASUREMENT
/begin MEASUREMENT rtDW_ADAS.GTBSW_OneSide_Solver_a.GTLeftSwitchCaseActionSubsyst_e.GTMemory1_PreviousInput "" FLOAT64_IEEE ADAS_CM_double 0 0 -1.7E+308 1.7E+308 ECU_ADDRESS 0x0000 /* @ECU_Address@rtDW_ADAS.GTBSW_OneSide_Solver_a.GTLeftSwitchCaseActionSubsyst_e.GTMemory1_PreviousInput@ */ /end MEASUREMENT
/begin MEASUREMENT rtDW_ADAS.GTBSW_OneSide_Solver_a.GTLeftSwitchCaseActionSubsyst_e.GTMemory_PreviousInput "" FLOAT32_IEEE ADAS_CM_single 0 0 -3.4E+38 3.4E+38 ECU_ADDRESS 0x0000 /* @ECU_Address@rtDW_ADAS.GTBSW_OneSide_Solver_a.GTLeftSwitchCaseActionSubsyst_e.GTMemory_PreviousInput@ */ /end MEASUREMENT
/begin MEASUREMENT rtDW_ADAS.GTBSW_OneSide_Solver_a.GTLeftSwitchCaseActionSubsyst_h.GTMemory1_PreviousInput "" FLOAT64_IEEE ADAS_CM_double 0 0 -1.7E+308 1.7E+308 ECU_ADDRESS 0x0000 /* @ECU_Address@rtDW_ADAS.GTBSW_OneSide_Solver_a.GTLeftSwitchCaseActionSubsyst_h.GTMemory1_PreviousInput@ */ /end MEASUREMENT
/begin MEASUREMENT rtDW_ADAS.GTBSW_OneSide_Solver_a.GTLeftSwitchCaseActionSubsyst_h.GTMemory_PreviousInput "" FLOAT32_IEEE ADAS_CM_single 0 0 -3.4E+38 3.4E+38 ECU_ADDRESS 0x0000 /* @ECU_Address@rtDW_ADAS.GTBSW_OneSide_Solver_a.GTLeftSwitchCaseActionSubsyst_h.GTMemory_PreviousInput@ */ /end MEASUREMENT
/begin MEASUREMENT rtDW_ADAS.GTBSW_OneSide_Solver_a.GTLeftSwitchCaseActionSubsyst_i.GTMemory1_PreviousInput "" FLOAT64_IEEE ADAS_CM_double 0 0 -1.7E+308 1.7E+308 ECU_ADDRESS 0x0000 /* @ECU_Address@rtDW_ADAS.GTBSW_OneSide_Solver_a.GTLeftSwitchCaseActionSubsyst_i.GTMemory1_PreviousInput@ */ /end MEASUREMENT
/begin MEASUREMENT rtDW_ADAS.GTBSW_OneSide_Solver_a.GTLeftSwitchCaseActionSubsyst_i.GTMemory_PreviousInput "" FLOAT32_IEEE ADAS_CM_single 0 0 -3.4E+38 3.4E+38 ECU_ADDRESS 0x0000 /* @ECU_Address@rtDW_ADAS.GTBSW_OneSide_Solver_a.GTLeftSwitchCaseActionSubsyst_i.GTMemory_PreviousInput@ */ /end MEASUREMENT
/begin MEASUREMENT rtDW_ADAS.GTBSW_OneSide_Solver_a.GTLeftSwitchCaseActionSubsyst_l.GTMemory1_PreviousInput "" FLOAT64_IEEE ADAS_CM_double 0 0 -1.7E+308 1.7E+308 ECU_ADDRESS 0x0000 /* @ECU_Address@rtDW_ADAS.GTBSW_OneSide_Solver_a.GTLeftSwitchCaseActionSubsyst_l.GTMemory1_PreviousInput@ */ /end MEASUREMENT
/begin MEASUREMENT rtDW_ADAS.GTBSW_OneSide_Solver_a.GTLeftSwitchCaseActionSubsyst_l.GTMemory_PreviousInput "" FLOAT32_IEEE ADAS_CM_single 0 0 -3.4E+38 3.4E+38 ECU_ADDRESS 0x0000 /* @ECU_Address@rtDW_ADAS.GTBSW_OneSide_Solver_a.GTLeftSwitchCaseActionSubsyst_l.GTMemory_PreviousInput@ */ /end MEASUREMENT
/begin MEASUREMENT rtDW_ADAS.GTBSW_OneSide_Solver_a.GTLeftSwitchCaseActionSubsyst_m.GTMemory1_PreviousInput "" FLOAT64_IEEE ADAS_CM_double 0 0 -1.7E+308 1.7E+308 ECU_ADDRESS 0x0000 /* @ECU_Address@rtDW_ADAS.GTBSW_OneSide_Solver_a.GTLeftSwitchCaseActionSubsyst_m.GTMemory1_PreviousInput@ */ /end MEASUREMENT
/begin MEASUREMENT rtDW_ADAS.GTBSW_OneSide_Solver_a.GTLeftSwitchCaseActionSubsyst_m.GTMemory_PreviousInput "" FLOAT32_IEEE ADAS_CM_single 0 0 -3.4E+38 3.4E+38 ECU_ADDRESS 0x0000 /* @ECU_Address@rtDW_ADAS.GTBSW_OneSide_Solver_a.GTLeftSwitchCaseActionSubsyst_m.GTMemory_PreviousInput@ */ /end MEASUREMENT
/begin MEASUREMENT rtDW_ADAS.GTBSW_OneSide_Solver_a.GTLeftSwitchCaseActionSubsyst_p.GTMemory1_PreviousInput "" FLOAT64_IEEE ADAS_CM_double 0 0 -1.7E+308 1.7E+308 ECU_ADDRESS 0x0000 /* @ECU_Address@rtDW_ADAS.GTBSW_OneSide_Solver_a.GTLeftSwitchCaseActionSubsyst_p.GTMemory1_PreviousInput@ */ /end MEASUREMENT
/begin MEASUREMENT rtDW_ADAS.GTBSW_OneSide_Solver_a.GTLeftSwitchCaseActionSubsyst_p.GTMemory_PreviousInput "" FLOAT32_IEEE ADAS_CM_single 0 0 -3.4E+38 3.4E+38 ECU_ADDRESS 0x0000 /* @ECU_Address@rtDW_ADAS.GTBSW_OneSide_Solver_a.GTLeftSwitchCaseActionSubsyst_p.GTMemory_PreviousInput@ */ /end MEASUREMENT
/begin MEASUREMENT rtDW_ADAS.GTBSW_OneSide_Solver_a.GTLeftSwitchCaseActionSubsystem.GTMemory1_PreviousInput "" FLOAT64_IEEE ADAS_CM_double 0 0 -1.7E+308 1.7E+308 ECU_ADDRESS 0x0000 /* @ECU_Address@rtDW_ADAS.GTBSW_OneSide_Solver_a.GTLeftSwitchCaseActionSubsystem.GTMemory1_PreviousInput@ */ /end MEASUREMENT
/begin MEASUREMENT rtDW_ADAS.GTBSW_OneSide_Solver_a.GTLeftSwitchCaseActionSubsystem.GTMemory_PreviousInput "" FLOAT32_IEEE ADAS_CM_single 0 0 -3.4E+38 3.4E+38 ECU_ADDRESS 0x0000 /* @ECU_Address@rtDW_ADAS.GTBSW_OneSide_Solver_a.GTLeftSwitchCaseActionSubsystem.GTMemory_PreviousInput@ */ /end MEASUREMENT
/begin MEASUREMENT rtDW_ADAS.GTBSW_OneSide_Solver_a.GTMemory1_PreviousInput "" FLOAT64_IEEE ADAS_CM_double 0 0 -1.7E+308 1.7E+308 ECU_ADDRESS 0x0000 /* @ECU_Address@rtDW_ADAS.GTBSW_OneSide_Solver_a.GTMemory1_PreviousInput@ */ /end MEASUREMENT
/begin MEASUREMENT rtDW_ADAS.GTBSW_OneSide_Solver_a.GTMemory1_PreviousInput_b "" FLOAT64_IEEE ADAS_CM_double 0 0 -1.7E+308 1.7E+308 ECU_ADDRESS 0x0000 /* @ECU_Address@rtDW_ADAS.GTBSW_OneSide_Solver_a.GTMemory1_PreviousInput_b@ */ /end MEASUREMENT
/begin MEASUREMENT rtDW_ADAS.GTBSW_OneSide_Solver_a.GTMemory1_PreviousInput_ba "" FLOAT64_IEEE ADAS_CM_double 0 0 -1.7E+308 1.7E+308 ECU_ADDRESS 0x0000 /* @ECU_Address@rtDW_ADAS.GTBSW_OneSide_Solver_a.GTMemory1_PreviousInput_ba@ */ /end MEASUREMENT
/begin MEASUREMENT rtDW_ADAS.GTBSW_OneSide_Solver_a.GTMemory1_PreviousInput_i "" FLOAT64_IEEE ADAS_CM_double 0 0 -1.7E+308 1.7E+308 ECU_ADDRESS 0x0000 /* @ECU_Address@rtDW_ADAS.GTBSW_OneSide_Solver_a.GTMemory1_PreviousInput_i@ */ /end MEASUREMENT
/begin MEASUREMENT rtDW_ADAS.GTBSW_OneSide_Solver_a.GTMemory1_PreviousInput_it "" FLOAT64_IEEE ADAS_CM_double 0 0 -1.7E+308 1.7E+308 ECU_ADDRESS 0x0000 /* @ECU_Address@rtDW_ADAS.GTBSW_OneSide_Solver_a.GTMemory1_PreviousInput_it@ */ /end MEASUREMENT
/begin MEASUREMENT rtDW_ADAS.GTBSW_OneSide_Solver_a.GTMemory1_PreviousInput_m "" FLOAT64_IEEE ADAS_CM_double 0 0 -1.7E+308 1.7E+308 ECU_ADDRESS 0x0000 /* @ECU_Address@rtDW_ADAS.GTBSW_OneSide_Solver_a.GTMemory1_PreviousInput_m@ */ /end MEASUREMENT
/begin MEASUREMENT rtDW_ADAS.GTBSW_OneSide_Solver_a.GTMemory1_PreviousInput_n "" FLOAT64_IEEE ADAS_CM_double 0 0 -1.7E+308 1.7E+308 ECU_ADDRESS 0x0000 /* @ECU_Address@rtDW_ADAS.GTBSW_OneSide_Solver_a.GTMemory1_PreviousInput_n@ */ /end MEASUREMENT
/begin MEASUREMENT rtDW_ADAS.GTBSW_OneSide_Solver_a.GTMemory1_PreviousInput_p "" FLOAT64_IEEE ADAS_CM_double 0 0 -1.7E+308 1.7E+308 ECU_ADDRESS 0x0000 /* @ECU_Address@rtDW_ADAS.GTBSW_OneSide_Solver_a.GTMemory1_PreviousInput_p@ */ /end MEASUREMENT
/begin MEASUREMENT rtDW_ADAS.GTBSW_OneSide_Solver_a.GTMemory_PreviousInput "" FLOAT64_IEEE ADAS_CM_double 0 0 -1.7E+308 1.7E+308 ECU_ADDRESS 0x0000 /* @ECU_Address@rtDW_ADAS.GTBSW_OneSide_Solver_a.GTMemory_PreviousInput@ */ /end MEASUREMENT
/begin MEASUREMENT rtDW_ADAS.GTBSW_OneSide_Solver_a.GTMemory_PreviousInput_c "" FLOAT32_IEEE ADAS_CM_single 0 0 -3.4E+38 3.4E+38 ECU_ADDRESS 0x0000 /* @ECU_Address@rtDW_ADAS.GTBSW_OneSide_Solver_a.GTMemory_PreviousInput_c@ */ /end MEASUREMENT
/begin MEASUREMENT rtDW_ADAS.GTBSW_OneSide_Solver_a.GTMemory_PreviousInput_f "" FLOAT64_IEEE ADAS_CM_double 0 0 -1.7E+308 1.7E+308 ECU_ADDRESS 0x0000 /* @ECU_Address@rtDW_ADAS.GTBSW_OneSide_Solver_a.GTMemory_PreviousInput_f@ */ /end MEASUREMENT
/begin MEASUREMENT rtDW_ADAS.GTBSW_OneSide_Solver_a.GTMemory_PreviousInput_fo "" FLOAT32_IEEE ADAS_CM_single 0 0 -3.4E+38 3.4E+38 ECU_ADDRESS 0x0000 /* @ECU_Address@rtDW_ADAS.GTBSW_OneSide_Solver_a.GTMemory_PreviousInput_fo@ */ /end MEASUREMENT
/begin MEASUREMENT rtDW_ADAS.GTBSW_OneSide_Solver_a.GTMemory_PreviousInput_i "" FLOAT32_IEEE ADAS_CM_single 0 0 -3.4E+38 3.4E+38 ECU_ADDRESS 0x0000 /* @ECU_Address@rtDW_ADAS.GTBSW_OneSide_Solver_a.GTMemory_PreviousInput_i@ */ /end MEASUREMENT
/begin MEASUREMENT rtDW_ADAS.GTBSW_OneSide_Solver_a.GTMemory_PreviousInput_k "" FLOAT32_IEEE ADAS_CM_single 0 0 -3.4E+38 3.4E+38 ECU_ADDRESS 0x0000 /* @ECU_Address@rtDW_ADAS.GTBSW_OneSide_Solver_a.GTMemory_PreviousInput_k@ */ /end MEASUREMENT
/begin MEASUREMENT rtDW_ADAS.GTBSW_OneSide_Solver_a.GTMemory_PreviousInput_m "" FLOAT32_IEEE ADAS_CM_single 0 0 -3.4E+38 3.4E+38 ECU_ADDRESS 0x0000 /* @ECU_Address@rtDW_ADAS.GTBSW_OneSide_Solver_a.GTMemory_PreviousInput_m@ */ /end MEASUREMENT
/begin MEASUREMENT rtDW_ADAS.GTBSW_OneSide_Solver_a.GTMemory_PreviousInput_n "" FLOAT64_IEEE ADAS_CM_double 0 0 -1.7E+308 1.7E+308 ECU_ADDRESS 0x0000 /* @ECU_Address@rtDW_ADAS.GTBSW_OneSide_Solver_a.GTMemory_PreviousInput_n@ */ /end MEASUREMENT
/begin MEASUREMENT rtDW_ADAS.GTBSW_OneSide_Solver_a.GTMerge "" UBYTE ADAS_CM_logical 0 0 0 1 ECU_ADDRESS 0x0000 /* @ECU_Address@rtDW_ADAS.GTBSW_OneSide_Solver_a.GTMerge@ */ /end MEASUREMENT
/begin MEASUREMENT rtDW_ADAS.GTBSW_OneSide_Solver_a.GTMerge_b "" UBYTE ADAS_CM_logical 0 0 0 1 ECU_ADDRESS 0x0000 /* @ECU_Address@rtDW_ADAS.GTBSW_OneSide_Solver_a.GTMerge_b@ */ /end MEASUREMENT
/begin MEASUREMENT rtDW_ADAS.GTBSW_OneSide_Solver_a.GTMerge_g "" UBYTE ADAS_CM_logical 0 0 0 1 ECU_ADDRESS 0x0000 /* @ECU_Address@rtDW_ADAS.GTBSW_OneSide_Solver_a.GTMerge_g@ */ /end MEASUREMENT
/begin MEASUREMENT rtDW_ADAS.GTBSW_OneSide_Solver_a.GTMerge_h "" UBYTE ADAS_CM_logical 0 0 0 1 ECU_ADDRESS 0x0000 /* @ECU_Address@rtDW_ADAS.GTBSW_OneSide_Solver_a.GTMerge_h@ */ /end MEASUREMENT
/begin MEASUREMENT rtDW_ADAS.GTBSW_OneSide_Solver_a.GTMerge_j "" UBYTE ADAS_CM_logical 0 0 0 1 ECU_ADDRESS 0x0000 /* @ECU_Address@rtDW_ADAS.GTBSW_OneSide_Solver_a.GTMerge_j@ */ /end MEASUREMENT
/begin MEASUREMENT rtDW_ADAS.GTBSW_OneSide_Solver_a.GTMerge_k "" UBYTE ADAS_CM_logical 0 0 0 1 ECU_ADDRESS 0x0000 /* @ECU_Address@rtDW_ADAS.GTBSW_OneSide_Solver_a.GTMerge_k@ */ /end MEASUREMENT
/begin MEASUREMENT rtDW_ADAS.GTBSW_OneSide_Solver_a.GTMerge_k2 "" UBYTE ADAS_CM_logical 0 0 0 1 ECU_ADDRESS 0x0000 /* @ECU_Address@rtDW_ADAS.GTBSW_OneSide_Solver_a.GTMerge_k2@ */ /end MEASUREMENT
/begin MEASUREMENT rtDW_ADAS.GTBSW_OneSide_Solver_a.GTMerge_l "" UBYTE ADAS_CM_logical 0 0 0 1 ECU_ADDRESS 0x0000 /* @ECU_Address@rtDW_ADAS.GTBSW_OneSide_Solver_a.GTMerge_l@ */ /end MEASUREMENT
/begin MEASUREMENT rtDW_ADAS.GTBSW_OneSide_Solver_a.GTMerge_m "" UBYTE ADAS_CM_logical 0 0 0 1 ECU_ADDRESS 0x0000 /* @ECU_Address@rtDW_ADAS.GTBSW_OneSide_Solver_a.GTMerge_m@ */ /end MEASUREMENT
/begin MEASUREMENT rtDW_ADAS.GTBSW_OneSide_Solver_a.GTMerge_o "" UBYTE ADAS_CM_logical 0 0 0 1 ECU_ADDRESS 0x0000 /* @ECU_Address@rtDW_ADAS.GTBSW_OneSide_Solver_a.GTMerge_o@ */ /end MEASUREMENT
/begin MEASUREMENT rtDW_ADAS.GTBSW_OneSide_Solver_a.GTRightSwitchCaseActionSubsy_dz.GTMemory1_PreviousInput "" FLOAT64_IEEE ADAS_CM_double 0 0 -1.7E+308 1.7E+308 ECU_ADDRESS 0x0000 /* @ECU_Address@rtDW_ADAS.GTBSW_OneSide_Solver_a.GTRightSwitchCaseActionSubsy_dz.GTMemory1_PreviousInput@ */ /end MEASUREMENT
/begin MEASUREMENT rtDW_ADAS.GTBSW_OneSide_Solver_a.GTRightSwitchCaseActionSubsy_dz.GTMemory_PreviousInput "" FLOAT32_IEEE ADAS_CM_single 0 0 -3.4E+38 3.4E+38 ECU_ADDRESS 0x0000 /* @ECU_Address@rtDW_ADAS.GTBSW_OneSide_Solver_a.GTRightSwitchCaseActionSubsy_dz.GTMemory_PreviousInput@ */ /end MEASUREMENT
/begin MEASUREMENT rtDW_ADAS.GTBSW_OneSide_Solver_a.GTRightSwitchCaseActionSubsys_a.GTMemory1_PreviousInput "" FLOAT64_IEEE ADAS_CM_double 0 0 -1.7E+308 1.7E+308 ECU_ADDRESS 0x0000 /* @ECU_Address@rtDW_ADAS.GTBSW_OneSide_Solver_a.GTRightSwitchCaseActionSubsys_a.GTMemory1_PreviousInput@ */ /end MEASUREMENT
/begin MEASUREMENT rtDW_ADAS.GTBSW_OneSide_Solver_a.GTRightSwitchCaseActionSubsys_a.GTMemory_PreviousInput "" FLOAT32_IEEE ADAS_CM_single 0 0 -3.4E+38 3.4E+38 ECU_ADDRESS 0x0000 /* @ECU_Address@rtDW_ADAS.GTBSW_OneSide_Solver_a.GTRightSwitchCaseActionSubsys_a.GTMemory_PreviousInput@ */ /end MEASUREMENT
/begin MEASUREMENT rtDW_ADAS.GTBSW_OneSide_Solver_a.GTRightSwitchCaseActionSubsys_b.GTMemory1_PreviousInput "" FLOAT64_IEEE ADAS_CM_double 0 0 -1.7E+308 1.7E+308 ECU_ADDRESS 0x0000 /* @ECU_Address@rtDW_ADAS.GTBSW_OneSide_Solver_a.GTRightSwitchCaseActionSubsys_b.GTMemory1_PreviousInput@ */ /end MEASUREMENT
/begin MEASUREMENT rtDW_ADAS.GTBSW_OneSide_Solver_a.GTRightSwitchCaseActionSubsys_b.GTMemory_PreviousInput "" FLOAT32_IEEE ADAS_CM_single 0 0 -3.4E+38 3.4E+38 ECU_ADDRESS 0x0000 /* @ECU_Address@rtDW_ADAS.GTBSW_OneSide_Solver_a.GTRightSwitchCaseActionSubsys_b.GTMemory_PreviousInput@ */ /end MEASUREMENT
/begin MEASUREMENT rtDW_ADAS.GTBSW_OneSide_Solver_a.GTRightSwitchCaseActionSubsys_c.GTMemory1_PreviousInput "" FLOAT64_IEEE ADAS_CM_double 0 0 -1.7E+308 1.7E+308 ECU_ADDRESS 0x0000 /* @ECU_Address@rtDW_ADAS.GTBSW_OneSide_Solver_a.GTRightSwitchCaseActionSubsys_c.GTMemory1_PreviousInput@ */ /end MEASUREMENT
/begin MEASUREMENT rtDW_ADAS.GTBSW_OneSide_Solver_a.GTRightSwitchCaseActionSubsys_c.GTMemory_PreviousInput "" FLOAT32_IEEE ADAS_CM_single 0 0 -3.4E+38 3.4E+38 ECU_ADDRESS 0x0000 /* @ECU_Address@rtDW_ADAS.GTBSW_OneSide_Solver_a.GTRightSwitchCaseActionSubsys_c.GTMemory_PreviousInput@ */ /end MEASUREMENT
/begin MEASUREMENT rtDW_ADAS.GTBSW_OneSide_Solver_a.GTRightSwitchCaseActionSubsys_d.GTMemory1_PreviousInput "" FLOAT64_IEEE ADAS_CM_double 0 0 -1.7E+308 1.7E+308 ECU_ADDRESS 0x0000 /* @ECU_Address@rtDW_ADAS.GTBSW_OneSide_Solver_a.GTRightSwitchCaseActionSubsys_d.GTMemory1_PreviousInput@ */ /end MEASUREMENT
/begin MEASUREMENT rtDW_ADAS.GTBSW_OneSide_Solver_a.GTRightSwitchCaseActionSubsys_d.GTMemory_PreviousInput "" FLOAT32_IEEE ADAS_CM_single 0 0 -3.4E+38 3.4E+38 ECU_ADDRESS 0x0000 /* @ECU_Address@rtDW_ADAS.GTBSW_OneSide_Solver_a.GTRightSwitchCaseActionSubsys_d.GTMemory_PreviousInput@ */ /end MEASUREMENT
/begin MEASUREMENT rtDW_ADAS.GTBSW_OneSide_Solver_a.GTRightSwitchCaseActionSubsys_e.GTMemory1_PreviousInput "" FLOAT64_IEEE ADAS_CM_double 0 0 -1.7E+308 1.7E+308 ECU_ADDRESS 0x0000 /* @ECU_Address@rtDW_ADAS.GTBSW_OneSide_Solver_a.GTRightSwitchCaseActionSubsys_e.GTMemory1_PreviousInput@ */ /end MEASUREMENT
/begin MEASUREMENT rtDW_ADAS.GTBSW_OneSide_Solver_a.GTRightSwitchCaseActionSubsys_e.GTMemory_PreviousInput "" FLOAT32_IEEE ADAS_CM_single 0 0 -3.4E+38 3.4E+38 ECU_ADDRESS 0x0000 /* @ECU_Address@rtDW_ADAS.GTBSW_OneSide_Solver_a.GTRightSwitchCaseActionSubsys_e.GTMemory_PreviousInput@ */ /end MEASUREMENT
/begin MEASUREMENT rtDW_ADAS.GTBSW_OneSide_Solver_a.GTRightSwitchCaseActionSubsys_f.GTMemory1_PreviousInput "" FLOAT64_IEEE ADAS_CM_double 0 0 -1.7E+308 1.7E+308 ECU_ADDRESS 0x0000 /* @ECU_Address@rtDW_ADAS.GTBSW_OneSide_Solver_a.GTRightSwitchCaseActionSubsys_f.GTMemory1_PreviousInput@ */ /end MEASUREMENT
/begin MEASUREMENT rtDW_ADAS.GTBSW_OneSide_Solver_a.GTRightSwitchCaseActionSubsys_f.GTMemory_PreviousInput "" FLOAT32_IEEE ADAS_CM_single 0 0 -3.4E+38 3.4E+38 ECU_ADDRESS 0x0000 /* @ECU_Address@rtDW_ADAS.GTBSW_OneSide_Solver_a.GTRightSwitchCaseActionSubsys_f.GTMemory_PreviousInput@ */ /end MEASUREMENT
/begin MEASUREMENT rtDW_ADAS.GTBSW_OneSide_Solver_a.GTRightSwitchCaseActionSubsys_g.GTMemory1_PreviousInput "" FLOAT64_IEEE ADAS_CM_double 0 0 -1.7E+308 1.7E+308 ECU_ADDRESS 0x0000 /* @ECU_Address@rtDW_ADAS.GTBSW_OneSide_Solver_a.GTRightSwitchCaseActionSubsys_g.GTMemory1_PreviousInput@ */ /end MEASUREMENT
/begin MEASUREMENT rtDW_ADAS.GTBSW_OneSide_Solver_a.GTRightSwitchCaseActionSubsys_g.GTMemory_PreviousInput "" FLOAT32_IEEE ADAS_CM_single 0 0 -3.4E+38 3.4E+38 ECU_ADDRESS 0x0000 /* @ECU_Address@rtDW_ADAS.GTBSW_OneSide_Solver_a.GTRightSwitchCaseActionSubsys_g.GTMemory_PreviousInput@ */ /end MEASUREMENT
/begin MEASUREMENT rtDW_ADAS.GTBSW_OneSide_Solver_a.GTRightSwitchCaseActionSubsys_l.GTMemory1_PreviousInput "" FLOAT64_IEEE ADAS_CM_double 0 0 -1.7E+308 1.7E+308 ECU_ADDRESS 0x0000 /* @ECU_Address@rtDW_ADAS.GTBSW_OneSide_Solver_a.GTRightSwitchCaseActionSubsys_l.GTMemory1_PreviousInput@ */ /end MEASUREMENT
/begin MEASUREMENT rtDW_ADAS.GTBSW_OneSide_Solver_a.GTRightSwitchCaseActionSubsys_l.GTMemory_PreviousInput "" FLOAT32_IEEE ADAS_CM_single 0 0 -3.4E+38 3.4E+38 ECU_ADDRESS 0x0000 /* @ECU_Address@rtDW_ADAS.GTBSW_OneSide_Solver_a.GTRightSwitchCaseActionSubsys_l.GTMemory_PreviousInput@ */ /end MEASUREMENT
/begin MEASUREMENT rtDW_ADAS.GTBSW_OneSide_Solver_a.GTRightSwitchCaseActionSubsyste.GTMemory1_PreviousInput "" FLOAT64_IEEE ADAS_CM_double 0 0 -1.7E+308 1.7E+308 ECU_ADDRESS 0x0000 /* @ECU_Address@rtDW_ADAS.GTBSW_OneSide_Solver_a.GTRightSwitchCaseActionSubsyste.GTMemory1_PreviousInput@ */ /end MEASUREMENT
/begin MEASUREMENT rtDW_ADAS.GTBSW_OneSide_Solver_a.GTRightSwitchCaseActionSubsyste.GTMemory_PreviousInput "" FLOAT32_IEEE ADAS_CM_single 0 0 -3.4E+38 3.4E+38 ECU_ADDRESS 0x0000 /* @ECU_Address@rtDW_ADAS.GTBSW_OneSide_Solver_a.GTRightSwitchCaseActionSubsyste.GTMemory_PreviousInput@ */ /end MEASUREMENT
/begin MEASUREMENT rtDW_ADAS.GTByeSts "" UBYTE ADAS_CM_uint8 0 0 0 255 ECU_ADDRESS 0x0000 /* @ECU_Address@rtDW_ADAS.GTByeSts@ */ /end MEASUREMENT
/begin MEASUREMENT rtDW_ADAS.GTByeSts_a "" UBYTE ADAS_CM_uint8 0 0 0 255 ECU_ADDRESS 0x0000 /* @ECU_Address@rtDW_ADAS.GTByeSts_a@ */ /end MEASUREMENT
/begin MEASUREMENT rtDW_ADAS.GTByeSts_g "" UBYTE ADAS_CM_uint8 0 0 0 255 ECU_ADDRESS 0x0000 /* @ECU_Address@rtDW_ADAS.GTByeSts_g@ */ /end MEASUREMENT
/begin MEASUREMENT rtDW_ADAS.GTByeSts_gx "" UBYTE ADAS_CM_uint8 0 0 0 255 ECU_ADDRESS 0x0000 /* @ECU_Address@rtDW_ADAS.GTByeSts_gx@ */ /end MEASUREMENT
/begin MEASUREMENT rtDW_ADAS.GTByeSts_gx0 "" UBYTE ADAS_CM_uint8 0 0 0 255 ECU_ADDRESS 0x0000 /* @ECU_Address@rtDW_ADAS.GTByeSts_gx0@ */ /end MEASUREMENT
/begin MEASUREMENT rtDW_ADAS.GTByetype_MODE "" UBYTE ADAS_CM_logical 0 0 0 1 ECU_ADDRESS 0x0000 /* @ECU_Address@rtDW_ADAS.GTByetype_MODE@ */ /end MEASUREMENT
/begin MEASUREMENT rtDW_ADAS.GTByetypefromcentertoedge_MODE "" UBYTE ADAS_CM_logical 0 0 0 1 ECU_ADDRESS 0x0000 /* @ECU_Address@rtDW_ADAS.GTByetypefromcentertoedge_MODE@ */ /end MEASUREMENT
/begin MEASUREMENT rtDW_ADAS.GTByetypefromedgetocenter_MODE "" UBYTE ADAS_CM_logical 0 0 0 1 ECU_ADDRESS 0x0000 /* @ECU_Address@rtDW_ADAS.GTByetypefromedgetocenter_MODE@ */ /end MEASUREMENT
/begin MEASUREMENT rtDW_ADAS.GTCORRECTION.GTCORRECTION_MODE "" UBYTE ADAS_CM_logical 0 0 0 1 ECU_ADDRESS 0x0000 /* @ECU_Address@rtDW_ADAS.GTCORRECTION.GTCORRECTION_MODE@ */ /end MEASUREMENT
/begin MEASUREMENT rtDW_ADAS.GTCORRECTION.GTCorrection "" FLOAT32_IEEE ADAS_CM_single 0 0 -3.4E+38 3.4E+38 ECU_ADDRESS 0x0000 /* @ECU_Address@rtDW_ADAS.GTCORRECTION.GTCorrection@ */ /end MEASUREMENT
/begin MEASUREMENT rtDW_ADAS.GTCORRECTION.GTPrevY "" FLOAT32_IEEE ADAS_CM_single 0 0 -3.4E+38 3.4E+38 ECU_ADDRESS 0x0000 /* @ECU_Address@rtDW_ADAS.GTCORRECTION.GTPrevY@ */ /end MEASUREMENT
/begin MEASUREMENT rtDW_ADAS.GTCORRECTION.GTis_NO_CORRECTION "" UBYTE ADAS_CM_uint8 0 0 0 255 ECU_ADDRESS 0x0000 /* @ECU_Address@rtDW_ADAS.GTCORRECTION.GTis_NO_CORRECTION@ */ /end MEASUREMENT
/begin MEASUREMENT rtDW_ADAS.GTCORRECTION.GTis_active_c271_ADAS "" UBYTE ADAS_CM_uint8 0 0 0 255 ECU_ADDRESS 0x0000 /* @ECU_Address@rtDW_ADAS.GTCORRECTION.GTis_active_c271_ADAS@ */ /end MEASUREMENT
/begin MEASUREMENT rtDW_ADAS.GTCORRECTION.GTis_c271_ADAS "" UBYTE ADAS_CM_uint8 0 0 0 255 ECU_ADDRESS 0x0000 /* @ECU_Address@rtDW_ADAS.GTCORRECTION.GTis_c271_ADAS@ */ /end MEASUREMENT
/begin MEASUREMENT rtDW_ADAS.GTCORRECTION.GTtemporalCounter_i1 "" ULONG ADAS_CM_uint32 0 0 0 4294967295 ECU_ADDRESS 0x0000 /* @ECU_Address@rtDW_ADAS.GTCORRECTION.GTtemporalCounter_i1@ */ /end MEASUREMENT
/begin MEASUREMENT rtDW_ADAS.GTCORRECTION_b.GTCORRECTION_MODE "" UBYTE ADAS_CM_logical 0 0 0 1 ECU_ADDRESS 0x0000 /* @ECU_Address@rtDW_ADAS.GTCORRECTION_b.GTCORRECTION_MODE@ */ /end MEASUREMENT
/begin MEASUREMENT rtDW_ADAS.GTCORRECTION_b.GTCorrection "" FLOAT32_IEEE ADAS_CM_single 0 0 -3.4E+38 3.4E+38 ECU_ADDRESS 0x0000 /* @ECU_Address@rtDW_ADAS.GTCORRECTION_b.GTCorrection@ */ /end MEASUREMENT
/begin MEASUREMENT rtDW_ADAS.GTCORRECTION_b.GTPrevY "" FLOAT32_IEEE ADAS_CM_single 0 0 -3.4E+38 3.4E+38 ECU_ADDRESS 0x0000 /* @ECU_Address@rtDW_ADAS.GTCORRECTION_b.GTPrevY@ */ /end MEASUREMENT
/begin MEASUREMENT rtDW_ADAS.GTCORRECTION_b.GTis_NO_CORRECTION "" UBYTE ADAS_CM_uint8 0 0 0 255 ECU_ADDRESS 0x0000 /* @ECU_Address@rtDW_ADAS.GTCORRECTION_b.GTis_NO_CORRECTION@ */ /end MEASUREMENT
/begin MEASUREMENT rtDW_ADAS.GTCORRECTION_b.GTis_active_c271_ADAS "" UBYTE ADAS_CM_uint8 0 0 0 255 ECU_ADDRESS 0x0000 /* @ECU_Address@rtDW_ADAS.GTCORRECTION_b.GTis_active_c271_ADAS@ */ /end MEASUREMENT
/begin MEASUREMENT rtDW_ADAS.GTCORRECTION_b.GTis_c271_ADAS "" UBYTE ADAS_CM_uint8 0 0 0 255 ECU_ADDRESS 0x0000 /* @ECU_Address@rtDW_ADAS.GTCORRECTION_b.GTis_c271_ADAS@ */ /end MEASUREMENT
/begin MEASUREMENT rtDW_ADAS.GTCORRECTION_b.GTtemporalCounter_i1 "" ULONG ADAS_CM_uint32 0 0 0 4294967295 ECU_ADDRESS 0x0000 /* @ECU_Address@rtDW_ADAS.GTCORRECTION_b.GTtemporalCounter_i1@ */ /end MEASUREMENT
/begin MEASUREMENT rtDW_ADAS.GTCVW_OneSide_solver.GTCVW_OneSide_solver_MODE "" UBYTE ADAS_CM_logical 0 0 0 1 ECU_ADDRESS 0x0000 /* @ECU_Address@rtDW_ADAS.GTCVW_OneSide_solver.GTCVW_OneSide_solver_MODE@ */ /end MEASUREMENT
/begin MEASUREMENT rtDW_ADAS.GTCVW_OneSide_solver.GTCastToBoolean2 "" FLOAT32_IEEE ADAS_CM_single 0 0 -3.4E+38 3.4E+38 LAYOUT COLUMN_DIR MATRIX_DIM 3 1 ECU_ADDRESS 0x0000 /* @ECU_Address@rtDW_ADAS.GTCVW_OneSide_solver.GTCastToBoolean2@ */ /end MEASUREMENT
/begin MEASUREMENT rtDW_ADAS.GTCVW_OneSide_solver.GTCastToBoolean2_k "" FLOAT32_IEEE ADAS_CM_single 0 0 -3.4E+38 3.4E+38 LAYOUT COLUMN_DIR MATRIX_DIM 3 1 ECU_ADDRESS 0x0000 /* @ECU_Address@rtDW_ADAS.GTCVW_OneSide_solver.GTCastToBoolean2_k@ */ /end MEASUREMENT
/begin MEASUREMENT rtDW_ADAS.GTCVW_OneSide_solver.GTCastToBoolean2_m "" FLOAT32_IEEE ADAS_CM_single 0 0 -3.4E+38 3.4E+38 LAYOUT COLUMN_DIR MATRIX_DIM 3 1 ECU_ADDRESS 0x0000 /* @ECU_Address@rtDW_ADAS.GTCVW_OneSide_solver.GTCastToBoolean2_m@ */ /end MEASUREMENT
/begin MEASUREMENT rtDW_ADAS.GTCVW_OneSide_solver.GTCastToBoolean2_mv "" FLOAT32_IEEE ADAS_CM_single 0 0 -3.4E+38 3.4E+38 LAYOUT COLUMN_DIR MATRIX_DIM 3 1 ECU_ADDRESS 0x0000 /* @ECU_Address@rtDW_ADAS.GTCVW_OneSide_solver.GTCastToBoolean2_mv@ */ /end MEASUREMENT
/begin MEASUREMENT rtDW_ADAS.GTCVW_OneSide_solver.GTCastToBoolean2_p "" FLOAT32_IEEE ADAS_CM_single 0 0 -3.4E+38 3.4E+38 LAYOUT COLUMN_DIR MATRIX_DIM 3 1 ECU_ADDRESS 0x0000 /* @ECU_Address@rtDW_ADAS.GTCVW_OneSide_solver.GTCastToBoolean2_p@ */ /end MEASUREMENT
/begin MEASUREMENT rtDW_ADAS.GTCVW_OneSide_solver.GTLeftSwitchCaseActionSubsys_c5.GTMemory1_PreviousInput "" FLOAT64_IEEE ADAS_CM_double 0 0 -1.7E+308 1.7E+308 ECU_ADDRESS 0x0000 /* @ECU_Address@rtDW_ADAS.GTCVW_OneSide_solver.GTLeftSwitchCaseActionSubsys_c5.GTMemory1_PreviousInput@ */ /end MEASUREMENT
/begin MEASUREMENT rtDW_ADAS.GTCVW_OneSide_solver.GTLeftSwitchCaseActionSubsys_c5.GTMemory_PreviousInput "" FLOAT32_IEEE ADAS_CM_single 0 0 -3.4E+38 3.4E+38 ECU_ADDRESS 0x0000 /* @ECU_Address@rtDW_ADAS.GTCVW_OneSide_solver.GTLeftSwitchCaseActionSubsys_c5.GTMemory_PreviousInput@ */ /end MEASUREMENT
/begin MEASUREMENT rtDW_ADAS.GTCVW_OneSide_solver.GTLeftSwitchCaseActionSubsys_cj.GTMemory1_PreviousInput "" FLOAT64_IEEE ADAS_CM_double 0 0 -1.7E+308 1.7E+308 ECU_ADDRESS 0x0000 /* @ECU_Address@rtDW_ADAS.GTCVW_OneSide_solver.GTLeftSwitchCaseActionSubsys_cj.GTMemory1_PreviousInput@ */ /end MEASUREMENT
/begin MEASUREMENT rtDW_ADAS.GTCVW_OneSide_solver.GTLeftSwitchCaseActionSubsys_cj.GTMemory_PreviousInput "" FLOAT32_IEEE ADAS_CM_single 0 0 -3.4E+38 3.4E+38 ECU_ADDRESS 0x0000 /* @ECU_Address@rtDW_ADAS.GTCVW_OneSide_solver.GTLeftSwitchCaseActionSubsys_cj.GTMemory_PreviousInput@ */ /end MEASUREMENT
/begin MEASUREMENT rtDW_ADAS.GTCVW_OneSide_solver.GTLeftSwitchCaseActionSubsys_en.GTMemory1_PreviousInput "" FLOAT64_IEEE ADAS_CM_double 0 0 -1.7E+308 1.7E+308 ECU_ADDRESS 0x0000 /* @ECU_Address@rtDW_ADAS.GTCVW_OneSide_solver.GTLeftSwitchCaseActionSubsys_en.GTMemory1_PreviousInput@ */ /end MEASUREMENT
/begin MEASUREMENT rtDW_ADAS.GTCVW_OneSide_solver.GTLeftSwitchCaseActionSubsys_en.GTMemory_PreviousInput "" FLOAT32_IEEE ADAS_CM_single 0 0 -3.4E+38 3.4E+38 ECU_ADDRESS 0x0000 /* @ECU_Address@rtDW_ADAS.GTCVW_OneSide_solver.GTLeftSwitchCaseActionSubsys_en.GTMemory_PreviousInput@ */ /end MEASUREMENT
/begin MEASUREMENT rtDW_ADAS.GTCVW_OneSide_solver.GTLeftSwitchCaseActionSubsys_fe.GTMemory1_PreviousInput "" FLOAT64_IEEE ADAS_CM_double 0 0 -1.7E+308 1.7E+308 ECU_ADDRESS 0x0000 /* @ECU_Address@rtDW_ADAS.GTCVW_OneSide_solver.GTLeftSwitchCaseActionSubsys_fe.GTMemory1_PreviousInput@ */ /end MEASUREMENT
/begin MEASUREMENT rtDW_ADAS.GTCVW_OneSide_solver.GTLeftSwitchCaseActionSubsys_fe.GTMemory_PreviousInput "" FLOAT32_IEEE ADAS_CM_single 0 0 -3.4E+38 3.4E+38 ECU_ADDRESS 0x0000 /* @ECU_Address@rtDW_ADAS.GTCVW_OneSide_solver.GTLeftSwitchCaseActionSubsys_fe.GTMemory_PreviousInput@ */ /end MEASUREMENT
/begin MEASUREMENT rtDW_ADAS.GTCVW_OneSide_solver.GTLeftSwitchCaseActionSubsyst_c.GTMemory1_PreviousInput "" FLOAT64_IEEE ADAS_CM_double 0 0 -1.7E+308 1.7E+308 ECU_ADDRESS 0x0000 /* @ECU_Address@rtDW_ADAS.GTCVW_OneSide_solver.GTLeftSwitchCaseActionSubsyst_c.GTMemory1_PreviousInput@ */ /end MEASUREMENT
/begin MEASUREMENT rtDW_ADAS.GTCVW_OneSide_solver.GTLeftSwitchCaseActionSubsyst_c.GTMemory_PreviousInput "" FLOAT32_IEEE ADAS_CM_single 0 0 -3.4E+38 3.4E+38 ECU_ADDRESS 0x0000 /* @ECU_Address@rtDW_ADAS.GTCVW_OneSide_solver.GTLeftSwitchCaseActionSubsyst_c.GTMemory_PreviousInput@ */ /end MEASUREMENT
/begin MEASUREMENT rtDW_ADAS.GTCVW_OneSide_solver.GTLeftSwitchCaseActionSubsyst_e.GTMemory1_PreviousInput "" FLOAT64_IEEE ADAS_CM_double 0 0 -1.7E+308 1.7E+308 ECU_ADDRESS 0x0000 /* @ECU_Address@rtDW_ADAS.GTCVW_OneSide_solver.GTLeftSwitchCaseActionSubsyst_e.GTMemory1_PreviousInput@ */ /end MEASUREMENT
/begin MEASUREMENT rtDW_ADAS.GTCVW_OneSide_solver.GTLeftSwitchCaseActionSubsyst_e.GTMemory_PreviousInput "" FLOAT32_IEEE ADAS_CM_single 0 0 -3.4E+38 3.4E+38 ECU_ADDRESS 0x0000 /* @ECU_Address@rtDW_ADAS.GTCVW_OneSide_solver.GTLeftSwitchCaseActionSubsyst_e.GTMemory_PreviousInput@ */ /end MEASUREMENT
/begin MEASUREMENT rtDW_ADAS.GTCVW_OneSide_solver.GTLeftSwitchCaseActionSubsyst_f.GTMemory1_PreviousInput "" FLOAT64_IEEE ADAS_CM_double 0 0 -1.7E+308 1.7E+308 ECU_ADDRESS 0x0000 /* @ECU_Address@rtDW_ADAS.GTCVW_OneSide_solver.GTLeftSwitchCaseActionSubsyst_f.GTMemory1_PreviousInput@ */ /end MEASUREMENT
/begin MEASUREMENT rtDW_ADAS.GTCVW_OneSide_solver.GTLeftSwitchCaseActionSubsyst_f.GTMemory_PreviousInput "" FLOAT32_IEEE ADAS_CM_single 0 0 -3.4E+38 3.4E+38 ECU_ADDRESS 0x0000 /* @ECU_Address@rtDW_ADAS.GTCVW_OneSide_solver.GTLeftSwitchCaseActionSubsyst_f.GTMemory_PreviousInput@ */ /end MEASUREMENT
/begin MEASUREMENT rtDW_ADAS.GTCVW_OneSide_solver.GTLeftSwitchCaseActionSubsyst_n.GTMemory1_PreviousInput "" FLOAT64_IEEE ADAS_CM_double 0 0 -1.7E+308 1.7E+308 ECU_ADDRESS 0x0000 /* @ECU_Address@rtDW_ADAS.GTCVW_OneSide_solver.GTLeftSwitchCaseActionSubsyst_n.GTMemory1_PreviousInput@ */ /end MEASUREMENT
/begin MEASUREMENT rtDW_ADAS.GTCVW_OneSide_solver.GTLeftSwitchCaseActionSubsyst_n.GTMemory_PreviousInput "" FLOAT32_IEEE ADAS_CM_single 0 0 -3.4E+38 3.4E+38 ECU_ADDRESS 0x0000 /* @ECU_Address@rtDW_ADAS.GTCVW_OneSide_solver.GTLeftSwitchCaseActionSubsyst_n.GTMemory_PreviousInput@ */ /end MEASUREMENT
/begin MEASUREMENT rtDW_ADAS.GTCVW_OneSide_solver.GTLeftSwitchCaseActionSubsyst_o.GTMemory1_PreviousInput "" FLOAT64_IEEE ADAS_CM_double 0 0 -1.7E+308 1.7E+308 ECU_ADDRESS 0x0000 /* @ECU_Address@rtDW_ADAS.GTCVW_OneSide_solver.GTLeftSwitchCaseActionSubsyst_o.GTMemory1_PreviousInput@ */ /end MEASUREMENT
/begin MEASUREMENT rtDW_ADAS.GTCVW_OneSide_solver.GTLeftSwitchCaseActionSubsyst_o.GTMemory_PreviousInput "" FLOAT32_IEEE ADAS_CM_single 0 0 -3.4E+38 3.4E+38 ECU_ADDRESS 0x0000 /* @ECU_Address@rtDW_ADAS.GTCVW_OneSide_solver.GTLeftSwitchCaseActionSubsyst_o.GTMemory_PreviousInput@ */ /end MEASUREMENT
/begin MEASUREMENT rtDW_ADAS.GTCVW_OneSide_solver.GTLeftSwitchCaseActionSubsystem.GTMemory1_PreviousInput "" FLOAT64_IEEE ADAS_CM_double 0 0 -1.7E+308 1.7E+308 ECU_ADDRESS 0x0000 /* @ECU_Address@rtDW_ADAS.GTCVW_OneSide_solver.GTLeftSwitchCaseActionSubsystem.GTMemory1_PreviousInput@ */ /end MEASUREMENT
/begin MEASUREMENT rtDW_ADAS.GTCVW_OneSide_solver.GTLeftSwitchCaseActionSubsystem.GTMemory_PreviousInput "" FLOAT32_IEEE ADAS_CM_single 0 0 -3.4E+38 3.4E+38 ECU_ADDRESS 0x0000 /* @ECU_Address@rtDW_ADAS.GTCVW_OneSide_solver.GTLeftSwitchCaseActionSubsystem.GTMemory_PreviousInput@ */ /end MEASUREMENT
/begin MEASUREMENT rtDW_ADAS.GTCVW_OneSide_solver.GTMerge "" UBYTE ADAS_CM_logical 0 0 0 1 ECU_ADDRESS 0x0000 /* @ECU_Address@rtDW_ADAS.GTCVW_OneSide_solver.GTMerge@ */ /end MEASUREMENT
/begin MEASUREMENT rtDW_ADAS.GTCVW_OneSide_solver.GTMerge_c "" UBYTE ADAS_CM_logical 0 0 0 1 ECU_ADDRESS 0x0000 /* @ECU_Address@rtDW_ADAS.GTCVW_OneSide_solver.GTMerge_c@ */ /end MEASUREMENT
/begin MEASUREMENT rtDW_ADAS.GTCVW_OneSide_solver.GTMerge_e "" UBYTE ADAS_CM_logical 0 0 0 1 ECU_ADDRESS 0x0000 /* @ECU_Address@rtDW_ADAS.GTCVW_OneSide_solver.GTMerge_e@ */ /end MEASUREMENT
/begin MEASUREMENT rtDW_ADAS.GTCVW_OneSide_solver.GTMerge_h "" UBYTE ADAS_CM_logical 0 0 0 1 ECU_ADDRESS 0x0000 /* @ECU_Address@rtDW_ADAS.GTCVW_OneSide_solver.GTMerge_h@ */ /end MEASUREMENT
/begin MEASUREMENT rtDW_ADAS.GTCVW_OneSide_solver.GTMerge_j "" UBYTE ADAS_CM_logical 0 0 0 1 ECU_ADDRESS 0x0000 /* @ECU_Address@rtDW_ADAS.GTCVW_OneSide_solver.GTMerge_j@ */ /end MEASUREMENT
/begin MEASUREMENT rtDW_ADAS.GTCVW_OneSide_solver.GTMerge_l "" UBYTE ADAS_CM_logical 0 0 0 1 ECU_ADDRESS 0x0000 /* @ECU_Address@rtDW_ADAS.GTCVW_OneSide_solver.GTMerge_l@ */ /end MEASUREMENT
/begin MEASUREMENT rtDW_ADAS.GTCVW_OneSide_solver.GTMerge_n "" UBYTE ADAS_CM_logical 0 0 0 1 ECU_ADDRESS 0x0000 /* @ECU_Address@rtDW_ADAS.GTCVW_OneSide_solver.GTMerge_n@ */ /end MEASUREMENT
/begin MEASUREMENT rtDW_ADAS.GTCVW_OneSide_solver.GTMerge_nb "" UBYTE ADAS_CM_logical 0 0 0 1 ECU_ADDRESS 0x0000 /* @ECU_Address@rtDW_ADAS.GTCVW_OneSide_solver.GTMerge_nb@ */ /end MEASUREMENT
/begin MEASUREMENT rtDW_ADAS.GTCVW_OneSide_solver.GTMerge_p "" UBYTE ADAS_CM_logical 0 0 0 1 ECU_ADDRESS 0x0000 /* @ECU_Address@rtDW_ADAS.GTCVW_OneSide_solver.GTMerge_p@ */ /end MEASUREMENT
/begin MEASUREMENT rtDW_ADAS.GTCVW_OneSide_solver.GTMerge_ps "" UBYTE ADAS_CM_logical 0 0 0 1 ECU_ADDRESS 0x0000 /* @ECU_Address@rtDW_ADAS.GTCVW_OneSide_solver.GTMerge_ps@ */ /end MEASUREMENT
/begin MEASUREMENT rtDW_ADAS.GTCVW_OneSide_solver.GTObj13inmarklinecoordsys.GTObj13inmarklinecoordsys_MODE "" UBYTE ADAS_CM_logical 0 0 0 1 ECU_ADDRESS 0x0000 /* @ECU_Address@rtDW_ADAS.GTCVW_OneSide_solver.GTObj13inmarklinecoordsys.GTObj13inmarklinecoordsys_MODE@ */ /end MEASUREMENT
/begin MEASUREMENT rtDW_ADAS.GTCVW_OneSide_solver.GTRightSwitchCaseActionSubsy_m0.GTMemory1_PreviousInput "" FLOAT64_IEEE ADAS_CM_double 0 0 -1.7E+308 1.7E+308 ECU_ADDRESS 0x0000 /* @ECU_Address@rtDW_ADAS.GTCVW_OneSide_solver.GTRightSwitchCaseActionSubsy_m0.GTMemory1_PreviousInput@ */ /end MEASUREMENT
/begin MEASUREMENT rtDW_ADAS.GTCVW_OneSide_solver.GTRightSwitchCaseActionSubsy_m0.GTMemory_PreviousInput "" FLOAT32_IEEE ADAS_CM_single 0 0 -3.4E+38 3.4E+38 ECU_ADDRESS 0x0000 /* @ECU_Address@rtDW_ADAS.GTCVW_OneSide_solver.GTRightSwitchCaseActionSubsy_m0.GTMemory_PreviousInput@ */ /end MEASUREMENT
/begin MEASUREMENT rtDW_ADAS.GTCVW_OneSide_solver.GTRightSwitchCaseActionSubsys_a.GTMemory1_PreviousInput "" FLOAT64_IEEE ADAS_CM_double 0 0 -1.7E+308 1.7E+308 ECU_ADDRESS 0x0000 /* @ECU_Address@rtDW_ADAS.GTCVW_OneSide_solver.GTRightSwitchCaseActionSubsys_a.GTMemory1_PreviousInput@ */ /end MEASUREMENT
/begin MEASUREMENT rtDW_ADAS.GTCVW_OneSide_solver.GTRightSwitchCaseActionSubsys_a.GTMemory_PreviousInput "" FLOAT32_IEEE ADAS_CM_single 0 0 -3.4E+38 3.4E+38 ECU_ADDRESS 0x0000 /* @ECU_Address@rtDW_ADAS.GTCVW_OneSide_solver.GTRightSwitchCaseActionSubsys_a.GTMemory_PreviousInput@ */ /end MEASUREMENT
/begin MEASUREMENT rtDW_ADAS.GTCVW_OneSide_solver.GTRightSwitchCaseActionSubsys_c.GTMemory1_PreviousInput "" FLOAT64_IEEE ADAS_CM_double 0 0 -1.7E+308 1.7E+308 ECU_ADDRESS 0x0000 /* @ECU_Address@rtDW_ADAS.GTCVW_OneSide_solver.GTRightSwitchCaseActionSubsys_c.GTMemory1_PreviousInput@ */ /end MEASUREMENT
/begin MEASUREMENT rtDW_ADAS.GTCVW_OneSide_solver.GTRightSwitchCaseActionSubsys_c.GTMemory_PreviousInput "" FLOAT32_IEEE ADAS_CM_single 0 0 -3.4E+38 3.4E+38 ECU_ADDRESS 0x0000 /* @ECU_Address@rtDW_ADAS.GTCVW_OneSide_solver.GTRightSwitchCaseActionSubsys_c.GTMemory_PreviousInput@ */ /end MEASUREMENT
/begin MEASUREMENT rtDW_ADAS.GTCVW_OneSide_solver.GTRightSwitchCaseActionSubsys_h.GTMemory1_PreviousInput "" FLOAT64_IEEE ADAS_CM_double 0 0 -1.7E+308 1.7E+308 ECU_ADDRESS 0x0000 /* @ECU_Address@rtDW_ADAS.GTCVW_OneSide_solver.GTRightSwitchCaseActionSubsys_h.GTMemory1_PreviousInput@ */ /end MEASUREMENT
/begin MEASUREMENT rtDW_ADAS.GTCVW_OneSide_solver.GTRightSwitchCaseActionSubsys_h.GTMemory_PreviousInput "" FLOAT32_IEEE ADAS_CM_single 0 0 -3.4E+38 3.4E+38 ECU_ADDRESS 0x0000 /* @ECU_Address@rtDW_ADAS.GTCVW_OneSide_solver.GTRightSwitchCaseActionSubsys_h.GTMemory_PreviousInput@ */ /end MEASUREMENT
/begin MEASUREMENT rtDW_ADAS.GTCVW_OneSide_solver.GTRightSwitchCaseActionSubsys_i.GTMemory1_PreviousInput "" FLOAT64_IEEE ADAS_CM_double 0 0 -1.7E+308 1.7E+308 ECU_ADDRESS 0x0000 /* @ECU_Address@rtDW_ADAS.GTCVW_OneSide_solver.GTRightSwitchCaseActionSubsys_i.GTMemory1_PreviousInput@ */ /end MEASUREMENT
/begin MEASUREMENT rtDW_ADAS.GTCVW_OneSide_solver.GTRightSwitchCaseActionSubsys_i.GTMemory_PreviousInput "" FLOAT32_IEEE ADAS_CM_single 0 0 -3.4E+38 3.4E+38 ECU_ADDRESS 0x0000 /* @ECU_Address@rtDW_ADAS.GTCVW_OneSide_solver.GTRightSwitchCaseActionSubsys_i.GTMemory_PreviousInput@ */ /end MEASUREMENT
/begin MEASUREMENT rtDW_ADAS.GTCVW_OneSide_solver.GTRightSwitchCaseActionSubsys_m.GTMemory1_PreviousInput "" FLOAT64_IEEE ADAS_CM_double 0 0 -1.7E+308 1.7E+308 ECU_ADDRESS 0x0000 /* @ECU_Address@rtDW_ADAS.GTCVW_OneSide_solver.GTRightSwitchCaseActionSubsys_m.GTMemory1_PreviousInput@ */ /end MEASUREMENT
/begin MEASUREMENT rtDW_ADAS.GTCVW_OneSide_solver.GTRightSwitchCaseActionSubsys_m.GTMemory_PreviousInput "" FLOAT32_IEEE ADAS_CM_single 0 0 -3.4E+38 3.4E+38 ECU_ADDRESS 0x0000 /* @ECU_Address@rtDW_ADAS.GTCVW_OneSide_solver.GTRightSwitchCaseActionSubsys_m.GTMemory_PreviousInput@ */ /end MEASUREMENT
/begin MEASUREMENT rtDW_ADAS.GTCVW_OneSide_solver.GTRightSwitchCaseActionSubsys_n.GTMemory1_PreviousInput "" FLOAT64_IEEE ADAS_CM_double 0 0 -1.7E+308 1.7E+308 ECU_ADDRESS 0x0000 /* @ECU_Address@rtDW_ADAS.GTCVW_OneSide_solver.GTRightSwitchCaseActionSubsys_n.GTMemory1_PreviousInput@ */ /end MEASUREMENT
/begin MEASUREMENT rtDW_ADAS.GTCVW_OneSide_solver.GTRightSwitchCaseActionSubsys_n.GTMemory_PreviousInput "" FLOAT32_IEEE ADAS_CM_single 0 0 -3.4E+38 3.4E+38 ECU_ADDRESS 0x0000 /* @ECU_Address@rtDW_ADAS.GTCVW_OneSide_solver.GTRightSwitchCaseActionSubsys_n.GTMemory_PreviousInput@ */ /end MEASUREMENT
/begin MEASUREMENT rtDW_ADAS.GTCVW_OneSide_solver.GTRightSwitchCaseActionSubsys_o.GTMemory1_PreviousInput "" FLOAT64_IEEE ADAS_CM_double 0 0 -1.7E+308 1.7E+308 ECU_ADDRESS 0x0000 /* @ECU_Address@rtDW_ADAS.GTCVW_OneSide_solver.GTRightSwitchCaseActionSubsys_o.GTMemory1_PreviousInput@ */ /end MEASUREMENT
/begin MEASUREMENT rtDW_ADAS.GTCVW_OneSide_solver.GTRightSwitchCaseActionSubsys_o.GTMemory_PreviousInput "" FLOAT32_IEEE ADAS_CM_single 0 0 -3.4E+38 3.4E+38 ECU_ADDRESS 0x0000 /* @ECU_Address@rtDW_ADAS.GTCVW_OneSide_solver.GTRightSwitchCaseActionSubsys_o.GTMemory_PreviousInput@ */ /end MEASUREMENT
/begin MEASUREMENT rtDW_ADAS.GTCVW_OneSide_solver.GTRightSwitchCaseActionSubsys_p.GTMemory1_PreviousInput "" FLOAT64_IEEE ADAS_CM_double 0 0 -1.7E+308 1.7E+308 ECU_ADDRESS 0x0000 /* @ECU_Address@rtDW_ADAS.GTCVW_OneSide_solver.GTRightSwitchCaseActionSubsys_p.GTMemory1_PreviousInput@ */ /end MEASUREMENT
/begin MEASUREMENT rtDW_ADAS.GTCVW_OneSide_solver.GTRightSwitchCaseActionSubsys_p.GTMemory_PreviousInput "" FLOAT32_IEEE ADAS_CM_single 0 0 -3.4E+38 3.4E+38 ECU_ADDRESS 0x0000 /* @ECU_Address@rtDW_ADAS.GTCVW_OneSide_solver.GTRightSwitchCaseActionSubsys_p.GTMemory_PreviousInput@ */ /end MEASUREMENT
/begin MEASUREMENT rtDW_ADAS.GTCVW_OneSide_solver.GTRightSwitchCaseActionSubsyste.GTMemory1_PreviousInput "" FLOAT64_IEEE ADAS_CM_double 0 0 -1.7E+308 1.7E+308 ECU_ADDRESS 0x0000 /* @ECU_Address@rtDW_ADAS.GTCVW_OneSide_solver.GTRightSwitchCaseActionSubsyste.GTMemory1_PreviousInput@ */ /end MEASUREMENT
/begin MEASUREMENT rtDW_ADAS.GTCVW_OneSide_solver.GTRightSwitchCaseActionSubsyste.GTMemory_PreviousInput "" FLOAT32_IEEE ADAS_CM_single 0 0 -3.4E+38 3.4E+38 ECU_ADDRESS 0x0000 /* @ECU_Address@rtDW_ADAS.GTCVW_OneSide_solver.GTRightSwitchCaseActionSubsyste.GTMemory_PreviousInput@ */ /end MEASUREMENT
/begin MEASUREMENT rtDW_ADAS.GTCVW_OneSide_solver.GTSideFarObjinmarklinecoordsys.GTObj13inmarklinecoordsys_MODE "" UBYTE ADAS_CM_logical 0 0 0 1 ECU_ADDRESS 0x0000 /* @ECU_Address@rtDW_ADAS.GTCVW_OneSide_solver.GTSideFarObjinmarklinecoordsys.GTObj13inmarklinecoordsys_MODE@ */ /end MEASUREMENT
/begin MEASUREMENT rtDW_ADAS.GTCVW_OneSide_solver.GTSideNearObjinmarklinecoordsys.GTObj13inmarklinecoordsys_MODE "" UBYTE ADAS_CM_logical 0 0 0 1 ECU_ADDRESS 0x0000 /* @ECU_Address@rtDW_ADAS.GTCVW_OneSide_solver.GTSideNearObjinmarklinecoordsys.GTObj13inmarklinecoordsys_MODE@ */ /end MEASUREMENT
/begin MEASUREMENT rtDW_ADAS.GTCVW_OneSide_solver.GTSideOppFarObjinmarklinecoords.GTObj13inmarklinecoordsys_MODE "" UBYTE ADAS_CM_logical 0 0 0 1 ECU_ADDRESS 0x0000 /* @ECU_Address@rtDW_ADAS.GTCVW_OneSide_solver.GTSideOppFarObjinmarklinecoords.GTObj13inmarklinecoordsys_MODE@ */ /end MEASUREMENT
/begin MEASUREMENT rtDW_ADAS.GTCVW_OneSide_solver.GTSideOppNearObjinmarklinecoord.GTObj13inmarklinecoordsys_MODE "" UBYTE ADAS_CM_logical 0 0 0 1 ECU_ADDRESS 0x0000 /* @ECU_Address@rtDW_ADAS.GTCVW_OneSide_solver.GTSideOppNearObjinmarklinecoord.GTObj13inmarklinecoordsys_MODE@ */ /end MEASUREMENT
/begin MEASUREMENT rtDW_ADAS.GTCVW_OneSide_solver.GThasPointProjOnMarkLineFlag "" FLOAT64_IEEE ADAS_CM_double 0 0 -1.7E+308 1.7E+308 ECU_ADDRESS 0x0000 /* @ECU_Address@rtDW_ADAS.GTCVW_OneSide_solver.GThasPointProjOnMarkLineFlag@ */ /end MEASUREMENT
/begin MEASUREMENT rtDW_ADAS.GTCVW_OneSide_solver.GThasPointProjOnMarkLineFlag_f "" FLOAT64_IEEE ADAS_CM_double 0 0 -1.7E+308 1.7E+308 ECU_ADDRESS 0x0000 /* @ECU_Address@rtDW_ADAS.GTCVW_OneSide_solver.GThasPointProjOnMarkLineFlag_f@ */ /end MEASUREMENT
/begin MEASUREMENT rtDW_ADAS.GTCVW_OneSide_solver.GThasPointProjOnMarkLineFlag_k "" FLOAT64_IEEE ADAS_CM_double 0 0 -1.7E+308 1.7E+308 ECU_ADDRESS 0x0000 /* @ECU_Address@rtDW_ADAS.GTCVW_OneSide_solver.GThasPointProjOnMarkLineFlag_k@ */ /end MEASUREMENT
/begin MEASUREMENT rtDW_ADAS.GTCVW_OneSide_solver.GThasPointProjOnMarkLineFlag_kw "" FLOAT64_IEEE ADAS_CM_double 0 0 -1.7E+308 1.7E+308 ECU_ADDRESS 0x0000 /* @ECU_Address@rtDW_ADAS.GTCVW_OneSide_solver.GThasPointProjOnMarkLineFlag_kw@ */ /end MEASUREMENT
/begin MEASUREMENT rtDW_ADAS.GTCVW_OneSide_solver.GThasPointProjOnMarkLineFlag_p "" FLOAT64_IEEE ADAS_CM_double 0 0 -1.7E+308 1.7E+308 ECU_ADDRESS 0x0000 /* @ECU_Address@rtDW_ADAS.GTCVW_OneSide_solver.GThasPointProjOnMarkLineFlag_p@ */ /end MEASUREMENT
/begin MEASUREMENT rtDW_ADAS.GTCVW_OneSide_solver.GTis_active_c148_ADAS "" UBYTE ADAS_CM_uint8 0 0 0 255 ECU_ADDRESS 0x0000 /* @ECU_Address@rtDW_ADAS.GTCVW_OneSide_solver.GTis_active_c148_ADAS@ */ /end MEASUREMENT
/begin MEASUREMENT rtDW_ADAS.GTCVW_OneSide_solver.GTis_active_c179_ADAS "" UBYTE ADAS_CM_uint8 0 0 0 255 ECU_ADDRESS 0x0000 /* @ECU_Address@rtDW_ADAS.GTCVW_OneSide_solver.GTis_active_c179_ADAS@ */ /end MEASUREMENT
/begin MEASUREMENT rtDW_ADAS.GTCVW_OneSide_solver.GTis_c148_ADAS "" UBYTE ADAS_CM_uint8 0 0 0 255 ECU_ADDRESS 0x0000 /* @ECU_Address@rtDW_ADAS.GTCVW_OneSide_solver.GTis_c148_ADAS@ */ /end MEASUREMENT
/begin MEASUREMENT rtDW_ADAS.GTCVW_OneSide_solver.GTis_c179_ADAS "" UBYTE ADAS_CM_uint8 0 0 0 255 ECU_ADDRESS 0x0000 /* @ECU_Address@rtDW_ADAS.GTCVW_OneSide_solver.GTis_c179_ADAS@ */ /end MEASUREMENT
/begin MEASUREMENT rtDW_ADAS.GTCVW_OneSide_solver.GTlast_et "" FLOAT64_IEEE ADAS_CM_double 0 0 -1.7E+308 1.7E+308 ECU_ADDRESS 0x0000 /* @ECU_Address@rtDW_ADAS.GTCVW_OneSide_solver.GTlast_et@ */ /end MEASUREMENT
/begin MEASUREMENT rtDW_ADAS.GTCVW_OneSide_solver.GTpath "" FLOAT64_IEEE ADAS_CM_double 0 0 -1.7E+308 1.7E+308 ECU_ADDRESS 0x0000 /* @ECU_Address@rtDW_ADAS.GTCVW_OneSide_solver.GTpath@ */ /end MEASUREMENT
/begin MEASUREMENT rtDW_ADAS.GTCVW_OneSide_solver.GTsum_segments_length "" FLOAT64_IEEE ADAS_CM_double 0 0 -1.7E+308 1.7E+308 ECU_ADDRESS 0x0000 /* @ECU_Address@rtDW_ADAS.GTCVW_OneSide_solver.GTsum_segments_length@ */ /end MEASUREMENT
/begin MEASUREMENT rtDW_ADAS.GTCVW_OneSide_solver.GTsum_segments_length_c "" FLOAT64_IEEE ADAS_CM_double 0 0 -1.7E+308 1.7E+308 ECU_ADDRESS 0x0000 /* @ECU_Address@rtDW_ADAS.GTCVW_OneSide_solver.GTsum_segments_length_c@ */ /end MEASUREMENT
/begin MEASUREMENT rtDW_ADAS.GTCVW_OneSide_solver.GTsum_segments_length_e "" FLOAT64_IEEE ADAS_CM_double 0 0 -1.7E+308 1.7E+308 ECU_ADDRESS 0x0000 /* @ECU_Address@rtDW_ADAS.GTCVW_OneSide_solver.GTsum_segments_length_e@ */ /end MEASUREMENT
/begin MEASUREMENT rtDW_ADAS.GTCVW_OneSide_solver.GTsum_segments_length_j "" FLOAT64_IEEE ADAS_CM_double 0 0 -1.7E+308 1.7E+308 ECU_ADDRESS 0x0000 /* @ECU_Address@rtDW_ADAS.GTCVW_OneSide_solver.GTsum_segments_length_j@ */ /end MEASUREMENT
/begin MEASUREMENT rtDW_ADAS.GTCVW_OneSide_solver.GTsum_segments_length_o "" FLOAT64_IEEE ADAS_CM_double 0 0 -1.7E+308 1.7E+308 ECU_ADDRESS 0x0000 /* @ECU_Address@rtDW_ADAS.GTCVW_OneSide_solver.GTsum_segments_length_o@ */ /end MEASUREMENT
/begin MEASUREMENT rtDW_ADAS.GTCVW_OneSide_solver.GTtemporalCounter_i1 "" ULONG ADAS_CM_uint32 0 0 0 4294967295 ECU_ADDRESS 0x0000 /* @ECU_Address@rtDW_ADAS.GTCVW_OneSide_solver.GTtemporalCounter_i1@ */ /end MEASUREMENT
/begin MEASUREMENT rtDW_ADAS.GTCVW_OneSide_solver_h.GTCVW_OneSide_solver_MODE "" UBYTE ADAS_CM_logical 0 0 0 1 ECU_ADDRESS 0x0000 /* @ECU_Address@rtDW_ADAS.GTCVW_OneSide_solver_h.GTCVW_OneSide_solver_MODE@ */ /end MEASUREMENT
/begin MEASUREMENT rtDW_ADAS.GTCVW_OneSide_solver_h.GTCastToBoolean2 "" FLOAT32_IEEE ADAS_CM_single 0 0 -3.4E+38 3.4E+38 LAYOUT COLUMN_DIR MATRIX_DIM 3 1 ECU_ADDRESS 0x0000 /* @ECU_Address@rtDW_ADAS.GTCVW_OneSide_solver_h.GTCastToBoolean2@ */ /end MEASUREMENT
/begin MEASUREMENT rtDW_ADAS.GTCVW_OneSide_solver_h.GTCastToBoolean2_k "" FLOAT32_IEEE ADAS_CM_single 0 0 -3.4E+38 3.4E+38 LAYOUT COLUMN_DIR MATRIX_DIM 3 1 ECU_ADDRESS 0x0000 /* @ECU_Address@rtDW_ADAS.GTCVW_OneSide_solver_h.GTCastToBoolean2_k@ */ /end MEASUREMENT
/begin MEASUREMENT rtDW_ADAS.GTCVW_OneSide_solver_h.GTCastToBoolean2_m "" FLOAT32_IEEE ADAS_CM_single 0 0 -3.4E+38 3.4E+38 LAYOUT COLUMN_DIR MATRIX_DIM 3 1 ECU_ADDRESS 0x0000 /* @ECU_Address@rtDW_ADAS.GTCVW_OneSide_solver_h.GTCastToBoolean2_m@ */ /end MEASUREMENT
/begin MEASUREMENT rtDW_ADAS.GTCVW_OneSide_solver_h.GTCastToBoolean2_mv "" FLOAT32_IEEE ADAS_CM_single 0 0 -3.4E+38 3.4E+38 LAYOUT COLUMN_DIR MATRIX_DIM 3 1 ECU_ADDRESS 0x0000 /* @ECU_Address@rtDW_ADAS.GTCVW_OneSide_solver_h.GTCastToBoolean2_mv@ */ /end MEASUREMENT
/begin MEASUREMENT rtDW_ADAS.GTCVW_OneSide_solver_h.GTCastToBoolean2_p "" FLOAT32_IEEE ADAS_CM_single 0 0 -3.4E+38 3.4E+38 LAYOUT COLUMN_DIR MATRIX_DIM 3 1 ECU_ADDRESS 0x0000 /* @ECU_Address@rtDW_ADAS.GTCVW_OneSide_solver_h.GTCastToBoolean2_p@ */ /end MEASUREMENT
/begin MEASUREMENT rtDW_ADAS.GTCVW_OneSide_solver_h.GTLeftSwitchCaseActionSubsys_c5.GTMemory1_PreviousInput "" FLOAT64_IEEE ADAS_CM_double 0 0 -1.7E+308 1.7E+308 ECU_ADDRESS 0x0000 /* @ECU_Address@rtDW_ADAS.GTCVW_OneSide_solver_h.GTLeftSwitchCaseActionSubsys_c5.GTMemory1_PreviousInput@ */ /end MEASUREMENT
/begin MEASUREMENT rtDW_ADAS.GTCVW_OneSide_solver_h.GTLeftSwitchCaseActionSubsys_c5.GTMemory_PreviousInput "" FLOAT32_IEEE ADAS_CM_single 0 0 -3.4E+38 3.4E+38 ECU_ADDRESS 0x0000 /* @ECU_Address@rtDW_ADAS.GTCVW_OneSide_solver_h.GTLeftSwitchCaseActionSubsys_c5.GTMemory_PreviousInput@ */ /end MEASUREMENT
/begin MEASUREMENT rtDW_ADAS.GTCVW_OneSide_solver_h.GTLeftSwitchCaseActionSubsys_cj.GTMemory1_PreviousInput "" FLOAT64_IEEE ADAS_CM_double 0 0 -1.7E+308 1.7E+308 ECU_ADDRESS 0x0000 /* @ECU_Address@rtDW_ADAS.GTCVW_OneSide_solver_h.GTLeftSwitchCaseActionSubsys_cj.GTMemory1_PreviousInput@ */ /end MEASUREMENT
/begin MEASUREMENT rtDW_ADAS.GTCVW_OneSide_solver_h.GTLeftSwitchCaseActionSubsys_cj.GTMemory_PreviousInput "" FLOAT32_IEEE ADAS_CM_single 0 0 -3.4E+38 3.4E+38 ECU_ADDRESS 0x0000 /* @ECU_Address@rtDW_ADAS.GTCVW_OneSide_solver_h.GTLeftSwitchCaseActionSubsys_cj.GTMemory_PreviousInput@ */ /end MEASUREMENT
/begin MEASUREMENT rtDW_ADAS.GTCVW_OneSide_solver_h.GTLeftSwitchCaseActionSubsys_en.GTMemory1_PreviousInput "" FLOAT64_IEEE ADAS_CM_double 0 0 -1.7E+308 1.7E+308 ECU_ADDRESS 0x0000 /* @ECU_Address@rtDW_ADAS.GTCVW_OneSide_solver_h.GTLeftSwitchCaseActionSubsys_en.GTMemory1_PreviousInput@ */ /end MEASUREMENT
/begin MEASUREMENT rtDW_ADAS.GTCVW_OneSide_solver_h.GTLeftSwitchCaseActionSubsys_en.GTMemory_PreviousInput "" FLOAT32_IEEE ADAS_CM_single 0 0 -3.4E+38 3.4E+38 ECU_ADDRESS 0x0000 /* @ECU_Address@rtDW_ADAS.GTCVW_OneSide_solver_h.GTLeftSwitchCaseActionSubsys_en.GTMemory_PreviousInput@ */ /end MEASUREMENT
/begin MEASUREMENT rtDW_ADAS.GTCVW_OneSide_solver_h.GTLeftSwitchCaseActionSubsys_fe.GTMemory1_PreviousInput "" FLOAT64_IEEE ADAS_CM_double 0 0 -1.7E+308 1.7E+308 ECU_ADDRESS 0x0000 /* @ECU_Address@rtDW_ADAS.GTCVW_OneSide_solver_h.GTLeftSwitchCaseActionSubsys_fe.GTMemory1_PreviousInput@ */ /end MEASUREMENT
/begin MEASUREMENT rtDW_ADAS.GTCVW_OneSide_solver_h.GTLeftSwitchCaseActionSubsys_fe.GTMemory_PreviousInput "" FLOAT32_IEEE ADAS_CM_single 0 0 -3.4E+38 3.4E+38 ECU_ADDRESS 0x0000 /* @ECU_Address@rtDW_ADAS.GTCVW_OneSide_solver_h.GTLeftSwitchCaseActionSubsys_fe.GTMemory_PreviousInput@ */ /end MEASUREMENT
/begin MEASUREMENT rtDW_ADAS.GTCVW_OneSide_solver_h.GTLeftSwitchCaseActionSubsyst_c.GTMemory1_PreviousInput "" FLOAT64_IEEE ADAS_CM_double 0 0 -1.7E+308 1.7E+308 ECU_ADDRESS 0x0000 /* @ECU_Address@rtDW_ADAS.GTCVW_OneSide_solver_h.GTLeftSwitchCaseActionSubsyst_c.GTMemory1_PreviousInput@ */ /end MEASUREMENT
/begin MEASUREMENT rtDW_ADAS.GTCVW_OneSide_solver_h.GTLeftSwitchCaseActionSubsyst_c.GTMemory_PreviousInput "" FLOAT32_IEEE ADAS_CM_single 0 0 -3.4E+38 3.4E+38 ECU_ADDRESS 0x0000 /* @ECU_Address@rtDW_ADAS.GTCVW_OneSide_solver_h.GTLeftSwitchCaseActionSubsyst_c.GTMemory_PreviousInput@ */ /end MEASUREMENT
/begin MEASUREMENT rtDW_ADAS.GTCVW_OneSide_solver_h.GTLeftSwitchCaseActionSubsyst_e.GTMemory1_PreviousInput "" FLOAT64_IEEE ADAS_CM_double 0 0 -1.7E+308 1.7E+308 ECU_ADDRESS 0x0000 /* @ECU_Address@rtDW_ADAS.GTCVW_OneSide_solver_h.GTLeftSwitchCaseActionSubsyst_e.GTMemory1_PreviousInput@ */ /end MEASUREMENT
/begin MEASUREMENT rtDW_ADAS.GTCVW_OneSide_solver_h.GTLeftSwitchCaseActionSubsyst_e.GTMemory_PreviousInput "" FLOAT32_IEEE ADAS_CM_single 0 0 -3.4E+38 3.4E+38 ECU_ADDRESS 0x0000 /* @ECU_Address@rtDW_ADAS.GTCVW_OneSide_solver_h.GTLeftSwitchCaseActionSubsyst_e.GTMemory_PreviousInput@ */ /end MEASUREMENT
/begin MEASUREMENT rtDW_ADAS.GTCVW_OneSide_solver_h.GTLeftSwitchCaseActionSubsyst_f.GTMemory1_PreviousInput "" FLOAT64_IEEE ADAS_CM_double 0 0 -1.7E+308 1.7E+308 ECU_ADDRESS 0x0000 /* @ECU_Address@rtDW_ADAS.GTCVW_OneSide_solver_h.GTLeftSwitchCaseActionSubsyst_f.GTMemory1_PreviousInput@ */ /end MEASUREMENT
/begin MEASUREMENT rtDW_ADAS.GTCVW_OneSide_solver_h.GTLeftSwitchCaseActionSubsyst_f.GTMemory_PreviousInput "" FLOAT32_IEEE ADAS_CM_single 0 0 -3.4E+38 3.4E+38 ECU_ADDRESS 0x0000 /* @ECU_Address@rtDW_ADAS.GTCVW_OneSide_solver_h.GTLeftSwitchCaseActionSubsyst_f.GTMemory_PreviousInput@ */ /end MEASUREMENT
/begin MEASUREMENT rtDW_ADAS.GTCVW_OneSide_solver_h.GTLeftSwitchCaseActionSubsyst_n.GTMemory1_PreviousInput "" FLOAT64_IEEE ADAS_CM_double 0 0 -1.7E+308 1.7E+308 ECU_ADDRESS 0x0000 /* @ECU_Address@rtDW_ADAS.GTCVW_OneSide_solver_h.GTLeftSwitchCaseActionSubsyst_n.GTMemory1_PreviousInput@ */ /end MEASUREMENT
/begin MEASUREMENT rtDW_ADAS.GTCVW_OneSide_solver_h.GTLeftSwitchCaseActionSubsyst_n.GTMemory_PreviousInput "" FLOAT32_IEEE ADAS_CM_single 0 0 -3.4E+38 3.4E+38 ECU_ADDRESS 0x0000 /* @ECU_Address@rtDW_ADAS.GTCVW_OneSide_solver_h.GTLeftSwitchCaseActionSubsyst_n.GTMemory_PreviousInput@ */ /end MEASUREMENT
/begin MEASUREMENT rtDW_ADAS.GTCVW_OneSide_solver_h.GTLeftSwitchCaseActionSubsyst_o.GTMemory1_PreviousInput "" FLOAT64_IEEE ADAS_CM_double 0 0 -1.7E+308 1.7E+308 ECU_ADDRESS 0x0000 /* @ECU_Address@rtDW_ADAS.GTCVW_OneSide_solver_h.GTLeftSwitchCaseActionSubsyst_o.GTMemory1_PreviousInput@ */ /end MEASUREMENT
/begin MEASUREMENT rtDW_ADAS.GTCVW_OneSide_solver_h.GTLeftSwitchCaseActionSubsyst_o.GTMemory_PreviousInput "" FLOAT32_IEEE ADAS_CM_single 0 0 -3.4E+38 3.4E+38 ECU_ADDRESS 0x0000 /* @ECU_Address@rtDW_ADAS.GTCVW_OneSide_solver_h.GTLeftSwitchCaseActionSubsyst_o.GTMemory_PreviousInput@ */ /end MEASUREMENT
/begin MEASUREMENT rtDW_ADAS.GTCVW_OneSide_solver_h.GTLeftSwitchCaseActionSubsystem.GTMemory1_PreviousInput "" FLOAT64_IEEE ADAS_CM_double 0 0 -1.7E+308 1.7E+308 ECU_ADDRESS 0x0000 /* @ECU_Address@rtDW_ADAS.GTCVW_OneSide_solver_h.GTLeftSwitchCaseActionSubsystem.GTMemory1_PreviousInput@ */ /end MEASUREMENT
/begin MEASUREMENT rtDW_ADAS.GTCVW_OneSide_solver_h.GTLeftSwitchCaseActionSubsystem.GTMemory_PreviousInput "" FLOAT32_IEEE ADAS_CM_single 0 0 -3.4E+38 3.4E+38 ECU_ADDRESS 0x0000 /* @ECU_Address@rtDW_ADAS.GTCVW_OneSide_solver_h.GTLeftSwitchCaseActionSubsystem.GTMemory_PreviousInput@ */ /end MEASUREMENT
/begin MEASUREMENT rtDW_ADAS.GTCVW_OneSide_solver_h.GTMerge "" UBYTE ADAS_CM_logical 0 0 0 1 ECU_ADDRESS 0x0000 /* @ECU_Address@rtDW_ADAS.GTCVW_OneSide_solver_h.GTMerge@ */ /end MEASUREMENT
/begin MEASUREMENT rtDW_ADAS.GTCVW_OneSide_solver_h.GTMerge_c "" UBYTE ADAS_CM_logical 0 0 0 1 ECU_ADDRESS 0x0000 /* @ECU_Address@rtDW_ADAS.GTCVW_OneSide_solver_h.GTMerge_c@ */ /end MEASUREMENT
/begin MEASUREMENT rtDW_ADAS.GTCVW_OneSide_solver_h.GTMerge_e "" UBYTE ADAS_CM_logical 0 0 0 1 ECU_ADDRESS 0x0000 /* @ECU_Address@rtDW_ADAS.GTCVW_OneSide_solver_h.GTMerge_e@ */ /end MEASUREMENT
/begin MEASUREMENT rtDW_ADAS.GTCVW_OneSide_solver_h.GTMerge_h "" UBYTE ADAS_CM_logical 0 0 0 1 ECU_ADDRESS 0x0000 /* @ECU_Address@rtDW_ADAS.GTCVW_OneSide_solver_h.GTMerge_h@ */ /end MEASUREMENT
/begin MEASUREMENT rtDW_ADAS.GTCVW_OneSide_solver_h.GTMerge_j "" UBYTE ADAS_CM_logical 0 0 0 1 ECU_ADDRESS 0x0000 /* @ECU_Address@rtDW_ADAS.GTCVW_OneSide_solver_h.GTMerge_j@ */ /end MEASUREMENT
/begin MEASUREMENT rtDW_ADAS.GTCVW_OneSide_solver_h.GTMerge_l "" UBYTE ADAS_CM_logical 0 0 0 1 ECU_ADDRESS 0x0000 /* @ECU_Address@rtDW_ADAS.GTCVW_OneSide_solver_h.GTMerge_l@ */ /end MEASUREMENT
/begin MEASUREMENT rtDW_ADAS.GTCVW_OneSide_solver_h.GTMerge_n "" UBYTE ADAS_CM_logical 0 0 0 1 ECU_ADDRESS 0x0000 /* @ECU_Address@rtDW_ADAS.GTCVW_OneSide_solver_h.GTMerge_n@ */ /end MEASUREMENT
/begin MEASUREMENT rtDW_ADAS.GTCVW_OneSide_solver_h.GTMerge_nb "" UBYTE ADAS_CM_logical 0 0 0 1 ECU_ADDRESS 0x0000 /* @ECU_Address@rtDW_ADAS.GTCVW_OneSide_solver_h.GTMerge_nb@ */ /end MEASUREMENT
/begin MEASUREMENT rtDW_ADAS.GTCVW_OneSide_solver_h.GTMerge_p "" UBYTE ADAS_CM_logical 0 0 0 1 ECU_ADDRESS 0x0000 /* @ECU_Address@rtDW_ADAS.GTCVW_OneSide_solver_h.GTMerge_p@ */ /end MEASUREMENT
/begin MEASUREMENT rtDW_ADAS.GTCVW_OneSide_solver_h.GTMerge_ps "" UBYTE ADAS_CM_logical 0 0 0 1 ECU_ADDRESS 0x0000 /* @ECU_Address@rtDW_ADAS.GTCVW_OneSide_solver_h.GTMerge_ps@ */ /end MEASUREMENT
/begin MEASUREMENT rtDW_ADAS.GTCVW_OneSide_solver_h.GTObj13inmarklinecoordsys.GTObj13inmarklinecoordsys_MODE "" UBYTE ADAS_CM_logical 0 0 0 1 ECU_ADDRESS 0x0000 /* @ECU_Address@rtDW_ADAS.GTCVW_OneSide_solver_h.GTObj13inmarklinecoordsys.GTObj13inmarklinecoordsys_MODE@ */ /end MEASUREMENT
/begin MEASUREMENT rtDW_ADAS.GTCVW_OneSide_solver_h.GTRightSwitchCaseActionSubsy_m0.GTMemory1_PreviousInput "" FLOAT64_IEEE ADAS_CM_double 0 0 -1.7E+308 1.7E+308 ECU_ADDRESS 0x0000 /* @ECU_Address@rtDW_ADAS.GTCVW_OneSide_solver_h.GTRightSwitchCaseActionSubsy_m0.GTMemory1_PreviousInput@ */ /end MEASUREMENT
/begin MEASUREMENT rtDW_ADAS.GTCVW_OneSide_solver_h.GTRightSwitchCaseActionSubsy_m0.GTMemory_PreviousInput "" FLOAT32_IEEE ADAS_CM_single 0 0 -3.4E+38 3.4E+38 ECU_ADDRESS 0x0000 /* @ECU_Address@rtDW_ADAS.GTCVW_OneSide_solver_h.GTRightSwitchCaseActionSubsy_m0.GTMemory_PreviousInput@ */ /end MEASUREMENT
/begin MEASUREMENT rtDW_ADAS.GTCVW_OneSide_solver_h.GTRightSwitchCaseActionSubsys_a.GTMemory1_PreviousInput "" FLOAT64_IEEE ADAS_CM_double 0 0 -1.7E+308 1.7E+308 ECU_ADDRESS 0x0000 /* @ECU_Address@rtDW_ADAS.GTCVW_OneSide_solver_h.GTRightSwitchCaseActionSubsys_a.GTMemory1_PreviousInput@ */ /end MEASUREMENT
/begin MEASUREMENT rtDW_ADAS.GTCVW_OneSide_solver_h.GTRightSwitchCaseActionSubsys_a.GTMemory_PreviousInput "" FLOAT32_IEEE ADAS_CM_single 0 0 -3.4E+38 3.4E+38 ECU_ADDRESS 0x0000 /* @ECU_Address@rtDW_ADAS.GTCVW_OneSide_solver_h.GTRightSwitchCaseActionSubsys_a.GTMemory_PreviousInput@ */ /end MEASUREMENT
/begin MEASUREMENT rtDW_ADAS.GTCVW_OneSide_solver_h.GTRightSwitchCaseActionSubsys_c.GTMemory1_PreviousInput "" FLOAT64_IEEE ADAS_CM_double 0 0 -1.7E+308 1.7E+308 ECU_ADDRESS 0x0000 /* @ECU_Address@rtDW_ADAS.GTCVW_OneSide_solver_h.GTRightSwitchCaseActionSubsys_c.GTMemory1_PreviousInput@ */ /end MEASUREMENT
/begin MEASUREMENT rtDW_ADAS.GTCVW_OneSide_solver_h.GTRightSwitchCaseActionSubsys_c.GTMemory_PreviousInput "" FLOAT32_IEEE ADAS_CM_single 0 0 -3.4E+38 3.4E+38 ECU_ADDRESS 0x0000 /* @ECU_Address@rtDW_ADAS.GTCVW_OneSide_solver_h.GTRightSwitchCaseActionSubsys_c.GTMemory_PreviousInput@ */ /end MEASUREMENT
/begin MEASUREMENT rtDW_ADAS.GTCVW_OneSide_solver_h.GTRightSwitchCaseActionSubsys_h.GTMemory1_PreviousInput "" FLOAT64_IEEE ADAS_CM_double 0 0 -1.7E+308 1.7E+308 ECU_ADDRESS 0x0000 /* @ECU_Address@rtDW_ADAS.GTCVW_OneSide_solver_h.GTRightSwitchCaseActionSubsys_h.GTMemory1_PreviousInput@ */ /end MEASUREMENT
/begin MEASUREMENT rtDW_ADAS.GTCVW_OneSide_solver_h.GTRightSwitchCaseActionSubsys_h.GTMemory_PreviousInput "" FLOAT32_IEEE ADAS_CM_single 0 0 -3.4E+38 3.4E+38 ECU_ADDRESS 0x0000 /* @ECU_Address@rtDW_ADAS.GTCVW_OneSide_solver_h.GTRightSwitchCaseActionSubsys_h.GTMemory_PreviousInput@ */ /end MEASUREMENT
/begin MEASUREMENT rtDW_ADAS.GTCVW_OneSide_solver_h.GTRightSwitchCaseActionSubsys_i.GTMemory1_PreviousInput "" FLOAT64_IEEE ADAS_CM_double 0 0 -1.7E+308 1.7E+308 ECU_ADDRESS 0x0000 /* @ECU_Address@rtDW_ADAS.GTCVW_OneSide_solver_h.GTRightSwitchCaseActionSubsys_i.GTMemory1_PreviousInput@ */ /end MEASUREMENT
/begin MEASUREMENT rtDW_ADAS.GTCVW_OneSide_solver_h.GTRightSwitchCaseActionSubsys_i.GTMemory_PreviousInput "" FLOAT32_IEEE ADAS_CM_single 0 0 -3.4E+38 3.4E+38 ECU_ADDRESS 0x0000 /* @ECU_Address@rtDW_ADAS.GTCVW_OneSide_solver_h.GTRightSwitchCaseActionSubsys_i.GTMemory_PreviousInput@ */ /end MEASUREMENT
/begin MEASUREMENT rtDW_ADAS.GTCVW_OneSide_solver_h.GTRightSwitchCaseActionSubsys_m.GTMemory1_PreviousInput "" FLOAT64_IEEE ADAS_CM_double 0 0 -1.7E+308 1.7E+308 ECU_ADDRESS 0x0000 /* @ECU_Address@rtDW_ADAS.GTCVW_OneSide_solver_h.GTRightSwitchCaseActionSubsys_m.GTMemory1_PreviousInput@ */ /end MEASUREMENT
/begin MEASUREMENT rtDW_ADAS.GTCVW_OneSide_solver_h.GTRightSwitchCaseActionSubsys_m.GTMemory_PreviousInput "" FLOAT32_IEEE ADAS_CM_single 0 0 -3.4E+38 3.4E+38 ECU_ADDRESS 0x0000 /* @ECU_Address@rtDW_ADAS.GTCVW_OneSide_solver_h.GTRightSwitchCaseActionSubsys_m.GTMemory_PreviousInput@ */ /end MEASUREMENT
/begin MEASUREMENT rtDW_ADAS.GTCVW_OneSide_solver_h.GTRightSwitchCaseActionSubsys_n.GTMemory1_PreviousInput "" FLOAT64_IEEE ADAS_CM_double 0 0 -1.7E+308 1.7E+308 ECU_ADDRESS 0x0000 /* @ECU_Address@rtDW_ADAS.GTCVW_OneSide_solver_h.GTRightSwitchCaseActionSubsys_n.GTMemory1_PreviousInput@ */ /end MEASUREMENT
/begin MEASUREMENT rtDW_ADAS.GTCVW_OneSide_solver_h.GTRightSwitchCaseActionSubsys_n.GTMemory_PreviousInput "" FLOAT32_IEEE ADAS_CM_single 0 0 -3.4E+38 3.4E+38 ECU_ADDRESS 0x0000 /* @ECU_Address@rtDW_ADAS.GTCVW_OneSide_solver_h.GTRightSwitchCaseActionSubsys_n.GTMemory_PreviousInput@ */ /end MEASUREMENT
/begin MEASUREMENT rtDW_ADAS.GTCVW_OneSide_solver_h.GTRightSwitchCaseActionSubsys_o.GTMemory1_PreviousInput "" FLOAT64_IEEE ADAS_CM_double 0 0 -1.7E+308 1.7E+308 ECU_ADDRESS 0x0000 /* @ECU_Address@rtDW_ADAS.GTCVW_OneSide_solver_h.GTRightSwitchCaseActionSubsys_o.GTMemory1_PreviousInput@ */ /end MEASUREMENT
/begin MEASUREMENT rtDW_ADAS.GTCVW_OneSide_solver_h.GTRightSwitchCaseActionSubsys_o.GTMemory_PreviousInput "" FLOAT32_IEEE ADAS_CM_single 0 0 -3.4E+38 3.4E+38 ECU_ADDRESS 0x0000 /* @ECU_Address@rtDW_ADAS.GTCVW_OneSide_solver_h.GTRightSwitchCaseActionSubsys_o.GTMemory_PreviousInput@ */ /end MEASUREMENT
/begin MEASUREMENT rtDW_ADAS.GTCVW_OneSide_solver_h.GTRightSwitchCaseActionSubsys_p.GTMemory1_PreviousInput "" FLOAT64_IEEE ADAS_CM_double 0 0 -1.7E+308 1.7E+308 ECU_ADDRESS 0x0000 /* @ECU_Address@rtDW_ADAS.GTCVW_OneSide_solver_h.GTRightSwitchCaseActionSubsys_p.GTMemory1_PreviousInput@ */ /end MEASUREMENT
/begin MEASUREMENT rtDW_ADAS.GTCVW_OneSide_solver_h.GTRightSwitchCaseActionSubsys_p.GTMemory_PreviousInput "" FLOAT32_IEEE ADAS_CM_single 0 0 -3.4E+38 3.4E+38 ECU_ADDRESS 0x0000 /* @ECU_Address@rtDW_ADAS.GTCVW_OneSide_solver_h.GTRightSwitchCaseActionSubsys_p.GTMemory_PreviousInput@ */ /end MEASUREMENT
/begin MEASUREMENT rtDW_ADAS.GTCVW_OneSide_solver_h.GTRightSwitchCaseActionSubsyste.GTMemory1_PreviousInput "" FLOAT64_IEEE ADAS_CM_double 0 0 -1.7E+308 1.7E+308 ECU_ADDRESS 0x0000 /* @ECU_Address@rtDW_ADAS.GTCVW_OneSide_solver_h.GTRightSwitchCaseActionSubsyste.GTMemory1_PreviousInput@ */ /end MEASUREMENT
/begin MEASUREMENT rtDW_ADAS.GTCVW_OneSide_solver_h.GTRightSwitchCaseActionSubsyste.GTMemory_PreviousInput "" FLOAT32_IEEE ADAS_CM_single 0 0 -3.4E+38 3.4E+38 ECU_ADDRESS 0x0000 /* @ECU_Address@rtDW_ADAS.GTCVW_OneSide_solver_h.GTRightSwitchCaseActionSubsyste.GTMemory_PreviousInput@ */ /end MEASUREMENT
/begin MEASUREMENT rtDW_ADAS.GTCVW_OneSide_solver_h.GTSideFarObjinmarklinecoordsys.GTObj13inmarklinecoordsys_MODE "" UBYTE ADAS_CM_logical 0 0 0 1 ECU_ADDRESS 0x0000 /* @ECU_Address@rtDW_ADAS.GTCVW_OneSide_solver_h.GTSideFarObjinmarklinecoordsys.GTObj13inmarklinecoordsys_MODE@ */ /end MEASUREMENT
/begin MEASUREMENT rtDW_ADAS.GTCVW_OneSide_solver_h.GTSideNearObjinmarklinecoordsys.GTObj13inmarklinecoordsys_MODE "" UBYTE ADAS_CM_logical 0 0 0 1 ECU_ADDRESS 0x0000 /* @ECU_Address@rtDW_ADAS.GTCVW_OneSide_solver_h.GTSideNearObjinmarklinecoordsys.GTObj13inmarklinecoordsys_MODE@ */ /end MEASUREMENT
/begin MEASUREMENT rtDW_ADAS.GTCVW_OneSide_solver_h.GTSideOppFarObjinmarklinecoords.GTObj13inmarklinecoordsys_MODE "" UBYTE ADAS_CM_logical 0 0 0 1 ECU_ADDRESS 0x0000 /* @ECU_Address@rtDW_ADAS.GTCVW_OneSide_solver_h.GTSideOppFarObjinmarklinecoords.GTObj13inmarklinecoordsys_MODE@ */ /end MEASUREMENT
/begin MEASUREMENT rtDW_ADAS.GTCVW_OneSide_solver_h.GTSideOppNearObjinmarklinecoord.GTObj13inmarklinecoordsys_MODE "" UBYTE ADAS_CM_logical 0 0 0 1 ECU_ADDRESS 0x0000 /* @ECU_Address@rtDW_ADAS.GTCVW_OneSide_solver_h.GTSideOppNearObjinmarklinecoord.GTObj13inmarklinecoordsys_MODE@ */ /end MEASUREMENT
/begin MEASUREMENT rtDW_ADAS.GTCVW_OneSide_solver_h.GThasPointProjOnMarkLineFlag "" FLOAT64_IEEE ADAS_CM_double 0 0 -1.7E+308 1.7E+308 ECU_ADDRESS 0x0000 /* @ECU_Address@rtDW_ADAS.GTCVW_OneSide_solver_h.GThasPointProjOnMarkLineFlag@ */ /end MEASUREMENT
/begin MEASUREMENT rtDW_ADAS.GTCVW_OneSide_solver_h.GThasPointProjOnMarkLineFlag_f "" FLOAT64_IEEE ADAS_CM_double 0 0 -1.7E+308 1.7E+308 ECU_ADDRESS 0x0000 /* @ECU_Address@rtDW_ADAS.GTCVW_OneSide_solver_h.GThasPointProjOnMarkLineFlag_f@ */ /end MEASUREMENT
/begin MEASUREMENT rtDW_ADAS.GTCVW_OneSide_solver_h.GThasPointProjOnMarkLineFlag_k "" FLOAT64_IEEE ADAS_CM_double 0 0 -1.7E+308 1.7E+308 ECU_ADDRESS 0x0000 /* @ECU_Address@rtDW_ADAS.GTCVW_OneSide_solver_h.GThasPointProjOnMarkLineFlag_k@ */ /end MEASUREMENT
/begin MEASUREMENT rtDW_ADAS.GTCVW_OneSide_solver_h.GThasPointProjOnMarkLineFlag_kw "" FLOAT64_IEEE ADAS_CM_double 0 0 -1.7E+308 1.7E+308 ECU_ADDRESS 0x0000 /* @ECU_Address@rtDW_ADAS.GTCVW_OneSide_solver_h.GThasPointProjOnMarkLineFlag_kw@ */ /end MEASUREMENT
/begin MEASUREMENT rtDW_ADAS.GTCVW_OneSide_solver_h.GThasPointProjOnMarkLineFlag_p "" FLOAT64_IEEE ADAS_CM_double 0 0 -1.7E+308 1.7E+308 ECU_ADDRESS 0x0000 /* @ECU_Address@rtDW_ADAS.GTCVW_OneSide_solver_h.GThasPointProjOnMarkLineFlag_p@ */ /end MEASUREMENT
/begin MEASUREMENT rtDW_ADAS.GTCVW_OneSide_solver_h.GTis_active_c148_ADAS "" UBYTE ADAS_CM_uint8 0 0 0 255 ECU_ADDRESS 0x0000 /* @ECU_Address@rtDW_ADAS.GTCVW_OneSide_solver_h.GTis_active_c148_ADAS@ */ /end MEASUREMENT
/begin MEASUREMENT rtDW_ADAS.GTCVW_OneSide_solver_h.GTis_active_c179_ADAS "" UBYTE ADAS_CM_uint8 0 0 0 255 ECU_ADDRESS 0x0000 /* @ECU_Address@rtDW_ADAS.GTCVW_OneSide_solver_h.GTis_active_c179_ADAS@ */ /end MEASUREMENT
/begin MEASUREMENT rtDW_ADAS.GTCVW_OneSide_solver_h.GTis_c148_ADAS "" UBYTE ADAS_CM_uint8 0 0 0 255 ECU_ADDRESS 0x0000 /* @ECU_Address@rtDW_ADAS.GTCVW_OneSide_solver_h.GTis_c148_ADAS@ */ /end MEASUREMENT
/begin MEASUREMENT rtDW_ADAS.GTCVW_OneSide_solver_h.GTis_c179_ADAS "" UBYTE ADAS_CM_uint8 0 0 0 255 ECU_ADDRESS 0x0000 /* @ECU_Address@rtDW_ADAS.GTCVW_OneSide_solver_h.GTis_c179_ADAS@ */ /end MEASUREMENT
/begin MEASUREMENT rtDW_ADAS.GTCVW_OneSide_solver_h.GTlast_et "" FLOAT64_IEEE ADAS_CM_double 0 0 -1.7E+308 1.7E+308 ECU_ADDRESS 0x0000 /* @ECU_Address@rtDW_ADAS.GTCVW_OneSide_solver_h.GTlast_et@ */ /end MEASUREMENT
/begin MEASUREMENT rtDW_ADAS.GTCVW_OneSide_solver_h.GTpath "" FLOAT64_IEEE ADAS_CM_double 0 0 -1.7E+308 1.7E+308 ECU_ADDRESS 0x0000 /* @ECU_Address@rtDW_ADAS.GTCVW_OneSide_solver_h.GTpath@ */ /end MEASUREMENT
/begin MEASUREMENT rtDW_ADAS.GTCVW_OneSide_solver_h.GTsum_segments_length "" FLOAT64_IEEE ADAS_CM_double 0 0 -1.7E+308 1.7E+308 ECU_ADDRESS 0x0000 /* @ECU_Address@rtDW_ADAS.GTCVW_OneSide_solver_h.GTsum_segments_length@ */ /end MEASUREMENT
/begin MEASUREMENT rtDW_ADAS.GTCVW_OneSide_solver_h.GTsum_segments_length_c "" FLOAT64_IEEE ADAS_CM_double 0 0 -1.7E+308 1.7E+308 ECU_ADDRESS 0x0000 /* @ECU_Address@rtDW_ADAS.GTCVW_OneSide_solver_h.GTsum_segments_length_c@ */ /end MEASUREMENT
/begin MEASUREMENT rtDW_ADAS.GTCVW_OneSide_solver_h.GTsum_segments_length_e "" FLOAT64_IEEE ADAS_CM_double 0 0 -1.7E+308 1.7E+308 ECU_ADDRESS 0x0000 /* @ECU_Address@rtDW_ADAS.GTCVW_OneSide_solver_h.GTsum_segments_length_e@ */ /end MEASUREMENT
/begin MEASUREMENT rtDW_ADAS.GTCVW_OneSide_solver_h.GTsum_segments_length_j "" FLOAT64_IEEE ADAS_CM_double 0 0 -1.7E+308 1.7E+308 ECU_ADDRESS 0x0000 /* @ECU_Address@rtDW_ADAS.GTCVW_OneSide_solver_h.GTsum_segments_length_j@ */ /end MEASUREMENT
/begin MEASUREMENT rtDW_ADAS.GTCVW_OneSide_solver_h.GTsum_segments_length_o "" FLOAT64_IEEE ADAS_CM_double 0 0 -1.7E+308 1.7E+308 ECU_ADDRESS 0x0000 /* @ECU_Address@rtDW_ADAS.GTCVW_OneSide_solver_h.GTsum_segments_length_o@ */ /end MEASUREMENT
/begin MEASUREMENT rtDW_ADAS.GTCVW_OneSide_solver_h.GTtemporalCounter_i1 "" ULONG ADAS_CM_uint32 0 0 0 4294967295 ECU_ADDRESS 0x0000 /* @ECU_Address@rtDW_ADAS.GTCVW_OneSide_solver_h.GTtemporalCounter_i1@ */ /end MEASUREMENT
/begin MEASUREMENT rtDW_ADAS.GTCalculatingdataoftheleader_MO "" UBYTE ADAS_CM_logical 0 0 0 1 ECU_ADDRESS 0x0000 /* @ECU_Address@rtDW_ADAS.GTCalculatingdataoftheleader_MO@ */ /end MEASUREMENT
/begin MEASUREMENT rtDW_ADAS.GTCollisionanalysis_MODE "" UBYTE ADAS_CM_logical 0 0 0 1 ECU_ADDRESS 0x0000 /* @ECU_Address@rtDW_ADAS.GTCollisionanalysis_MODE@ */ /end MEASUREMENT
/begin MEASUREMENT rtDW_ADAS.GTDOW_OneSide_solver.GTCastToBoolean2 "" FLOAT32_IEEE ADAS_CM_single 0 0 -3.4E+38 3.4E+38 LAYOUT COLUMN_DIR MATRIX_DIM 3 1 ECU_ADDRESS 0x0000 /* @ECU_Address@rtDW_ADAS.GTDOW_OneSide_solver.GTCastToBoolean2@ */ /end MEASUREMENT
/begin MEASUREMENT rtDW_ADAS.GTDOW_OneSide_solver.GTCastToBoolean2_d "" FLOAT32_IEEE ADAS_CM_single 0 0 -3.4E+38 3.4E+38 LAYOUT COLUMN_DIR MATRIX_DIM 3 1 ECU_ADDRESS 0x0000 /* @ECU_Address@rtDW_ADAS.GTDOW_OneSide_solver.GTCastToBoolean2_d@ */ /end MEASUREMENT
/begin MEASUREMENT rtDW_ADAS.GTDOW_OneSide_solver.GTCastToBoolean2_p "" FLOAT32_IEEE ADAS_CM_single 0 0 -3.4E+38 3.4E+38 LAYOUT COLUMN_DIR MATRIX_DIM 3 1 ECU_ADDRESS 0x0000 /* @ECU_Address@rtDW_ADAS.GTDOW_OneSide_solver.GTCastToBoolean2_p@ */ /end MEASUREMENT
/begin MEASUREMENT rtDW_ADAS.GTDOW_OneSide_solver.GTCastToBoolean2_p1 "" FLOAT32_IEEE ADAS_CM_single 0 0 -3.4E+38 3.4E+38 LAYOUT COLUMN_DIR MATRIX_DIM 3 1 ECU_ADDRESS 0x0000 /* @ECU_Address@rtDW_ADAS.GTDOW_OneSide_solver.GTCastToBoolean2_p1@ */ /end MEASUREMENT
/begin MEASUREMENT rtDW_ADAS.GTDOW_OneSide_solver.GTCastToBoolean2_po "" FLOAT32_IEEE ADAS_CM_single 0 0 -3.4E+38 3.4E+38 LAYOUT COLUMN_DIR MATRIX_DIM 3 1 ECU_ADDRESS 0x0000 /* @ECU_Address@rtDW_ADAS.GTDOW_OneSide_solver.GTCastToBoolean2_po@ */ /end MEASUREMENT
/begin MEASUREMENT rtDW_ADAS.GTDOW_OneSide_solver.GTDOW_OneSide_solver_MODE "" UBYTE ADAS_CM_logical 0 0 0 1 ECU_ADDRESS 0x0000 /* @ECU_Address@rtDW_ADAS.GTDOW_OneSide_solver.GTDOW_OneSide_solver_MODE@ */ /end MEASUREMENT
/begin MEASUREMENT rtDW_ADAS.GTDOW_OneSide_solver.GTLeftSwitchCaseActionSubsys_gg.GTMemory1_PreviousInput "" FLOAT64_IEEE ADAS_CM_double 0 0 -1.7E+308 1.7E+308 ECU_ADDRESS 0x0000 /* @ECU_Address@rtDW_ADAS.GTDOW_OneSide_solver.GTLeftSwitchCaseActionSubsys_gg.GTMemory1_PreviousInput@ */ /end MEASUREMENT
/begin MEASUREMENT rtDW_ADAS.GTDOW_OneSide_solver.GTLeftSwitchCaseActionSubsys_gg.GTMemory_PreviousInput "" FLOAT32_IEEE ADAS_CM_single 0 0 -3.4E+38 3.4E+38 ECU_ADDRESS 0x0000 /* @ECU_Address@rtDW_ADAS.GTDOW_OneSide_solver.GTLeftSwitchCaseActionSubsys_gg.GTMemory_PreviousInput@ */ /end MEASUREMENT
/begin MEASUREMENT rtDW_ADAS.GTDOW_OneSide_solver.GTLeftSwitchCaseActionSubsyst_a.GTMemory1_PreviousInput "" FLOAT64_IEEE ADAS_CM_double 0 0 -1.7E+308 1.7E+308 ECU_ADDRESS 0x0000 /* @ECU_Address@rtDW_ADAS.GTDOW_OneSide_solver.GTLeftSwitchCaseActionSubsyst_a.GTMemory1_PreviousInput@ */ /end MEASUREMENT
/begin MEASUREMENT rtDW_ADAS.GTDOW_OneSide_solver.GTLeftSwitchCaseActionSubsyst_a.GTMemory_PreviousInput "" FLOAT32_IEEE ADAS_CM_single 0 0 -3.4E+38 3.4E+38 ECU_ADDRESS 0x0000 /* @ECU_Address@rtDW_ADAS.GTDOW_OneSide_solver.GTLeftSwitchCaseActionSubsyst_a.GTMemory_PreviousInput@ */ /end MEASUREMENT
/begin MEASUREMENT rtDW_ADAS.GTDOW_OneSide_solver.GTLeftSwitchCaseActionSubsyst_e.GTMemory1_PreviousInput "" FLOAT64_IEEE ADAS_CM_double 0 0 -1.7E+308 1.7E+308 ECU_ADDRESS 0x0000 /* @ECU_Address@rtDW_ADAS.GTDOW_OneSide_solver.GTLeftSwitchCaseActionSubsyst_e.GTMemory1_PreviousInput@ */ /end MEASUREMENT
/begin MEASUREMENT rtDW_ADAS.GTDOW_OneSide_solver.GTLeftSwitchCaseActionSubsyst_e.GTMemory_PreviousInput "" FLOAT32_IEEE ADAS_CM_single 0 0 -3.4E+38 3.4E+38 ECU_ADDRESS 0x0000 /* @ECU_Address@rtDW_ADAS.GTDOW_OneSide_solver.GTLeftSwitchCaseActionSubsyst_e.GTMemory_PreviousInput@ */ /end MEASUREMENT
/begin MEASUREMENT rtDW_ADAS.GTDOW_OneSide_solver.GTLeftSwitchCaseActionSubsyst_f.GTMemory1_PreviousInput "" FLOAT64_IEEE ADAS_CM_double 0 0 -1.7E+308 1.7E+308 ECU_ADDRESS 0x0000 /* @ECU_Address@rtDW_ADAS.GTDOW_OneSide_solver.GTLeftSwitchCaseActionSubsyst_f.GTMemory1_PreviousInput@ */ /end MEASUREMENT
/begin MEASUREMENT rtDW_ADAS.GTDOW_OneSide_solver.GTLeftSwitchCaseActionSubsyst_f.GTMemory_PreviousInput "" FLOAT32_IEEE ADAS_CM_single 0 0 -3.4E+38 3.4E+38 ECU_ADDRESS 0x0000 /* @ECU_Address@rtDW_ADAS.GTDOW_OneSide_solver.GTLeftSwitchCaseActionSubsyst_f.GTMemory_PreviousInput@ */ /end MEASUREMENT
/begin MEASUREMENT rtDW_ADAS.GTDOW_OneSide_solver.GTLeftSwitchCaseActionSubsyst_g.GTMemory1_PreviousInput "" FLOAT64_IEEE ADAS_CM_double 0 0 -1.7E+308 1.7E+308 ECU_ADDRESS 0x0000 /* @ECU_Address@rtDW_ADAS.GTDOW_OneSide_solver.GTLeftSwitchCaseActionSubsyst_g.GTMemory1_PreviousInput@ */ /end MEASUREMENT
/begin MEASUREMENT rtDW_ADAS.GTDOW_OneSide_solver.GTLeftSwitchCaseActionSubsyst_g.GTMemory_PreviousInput "" FLOAT32_IEEE ADAS_CM_single 0 0 -3.4E+38 3.4E+38 ECU_ADDRESS 0x0000 /* @ECU_Address@rtDW_ADAS.GTDOW_OneSide_solver.GTLeftSwitchCaseActionSubsyst_g.GTMemory_PreviousInput@ */ /end MEASUREMENT
/begin MEASUREMENT rtDW_ADAS.GTDOW_OneSide_solver.GTLeftSwitchCaseActionSubsyst_j.GTMemory1_PreviousInput "" FLOAT64_IEEE ADAS_CM_double 0 0 -1.7E+308 1.7E+308 ECU_ADDRESS 0x0000 /* @ECU_Address@rtDW_ADAS.GTDOW_OneSide_solver.GTLeftSwitchCaseActionSubsyst_j.GTMemory1_PreviousInput@ */ /end MEASUREMENT
/begin MEASUREMENT rtDW_ADAS.GTDOW_OneSide_solver.GTLeftSwitchCaseActionSubsyst_j.GTMemory_PreviousInput "" FLOAT32_IEEE ADAS_CM_single 0 0 -3.4E+38 3.4E+38 ECU_ADDRESS 0x0000 /* @ECU_Address@rtDW_ADAS.GTDOW_OneSide_solver.GTLeftSwitchCaseActionSubsyst_j.GTMemory_PreviousInput@ */ /end MEASUREMENT
/begin MEASUREMENT rtDW_ADAS.GTDOW_OneSide_solver.GTLeftSwitchCaseActionSubsyst_n.GTMemory1_PreviousInput "" FLOAT64_IEEE ADAS_CM_double 0 0 -1.7E+308 1.7E+308 ECU_ADDRESS 0x0000 /* @ECU_Address@rtDW_ADAS.GTDOW_OneSide_solver.GTLeftSwitchCaseActionSubsyst_n.GTMemory1_PreviousInput@ */ /end MEASUREMENT
/begin MEASUREMENT rtDW_ADAS.GTDOW_OneSide_solver.GTLeftSwitchCaseActionSubsyst_n.GTMemory_PreviousInput "" FLOAT32_IEEE ADAS_CM_single 0 0 -3.4E+38 3.4E+38 ECU_ADDRESS 0x0000 /* @ECU_Address@rtDW_ADAS.GTDOW_OneSide_solver.GTLeftSwitchCaseActionSubsyst_n.GTMemory_PreviousInput@ */ /end MEASUREMENT
/begin MEASUREMENT rtDW_ADAS.GTDOW_OneSide_solver.GTLeftSwitchCaseActionSubsyst_o.GTMemory1_PreviousInput "" FLOAT64_IEEE ADAS_CM_double 0 0 -1.7E+308 1.7E+308 ECU_ADDRESS 0x0000 /* @ECU_Address@rtDW_ADAS.GTDOW_OneSide_solver.GTLeftSwitchCaseActionSubsyst_o.GTMemory1_PreviousInput@ */ /end MEASUREMENT
/begin MEASUREMENT rtDW_ADAS.GTDOW_OneSide_solver.GTLeftSwitchCaseActionSubsyst_o.GTMemory_PreviousInput "" FLOAT32_IEEE ADAS_CM_single 0 0 -3.4E+38 3.4E+38 ECU_ADDRESS 0x0000 /* @ECU_Address@rtDW_ADAS.GTDOW_OneSide_solver.GTLeftSwitchCaseActionSubsyst_o.GTMemory_PreviousInput@ */ /end MEASUREMENT
/begin MEASUREMENT rtDW_ADAS.GTDOW_OneSide_solver.GTLeftSwitchCaseActionSubsyst_p.GTMemory1_PreviousInput "" FLOAT64_IEEE ADAS_CM_double 0 0 -1.7E+308 1.7E+308 ECU_ADDRESS 0x0000 /* @ECU_Address@rtDW_ADAS.GTDOW_OneSide_solver.GTLeftSwitchCaseActionSubsyst_p.GTMemory1_PreviousInput@ */ /end MEASUREMENT
/begin MEASUREMENT rtDW_ADAS.GTDOW_OneSide_solver.GTLeftSwitchCaseActionSubsyst_p.GTMemory_PreviousInput "" FLOAT32_IEEE ADAS_CM_single 0 0 -3.4E+38 3.4E+38 ECU_ADDRESS 0x0000 /* @ECU_Address@rtDW_ADAS.GTDOW_OneSide_solver.GTLeftSwitchCaseActionSubsyst_p.GTMemory_PreviousInput@ */ /end MEASUREMENT
/begin MEASUREMENT rtDW_ADAS.GTDOW_OneSide_solver.GTLeftSwitchCaseActionSubsystem.GTMemory1_PreviousInput "" FLOAT64_IEEE ADAS_CM_double 0 0 -1.7E+308 1.7E+308 ECU_ADDRESS 0x0000 /* @ECU_Address@rtDW_ADAS.GTDOW_OneSide_solver.GTLeftSwitchCaseActionSubsystem.GTMemory1_PreviousInput@ */ /end MEASUREMENT
/begin MEASUREMENT rtDW_ADAS.GTDOW_OneSide_solver.GTLeftSwitchCaseActionSubsystem.GTMemory_PreviousInput "" FLOAT32_IEEE ADAS_CM_single 0 0 -3.4E+38 3.4E+38 ECU_ADDRESS 0x0000 /* @ECU_Address@rtDW_ADAS.GTDOW_OneSide_solver.GTLeftSwitchCaseActionSubsystem.GTMemory_PreviousInput@ */ /end MEASUREMENT
/begin MEASUREMENT rtDW_ADAS.GTDOW_OneSide_solver.GTMerge "" UBYTE ADAS_CM_logical 0 0 0 1 ECU_ADDRESS 0x0000 /* @ECU_Address@rtDW_ADAS.GTDOW_OneSide_solver.GTMerge@ */ /end MEASUREMENT
/begin MEASUREMENT rtDW_ADAS.GTDOW_OneSide_solver.GTMerge_a "" UBYTE ADAS_CM_logical 0 0 0 1 ECU_ADDRESS 0x0000 /* @ECU_Address@rtDW_ADAS.GTDOW_OneSide_solver.GTMerge_a@ */ /end MEASUREMENT
/begin MEASUREMENT rtDW_ADAS.GTDOW_OneSide_solver.GTMerge_c "" UBYTE ADAS_CM_logical 0 0 0 1 ECU_ADDRESS 0x0000 /* @ECU_Address@rtDW_ADAS.GTDOW_OneSide_solver.GTMerge_c@ */ /end MEASUREMENT
/begin MEASUREMENT rtDW_ADAS.GTDOW_OneSide_solver.GTMerge_f "" UBYTE ADAS_CM_logical 0 0 0 1 ECU_ADDRESS 0x0000 /* @ECU_Address@rtDW_ADAS.GTDOW_OneSide_solver.GTMerge_f@ */ /end MEASUREMENT
/begin MEASUREMENT rtDW_ADAS.GTDOW_OneSide_solver.GTMerge_h "" UBYTE ADAS_CM_logical 0 0 0 1 ECU_ADDRESS 0x0000 /* @ECU_Address@rtDW_ADAS.GTDOW_OneSide_solver.GTMerge_h@ */ /end MEASUREMENT
/begin MEASUREMENT rtDW_ADAS.GTDOW_OneSide_solver.GTMerge_k "" UBYTE ADAS_CM_logical 0 0 0 1 ECU_ADDRESS 0x0000 /* @ECU_Address@rtDW_ADAS.GTDOW_OneSide_solver.GTMerge_k@ */ /end MEASUREMENT
/begin MEASUREMENT rtDW_ADAS.GTDOW_OneSide_solver.GTMerge_m "" UBYTE ADAS_CM_logical 0 0 0 1 ECU_ADDRESS 0x0000 /* @ECU_Address@rtDW_ADAS.GTDOW_OneSide_solver.GTMerge_m@ */ /end MEASUREMENT
/begin MEASUREMENT rtDW_ADAS.GTDOW_OneSide_solver.GTMerge_o "" UBYTE ADAS_CM_logical 0 0 0 1 ECU_ADDRESS 0x0000 /* @ECU_Address@rtDW_ADAS.GTDOW_OneSide_solver.GTMerge_o@ */ /end MEASUREMENT
/begin MEASUREMENT rtDW_ADAS.GTDOW_OneSide_solver.GTMerge_od "" UBYTE ADAS_CM_logical 0 0 0 1 ECU_ADDRESS 0x0000 /* @ECU_Address@rtDW_ADAS.GTDOW_OneSide_solver.GTMerge_od@ */ /end MEASUREMENT
/begin MEASUREMENT rtDW_ADAS.GTDOW_OneSide_solver.GTMerge_ou "" UBYTE ADAS_CM_logical 0 0 0 1 ECU_ADDRESS 0x0000 /* @ECU_Address@rtDW_ADAS.GTDOW_OneSide_solver.GTMerge_ou@ */ /end MEASUREMENT
/begin MEASUREMENT rtDW_ADAS.GTDOW_OneSide_solver.GTObj13inmarklinecoordsys.GTObj13inmarklinecoordsys_MODE "" UBYTE ADAS_CM_logical 0 0 0 1 ECU_ADDRESS 0x0000 /* @ECU_Address@rtDW_ADAS.GTDOW_OneSide_solver.GTObj13inmarklinecoordsys.GTObj13inmarklinecoordsys_MODE@ */ /end MEASUREMENT
/begin MEASUREMENT rtDW_ADAS.GTDOW_OneSide_solver.GTOppSideFarObjinmarklinecoords.GTObj13inmarklinecoordsys_MODE "" UBYTE ADAS_CM_logical 0 0 0 1 ECU_ADDRESS 0x0000 /* @ECU_Address@rtDW_ADAS.GTDOW_OneSide_solver.GTOppSideFarObjinmarklinecoords.GTObj13inmarklinecoordsys_MODE@ */ /end MEASUREMENT
/begin MEASUREMENT rtDW_ADAS.GTDOW_OneSide_solver.GTOppSideNearObjinmarklinecoord.GTObj13inmarklinecoordsys_MODE "" UBYTE ADAS_CM_logical 0 0 0 1 ECU_ADDRESS 0x0000 /* @ECU_Address@rtDW_ADAS.GTDOW_OneSide_solver.GTOppSideNearObjinmarklinecoord.GTObj13inmarklinecoordsys_MODE@ */ /end MEASUREMENT
/begin MEASUREMENT rtDW_ADAS.GTDOW_OneSide_solver.GTRightSwitchCaseActionSubsy_fj.GTMemory1_PreviousInput "" FLOAT64_IEEE ADAS_CM_double 0 0 -1.7E+308 1.7E+308 ECU_ADDRESS 0x0000 /* @ECU_Address@rtDW_ADAS.GTDOW_OneSide_solver.GTRightSwitchCaseActionSubsy_fj.GTMemory1_PreviousInput@ */ /end MEASUREMENT
/begin MEASUREMENT rtDW_ADAS.GTDOW_OneSide_solver.GTRightSwitchCaseActionSubsy_fj.GTMemory_PreviousInput "" FLOAT32_IEEE ADAS_CM_single 0 0 -3.4E+38 3.4E+38 ECU_ADDRESS 0x0000 /* @ECU_Address@rtDW_ADAS.GTDOW_OneSide_solver.GTRightSwitchCaseActionSubsy_fj.GTMemory_PreviousInput@ */ /end MEASUREMENT
/begin MEASUREMENT rtDW_ADAS.GTDOW_OneSide_solver.GTRightSwitchCaseActionSubsy_fo.GTMemory1_PreviousInput "" FLOAT64_IEEE ADAS_CM_double 0 0 -1.7E+308 1.7E+308 ECU_ADDRESS 0x0000 /* @ECU_Address@rtDW_ADAS.GTDOW_OneSide_solver.GTRightSwitchCaseActionSubsy_fo.GTMemory1_PreviousInput@ */ /end MEASUREMENT
/begin MEASUREMENT rtDW_ADAS.GTDOW_OneSide_solver.GTRightSwitchCaseActionSubsy_fo.GTMemory_PreviousInput "" FLOAT32_IEEE ADAS_CM_single 0 0 -3.4E+38 3.4E+38 ECU_ADDRESS 0x0000 /* @ECU_Address@rtDW_ADAS.GTDOW_OneSide_solver.GTRightSwitchCaseActionSubsy_fo.GTMemory_PreviousInput@ */ /end MEASUREMENT
/begin MEASUREMENT rtDW_ADAS.GTDOW_OneSide_solver.GTRightSwitchCaseActionSubsy_gt.GTMemory1_PreviousInput "" FLOAT64_IEEE ADAS_CM_double 0 0 -1.7E+308 1.7E+308 ECU_ADDRESS 0x0000 /* @ECU_Address@rtDW_ADAS.GTDOW_OneSide_solver.GTRightSwitchCaseActionSubsy_gt.GTMemory1_PreviousInput@ */ /end MEASUREMENT
/begin MEASUREMENT rtDW_ADAS.GTDOW_OneSide_solver.GTRightSwitchCaseActionSubsy_gt.GTMemory_PreviousInput "" FLOAT32_IEEE ADAS_CM_single 0 0 -3.4E+38 3.4E+38 ECU_ADDRESS 0x0000 /* @ECU_Address@rtDW_ADAS.GTDOW_OneSide_solver.GTRightSwitchCaseActionSubsy_gt.GTMemory_PreviousInput@ */ /end MEASUREMENT
/begin MEASUREMENT rtDW_ADAS.GTDOW_OneSide_solver.GTRightSwitchCaseActionSubsys_f.GTMemory1_PreviousInput "" FLOAT64_IEEE ADAS_CM_double 0 0 -1.7E+308 1.7E+308 ECU_ADDRESS 0x0000 /* @ECU_Address@rtDW_ADAS.GTDOW_OneSide_solver.GTRightSwitchCaseActionSubsys_f.GTMemory1_PreviousInput@ */ /end MEASUREMENT
/begin MEASUREMENT rtDW_ADAS.GTDOW_OneSide_solver.GTRightSwitchCaseActionSubsys_f.GTMemory_PreviousInput "" FLOAT32_IEEE ADAS_CM_single 0 0 -3.4E+38 3.4E+38 ECU_ADDRESS 0x0000 /* @ECU_Address@rtDW_ADAS.GTDOW_OneSide_solver.GTRightSwitchCaseActionSubsys_f.GTMemory_PreviousInput@ */ /end MEASUREMENT
/begin MEASUREMENT rtDW_ADAS.GTDOW_OneSide_solver.GTRightSwitchCaseActionSubsys_g.GTMemory1_PreviousInput "" FLOAT64_IEEE ADAS_CM_double 0 0 -1.7E+308 1.7E+308 ECU_ADDRESS 0x0000 /* @ECU_Address@rtDW_ADAS.GTDOW_OneSide_solver.GTRightSwitchCaseActionSubsys_g.GTMemory1_PreviousInput@ */ /end MEASUREMENT
/begin MEASUREMENT rtDW_ADAS.GTDOW_OneSide_solver.GTRightSwitchCaseActionSubsys_g.GTMemory_PreviousInput "" FLOAT32_IEEE ADAS_CM_single 0 0 -3.4E+38 3.4E+38 ECU_ADDRESS 0x0000 /* @ECU_Address@rtDW_ADAS.GTDOW_OneSide_solver.GTRightSwitchCaseActionSubsys_g.GTMemory_PreviousInput@ */ /end MEASUREMENT
/begin MEASUREMENT rtDW_ADAS.GTDOW_OneSide_solver.GTRightSwitchCaseActionSubsys_h.GTMemory1_PreviousInput "" FLOAT64_IEEE ADAS_CM_double 0 0 -1.7E+308 1.7E+308 ECU_ADDRESS 0x0000 /* @ECU_Address@rtDW_ADAS.GTDOW_OneSide_solver.GTRightSwitchCaseActionSubsys_h.GTMemory1_PreviousInput@ */ /end MEASUREMENT
/begin MEASUREMENT rtDW_ADAS.GTDOW_OneSide_solver.GTRightSwitchCaseActionSubsys_h.GTMemory_PreviousInput "" FLOAT32_IEEE ADAS_CM_single 0 0 -3.4E+38 3.4E+38 ECU_ADDRESS 0x0000 /* @ECU_Address@rtDW_ADAS.GTDOW_OneSide_solver.GTRightSwitchCaseActionSubsys_h.GTMemory_PreviousInput@ */ /end MEASUREMENT
/begin MEASUREMENT rtDW_ADAS.GTDOW_OneSide_solver.GTRightSwitchCaseActionSubsys_j.GTMemory1_PreviousInput "" FLOAT64_IEEE ADAS_CM_double 0 0 -1.7E+308 1.7E+308 ECU_ADDRESS 0x0000 /* @ECU_Address@rtDW_ADAS.GTDOW_OneSide_solver.GTRightSwitchCaseActionSubsys_j.GTMemory1_PreviousInput@ */ /end MEASUREMENT
/begin MEASUREMENT rtDW_ADAS.GTDOW_OneSide_solver.GTRightSwitchCaseActionSubsys_j.GTMemory_PreviousInput "" FLOAT32_IEEE ADAS_CM_single 0 0 -3.4E+38 3.4E+38 ECU_ADDRESS 0x0000 /* @ECU_Address@rtDW_ADAS.GTDOW_OneSide_solver.GTRightSwitchCaseActionSubsys_j.GTMemory_PreviousInput@ */ /end MEASUREMENT
/begin MEASUREMENT rtDW_ADAS.GTDOW_OneSide_solver.GTRightSwitchCaseActionSubsys_m.GTMemory1_PreviousInput "" FLOAT64_IEEE ADAS_CM_double 0 0 -1.7E+308 1.7E+308 ECU_ADDRESS 0x0000 /* @ECU_Address@rtDW_ADAS.GTDOW_OneSide_solver.GTRightSwitchCaseActionSubsys_m.GTMemory1_PreviousInput@ */ /end MEASUREMENT
/begin MEASUREMENT rtDW_ADAS.GTDOW_OneSide_solver.GTRightSwitchCaseActionSubsys_m.GTMemory_PreviousInput "" FLOAT32_IEEE ADAS_CM_single 0 0 -3.4E+38 3.4E+38 ECU_ADDRESS 0x0000 /* @ECU_Address@rtDW_ADAS.GTDOW_OneSide_solver.GTRightSwitchCaseActionSubsys_m.GTMemory_PreviousInput@ */ /end MEASUREMENT
/begin MEASUREMENT rtDW_ADAS.GTDOW_OneSide_solver.GTRightSwitchCaseActionSubsys_o.GTMemory1_PreviousInput "" FLOAT64_IEEE ADAS_CM_double 0 0 -1.7E+308 1.7E+308 ECU_ADDRESS 0x0000 /* @ECU_Address@rtDW_ADAS.GTDOW_OneSide_solver.GTRightSwitchCaseActionSubsys_o.GTMemory1_PreviousInput@ */ /end MEASUREMENT
/begin MEASUREMENT rtDW_ADAS.GTDOW_OneSide_solver.GTRightSwitchCaseActionSubsys_o.GTMemory_PreviousInput "" FLOAT32_IEEE ADAS_CM_single 0 0 -3.4E+38 3.4E+38 ECU_ADDRESS 0x0000 /* @ECU_Address@rtDW_ADAS.GTDOW_OneSide_solver.GTRightSwitchCaseActionSubsys_o.GTMemory_PreviousInput@ */ /end MEASUREMENT
/begin MEASUREMENT rtDW_ADAS.GTDOW_OneSide_solver.GTRightSwitchCaseActionSubsyste.GTMemory1_PreviousInput "" FLOAT64_IEEE ADAS_CM_double 0 0 -1.7E+308 1.7E+308 ECU_ADDRESS 0x0000 /* @ECU_Address@rtDW_ADAS.GTDOW_OneSide_solver.GTRightSwitchCaseActionSubsyste.GTMemory1_PreviousInput@ */ /end MEASUREMENT
/begin MEASUREMENT rtDW_ADAS.GTDOW_OneSide_solver.GTRightSwitchCaseActionSubsyste.GTMemory_PreviousInput "" FLOAT32_IEEE ADAS_CM_single 0 0 -3.4E+38 3.4E+38 ECU_ADDRESS 0x0000 /* @ECU_Address@rtDW_ADAS.GTDOW_OneSide_solver.GTRightSwitchCaseActionSubsyste.GTMemory_PreviousInput@ */ /end MEASUREMENT
/begin MEASUREMENT rtDW_ADAS.GTDOW_OneSide_solver.GTSideFarObjinmarklinecoordsys.GTObj13inmarklinecoordsys_MODE "" UBYTE ADAS_CM_logical 0 0 0 1 ECU_ADDRESS 0x0000 /* @ECU_Address@rtDW_ADAS.GTDOW_OneSide_solver.GTSideFarObjinmarklinecoordsys.GTObj13inmarklinecoordsys_MODE@ */ /end MEASUREMENT
/begin MEASUREMENT rtDW_ADAS.GTDOW_OneSide_solver.GTSideNearObjinmarklinecoordsys.GTObj13inmarklinecoordsys_MODE "" UBYTE ADAS_CM_logical 0 0 0 1 ECU_ADDRESS 0x0000 /* @ECU_Address@rtDW_ADAS.GTDOW_OneSide_solver.GTSideNearObjinmarklinecoordsys.GTObj13inmarklinecoordsys_MODE@ */ /end MEASUREMENT
/begin MEASUREMENT rtDW_ADAS.GTDOW_OneSide_solver.GThasPointProjOnMarkLineFlag "" FLOAT64_IEEE ADAS_CM_double 0 0 -1.7E+308 1.7E+308 ECU_ADDRESS 0x0000 /* @ECU_Address@rtDW_ADAS.GTDOW_OneSide_solver.GThasPointProjOnMarkLineFlag@ */ /end MEASUREMENT
/begin MEASUREMENT rtDW_ADAS.GTDOW_OneSide_solver.GThasPointProjOnMarkLineFlag_c "" FLOAT64_IEEE ADAS_CM_double 0 0 -1.7E+308 1.7E+308 ECU_ADDRESS 0x0000 /* @ECU_Address@rtDW_ADAS.GTDOW_OneSide_solver.GThasPointProjOnMarkLineFlag_c@ */ /end MEASUREMENT
/begin MEASUREMENT rtDW_ADAS.GTDOW_OneSide_solver.GThasPointProjOnMarkLineFlag_m "" FLOAT64_IEEE ADAS_CM_double 0 0 -1.7E+308 1.7E+308 ECU_ADDRESS 0x0000 /* @ECU_Address@rtDW_ADAS.GTDOW_OneSide_solver.GThasPointProjOnMarkLineFlag_m@ */ /end MEASUREMENT
/begin MEASUREMENT rtDW_ADAS.GTDOW_OneSide_solver.GThasPointProjOnMarkLineFlag_ma "" FLOAT64_IEEE ADAS_CM_double 0 0 -1.7E+308 1.7E+308 ECU_ADDRESS 0x0000 /* @ECU_Address@rtDW_ADAS.GTDOW_OneSide_solver.GThasPointProjOnMarkLineFlag_ma@ */ /end MEASUREMENT
/begin MEASUREMENT rtDW_ADAS.GTDOW_OneSide_solver.GThasPointProjOnMarkLineFlag_n "" FLOAT64_IEEE ADAS_CM_double 0 0 -1.7E+308 1.7E+308 ECU_ADDRESS 0x0000 /* @ECU_Address@rtDW_ADAS.GTDOW_OneSide_solver.GThasPointProjOnMarkLineFlag_n@ */ /end MEASUREMENT
/begin MEASUREMENT rtDW_ADAS.GTDOW_OneSide_solver.GTsum_segments_length "" FLOAT64_IEEE ADAS_CM_double 0 0 -1.7E+308 1.7E+308 ECU_ADDRESS 0x0000 /* @ECU_Address@rtDW_ADAS.GTDOW_OneSide_solver.GTsum_segments_length@ */ /end MEASUREMENT
/begin MEASUREMENT rtDW_ADAS.GTDOW_OneSide_solver.GTsum_segments_length_h "" FLOAT64_IEEE ADAS_CM_double 0 0 -1.7E+308 1.7E+308 ECU_ADDRESS 0x0000 /* @ECU_Address@rtDW_ADAS.GTDOW_OneSide_solver.GTsum_segments_length_h@ */ /end MEASUREMENT
/begin MEASUREMENT rtDW_ADAS.GTDOW_OneSide_solver.GTsum_segments_length_k "" FLOAT64_IEEE ADAS_CM_double 0 0 -1.7E+308 1.7E+308 ECU_ADDRESS 0x0000 /* @ECU_Address@rtDW_ADAS.GTDOW_OneSide_solver.GTsum_segments_length_k@ */ /end MEASUREMENT
/begin MEASUREMENT rtDW_ADAS.GTDOW_OneSide_solver.GTsum_segments_length_o "" FLOAT64_IEEE ADAS_CM_double 0 0 -1.7E+308 1.7E+308 ECU_ADDRESS 0x0000 /* @ECU_Address@rtDW_ADAS.GTDOW_OneSide_solver.GTsum_segments_length_o@ */ /end MEASUREMENT
/begin MEASUREMENT rtDW_ADAS.GTDOW_OneSide_solver.GTsum_segments_length_ou "" FLOAT64_IEEE ADAS_CM_double 0 0 -1.7E+308 1.7E+308 ECU_ADDRESS 0x0000 /* @ECU_Address@rtDW_ADAS.GTDOW_OneSide_solver.GTsum_segments_length_ou@ */ /end MEASUREMENT
/begin MEASUREMENT rtDW_ADAS.GTDOW_OneSide_solver_c.GTCastToBoolean2 "" FLOAT32_IEEE ADAS_CM_single 0 0 -3.4E+38 3.4E+38 LAYOUT COLUMN_DIR MATRIX_DIM 3 1 ECU_ADDRESS 0x0000 /* @ECU_Address@rtDW_ADAS.GTDOW_OneSide_solver_c.GTCastToBoolean2@ */ /end MEASUREMENT
/begin MEASUREMENT rtDW_ADAS.GTDOW_OneSide_solver_c.GTCastToBoolean2_d "" FLOAT32_IEEE ADAS_CM_single 0 0 -3.4E+38 3.4E+38 LAYOUT COLUMN_DIR MATRIX_DIM 3 1 ECU_ADDRESS 0x0000 /* @ECU_Address@rtDW_ADAS.GTDOW_OneSide_solver_c.GTCastToBoolean2_d@ */ /end MEASUREMENT
/begin MEASUREMENT rtDW_ADAS.GTDOW_OneSide_solver_c.GTCastToBoolean2_p "" FLOAT32_IEEE ADAS_CM_single 0 0 -3.4E+38 3.4E+38 LAYOUT COLUMN_DIR MATRIX_DIM 3 1 ECU_ADDRESS 0x0000 /* @ECU_Address@rtDW_ADAS.GTDOW_OneSide_solver_c.GTCastToBoolean2_p@ */ /end MEASUREMENT
/begin MEASUREMENT rtDW_ADAS.GTDOW_OneSide_solver_c.GTCastToBoolean2_p1 "" FLOAT32_IEEE ADAS_CM_single 0 0 -3.4E+38 3.4E+38 LAYOUT COLUMN_DIR MATRIX_DIM 3 1 ECU_ADDRESS 0x0000 /* @ECU_Address@rtDW_ADAS.GTDOW_OneSide_solver_c.GTCastToBoolean2_p1@ */ /end MEASUREMENT
/begin MEASUREMENT rtDW_ADAS.GTDOW_OneSide_solver_c.GTCastToBoolean2_po "" FLOAT32_IEEE ADAS_CM_single 0 0 -3.4E+38 3.4E+38 LAYOUT COLUMN_DIR MATRIX_DIM 3 1 ECU_ADDRESS 0x0000 /* @ECU_Address@rtDW_ADAS.GTDOW_OneSide_solver_c.GTCastToBoolean2_po@ */ /end MEASUREMENT
/begin MEASUREMENT rtDW_ADAS.GTDOW_OneSide_solver_c.GTDOW_OneSide_solver_MODE "" UBYTE ADAS_CM_logical 0 0 0 1 ECU_ADDRESS 0x0000 /* @ECU_Address@rtDW_ADAS.GTDOW_OneSide_solver_c.GTDOW_OneSide_solver_MODE@ */ /end MEASUREMENT
/begin MEASUREMENT rtDW_ADAS.GTDOW_OneSide_solver_c.GTLeftSwitchCaseActionSubsys_gg.GTMemory1_PreviousInput "" FLOAT64_IEEE ADAS_CM_double 0 0 -1.7E+308 1.7E+308 ECU_ADDRESS 0x0000 /* @ECU_Address@rtDW_ADAS.GTDOW_OneSide_solver_c.GTLeftSwitchCaseActionSubsys_gg.GTMemory1_PreviousInput@ */ /end MEASUREMENT
/begin MEASUREMENT rtDW_ADAS.GTDOW_OneSide_solver_c.GTLeftSwitchCaseActionSubsys_gg.GTMemory_PreviousInput "" FLOAT32_IEEE ADAS_CM_single 0 0 -3.4E+38 3.4E+38 ECU_ADDRESS 0x0000 /* @ECU_Address@rtDW_ADAS.GTDOW_OneSide_solver_c.GTLeftSwitchCaseActionSubsys_gg.GTMemory_PreviousInput@ */ /end MEASUREMENT
/begin MEASUREMENT rtDW_ADAS.GTDOW_OneSide_solver_c.GTLeftSwitchCaseActionSubsyst_a.GTMemory1_PreviousInput "" FLOAT64_IEEE ADAS_CM_double 0 0 -1.7E+308 1.7E+308 ECU_ADDRESS 0x0000 /* @ECU_Address@rtDW_ADAS.GTDOW_OneSide_solver_c.GTLeftSwitchCaseActionSubsyst_a.GTMemory1_PreviousInput@ */ /end MEASUREMENT
/begin MEASUREMENT rtDW_ADAS.GTDOW_OneSide_solver_c.GTLeftSwitchCaseActionSubsyst_a.GTMemory_PreviousInput "" FLOAT32_IEEE ADAS_CM_single 0 0 -3.4E+38 3.4E+38 ECU_ADDRESS 0x0000 /* @ECU_Address@rtDW_ADAS.GTDOW_OneSide_solver_c.GTLeftSwitchCaseActionSubsyst_a.GTMemory_PreviousInput@ */ /end MEASUREMENT
/begin MEASUREMENT rtDW_ADAS.GTDOW_OneSide_solver_c.GTLeftSwitchCaseActionSubsyst_e.GTMemory1_PreviousInput "" FLOAT64_IEEE ADAS_CM_double 0 0 -1.7E+308 1.7E+308 ECU_ADDRESS 0x0000 /* @ECU_Address@rtDW_ADAS.GTDOW_OneSide_solver_c.GTLeftSwitchCaseActionSubsyst_e.GTMemory1_PreviousInput@ */ /end MEASUREMENT
/begin MEASUREMENT rtDW_ADAS.GTDOW_OneSide_solver_c.GTLeftSwitchCaseActionSubsyst_e.GTMemory_PreviousInput "" FLOAT32_IEEE ADAS_CM_single 0 0 -3.4E+38 3.4E+38 ECU_ADDRESS 0x0000 /* @ECU_Address@rtDW_ADAS.GTDOW_OneSide_solver_c.GTLeftSwitchCaseActionSubsyst_e.GTMemory_PreviousInput@ */ /end MEASUREMENT
/begin MEASUREMENT rtDW_ADAS.GTDOW_OneSide_solver_c.GTLeftSwitchCaseActionSubsyst_f.GTMemory1_PreviousInput "" FLOAT64_IEEE ADAS_CM_double 0 0 -1.7E+308 1.7E+308 ECU_ADDRESS 0x0000 /* @ECU_Address@rtDW_ADAS.GTDOW_OneSide_solver_c.GTLeftSwitchCaseActionSubsyst_f.GTMemory1_PreviousInput@ */ /end MEASUREMENT
/begin MEASUREMENT rtDW_ADAS.GTDOW_OneSide_solver_c.GTLeftSwitchCaseActionSubsyst_f.GTMemory_PreviousInput "" FLOAT32_IEEE ADAS_CM_single 0 0 -3.4E+38 3.4E+38 ECU_ADDRESS 0x0000 /* @ECU_Address@rtDW_ADAS.GTDOW_OneSide_solver_c.GTLeftSwitchCaseActionSubsyst_f.GTMemory_PreviousInput@ */ /end MEASUREMENT
/begin MEASUREMENT rtDW_ADAS.GTDOW_OneSide_solver_c.GTLeftSwitchCaseActionSubsyst_g.GTMemory1_PreviousInput "" FLOAT64_IEEE ADAS_CM_double 0 0 -1.7E+308 1.7E+308 ECU_ADDRESS 0x0000 /* @ECU_Address@rtDW_ADAS.GTDOW_OneSide_solver_c.GTLeftSwitchCaseActionSubsyst_g.GTMemory1_PreviousInput@ */ /end MEASUREMENT
/begin MEASUREMENT rtDW_ADAS.GTDOW_OneSide_solver_c.GTLeftSwitchCaseActionSubsyst_g.GTMemory_PreviousInput "" FLOAT32_IEEE ADAS_CM_single 0 0 -3.4E+38 3.4E+38 ECU_ADDRESS 0x0000 /* @ECU_Address@rtDW_ADAS.GTDOW_OneSide_solver_c.GTLeftSwitchCaseActionSubsyst_g.GTMemory_PreviousInput@ */ /end MEASUREMENT
/begin MEASUREMENT rtDW_ADAS.GTDOW_OneSide_solver_c.GTLeftSwitchCaseActionSubsyst_j.GTMemory1_PreviousInput "" FLOAT64_IEEE ADAS_CM_double 0 0 -1.7E+308 1.7E+308 ECU_ADDRESS 0x0000 /* @ECU_Address@rtDW_ADAS.GTDOW_OneSide_solver_c.GTLeftSwitchCaseActionSubsyst_j.GTMemory1_PreviousInput@ */ /end MEASUREMENT
/begin MEASUREMENT rtDW_ADAS.GTDOW_OneSide_solver_c.GTLeftSwitchCaseActionSubsyst_j.GTMemory_PreviousInput "" FLOAT32_IEEE ADAS_CM_single 0 0 -3.4E+38 3.4E+38 ECU_ADDRESS 0x0000 /* @ECU_Address@rtDW_ADAS.GTDOW_OneSide_solver_c.GTLeftSwitchCaseActionSubsyst_j.GTMemory_PreviousInput@ */ /end MEASUREMENT
/begin MEASUREMENT rtDW_ADAS.GTDOW_OneSide_solver_c.GTLeftSwitchCaseActionSubsyst_n.GTMemory1_PreviousInput "" FLOAT64_IEEE ADAS_CM_double 0 0 -1.7E+308 1.7E+308 ECU_ADDRESS 0x0000 /* @ECU_Address@rtDW_ADAS.GTDOW_OneSide_solver_c.GTLeftSwitchCaseActionSubsyst_n.GTMemory1_PreviousInput@ */ /end MEASUREMENT
/begin MEASUREMENT rtDW_ADAS.GTDOW_OneSide_solver_c.GTLeftSwitchCaseActionSubsyst_n.GTMemory_PreviousInput "" FLOAT32_IEEE ADAS_CM_single 0 0 -3.4E+38 3.4E+38 ECU_ADDRESS 0x0000 /* @ECU_Address@rtDW_ADAS.GTDOW_OneSide_solver_c.GTLeftSwitchCaseActionSubsyst_n.GTMemory_PreviousInput@ */ /end MEASUREMENT
/begin MEASUREMENT rtDW_ADAS.GTDOW_OneSide_solver_c.GTLeftSwitchCaseActionSubsyst_o.GTMemory1_PreviousInput "" FLOAT64_IEEE ADAS_CM_double 0 0 -1.7E+308 1.7E+308 ECU_ADDRESS 0x0000 /* @ECU_Address@rtDW_ADAS.GTDOW_OneSide_solver_c.GTLeftSwitchCaseActionSubsyst_o.GTMemory1_PreviousInput@ */ /end MEASUREMENT
/begin MEASUREMENT rtDW_ADAS.GTDOW_OneSide_solver_c.GTLeftSwitchCaseActionSubsyst_o.GTMemory_PreviousInput "" FLOAT32_IEEE ADAS_CM_single 0 0 -3.4E+38 3.4E+38 ECU_ADDRESS 0x0000 /* @ECU_Address@rtDW_ADAS.GTDOW_OneSide_solver_c.GTLeftSwitchCaseActionSubsyst_o.GTMemory_PreviousInput@ */ /end MEASUREMENT
/begin MEASUREMENT rtDW_ADAS.GTDOW_OneSide_solver_c.GTLeftSwitchCaseActionSubsyst_p.GTMemory1_PreviousInput "" FLOAT64_IEEE ADAS_CM_double 0 0 -1.7E+308 1.7E+308 ECU_ADDRESS 0x0000 /* @ECU_Address@rtDW_ADAS.GTDOW_OneSide_solver_c.GTLeftSwitchCaseActionSubsyst_p.GTMemory1_PreviousInput@ */ /end MEASUREMENT
/begin MEASUREMENT rtDW_ADAS.GTDOW_OneSide_solver_c.GTLeftSwitchCaseActionSubsyst_p.GTMemory_PreviousInput "" FLOAT32_IEEE ADAS_CM_single 0 0 -3.4E+38 3.4E+38 ECU_ADDRESS 0x0000 /* @ECU_Address@rtDW_ADAS.GTDOW_OneSide_solver_c.GTLeftSwitchCaseActionSubsyst_p.GTMemory_PreviousInput@ */ /end MEASUREMENT
/begin MEASUREMENT rtDW_ADAS.GTDOW_OneSide_solver_c.GTLeftSwitchCaseActionSubsystem.GTMemory1_PreviousInput "" FLOAT64_IEEE ADAS_CM_double 0 0 -1.7E+308 1.7E+308 ECU_ADDRESS 0x0000 /* @ECU_Address@rtDW_ADAS.GTDOW_OneSide_solver_c.GTLeftSwitchCaseActionSubsystem.GTMemory1_PreviousInput@ */ /end MEASUREMENT
/begin MEASUREMENT rtDW_ADAS.GTDOW_OneSide_solver_c.GTLeftSwitchCaseActionSubsystem.GTMemory_PreviousInput "" FLOAT32_IEEE ADAS_CM_single 0 0 -3.4E+38 3.4E+38 ECU_ADDRESS 0x0000 /* @ECU_Address@rtDW_ADAS.GTDOW_OneSide_solver_c.GTLeftSwitchCaseActionSubsystem.GTMemory_PreviousInput@ */ /end MEASUREMENT
/begin MEASUREMENT rtDW_ADAS.GTDOW_OneSide_solver_c.GTMerge "" UBYTE ADAS_CM_logical 0 0 0 1 ECU_ADDRESS 0x0000 /* @ECU_Address@rtDW_ADAS.GTDOW_OneSide_solver_c.GTMerge@ */ /end MEASUREMENT
/begin MEASUREMENT rtDW_ADAS.GTDOW_OneSide_solver_c.GTMerge_a "" UBYTE ADAS_CM_logical 0 0 0 1 ECU_ADDRESS 0x0000 /* @ECU_Address@rtDW_ADAS.GTDOW_OneSide_solver_c.GTMerge_a@ */ /end MEASUREMENT
/begin MEASUREMENT rtDW_ADAS.GTDOW_OneSide_solver_c.GTMerge_c "" UBYTE ADAS_CM_logical 0 0 0 1 ECU_ADDRESS 0x0000 /* @ECU_Address@rtDW_ADAS.GTDOW_OneSide_solver_c.GTMerge_c@ */ /end MEASUREMENT
/begin MEASUREMENT rtDW_ADAS.GTDOW_OneSide_solver_c.GTMerge_f "" UBYTE ADAS_CM_logical 0 0 0 1 ECU_ADDRESS 0x0000 /* @ECU_Address@rtDW_ADAS.GTDOW_OneSide_solver_c.GTMerge_f@ */ /end MEASUREMENT
/begin MEASUREMENT rtDW_ADAS.GTDOW_OneSide_solver_c.GTMerge_h "" UBYTE ADAS_CM_logical 0 0 0 1 ECU_ADDRESS 0x0000 /* @ECU_Address@rtDW_ADAS.GTDOW_OneSide_solver_c.GTMerge_h@ */ /end MEASUREMENT
/begin MEASUREMENT rtDW_ADAS.GTDOW_OneSide_solver_c.GTMerge_k "" UBYTE ADAS_CM_logical 0 0 0 1 ECU_ADDRESS 0x0000 /* @ECU_Address@rtDW_ADAS.GTDOW_OneSide_solver_c.GTMerge_k@ */ /end MEASUREMENT
/begin MEASUREMENT rtDW_ADAS.GTDOW_OneSide_solver_c.GTMerge_m "" UBYTE ADAS_CM_logical 0 0 0 1 ECU_ADDRESS 0x0000 /* @ECU_Address@rtDW_ADAS.GTDOW_OneSide_solver_c.GTMerge_m@ */ /end MEASUREMENT
/begin MEASUREMENT rtDW_ADAS.GTDOW_OneSide_solver_c.GTMerge_o "" UBYTE ADAS_CM_logical 0 0 0 1 ECU_ADDRESS 0x0000 /* @ECU_Address@rtDW_ADAS.GTDOW_OneSide_solver_c.GTMerge_o@ */ /end MEASUREMENT
/begin MEASUREMENT rtDW_ADAS.GTDOW_OneSide_solver_c.GTMerge_od "" UBYTE ADAS_CM_logical 0 0 0 1 ECU_ADDRESS 0x0000 /* @ECU_Address@rtDW_ADAS.GTDOW_OneSide_solver_c.GTMerge_od@ */ /end MEASUREMENT
/begin MEASUREMENT rtDW_ADAS.GTDOW_OneSide_solver_c.GTMerge_ou "" UBYTE ADAS_CM_logical 0 0 0 1 ECU_ADDRESS 0x0000 /* @ECU_Address@rtDW_ADAS.GTDOW_OneSide_solver_c.GTMerge_ou@ */ /end MEASUREMENT
/begin MEASUREMENT rtDW_ADAS.GTDOW_OneSide_solver_c.GTObj13inmarklinecoordsys.GTObj13inmarklinecoordsys_MODE "" UBYTE ADAS_CM_logical 0 0 0 1 ECU_ADDRESS 0x0000 /* @ECU_Address@rtDW_ADAS.GTDOW_OneSide_solver_c.GTObj13inmarklinecoordsys.GTObj13inmarklinecoordsys_MODE@ */ /end MEASUREMENT
/begin MEASUREMENT rtDW_ADAS.GTDOW_OneSide_solver_c.GTOppSideFarObjinmarklinecoords.GTObj13inmarklinecoordsys_MODE "" UBYTE ADAS_CM_logical 0 0 0 1 ECU_ADDRESS 0x0000 /* @ECU_Address@rtDW_ADAS.GTDOW_OneSide_solver_c.GTOppSideFarObjinmarklinecoords.GTObj13inmarklinecoordsys_MODE@ */ /end MEASUREMENT
/begin MEASUREMENT rtDW_ADAS.GTDOW_OneSide_solver_c.GTOppSideNearObjinmarklinecoord.GTObj13inmarklinecoordsys_MODE "" UBYTE ADAS_CM_logical 0 0 0 1 ECU_ADDRESS 0x0000 /* @ECU_Address@rtDW_ADAS.GTDOW_OneSide_solver_c.GTOppSideNearObjinmarklinecoord.GTObj13inmarklinecoordsys_MODE@ */ /end MEASUREMENT
/begin MEASUREMENT rtDW_ADAS.GTDOW_OneSide_solver_c.GTRightSwitchCaseActionSubsy_fj.GTMemory1_PreviousInput "" FLOAT64_IEEE ADAS_CM_double 0 0 -1.7E+308 1.7E+308 ECU_ADDRESS 0x0000 /* @ECU_Address@rtDW_ADAS.GTDOW_OneSide_solver_c.GTRightSwitchCaseActionSubsy_fj.GTMemory1_PreviousInput@ */ /end MEASUREMENT
/begin MEASUREMENT rtDW_ADAS.GTDOW_OneSide_solver_c.GTRightSwitchCaseActionSubsy_fj.GTMemory_PreviousInput "" FLOAT32_IEEE ADAS_CM_single 0 0 -3.4E+38 3.4E+38 ECU_ADDRESS 0x0000 /* @ECU_Address@rtDW_ADAS.GTDOW_OneSide_solver_c.GTRightSwitchCaseActionSubsy_fj.GTMemory_PreviousInput@ */ /end MEASUREMENT
/begin MEASUREMENT rtDW_ADAS.GTDOW_OneSide_solver_c.GTRightSwitchCaseActionSubsy_fo.GTMemory1_PreviousInput "" FLOAT64_IEEE ADAS_CM_double 0 0 -1.7E+308 1.7E+308 ECU_ADDRESS 0x0000 /* @ECU_Address@rtDW_ADAS.GTDOW_OneSide_solver_c.GTRightSwitchCaseActionSubsy_fo.GTMemory1_PreviousInput@ */ /end MEASUREMENT
/begin MEASUREMENT rtDW_ADAS.GTDOW_OneSide_solver_c.GTRightSwitchCaseActionSubsy_fo.GTMemory_PreviousInput "" FLOAT32_IEEE ADAS_CM_single 0 0 -3.4E+38 3.4E+38 ECU_ADDRESS 0x0000 /* @ECU_Address@rtDW_ADAS.GTDOW_OneSide_solver_c.GTRightSwitchCaseActionSubsy_fo.GTMemory_PreviousInput@ */ /end MEASUREMENT
/begin MEASUREMENT rtDW_ADAS.GTDOW_OneSide_solver_c.GTRightSwitchCaseActionSubsy_gt.GTMemory1_PreviousInput "" FLOAT64_IEEE ADAS_CM_double 0 0 -1.7E+308 1.7E+308 ECU_ADDRESS 0x0000 /* @ECU_Address@rtDW_ADAS.GTDOW_OneSide_solver_c.GTRightSwitchCaseActionSubsy_gt.GTMemory1_PreviousInput@ */ /end MEASUREMENT
/begin MEASUREMENT rtDW_ADAS.GTDOW_OneSide_solver_c.GTRightSwitchCaseActionSubsy_gt.GTMemory_PreviousInput "" FLOAT32_IEEE ADAS_CM_single 0 0 -3.4E+38 3.4E+38 ECU_ADDRESS 0x0000 /* @ECU_Address@rtDW_ADAS.GTDOW_OneSide_solver_c.GTRightSwitchCaseActionSubsy_gt.GTMemory_PreviousInput@ */ /end MEASUREMENT
/begin MEASUREMENT rtDW_ADAS.GTDOW_OneSide_solver_c.GTRightSwitchCaseActionSubsys_f.GTMemory1_PreviousInput "" FLOAT64_IEEE ADAS_CM_double 0 0 -1.7E+308 1.7E+308 ECU_ADDRESS 0x0000 /* @ECU_Address@rtDW_ADAS.GTDOW_OneSide_solver_c.GTRightSwitchCaseActionSubsys_f.GTMemory1_PreviousInput@ */ /end MEASUREMENT
/begin MEASUREMENT rtDW_ADAS.GTDOW_OneSide_solver_c.GTRightSwitchCaseActionSubsys_f.GTMemory_PreviousInput "" FLOAT32_IEEE ADAS_CM_single 0 0 -3.4E+38 3.4E+38 ECU_ADDRESS 0x0000 /* @ECU_Address@rtDW_ADAS.GTDOW_OneSide_solver_c.GTRightSwitchCaseActionSubsys_f.GTMemory_PreviousInput@ */ /end MEASUREMENT
/begin MEASUREMENT rtDW_ADAS.GTDOW_OneSide_solver_c.GTRightSwitchCaseActionSubsys_g.GTMemory1_PreviousInput "" FLOAT64_IEEE ADAS_CM_double 0 0 -1.7E+308 1.7E+308 ECU_ADDRESS 0x0000 /* @ECU_Address@rtDW_ADAS.GTDOW_OneSide_solver_c.GTRightSwitchCaseActionSubsys_g.GTMemory1_PreviousInput@ */ /end MEASUREMENT
/begin MEASUREMENT rtDW_ADAS.GTDOW_OneSide_solver_c.GTRightSwitchCaseActionSubsys_g.GTMemory_PreviousInput "" FLOAT32_IEEE ADAS_CM_single 0 0 -3.4E+38 3.4E+38 ECU_ADDRESS 0x0000 /* @ECU_Address@rtDW_ADAS.GTDOW_OneSide_solver_c.GTRightSwitchCaseActionSubsys_g.GTMemory_PreviousInput@ */ /end MEASUREMENT
/begin MEASUREMENT rtDW_ADAS.GTDOW_OneSide_solver_c.GTRightSwitchCaseActionSubsys_h.GTMemory1_PreviousInput "" FLOAT64_IEEE ADAS_CM_double 0 0 -1.7E+308 1.7E+308 ECU_ADDRESS 0x0000 /* @ECU_Address@rtDW_ADAS.GTDOW_OneSide_solver_c.GTRightSwitchCaseActionSubsys_h.GTMemory1_PreviousInput@ */ /end MEASUREMENT
/begin MEASUREMENT rtDW_ADAS.GTDOW_OneSide_solver_c.GTRightSwitchCaseActionSubsys_h.GTMemory_PreviousInput "" FLOAT32_IEEE ADAS_CM_single 0 0 -3.4E+38 3.4E+38 ECU_ADDRESS 0x0000 /* @ECU_Address@rtDW_ADAS.GTDOW_OneSide_solver_c.GTRightSwitchCaseActionSubsys_h.GTMemory_PreviousInput@ */ /end MEASUREMENT
/begin MEASUREMENT rtDW_ADAS.GTDOW_OneSide_solver_c.GTRightSwitchCaseActionSubsys_j.GTMemory1_PreviousInput "" FLOAT64_IEEE ADAS_CM_double 0 0 -1.7E+308 1.7E+308 ECU_ADDRESS 0x0000 /* @ECU_Address@rtDW_ADAS.GTDOW_OneSide_solver_c.GTRightSwitchCaseActionSubsys_j.GTMemory1_PreviousInput@ */ /end MEASUREMENT
/begin MEASUREMENT rtDW_ADAS.GTDOW_OneSide_solver_c.GTRightSwitchCaseActionSubsys_j.GTMemory_PreviousInput "" FLOAT32_IEEE ADAS_CM_single 0 0 -3.4E+38 3.4E+38 ECU_ADDRESS 0x0000 /* @ECU_Address@rtDW_ADAS.GTDOW_OneSide_solver_c.GTRightSwitchCaseActionSubsys_j.GTMemory_PreviousInput@ */ /end MEASUREMENT
/begin MEASUREMENT rtDW_ADAS.GTDOW_OneSide_solver_c.GTRightSwitchCaseActionSubsys_m.GTMemory1_PreviousInput "" FLOAT64_IEEE ADAS_CM_double 0 0 -1.7E+308 1.7E+308 ECU_ADDRESS 0x0000 /* @ECU_Address@rtDW_ADAS.GTDOW_OneSide_solver_c.GTRightSwitchCaseActionSubsys_m.GTMemory1_PreviousInput@ */ /end MEASUREMENT
/begin MEASUREMENT rtDW_ADAS.GTDOW_OneSide_solver_c.GTRightSwitchCaseActionSubsys_m.GTMemory_PreviousInput "" FLOAT32_IEEE ADAS_CM_single 0 0 -3.4E+38 3.4E+38 ECU_ADDRESS 0x0000 /* @ECU_Address@rtDW_ADAS.GTDOW_OneSide_solver_c.GTRightSwitchCaseActionSubsys_m.GTMemory_PreviousInput@ */ /end MEASUREMENT
/begin MEASUREMENT rtDW_ADAS.GTDOW_OneSide_solver_c.GTRightSwitchCaseActionSubsys_o.GTMemory1_PreviousInput "" FLOAT64_IEEE ADAS_CM_double 0 0 -1.7E+308 1.7E+308 ECU_ADDRESS 0x0000 /* @ECU_Address@rtDW_ADAS.GTDOW_OneSide_solver_c.GTRightSwitchCaseActionSubsys_o.GTMemory1_PreviousInput@ */ /end MEASUREMENT
/begin MEASUREMENT rtDW_ADAS.GTDOW_OneSide_solver_c.GTRightSwitchCaseActionSubsys_o.GTMemory_PreviousInput "" FLOAT32_IEEE ADAS_CM_single 0 0 -3.4E+38 3.4E+38 ECU_ADDRESS 0x0000 /* @ECU_Address@rtDW_ADAS.GTDOW_OneSide_solver_c.GTRightSwitchCaseActionSubsys_o.GTMemory_PreviousInput@ */ /end MEASUREMENT
/begin MEASUREMENT rtDW_ADAS.GTDOW_OneSide_solver_c.GTRightSwitchCaseActionSubsyste.GTMemory1_PreviousInput "" FLOAT64_IEEE ADAS_CM_double 0 0 -1.7E+308 1.7E+308 ECU_ADDRESS 0x0000 /* @ECU_Address@rtDW_ADAS.GTDOW_OneSide_solver_c.GTRightSwitchCaseActionSubsyste.GTMemory1_PreviousInput@ */ /end MEASUREMENT
/begin MEASUREMENT rtDW_ADAS.GTDOW_OneSide_solver_c.GTRightSwitchCaseActionSubsyste.GTMemory_PreviousInput "" FLOAT32_IEEE ADAS_CM_single 0 0 -3.4E+38 3.4E+38 ECU_ADDRESS 0x0000 /* @ECU_Address@rtDW_ADAS.GTDOW_OneSide_solver_c.GTRightSwitchCaseActionSubsyste.GTMemory_PreviousInput@ */ /end MEASUREMENT
/begin MEASUREMENT rtDW_ADAS.GTDOW_OneSide_solver_c.GTSideFarObjinmarklinecoordsys.GTObj13inmarklinecoordsys_MODE "" UBYTE ADAS_CM_logical 0 0 0 1 ECU_ADDRESS 0x0000 /* @ECU_Address@rtDW_ADAS.GTDOW_OneSide_solver_c.GTSideFarObjinmarklinecoordsys.GTObj13inmarklinecoordsys_MODE@ */ /end MEASUREMENT
/begin MEASUREMENT rtDW_ADAS.GTDOW_OneSide_solver_c.GTSideNearObjinmarklinecoordsys.GTObj13inmarklinecoordsys_MODE "" UBYTE ADAS_CM_logical 0 0 0 1 ECU_ADDRESS 0x0000 /* @ECU_Address@rtDW_ADAS.GTDOW_OneSide_solver_c.GTSideNearObjinmarklinecoordsys.GTObj13inmarklinecoordsys_MODE@ */ /end MEASUREMENT
/begin MEASUREMENT rtDW_ADAS.GTDOW_OneSide_solver_c.GThasPointProjOnMarkLineFlag "" FLOAT64_IEEE ADAS_CM_double 0 0 -1.7E+308 1.7E+308 ECU_ADDRESS 0x0000 /* @ECU_Address@rtDW_ADAS.GTDOW_OneSide_solver_c.GThasPointProjOnMarkLineFlag@ */ /end MEASUREMENT
/begin MEASUREMENT rtDW_ADAS.GTDOW_OneSide_solver_c.GThasPointProjOnMarkLineFlag_c "" FLOAT64_IEEE ADAS_CM_double 0 0 -1.7E+308 1.7E+308 ECU_ADDRESS 0x0000 /* @ECU_Address@rtDW_ADAS.GTDOW_OneSide_solver_c.GThasPointProjOnMarkLineFlag_c@ */ /end MEASUREMENT
/begin MEASUREMENT rtDW_ADAS.GTDOW_OneSide_solver_c.GThasPointProjOnMarkLineFlag_m "" FLOAT64_IEEE ADAS_CM_double 0 0 -1.7E+308 1.7E+308 ECU_ADDRESS 0x0000 /* @ECU_Address@rtDW_ADAS.GTDOW_OneSide_solver_c.GThasPointProjOnMarkLineFlag_m@ */ /end MEASUREMENT
/begin MEASUREMENT rtDW_ADAS.GTDOW_OneSide_solver_c.GThasPointProjOnMarkLineFlag_ma "" FLOAT64_IEEE ADAS_CM_double 0 0 -1.7E+308 1.7E+308 ECU_ADDRESS 0x0000 /* @ECU_Address@rtDW_ADAS.GTDOW_OneSide_solver_c.GThasPointProjOnMarkLineFlag_ma@ */ /end MEASUREMENT
/begin MEASUREMENT rtDW_ADAS.GTDOW_OneSide_solver_c.GThasPointProjOnMarkLineFlag_n "" FLOAT64_IEEE ADAS_CM_double 0 0 -1.7E+308 1.7E+308 ECU_ADDRESS 0x0000 /* @ECU_Address@rtDW_ADAS.GTDOW_OneSide_solver_c.GThasPointProjOnMarkLineFlag_n@ */ /end MEASUREMENT
/begin MEASUREMENT rtDW_ADAS.GTDOW_OneSide_solver_c.GTsum_segments_length "" FLOAT64_IEEE ADAS_CM_double 0 0 -1.7E+308 1.7E+308 ECU_ADDRESS 0x0000 /* @ECU_Address@rtDW_ADAS.GTDOW_OneSide_solver_c.GTsum_segments_length@ */ /end MEASUREMENT
/begin MEASUREMENT rtDW_ADAS.GTDOW_OneSide_solver_c.GTsum_segments_length_h "" FLOAT64_IEEE ADAS_CM_double 0 0 -1.7E+308 1.7E+308 ECU_ADDRESS 0x0000 /* @ECU_Address@rtDW_ADAS.GTDOW_OneSide_solver_c.GTsum_segments_length_h@ */ /end MEASUREMENT
/begin MEASUREMENT rtDW_ADAS.GTDOW_OneSide_solver_c.GTsum_segments_length_k "" FLOAT64_IEEE ADAS_CM_double 0 0 -1.7E+308 1.7E+308 ECU_ADDRESS 0x0000 /* @ECU_Address@rtDW_ADAS.GTDOW_OneSide_solver_c.GTsum_segments_length_k@ */ /end MEASUREMENT
/begin MEASUREMENT rtDW_ADAS.GTDOW_OneSide_solver_c.GTsum_segments_length_o "" FLOAT64_IEEE ADAS_CM_double 0 0 -1.7E+308 1.7E+308 ECU_ADDRESS 0x0000 /* @ECU_Address@rtDW_ADAS.GTDOW_OneSide_solver_c.GTsum_segments_length_o@ */ /end MEASUREMENT
/begin MEASUREMENT rtDW_ADAS.GTDOW_OneSide_solver_c.GTsum_segments_length_ou "" FLOAT64_IEEE ADAS_CM_double 0 0 -1.7E+308 1.7E+308 ECU_ADDRESS 0x0000 /* @ECU_Address@rtDW_ADAS.GTDOW_OneSide_solver_c.GTsum_segments_length_ou@ */ /end MEASUREMENT
/begin MEASUREMENT rtDW_ADAS.GTDetectObj9_10 "" UBYTE ADAS_CM_uint8 0 0 0 255 ECU_ADDRESS 0x0000 /* @ECU_Address@rtDW_ADAS.GTDetectObj9_10@ */ /end MEASUREMENT
/begin MEASUREMENT rtDW_ADAS.GTDetectObj9_10_o "" UBYTE ADAS_CM_uint8 0 0 0 255 ECU_ADDRESS 0x0000 /* @ECU_Address@rtDW_ADAS.GTDetectObj9_10_o@ */ /end MEASUREMENT
/begin MEASUREMENT rtDW_ADAS.GTDetectObj9_10_oq "" UBYTE ADAS_CM_uint8 0 0 0 255 ECU_ADDRESS 0x0000 /* @ECU_Address@rtDW_ADAS.GTDetectObj9_10_oq@ */ /end MEASUREMENT
/begin MEASUREMENT rtDW_ADAS.GTDetectObj9_10_p "" UBYTE ADAS_CM_uint8 0 0 0 255 ECU_ADDRESS 0x0000 /* @ECU_Address@rtDW_ADAS.GTDetectObj9_10_p@ */ /end MEASUREMENT
/begin MEASUREMENT rtDW_ADAS.GTEnabledSubsystem1_MODE "" UBYTE ADAS_CM_logical 0 0 0 1 ECU_ADDRESS 0x0000 /* @ECU_Address@rtDW_ADAS.GTEnabledSubsystem1_MODE@ */ /end MEASUREMENT
/begin MEASUREMENT rtDW_ADAS.GTEnabledSubsystem1_MODE_a "" UBYTE ADAS_CM_logical 0 0 0 1 ECU_ADDRESS 0x0000 /* @ECU_Address@rtDW_ADAS.GTEnabledSubsystem1_MODE_a@ */ /end MEASUREMENT
/begin MEASUREMENT rtDW_ADAS.GTEnabledSubsystem2_MODE "" UBYTE ADAS_CM_logical 0 0 0 1 ECU_ADDRESS 0x0000 /* @ECU_Address@rtDW_ADAS.GTEnabledSubsystem2_MODE@ */ /end MEASUREMENT
/begin MEASUREMENT rtDW_ADAS.GTEnabledSubsystem2_MODE_e "" UBYTE ADAS_CM_logical 0 0 0 1 ECU_ADDRESS 0x0000 /* @ECU_Address@rtDW_ADAS.GTEnabledSubsystem2_MODE_e@ */ /end MEASUREMENT
/begin MEASUREMENT rtDW_ADAS.GTEnabledSubsystem3_MODE "" UBYTE ADAS_CM_logical 0 0 0 1 ECU_ADDRESS 0x0000 /* @ECU_Address@rtDW_ADAS.GTEnabledSubsystem3_MODE@ */ /end MEASUREMENT
/begin MEASUREMENT rtDW_ADAS.GTEnabledSubsystem3_MODE_e "" UBYTE ADAS_CM_logical 0 0 0 1 ECU_ADDRESS 0x0000 /* @ECU_Address@rtDW_ADAS.GTEnabledSubsystem3_MODE_e@ */ /end MEASUREMENT
/begin MEASUREMENT rtDW_ADAS.GTEnabledSubsystem_MODE "" UBYTE ADAS_CM_logical 0 0 0 1 ECU_ADDRESS 0x0000 /* @ECU_Address@rtDW_ADAS.GTEnabledSubsystem_MODE@ */ /end MEASUREMENT
/begin MEASUREMENT rtDW_ADAS.GTEnabledSubsystem_MODE_l "" UBYTE ADAS_CM_logical 0 0 0 1 ECU_ADDRESS 0x0000 /* @ECU_Address@rtDW_ADAS.GTEnabledSubsystem_MODE_l@ */ /end MEASUREMENT
/begin MEASUREMENT rtDW_ADAS.GTEnabledSubsystem_f.GTEnabledSubsystem_MODE "" UBYTE ADAS_CM_logical 0 0 0 1 ECU_ADDRESS 0x0000 /* @ECU_Address@rtDW_ADAS.GTEnabledSubsystem_f.GTEnabledSubsystem_MODE@ */ /end MEASUREMENT
/begin MEASUREMENT rtDW_ADAS.GTEnabledSubsystem_m.GTEnabledSubsystem_MODE "" UBYTE ADAS_CM_logical 0 0 0 1 ECU_ADDRESS 0x0000 /* @ECU_Address@rtDW_ADAS.GTEnabledSubsystem_m.GTEnabledSubsystem_MODE@ */ /end MEASUREMENT
/begin MEASUREMENT rtDW_ADAS.GTHLLADBtargetLEDs_MODE "" UBYTE ADAS_CM_logical 0 0 0 1 ECU_ADDRESS 0x0000 /* @ECU_Address@rtDW_ADAS.GTHLLADBtargetLEDs_MODE@ */ /end MEASUREMENT
/begin MEASUREMENT rtDW_ADAS.GTHLL_Y1_Obj1 "" FLOAT32_IEEE ADAS_CM_single 0 0 -3.4E+38 3.4E+38 ECU_ADDRESS 0x0000 /* @ECU_Address@rtDW_ADAS.GTHLL_Y1_Obj1@ */ /end MEASUREMENT
/begin MEASUREMENT rtDW_ADAS.GTHLL_Y1_Obj10 "" FLOAT32_IEEE ADAS_CM_single 0 0 -3.4E+38 3.4E+38 ECU_ADDRESS 0x0000 /* @ECU_Address@rtDW_ADAS.GTHLL_Y1_Obj10@ */ /end MEASUREMENT
/begin MEASUREMENT rtDW_ADAS.GTHLL_Y1_Obj10_b "" FLOAT32_IEEE ADAS_CM_single 0 0 -3.4E+38 3.4E+38 ECU_ADDRESS 0x0000 /* @ECU_Address@rtDW_ADAS.GTHLL_Y1_Obj10_b@ */ /end MEASUREMENT
/begin MEASUREMENT rtDW_ADAS.GTHLL_Y1_Obj1_k "" FLOAT32_IEEE ADAS_CM_single 0 0 -3.4E+38 3.4E+38 ECU_ADDRESS 0x0000 /* @ECU_Address@rtDW_ADAS.GTHLL_Y1_Obj1_k@ */ /end MEASUREMENT
/begin MEASUREMENT rtDW_ADAS.GTHLL_Y1_Obj2 "" FLOAT32_IEEE ADAS_CM_single 0 0 -3.4E+38 3.4E+38 ECU_ADDRESS 0x0000 /* @ECU_Address@rtDW_ADAS.GTHLL_Y1_Obj2@ */ /end MEASUREMENT
/begin MEASUREMENT rtDW_ADAS.GTHLL_Y1_Obj2_f "" FLOAT32_IEEE ADAS_CM_single 0 0 -3.4E+38 3.4E+38 ECU_ADDRESS 0x0000 /* @ECU_Address@rtDW_ADAS.GTHLL_Y1_Obj2_f@ */ /end MEASUREMENT
/begin MEASUREMENT rtDW_ADAS.GTHLL_Y1_Obj3 "" FLOAT32_IEEE ADAS_CM_single 0 0 -3.4E+38 3.4E+38 ECU_ADDRESS 0x0000 /* @ECU_Address@rtDW_ADAS.GTHLL_Y1_Obj3@ */ /end MEASUREMENT
/begin MEASUREMENT rtDW_ADAS.GTHLL_Y1_Obj3_c "" FLOAT32_IEEE ADAS_CM_single 0 0 -3.4E+38 3.4E+38 ECU_ADDRESS 0x0000 /* @ECU_Address@rtDW_ADAS.GTHLL_Y1_Obj3_c@ */ /end MEASUREMENT
/begin MEASUREMENT rtDW_ADAS.GTHLL_Y1_Obj4 "" FLOAT32_IEEE ADAS_CM_single 0 0 -3.4E+38 3.4E+38 ECU_ADDRESS 0x0000 /* @ECU_Address@rtDW_ADAS.GTHLL_Y1_Obj4@ */ /end MEASUREMENT
/begin MEASUREMENT rtDW_ADAS.GTHLL_Y1_Obj4_i "" FLOAT32_IEEE ADAS_CM_single 0 0 -3.4E+38 3.4E+38 ECU_ADDRESS 0x0000 /* @ECU_Address@rtDW_ADAS.GTHLL_Y1_Obj4_i@ */ /end MEASUREMENT
/begin MEASUREMENT rtDW_ADAS.GTHLL_Y1_Obj5 "" FLOAT32_IEEE ADAS_CM_single 0 0 -3.4E+38 3.4E+38 ECU_ADDRESS 0x0000 /* @ECU_Address@rtDW_ADAS.GTHLL_Y1_Obj5@ */ /end MEASUREMENT
/begin MEASUREMENT rtDW_ADAS.GTHLL_Y1_Obj5_e "" FLOAT32_IEEE ADAS_CM_single 0 0 -3.4E+38 3.4E+38 ECU_ADDRESS 0x0000 /* @ECU_Address@rtDW_ADAS.GTHLL_Y1_Obj5_e@ */ /end MEASUREMENT
/begin MEASUREMENT rtDW_ADAS.GTHLL_Y1_Obj6 "" FLOAT32_IEEE ADAS_CM_single 0 0 -3.4E+38 3.4E+38 ECU_ADDRESS 0x0000 /* @ECU_Address@rtDW_ADAS.GTHLL_Y1_Obj6@ */ /end MEASUREMENT
/begin MEASUREMENT rtDW_ADAS.GTHLL_Y1_Obj6_j "" FLOAT32_IEEE ADAS_CM_single 0 0 -3.4E+38 3.4E+38 ECU_ADDRESS 0x0000 /* @ECU_Address@rtDW_ADAS.GTHLL_Y1_Obj6_j@ */ /end MEASUREMENT
/begin MEASUREMENT rtDW_ADAS.GTHLL_Y1_Obj7 "" FLOAT32_IEEE ADAS_CM_single 0 0 -3.4E+38 3.4E+38 ECU_ADDRESS 0x0000 /* @ECU_Address@rtDW_ADAS.GTHLL_Y1_Obj7@ */ /end MEASUREMENT
/begin MEASUREMENT rtDW_ADAS.GTHLL_Y1_Obj7_a "" FLOAT32_IEEE ADAS_CM_single 0 0 -3.4E+38 3.4E+38 ECU_ADDRESS 0x0000 /* @ECU_Address@rtDW_ADAS.GTHLL_Y1_Obj7_a@ */ /end MEASUREMENT
/begin MEASUREMENT rtDW_ADAS.GTHLL_Y1_Obj8 "" FLOAT32_IEEE ADAS_CM_single 0 0 -3.4E+38 3.4E+38 ECU_ADDRESS 0x0000 /* @ECU_Address@rtDW_ADAS.GTHLL_Y1_Obj8@ */ /end MEASUREMENT
/begin MEASUREMENT rtDW_ADAS.GTHLL_Y1_Obj8_i "" FLOAT32_IEEE ADAS_CM_single 0 0 -3.4E+38 3.4E+38 ECU_ADDRESS 0x0000 /* @ECU_Address@rtDW_ADAS.GTHLL_Y1_Obj8_i@ */ /end MEASUREMENT
/begin MEASUREMENT rtDW_ADAS.GTHLL_Y1_Obj9 "" FLOAT32_IEEE ADAS_CM_single 0 0 -3.4E+38 3.4E+38 ECU_ADDRESS 0x0000 /* @ECU_Address@rtDW_ADAS.GTHLL_Y1_Obj9@ */ /end MEASUREMENT
/begin MEASUREMENT rtDW_ADAS.GTHLL_Y1_Obj9_o "" FLOAT32_IEEE ADAS_CM_single 0 0 -3.4E+38 3.4E+38 ECU_ADDRESS 0x0000 /* @ECU_Address@rtDW_ADAS.GTHLL_Y1_Obj9_o@ */ /end MEASUREMENT
/begin MEASUREMENT rtDW_ADAS.GTHLL_Y2_Obj1 "" FLOAT32_IEEE ADAS_CM_single 0 0 -3.4E+38 3.4E+38 ECU_ADDRESS 0x0000 /* @ECU_Address@rtDW_ADAS.GTHLL_Y2_Obj1@ */ /end MEASUREMENT
/begin MEASUREMENT rtDW_ADAS.GTHLL_Y2_Obj10 "" FLOAT32_IEEE ADAS_CM_single 0 0 -3.4E+38 3.4E+38 ECU_ADDRESS 0x0000 /* @ECU_Address@rtDW_ADAS.GTHLL_Y2_Obj10@ */ /end MEASUREMENT
/begin MEASUREMENT rtDW_ADAS.GTHLL_Y2_Obj10_f "" FLOAT32_IEEE ADAS_CM_single 0 0 -3.4E+38 3.4E+38 ECU_ADDRESS 0x0000 /* @ECU_Address@rtDW_ADAS.GTHLL_Y2_Obj10_f@ */ /end MEASUREMENT
/begin MEASUREMENT rtDW_ADAS.GTHLL_Y2_Obj1_e "" FLOAT32_IEEE ADAS_CM_single 0 0 -3.4E+38 3.4E+38 ECU_ADDRESS 0x0000 /* @ECU_Address@rtDW_ADAS.GTHLL_Y2_Obj1_e@ */ /end MEASUREMENT
/begin MEASUREMENT rtDW_ADAS.GTHLL_Y2_Obj2 "" FLOAT32_IEEE ADAS_CM_single 0 0 -3.4E+38 3.4E+38 ECU_ADDRESS 0x0000 /* @ECU_Address@rtDW_ADAS.GTHLL_Y2_Obj2@ */ /end MEASUREMENT
/begin MEASUREMENT rtDW_ADAS.GTHLL_Y2_Obj2_b "" FLOAT32_IEEE ADAS_CM_single 0 0 -3.4E+38 3.4E+38 ECU_ADDRESS 0x0000 /* @ECU_Address@rtDW_ADAS.GTHLL_Y2_Obj2_b@ */ /end MEASUREMENT
/begin MEASUREMENT rtDW_ADAS.GTHLL_Y2_Obj3 "" FLOAT32_IEEE ADAS_CM_single 0 0 -3.4E+38 3.4E+38 ECU_ADDRESS 0x0000 /* @ECU_Address@rtDW_ADAS.GTHLL_Y2_Obj3@ */ /end MEASUREMENT
/begin MEASUREMENT rtDW_ADAS.GTHLL_Y2_Obj3_n "" FLOAT32_IEEE ADAS_CM_single 0 0 -3.4E+38 3.4E+38 ECU_ADDRESS 0x0000 /* @ECU_Address@rtDW_ADAS.GTHLL_Y2_Obj3_n@ */ /end MEASUREMENT
/begin MEASUREMENT rtDW_ADAS.GTHLL_Y2_Obj4 "" FLOAT32_IEEE ADAS_CM_single 0 0 -3.4E+38 3.4E+38 ECU_ADDRESS 0x0000 /* @ECU_Address@rtDW_ADAS.GTHLL_Y2_Obj4@ */ /end MEASUREMENT
/begin MEASUREMENT rtDW_ADAS.GTHLL_Y2_Obj4_o "" FLOAT32_IEEE ADAS_CM_single 0 0 -3.4E+38 3.4E+38 ECU_ADDRESS 0x0000 /* @ECU_Address@rtDW_ADAS.GTHLL_Y2_Obj4_o@ */ /end MEASUREMENT
/begin MEASUREMENT rtDW_ADAS.GTHLL_Y2_Obj5 "" FLOAT32_IEEE ADAS_CM_single 0 0 -3.4E+38 3.4E+38 ECU_ADDRESS 0x0000 /* @ECU_Address@rtDW_ADAS.GTHLL_Y2_Obj5@ */ /end MEASUREMENT
/begin MEASUREMENT rtDW_ADAS.GTHLL_Y2_Obj5_l "" FLOAT32_IEEE ADAS_CM_single 0 0 -3.4E+38 3.4E+38 ECU_ADDRESS 0x0000 /* @ECU_Address@rtDW_ADAS.GTHLL_Y2_Obj5_l@ */ /end MEASUREMENT
/begin MEASUREMENT rtDW_ADAS.GTHLL_Y2_Obj6 "" FLOAT32_IEEE ADAS_CM_single 0 0 -3.4E+38 3.4E+38 ECU_ADDRESS 0x0000 /* @ECU_Address@rtDW_ADAS.GTHLL_Y2_Obj6@ */ /end MEASUREMENT
/begin MEASUREMENT rtDW_ADAS.GTHLL_Y2_Obj6_a "" FLOAT32_IEEE ADAS_CM_single 0 0 -3.4E+38 3.4E+38 ECU_ADDRESS 0x0000 /* @ECU_Address@rtDW_ADAS.GTHLL_Y2_Obj6_a@ */ /end MEASUREMENT
/begin MEASUREMENT rtDW_ADAS.GTHLL_Y2_Obj7 "" FLOAT32_IEEE ADAS_CM_single 0 0 -3.4E+38 3.4E+38 ECU_ADDRESS 0x0000 /* @ECU_Address@rtDW_ADAS.GTHLL_Y2_Obj7@ */ /end MEASUREMENT
/begin MEASUREMENT rtDW_ADAS.GTHLL_Y2_Obj7_o "" FLOAT32_IEEE ADAS_CM_single 0 0 -3.4E+38 3.4E+38 ECU_ADDRESS 0x0000 /* @ECU_Address@rtDW_ADAS.GTHLL_Y2_Obj7_o@ */ /end MEASUREMENT
/begin MEASUREMENT rtDW_ADAS.GTHLL_Y2_Obj8 "" FLOAT32_IEEE ADAS_CM_single 0 0 -3.4E+38 3.4E+38 ECU_ADDRESS 0x0000 /* @ECU_Address@rtDW_ADAS.GTHLL_Y2_Obj8@ */ /end MEASUREMENT
/begin MEASUREMENT rtDW_ADAS.GTHLL_Y2_Obj8_g "" FLOAT32_IEEE ADAS_CM_single 0 0 -3.4E+38 3.4E+38 ECU_ADDRESS 0x0000 /* @ECU_Address@rtDW_ADAS.GTHLL_Y2_Obj8_g@ */ /end MEASUREMENT
/begin MEASUREMENT rtDW_ADAS.GTHLL_Y2_Obj9 "" FLOAT32_IEEE ADAS_CM_single 0 0 -3.4E+38 3.4E+38 ECU_ADDRESS 0x0000 /* @ECU_Address@rtDW_ADAS.GTHLL_Y2_Obj9@ */ /end MEASUREMENT
/begin MEASUREMENT rtDW_ADAS.GTHLL_Y2_Obj9_i "" FLOAT32_IEEE ADAS_CM_single 0 0 -3.4E+38 3.4E+38 ECU_ADDRESS 0x0000 /* @ECU_Address@rtDW_ADAS.GTHLL_Y2_Obj9_i@ */ /end MEASUREMENT
/begin MEASUREMENT rtDW_ADAS.GTHLL_Z1_Obj1 "" UBYTE ADAS_CM_uint8 0 0 0 255 ECU_ADDRESS 0x0000 /* @ECU_Address@rtDW_ADAS.GTHLL_Z1_Obj1@ */ /end MEASUREMENT
/begin MEASUREMENT rtDW_ADAS.GTHLL_Z1_Obj10 "" UBYTE ADAS_CM_uint8 0 0 0 255 ECU_ADDRESS 0x0000 /* @ECU_Address@rtDW_ADAS.GTHLL_Z1_Obj10@ */ /end MEASUREMENT
/begin MEASUREMENT rtDW_ADAS.GTHLL_Z1_Obj10_c "" UBYTE ADAS_CM_uint8 0 0 0 255 ECU_ADDRESS 0x0000 /* @ECU_Address@rtDW_ADAS.GTHLL_Z1_Obj10_c@ */ /end MEASUREMENT
/begin MEASUREMENT rtDW_ADAS.GTHLL_Z1_Obj1_h "" UBYTE ADAS_CM_uint8 0 0 0 255 ECU_ADDRESS 0x0000 /* @ECU_Address@rtDW_ADAS.GTHLL_Z1_Obj1_h@ */ /end MEASUREMENT
/begin MEASUREMENT rtDW_ADAS.GTHLL_Z1_Obj2 "" UBYTE ADAS_CM_uint8 0 0 0 255 ECU_ADDRESS 0x0000 /* @ECU_Address@rtDW_ADAS.GTHLL_Z1_Obj2@ */ /end MEASUREMENT
/begin MEASUREMENT rtDW_ADAS.GTHLL_Z1_Obj2_e "" UBYTE ADAS_CM_uint8 0 0 0 255 ECU_ADDRESS 0x0000 /* @ECU_Address@rtDW_ADAS.GTHLL_Z1_Obj2_e@ */ /end MEASUREMENT
/begin MEASUREMENT rtDW_ADAS.GTHLL_Z1_Obj3 "" UBYTE ADAS_CM_uint8 0 0 0 255 ECU_ADDRESS 0x0000 /* @ECU_Address@rtDW_ADAS.GTHLL_Z1_Obj3@ */ /end MEASUREMENT
/begin MEASUREMENT rtDW_ADAS.GTHLL_Z1_Obj3_k "" UBYTE ADAS_CM_uint8 0 0 0 255 ECU_ADDRESS 0x0000 /* @ECU_Address@rtDW_ADAS.GTHLL_Z1_Obj3_k@ */ /end MEASUREMENT
/begin MEASUREMENT rtDW_ADAS.GTHLL_Z1_Obj4 "" UBYTE ADAS_CM_uint8 0 0 0 255 ECU_ADDRESS 0x0000 /* @ECU_Address@rtDW_ADAS.GTHLL_Z1_Obj4@ */ /end MEASUREMENT
/begin MEASUREMENT rtDW_ADAS.GTHLL_Z1_Obj4_a "" UBYTE ADAS_CM_uint8 0 0 0 255 ECU_ADDRESS 0x0000 /* @ECU_Address@rtDW_ADAS.GTHLL_Z1_Obj4_a@ */ /end MEASUREMENT
/begin MEASUREMENT rtDW_ADAS.GTHLL_Z1_Obj5 "" UBYTE ADAS_CM_uint8 0 0 0 255 ECU_ADDRESS 0x0000 /* @ECU_Address@rtDW_ADAS.GTHLL_Z1_Obj5@ */ /end MEASUREMENT
/begin MEASUREMENT rtDW_ADAS.GTHLL_Z1_Obj5_f "" UBYTE ADAS_CM_uint8 0 0 0 255 ECU_ADDRESS 0x0000 /* @ECU_Address@rtDW_ADAS.GTHLL_Z1_Obj5_f@ */ /end MEASUREMENT
/begin MEASUREMENT rtDW_ADAS.GTHLL_Z1_Obj6 "" UBYTE ADAS_CM_uint8 0 0 0 255 ECU_ADDRESS 0x0000 /* @ECU_Address@rtDW_ADAS.GTHLL_Z1_Obj6@ */ /end MEASUREMENT
/begin MEASUREMENT rtDW_ADAS.GTHLL_Z1_Obj6_p "" UBYTE ADAS_CM_uint8 0 0 0 255 ECU_ADDRESS 0x0000 /* @ECU_Address@rtDW_ADAS.GTHLL_Z1_Obj6_p@ */ /end MEASUREMENT
/begin MEASUREMENT rtDW_ADAS.GTHLL_Z1_Obj7 "" UBYTE ADAS_CM_uint8 0 0 0 255 ECU_ADDRESS 0x0000 /* @ECU_Address@rtDW_ADAS.GTHLL_Z1_Obj7@ */ /end MEASUREMENT
/begin MEASUREMENT rtDW_ADAS.GTHLL_Z1_Obj7_c "" UBYTE ADAS_CM_uint8 0 0 0 255 ECU_ADDRESS 0x0000 /* @ECU_Address@rtDW_ADAS.GTHLL_Z1_Obj7_c@ */ /end MEASUREMENT
/begin MEASUREMENT rtDW_ADAS.GTHLL_Z1_Obj8 "" UBYTE ADAS_CM_uint8 0 0 0 255 ECU_ADDRESS 0x0000 /* @ECU_Address@rtDW_ADAS.GTHLL_Z1_Obj8@ */ /end MEASUREMENT
/begin MEASUREMENT rtDW_ADAS.GTHLL_Z1_Obj8_p "" UBYTE ADAS_CM_uint8 0 0 0 255 ECU_ADDRESS 0x0000 /* @ECU_Address@rtDW_ADAS.GTHLL_Z1_Obj8_p@ */ /end MEASUREMENT
/begin MEASUREMENT rtDW_ADAS.GTHLL_Z1_Obj9 "" UBYTE ADAS_CM_uint8 0 0 0 255 ECU_ADDRESS 0x0000 /* @ECU_Address@rtDW_ADAS.GTHLL_Z1_Obj9@ */ /end MEASUREMENT
/begin MEASUREMENT rtDW_ADAS.GTHLL_Z1_Obj9_d "" UBYTE ADAS_CM_uint8 0 0 0 255 ECU_ADDRESS 0x0000 /* @ECU_Address@rtDW_ADAS.GTHLL_Z1_Obj9_d@ */ /end MEASUREMENT
/begin MEASUREMENT rtDW_ADAS.GTHLL_Z2_Obj1 "" UBYTE ADAS_CM_uint8 0 0 0 255 ECU_ADDRESS 0x0000 /* @ECU_Address@rtDW_ADAS.GTHLL_Z2_Obj1@ */ /end MEASUREMENT
/begin MEASUREMENT rtDW_ADAS.GTHLL_Z2_Obj10 "" UBYTE ADAS_CM_uint8 0 0 0 255 ECU_ADDRESS 0x0000 /* @ECU_Address@rtDW_ADAS.GTHLL_Z2_Obj10@ */ /end MEASUREMENT
/begin MEASUREMENT rtDW_ADAS.GTHLL_Z2_Obj10_d "" UBYTE ADAS_CM_uint8 0 0 0 255 ECU_ADDRESS 0x0000 /* @ECU_Address@rtDW_ADAS.GTHLL_Z2_Obj10_d@ */ /end MEASUREMENT
/begin MEASUREMENT rtDW_ADAS.GTHLL_Z2_Obj1_j "" UBYTE ADAS_CM_uint8 0 0 0 255 ECU_ADDRESS 0x0000 /* @ECU_Address@rtDW_ADAS.GTHLL_Z2_Obj1_j@ */ /end MEASUREMENT
/begin MEASUREMENT rtDW_ADAS.GTHLL_Z2_Obj2 "" UBYTE ADAS_CM_uint8 0 0 0 255 ECU_ADDRESS 0x0000 /* @ECU_Address@rtDW_ADAS.GTHLL_Z2_Obj2@ */ /end MEASUREMENT
/begin MEASUREMENT rtDW_ADAS.GTHLL_Z2_Obj2_k "" UBYTE ADAS_CM_uint8 0 0 0 255 ECU_ADDRESS 0x0000 /* @ECU_Address@rtDW_ADAS.GTHLL_Z2_Obj2_k@ */ /end MEASUREMENT
/begin MEASUREMENT rtDW_ADAS.GTHLL_Z2_Obj3 "" UBYTE ADAS_CM_uint8 0 0 0 255 ECU_ADDRESS 0x0000 /* @ECU_Address@rtDW_ADAS.GTHLL_Z2_Obj3@ */ /end MEASUREMENT
/begin MEASUREMENT rtDW_ADAS.GTHLL_Z2_Obj3_h "" UBYTE ADAS_CM_uint8 0 0 0 255 ECU_ADDRESS 0x0000 /* @ECU_Address@rtDW_ADAS.GTHLL_Z2_Obj3_h@ */ /end MEASUREMENT
/begin MEASUREMENT rtDW_ADAS.GTHLL_Z2_Obj4 "" UBYTE ADAS_CM_uint8 0 0 0 255 ECU_ADDRESS 0x0000 /* @ECU_Address@rtDW_ADAS.GTHLL_Z2_Obj4@ */ /end MEASUREMENT
/begin MEASUREMENT rtDW_ADAS.GTHLL_Z2_Obj4_d "" UBYTE ADAS_CM_uint8 0 0 0 255 ECU_ADDRESS 0x0000 /* @ECU_Address@rtDW_ADAS.GTHLL_Z2_Obj4_d@ */ /end MEASUREMENT
/begin MEASUREMENT rtDW_ADAS.GTHLL_Z2_Obj5 "" UBYTE ADAS_CM_uint8 0 0 0 255 ECU_ADDRESS 0x0000 /* @ECU_Address@rtDW_ADAS.GTHLL_Z2_Obj5@ */ /end MEASUREMENT
/begin MEASUREMENT rtDW_ADAS.GTHLL_Z2_Obj5_m "" UBYTE ADAS_CM_uint8 0 0 0 255 ECU_ADDRESS 0x0000 /* @ECU_Address@rtDW_ADAS.GTHLL_Z2_Obj5_m@ */ /end MEASUREMENT
/begin MEASUREMENT rtDW_ADAS.GTHLL_Z2_Obj6 "" UBYTE ADAS_CM_uint8 0 0 0 255 ECU_ADDRESS 0x0000 /* @ECU_Address@rtDW_ADAS.GTHLL_Z2_Obj6@ */ /end MEASUREMENT
/begin MEASUREMENT rtDW_ADAS.GTHLL_Z2_Obj6_l "" UBYTE ADAS_CM_uint8 0 0 0 255 ECU_ADDRESS 0x0000 /* @ECU_Address@rtDW_ADAS.GTHLL_Z2_Obj6_l@ */ /end MEASUREMENT
/begin MEASUREMENT rtDW_ADAS.GTHLL_Z2_Obj7 "" UBYTE ADAS_CM_uint8 0 0 0 255 ECU_ADDRESS 0x0000 /* @ECU_Address@rtDW_ADAS.GTHLL_Z2_Obj7@ */ /end MEASUREMENT
/begin MEASUREMENT rtDW_ADAS.GTHLL_Z2_Obj7_d "" UBYTE ADAS_CM_uint8 0 0 0 255 ECU_ADDRESS 0x0000 /* @ECU_Address@rtDW_ADAS.GTHLL_Z2_Obj7_d@ */ /end MEASUREMENT
/begin MEASUREMENT rtDW_ADAS.GTHLL_Z2_Obj8 "" UBYTE ADAS_CM_uint8 0 0 0 255 ECU_ADDRESS 0x0000 /* @ECU_Address@rtDW_ADAS.GTHLL_Z2_Obj8@ */ /end MEASUREMENT
/begin MEASUREMENT rtDW_ADAS.GTHLL_Z2_Obj8_o "" UBYTE ADAS_CM_uint8 0 0 0 255 ECU_ADDRESS 0x0000 /* @ECU_Address@rtDW_ADAS.GTHLL_Z2_Obj8_o@ */ /end MEASUREMENT
/begin MEASUREMENT rtDW_ADAS.GTHLL_Z2_Obj9 "" UBYTE ADAS_CM_uint8 0 0 0 255 ECU_ADDRESS 0x0000 /* @ECU_Address@rtDW_ADAS.GTHLL_Z2_Obj9@ */ /end MEASUREMENT
/begin MEASUREMENT rtDW_ADAS.GTHLL_Z2_Obj9_b "" UBYTE ADAS_CM_uint8 0 0 0 255 ECU_ADDRESS 0x0000 /* @ECU_Address@rtDW_ADAS.GTHLL_Z2_Obj9_b@ */ /end MEASUREMENT
/begin MEASUREMENT rtDW_ADAS.GTHLRADBtargetLEDs_MODE "" UBYTE ADAS_CM_logical 0 0 0 1 ECU_ADDRESS 0x0000 /* @ECU_Address@rtDW_ADAS.GTHLRADBtargetLEDs_MODE@ */ /end MEASUREMENT
/begin MEASUREMENT rtDW_ADAS.GTHLR_Y1_Obj1 "" FLOAT32_IEEE ADAS_CM_single 0 0 -3.4E+38 3.4E+38 ECU_ADDRESS 0x0000 /* @ECU_Address@rtDW_ADAS.GTHLR_Y1_Obj1@ */ /end MEASUREMENT
/begin MEASUREMENT rtDW_ADAS.GTHLR_Y1_Obj10 "" FLOAT32_IEEE ADAS_CM_single 0 0 -3.4E+38 3.4E+38 ECU_ADDRESS 0x0000 /* @ECU_Address@rtDW_ADAS.GTHLR_Y1_Obj10@ */ /end MEASUREMENT
/begin MEASUREMENT rtDW_ADAS.GTHLR_Y1_Obj10_j "" FLOAT32_IEEE ADAS_CM_single 0 0 -3.4E+38 3.4E+38 ECU_ADDRESS 0x0000 /* @ECU_Address@rtDW_ADAS.GTHLR_Y1_Obj10_j@ */ /end MEASUREMENT
/begin MEASUREMENT rtDW_ADAS.GTHLR_Y1_Obj1_f "" FLOAT32_IEEE ADAS_CM_single 0 0 -3.4E+38 3.4E+38 ECU_ADDRESS 0x0000 /* @ECU_Address@rtDW_ADAS.GTHLR_Y1_Obj1_f@ */ /end MEASUREMENT
/begin MEASUREMENT rtDW_ADAS.GTHLR_Y1_Obj2 "" FLOAT32_IEEE ADAS_CM_single 0 0 -3.4E+38 3.4E+38 ECU_ADDRESS 0x0000 /* @ECU_Address@rtDW_ADAS.GTHLR_Y1_Obj2@ */ /end MEASUREMENT
/begin COMPU_METHOD ADAS_CM_double "" IDENTICAL "%15.10" "" /end COMPU_METHOD
/begin COMPU_METHOD ADAS_CM_logical "" IDENTICAL "%1.0" "" /end COMPU_METHOD
/begin COMPU_METHOD ADAS_CM_single "" IDENTICAL "%8.6" "" /end COMPU_METHOD
/begin COMPU_METHOD ADAS_CM_uint32 "" IDENTICAL "%10.0" "" /end COMPU_METHOD
/begin COMPU_METHOD ADAS_CM_uint8 "" IDENTICAL "%3.0" "" /end COMPU_METHOD
/begin RECORD_LAYOUT Scalar_FLOAT64_IEEE FNC_VALUES 1 FLOAT64_IEEE COLUMN_DIR DIRECT /end RECORD_LAYOUT
/begin RECORD_LAYOUT Scalar_SLONG FNC_VALUES 1 SLONG COLUMN_DIR DIRECT /end RECORD_LAYOUT
/end MODULE
/end PROJECT
