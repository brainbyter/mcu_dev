/******************************************************************************
* ASAP2 file: ADAS.a2l
* Code generation for model "ADAS".
* Model version : 6.789
* Simulink Coder version : 10.5 R2022a
* C source code generated on : Fri May 30 14:42:37 2025
* Target selection: ert.tlc
* Embedded hardware selection: Infineon->TriCore
* Code generation objectives: Unspecified
* Validation result: Not run
* (add additional file header information here)
******************************************************************************/
ASAP2_VERSION 1 71
/begin PROJECT ProjectName "Project Comment Goes Here"
/begin HEADER "Header Comments go here" /end HEADER
/begin MODULE ModuleName "Module Comment Goes Here"
/begin MOD_PAR "MOD PAR Comment Goes Here" /end MOD_PAR
/begin MOD_COMMON "Mod Common Comment Here" BYTE_ORDER MSB_LAST ALIGNMENT_BYTE 1 ALIGNMENT_WORD 2 ALIGNMENT_LONG 4 ALIGNMENT_FLOAT32_IEEE 4 ALIGNMENT_FLOAT64_IEEE 8 ALIGNMENT_INT64 8 /end MOD_COMMON
/begin MEASUREMENT DtDiagVerNumSoftWare "" UBYTE ADAS_CM_uint8 0 0 0.000000 255.000000 ECU_ADDRESS 0x0000 /* @ECU_Address@DtDiagVerNumSoftWare@ */ /end MEASUREMENT
/begin MEASUREMENT rtDW_ADAS.GTAAErReq "" UBYTE ADAS_CM_uint8 0 0 0 255 ECU_ADDRESS 0x0000 /* @ECU_Address@rtDW_ADAS.GTAAErReq@ */ /end MEASUREMENT
/begin MEASUREMENT rtDW_ADAS.GTACC_BLA "" UBYTE ADAS_CM_uint8 0 0 0 255 ECU_ADDRESS 0x0000 /* @ECU_Address@rtDW_ADAS.GTACC_BLA@ */ /end MEASUREMENT
/begin MEASUREMENT rtDW_ADAS.GTAaModeReq "" UBYTE ADAS_CM_uint8 0 0 0 255 ECU_ADDRESS 0x0000 /* @ECU_Address@rtDW_ADAS.GTAaModeReq@ */ /end MEASUREMENT
/begin MEASUREMENT rtDW_ADAS.GTAccAvail "" UBYTE ADAS_CM_uint8 0 0 0 255 ECU_ADDRESS 0x0000 /* @ECU_Address@rtDW_ADAS.GTAccAvail@ */ /end MEASUREMENT
/begin MEASUREMENT rtDW_ADAS.GTAccErReq "" UBYTE ADAS_CM_uint8 0 0 0 255 ECU_ADDRESS 0x0000 /* @ECU_Address@rtDW_ADAS.GTAccErReq@ */ /end MEASUREMENT
/begin MEASUREMENT rtDW_ADAS.GTAccPlaussibCount "" UBYTE ADAS_CM_uint8 0 0 0 255 ECU_ADDRESS 0x0000 /* @ECU_Address@rtDW_ADAS.GTAccPlaussibCount@ */ /end MEASUREMENT
/begin MEASUREMENT rtDW_ADAS.GTAccel_Out "" FLOAT32_IEEE ADAS_CM_single 0 0 -3.4E+38 3.4E+38 ECU_ADDRESS 0x0000 /* @ECU_Address@rtDW_ADAS.GTAccel_Out@ */ /end MEASUREMENT
/begin MEASUREMENT rtDW_ADAS.GTAccel_lead "" FLOAT32_IEEE ADAS_CM_single 0 0 -3.4E+38 3.4E+38 ECU_ADDRESS 0x0000 /* @ECU_Address@rtDW_ADAS.GTAccel_lead@ */ /end MEASUREMENT
/begin MEASUREMENT rtDW_ADAS.GTActivSts "" UBYTE ADAS_CM_uint8 0 0 0 255 ECU_ADDRESS 0x0000 /* @ECU_Address@rtDW_ADAS.GTActivSts@ */ /end MEASUREMENT
/begin MEASUREMENT rtDW_ADAS.GTAdd "" FLOAT64_IEEE ADAS_CM_double 0 0 -1.7E+308 1.7E+308 ECU_ADDRESS 0x0000 /* @ECU_Address@rtDW_ADAS.GTAdd@ */ /end MEASUREMENT
/begin MEASUREMENT rtDW_ADAS.GTAebErReq "" UBYTE ADAS_CM_uint8 0 0 0 255 ECU_ADDRESS 0x0000 /* @ECU_Address@rtDW_ADAS.GTAebErReq@ */ /end MEASUREMENT
/begin MEASUREMENT rtDW_ADAS.GTAlccErReq "" UBYTE ADAS_CM_uint8 0 0 0 255 ECU_ADDRESS 0x0000 /* @ECU_Address@rtDW_ADAS.GTAlccErReq@ */ /end MEASUREMENT
/begin MEASUREMENT rtDW_ADAS.GTAslaDeltaReq "" FLOAT32_IEEE ADAS_CM_single 0 0 -3.4E+38 3.4E+38 ECU_ADDRESS 0x0000 /* @ECU_Address@rtDW_ADAS.GTAslaDeltaReq@ */ /end MEASUREMENT
/begin MEASUREMENT rtDW_ADAS.GTAslaErReq "" UBYTE ADAS_CM_uint8 0 0 0 255 ECU_ADDRESS 0x0000 /* @ECU_Address@rtDW_ADAS.GTAslaErReq@ */ /end MEASUREMENT
/begin MEASUREMENT rtDW_ADAS.GTB_ChType "" UBYTE ADAS_CM_uint8 0 0 0 255 ECU_ADDRESS 0x0000 /* @ECU_Address@rtDW_ADAS.GTB_ChType@ */ /end MEASUREMENT
/begin MEASUREMENT rtDW_ADAS.GTB_ON "" UBYTE ADAS_CM_uint8 0 0 0 255 ECU_ADDRESS 0x0000 /* @ECU_Address@rtDW_ADAS.GTB_ON@ */ /end MEASUREMENT
/begin MEASUREMENT rtDW_ADAS.GTBlsActive "" UBYTE ADAS_CM_uint8 0 0 0 255 ECU_ADDRESS 0x0000 /* @ECU_Address@rtDW_ADAS.GTBlsActive@ */ /end MEASUREMENT
/begin MEASUREMENT rtDW_ADAS.GTBtSpdDec "" UBYTE ADAS_CM_uint8 0 0 0 255 ECU_ADDRESS 0x0000 /* @ECU_Address@rtDW_ADAS.GTBtSpdDec@ */ /end MEASUREMENT
/begin MEASUREMENT rtDW_ADAS.GTBtSpdInc "" UBYTE ADAS_CM_uint8 0 0 0 255 ECU_ADDRESS 0x0000 /* @ECU_Address@rtDW_ADAS.GTBtSpdInc@ */ /end MEASUREMENT
/begin MEASUREMENT rtDW_ADAS.GTButtonCnt "" FLOAT64_IEEE ADAS_CM_double 0 0 -1.7E+308 1.7E+308 ECU_ADDRESS 0x0000 /* @ECU_Address@rtDW_ADAS.GTButtonCnt@ */ /end MEASUREMENT
/begin MEASUREMENT rtDW_ADAS.GTButtonLcc "" FLOAT64_IEEE ADAS_CM_double 0 0 -1.7E+308 1.7E+308 ECU_ADDRESS 0x0000 /* @ECU_Address@rtDW_ADAS.GTButtonLcc@ */ /end MEASUREMENT
/begin MEASUREMENT rtDW_ADAS.GTButtonLdw "" FLOAT64_IEEE ADAS_CM_double 0 0 -1.7E+308 1.7E+308 ECU_ADDRESS 0x0000 /* @ECU_Address@rtDW_ADAS.GTButtonLdw@ */ /end MEASUREMENT
/begin MEASUREMENT rtDW_ADAS.GTCCErReq "" UBYTE ADAS_CM_uint8 0 0 0 255 ECU_ADDRESS 0x0000 /* @ECU_Address@rtDW_ADAS.GTCCErReq@ */ /end MEASUREMENT
/begin MEASUREMENT rtDW_ADAS.GTCDA_ReleaseReq "" UBYTE ADAS_CM_uint8 0 0 0 255 ECU_ADDRESS 0x0000 /* @ECU_Address@rtDW_ADAS.GTCDA_ReleaseReq@ */ /end MEASUREMENT
/begin MEASUREMENT rtDW_ADAS.GTCDA_StandReq "" UBYTE ADAS_CM_uint8 0 0 0 255 MATRIX_DIM 1 1 ECU_ADDRESS 0x0000 /* @ECU_Address@rtDW_ADAS.GTCDA_StandReq@ */ /end MEASUREMENT
/begin MEASUREMENT rtDW_ADAS.GTCDA_Stand_Flag "" UBYTE ADAS_CM_uint8 0 0 0 255 ECU_ADDRESS 0x0000 /* @ECU_Address@rtDW_ADAS.GTCDA_Stand_Flag@ */ /end MEASUREMENT
/begin MEASUREMENT rtDW_ADAS.GTCDDReq "" UBYTE ADAS_CM_uint8 0 0 0 255 ECU_ADDRESS 0x0000 /* @ECU_Address@rtDW_ADAS.GTCDDReq@ */ /end MEASUREMENT
/begin MEASUREMENT rtDW_ADAS.GTCcActSts "" UBYTE ADAS_CM_uint8 0 0 0 255 ECU_ADDRESS 0x0000 /* @ECU_Address@rtDW_ADAS.GTCcActSts@ */ /end MEASUREMENT
/begin MEASUREMENT rtDW_ADAS.GTCcAutoSpeedReq "" UBYTE ADAS_CM_uint8 0 0 0 255 ECU_ADDRESS 0x0000 /* @ECU_Address@rtDW_ADAS.GTCcAutoSpeedReq@ */ /end MEASUREMENT
/begin MEASUREMENT rtDW_ADAS.GTCcAvail "" UBYTE ADAS_CM_uint8 0 0 0 255 ECU_ADDRESS 0x0000 /* @ECU_Address@rtDW_ADAS.GTCcAvail@ */ /end MEASUREMENT
/begin MEASUREMENT rtDW_ADAS.GTCcTypeReq "" UBYTE ADAS_CM_uint8 0 0 0 255 ECU_ADDRESS 0x0000 /* @ECU_Address@rtDW_ADAS.GTCcTypeReq@ */ /end MEASUREMENT
/begin MEASUREMENT rtDW_ADAS.GTCcmodeReq "" UBYTE ADAS_CM_uint8 0 0 0 255 ECU_ADDRESS 0x0000 /* @ECU_Address@rtDW_ADAS.GTCcmodeReq@ */ /end MEASUREMENT
/begin MEASUREMENT rtDW_ADAS.GTCddAvailable "" UBYTE ADAS_CM_uint8 0 0 0 255 ECU_ADDRESS 0x0000 /* @ECU_Address@rtDW_ADAS.GTCddAvailable@ */ /end MEASUREMENT
/begin MEASUREMENT rtDW_ADAS.GTCddStandstillSt "" UBYTE ADAS_CM_uint8 0 0 0 255 ECU_ADDRESS 0x0000 /* @ECU_Address@rtDW_ADAS.GTCddStandstillSt@ */ /end MEASUREMENT
/begin MEASUREMENT rtDW_ADAS.GTCleanSensorReq "" UBYTE ADAS_CM_uint8 0 0 0 255 ECU_ADDRESS 0x0000 /* @ECU_Address@rtDW_ADAS.GTCleanSensorReq@ */ /end MEASUREMENT
/begin MEASUREMENT rtDW_ADAS.GTCode_logic "" UBYTE ADAS_CM_uint8 0 0 0 255 ECU_ADDRESS 0x0000 /* @ECU_Address@rtDW_ADAS.GTCode_logic@ */ /end MEASUREMENT
/begin MEASUREMENT rtDW_ADAS.GTCompare "" UBYTE ADAS_CM_uint8 0 0 0 255 ECU_ADDRESS 0x0000 /* @ECU_Address@rtDW_ADAS.GTCompare@ */ /end MEASUREMENT
/begin MEASUREMENT rtDW_ADAS.GTCompare_i "" UBYTE ADAS_CM_logical 0 0 0 1 ECU_ADDRESS 0x0000 /* @ECU_Address@rtDW_ADAS.GTCompare_i@ */ /end MEASUREMENT
/begin MEASUREMENT rtDW_ADAS.GTDataT "" UBYTE ADAS_CM_uint8 0 0 0 255 ECU_ADDRESS 0x0000 /* @ECU_Address@rtDW_ADAS.GTDataT@ */ /end MEASUREMENT
/begin MEASUREMENT rtDW_ADAS.GTDataTypeConversion "" FLOAT32_IEEE ADAS_CM_single 0 0 -3.4E+38 3.4E+38 ECU_ADDRESS 0x0000 /* @ECU_Address@rtDW_ADAS.GTDataTypeConversion@ */ /end MEASUREMENT
/begin MEASUREMENT rtDW_ADAS.GTDataTypeConversion1 "" UBYTE ADAS_CM_uint8 0 0 0 255 ECU_ADDRESS 0x0000 /* @ECU_Address@rtDW_ADAS.GTDataTypeConversion1@ */ /end MEASUREMENT
/begin MEASUREMENT rtDW_ADAS.GTDataTypeConversion2 "" FLOAT32_IEEE ADAS_CM_single 0 0 -3.4E+38 3.4E+38 ECU_ADDRESS 0x0000 /* @ECU_Address@rtDW_ADAS.GTDataTypeConversion2@ */ /end MEASUREMENT
/begin MEASUREMENT rtDW_ADAS.GTDataTypeConversion3 "" UBYTE ADAS_CM_uint8 0 0 0 255 ECU_ADDRESS 0x0000 /* @ECU_Address@rtDW_ADAS.GTDataTypeConversion3@ */ /end MEASUREMENT
/begin MEASUREMENT rtDW_ADAS.GTDataTypeConversion3_g "" UBYTE ADAS_CM_uint8 0 0 0 255 ECU_ADDRESS 0x0000 /* @ECU_Address@rtDW_ADAS.GTDataTypeConversion3_g@ */ /end MEASUREMENT
/begin MEASUREMENT rtDW_ADAS.GTDataTypeConversion3_p "" UBYTE ADAS_CM_uint8 0 0 0 255 ECU_ADDRESS 0x0000 /* @ECU_Address@rtDW_ADAS.GTDataTypeConversion3_p@ */ /end MEASUREMENT
/begin MEASUREMENT rtDW_ADAS.GTDataTypeConversion4 "" UBYTE ADAS_CM_uint8 0 0 0 255 ECU_ADDRESS 0x0000 /* @ECU_Address@rtDW_ADAS.GTDataTypeConversion4@ */ /end MEASUREMENT
/begin MEASUREMENT rtDW_ADAS.GTDataTypeConversion4_i "" UBYTE ADAS_CM_uint8 0 0 0 255 ECU_ADDRESS 0x0000 /* @ECU_Address@rtDW_ADAS.GTDataTypeConversion4_i@ */ /end MEASUREMENT
/begin MEASUREMENT rtDW_ADAS.GTDataTypeConversion4_m "" UBYTE ADAS_CM_uint8 0 0 0 255 ECU_ADDRESS 0x0000 /* @ECU_Address@rtDW_ADAS.GTDataTypeConversion4_m@ */ /end MEASUREMENT
/begin MEASUREMENT rtDW_ADAS.GTDataTypeConversion_a "" UBYTE ADAS_CM_uint8 0 0 0 255 ECU_ADDRESS 0x0000 /* @ECU_Address@rtDW_ADAS.GTDataTypeConversion_a@ */ /end MEASUREMENT
/begin MEASUREMENT rtDW_ADAS.GTDataTypeConversion_c "" UBYTE ADAS_CM_uint8 0 0 0 255 ECU_ADDRESS 0x0000 /* @ECU_Address@rtDW_ADAS.GTDataTypeConversion_c@ */ /end MEASUREMENT
/begin MEASUREMENT rtDW_ADAS.GTDataTypeConversion_d "" UBYTE ADAS_CM_uint8 0 0 0 255 ECU_ADDRESS 0x0000 /* @ECU_Address@rtDW_ADAS.GTDataTypeConversion_d@ */ /end MEASUREMENT
/begin MEASUREMENT rtDW_ADAS.GTDataTypeConversion_d1 "" UBYTE ADAS_CM_uint8 0 0 0 255 ECU_ADDRESS 0x0000 /* @ECU_Address@rtDW_ADAS.GTDataTypeConversion_d1@ */ /end MEASUREMENT
/begin MEASUREMENT rtDW_ADAS.GTDataTypeConversion_i "" UBYTE ADAS_CM_uint8 0 0 0 255 ECU_ADDRESS 0x0000 /* @ECU_Address@rtDW_ADAS.GTDataTypeConversion_i@ */ /end MEASUREMENT
/begin MEASUREMENT rtDW_ADAS.GTDataTypeConversion_j "" UBYTE ADAS_CM_uint8 0 0 0 255 ECU_ADDRESS 0x0000 /* @ECU_Address@rtDW_ADAS.GTDataTypeConversion_j@ */ /end MEASUREMENT
/begin MEASUREMENT rtDW_ADAS.GTDataTypeConversion_o "" UBYTE ADAS_CM_uint8 0 0 0 255 ECU_ADDRESS 0x0000 /* @ECU_Address@rtDW_ADAS.GTDataTypeConversion_o@ */ /end MEASUREMENT
/begin MEASUREMENT rtDW_ADAS.GTDelay1_DSTATE "" FLOAT64_IEEE ADAS_CM_double 0 0 -1.7E+308 1.7E+308 ECU_ADDRESS 0x0000 /* @ECU_Address@rtDW_ADAS.GTDelay1_DSTATE@ */ /end MEASUREMENT
/begin MEASUREMENT rtDW_ADAS.GTDelay1_DSTATE_c "" FLOAT32_IEEE ADAS_CM_single 0 0 -3.4E+38 3.4E+38 ECU_ADDRESS 0x0000 /* @ECU_Address@rtDW_ADAS.GTDelay1_DSTATE_c@ */ /end MEASUREMENT
/begin MEASUREMENT rtDW_ADAS.GTDelay1_DSTATE_f "" UBYTE ADAS_CM_uint8 0 0 0 255 ECU_ADDRESS 0x0000 /* @ECU_Address@rtDW_ADAS.GTDelay1_DSTATE_f@ */ /end MEASUREMENT
/begin MEASUREMENT rtDW_ADAS.GTDelay1_DSTATE_h "" UBYTE ADAS_CM_uint8 0 0 0 255 LAYOUT COLUMN_DIR MATRIX_DIM 10 ECU_ADDRESS 0x0000 /* @ECU_Address@rtDW_ADAS.GTDelay1_DSTATE_h@ */ /end MEASUREMENT
/begin MEASUREMENT rtDW_ADAS.GTDelay1_DSTATE_i "" FLOAT64_IEEE ADAS_CM_double 0 0 -1.7E+308 1.7E+308 LAYOUT COLUMN_DIR MATRIX_DIM 2 ECU_ADDRESS 0x0000 /* @ECU_Address@rtDW_ADAS.GTDelay1_DSTATE_i@ */ /end MEASUREMENT
/begin MEASUREMENT rtDW_ADAS.GTDelay1_DSTATE_j "" UBYTE ADAS_CM_uint8 0 0 0 255 ECU_ADDRESS 0x0000 /* @ECU_Address@rtDW_ADAS.GTDelay1_DSTATE_j@ */ /end MEASUREMENT
/begin MEASUREMENT rtDW_ADAS.GTDelay2_DSTATE "" FLOAT64_IEEE ADAS_CM_double 0 0 -1.7E+308 1.7E+308 ECU_ADDRESS 0x0000 /* @ECU_Address@rtDW_ADAS.GTDelay2_DSTATE@ */ /end MEASUREMENT
/begin MEASUREMENT rtDW_ADAS.GTDelay2_DSTATE_d3 "" FLOAT32_IEEE ADAS_CM_single 0 0 -3.4E+38 3.4E+38 LAYOUT COLUMN_DIR MATRIX_DIM 8 ECU_ADDRESS 0x0000 /* @ECU_Address@rtDW_ADAS.GTDelay2_DSTATE_d3@ */ /end MEASUREMENT
/begin MEASUREMENT rtDW_ADAS.GTDelay2_DSTATE_l "" FLOAT64_IEEE ADAS_CM_double 0 0 -1.7E+308 1.7E+308 ECU_ADDRESS 0x0000 /* @ECU_Address@rtDW_ADAS.GTDelay2_DSTATE_l@ */ /end MEASUREMENT
/begin MEASUREMENT rtDW_ADAS.GTDelay3_DSTATE "" FLOAT64_IEEE ADAS_CM_double 0 0 -1.7E+308 1.7E+308 ECU_ADDRESS 0x0000 /* @ECU_Address@rtDW_ADAS.GTDelay3_DSTATE@ */ /end MEASUREMENT
/begin MEASUREMENT rtDW_ADAS.GTDelay3_DSTATE_b "" UBYTE ADAS_CM_uint8 0 0 0 255 ECU_ADDRESS 0x0000 /* @ECU_Address@rtDW_ADAS.GTDelay3_DSTATE_b@ */ /end MEASUREMENT
/begin MEASUREMENT rtDW_ADAS.GTDelay4_DSTATE_o "" FLOAT32_IEEE ADAS_CM_single 0 0 -3.4E+38 3.4E+38 ECU_ADDRESS 0x0000 /* @ECU_Address@rtDW_ADAS.GTDelay4_DSTATE_o@ */ /end MEASUREMENT
/begin MEASUREMENT rtDW_ADAS.GTDelay5_DSTATE_g "" FLOAT32_IEEE ADAS_CM_single 0 0 -3.4E+38 3.4E+38 ECU_ADDRESS 0x0000 /* @ECU_Address@rtDW_ADAS.GTDelay5_DSTATE_g@ */ /end MEASUREMENT
/begin MEASUREMENT rtDW_ADAS.GTDelay5_DSTATE_i "" UWORD ADAS_CM_uint16 0 0 0 65535 ECU_ADDRESS 0x0000 /* @ECU_Address@rtDW_ADAS.GTDelay5_DSTATE_i@ */ /end MEASUREMENT
/begin MEASUREMENT rtDW_ADAS.GTDelay6_DSTATE "" FLOAT64_IEEE ADAS_CM_double 0 0 -1.7E+308 1.7E+308 ECU_ADDRESS 0x0000 /* @ECU_Address@rtDW_ADAS.GTDelay6_DSTATE@ */ /end MEASUREMENT
/begin MEASUREMENT rtDW_ADAS.GTDelay7_DSTATE_l "" UWORD ADAS_CM_uint16 0 0 0 65535 LAYOUT COLUMN_DIR MATRIX_DIM 2 ECU_ADDRESS 0x0000 /* @ECU_Address@rtDW_ADAS.GTDelay7_DSTATE_l@ */ /end MEASUREMENT
/begin MEASUREMENT rtDW_ADAS.GTDelay8_DSTATE "" FLOAT64_IEEE ADAS_CM_double 0 0 -1.7E+308 1.7E+308 ECU_ADDRESS 0x0000 /* @ECU_Address@rtDW_ADAS.GTDelay8_DSTATE@ */ /end MEASUREMENT
/begin MEASUREMENT rtDW_ADAS.GTDelay9_DSTATE "" FLOAT64_IEEE ADAS_CM_double 0 0 -1.7E+308 1.7E+308 ECU_ADDRESS 0x0000 /* @ECU_Address@rtDW_ADAS.GTDelay9_DSTATE@ */ /end MEASUREMENT
/begin MEASUREMENT rtDW_ADAS.GTDelayInput2_DSTATE_a "" FLOAT32_IEEE ADAS_CM_single 0 0 -3.4E+38 3.4E+38 ECU_ADDRESS 0x0000 /* @ECU_Address@rtDW_ADAS.GTDelayInput2_DSTATE_a@ */ /end MEASUREMENT
/begin MEASUREMENT rtDW_ADAS.GTDelayInput2_DSTATE_ag "" FLOAT32_IEEE ADAS_CM_single 0 0 -3.4E+38 3.4E+38 ECU_ADDRESS 0x0000 /* @ECU_Address@rtDW_ADAS.GTDelayInput2_DSTATE_ag@ */ /end MEASUREMENT
/begin MEASUREMENT rtDW_ADAS.GTDelayInput2_DSTATE_lk "" FLOAT32_IEEE ADAS_CM_single 0 0 -3.4E+38 3.4E+38 ECU_ADDRESS 0x0000 /* @ECU_Address@rtDW_ADAS.GTDelayInput2_DSTATE_lk@ */ /end MEASUREMENT
/begin MEASUREMENT rtDW_ADAS.GTDelayInput2_DSTATE_o "" FLOAT32_IEEE ADAS_CM_single 0 0 -3.4E+38 3.4E+38 ECU_ADDRESS 0x0000 /* @ECU_Address@rtDW_ADAS.GTDelayInput2_DSTATE_o@ */ /end MEASUREMENT
/begin MEASUREMENT rtDW_ADAS.GTDelay_DSTATE "" FLOAT64_IEEE ADAS_CM_double 0 0 -1.7E+308 1.7E+308 ECU_ADDRESS 0x0000 /* @ECU_Address@rtDW_ADAS.GTDelay_DSTATE@ */ /end MEASUREMENT
/begin MEASUREMENT rtDW_ADAS.GTDelay_DSTATE_b "" FLOAT64_IEEE ADAS_CM_double 0 0 -1.7E+308 1.7E+308 LAYOUT COLUMN_DIR MATRIX_DIM 2 ECU_ADDRESS 0x0000 /* @ECU_Address@rtDW_ADAS.GTDelay_DSTATE_b@ */ /end MEASUREMENT
/begin MEASUREMENT rtDW_ADAS.GTDelay_DSTATE_c "" FLOAT32_IEEE ADAS_CM_single 0 0 -3.4E+38 3.4E+38 LAYOUT COLUMN_DIR MATRIX_DIM 10 ECU_ADDRESS 0x0000 /* @ECU_Address@rtDW_ADAS.GTDelay_DSTATE_c@ */ /end MEASUREMENT
/begin MEASUREMENT rtDW_ADAS.GTDelay_DSTATE_e "" FLOAT32_IEEE ADAS_CM_single 0 0 -3.4E+38 3.4E+38 LAYOUT COLUMN_DIR MATRIX_DIM 6 ECU_ADDRESS 0x0000 /* @ECU_Address@rtDW_ADAS.GTDelay_DSTATE_e@ */ /end MEASUREMENT
/begin MEASUREMENT rtDW_ADAS.GTDelay_DSTATE_j "" FLOAT64_IEEE ADAS_CM_double 0 0 -1.7E+308 1.7E+308 ECU_ADDRESS 0x0000 /* @ECU_Address@rtDW_ADAS.GTDelay_DSTATE_j@ */ /end MEASUREMENT
/begin MEASUREMENT rtDW_ADAS.GTDelay_DSTATE_l "" UBYTE ADAS_CM_uint8 0 0 0 255 LAYOUT COLUMN_DIR MATRIX_DIM 2 ECU_ADDRESS 0x0000 /* @ECU_Address@rtDW_ADAS.GTDelay_DSTATE_l@ */ /end MEASUREMENT
/begin MEASUREMENT rtDW_ADAS.GTDelay_DSTATE_o "" FLOAT32_IEEE ADAS_CM_single 0 0 -3.4E+38 3.4E+38 LAYOUT COLUMN_DIR MATRIX_DIM 10 ECU_ADDRESS 0x0000 /* @ECU_Address@rtDW_ADAS.GTDelay_DSTATE_o@ */ /end MEASUREMENT
/begin MEASUREMENT rtDW_ADAS.GTDoor "" UBYTE ADAS_CM_uint8 0 0 0 255 ECU_ADDRESS 0x0000 /* @ECU_Address@rtDW_ADAS.GTDoor@ */ /end MEASUREMENT
/begin MEASUREMENT rtDW_ADAS.GTDowErReq "" UBYTE ADAS_CM_uint8 0 0 0 255 ECU_ADDRESS 0x0000 /* @ECU_Address@rtDW_ADAS.GTDowErReq@ */ /end MEASUREMENT
/begin MEASUREMENT rtDW_ADAS.GTDowLeftLedReq "" UBYTE ADAS_CM_uint8 0 0 0 255 ECU_ADDRESS 0x0000 /* @ECU_Address@rtDW_ADAS.GTDowLeftLedReq@ */ /end MEASUREMENT
/begin MEASUREMENT rtDW_ADAS.GTDowLeftWarnReq "" UBYTE ADAS_CM_uint8 0 0 0 255 ECU_ADDRESS 0x0000 /* @ECU_Address@rtDW_ADAS.GTDowLeftWarnReq@ */ /end MEASUREMENT
/begin MEASUREMENT rtDW_ADAS.GTDowRightLedReq "" UBYTE ADAS_CM_uint8 0 0 0 255 ECU_ADDRESS 0x0000 /* @ECU_Address@rtDW_ADAS.GTDowRightLedReq@ */ /end MEASUREMENT
/begin MEASUREMENT rtDW_ADAS.GTDowRightWarnReq "" UBYTE ADAS_CM_uint8 0 0 0 255 ECU_ADDRESS 0x0000 /* @ECU_Address@rtDW_ADAS.GTDowRightWarnReq@ */ /end MEASUREMENT
/begin MEASUREMENT rtDW_ADAS.GTDowSoundReq "" UBYTE ADAS_CM_uint8 0 0 0 255 ECU_ADDRESS 0x0000 /* @ECU_Address@rtDW_ADAS.GTDowSoundReq@ */ /end MEASUREMENT
/begin MEASUREMENT rtDW_ADAS.GTDowSoundWarnReq "" UBYTE ADAS_CM_uint8 0 0 0 255 ECU_ADDRESS 0x0000 /* @ECU_Address@rtDW_ADAS.GTDowSoundWarnReq@ */ /end MEASUREMENT
/begin MEASUREMENT rtDW_ADAS.GTDrTake "" UBYTE ADAS_CM_logical 0 0 0 1 ECU_ADDRESS 0x0000 /* @ECU_Address@rtDW_ADAS.GTDrTake@ */ /end MEASUREMENT
/begin MEASUREMENT rtDW_ADAS.GTDrive_off_VLC "" UBYTE ADAS_CM_uint8 0 0 0 255 ECU_ADDRESS 0x0000 /* @ECU_Address@rtDW_ADAS.GTDrive_off_VLC@ */ /end MEASUREMENT
/begin MEASUREMENT rtDW_ADAS.GTDrivingMode_Sig "" UBYTE ADAS_CM_uint8 0 0 0 255 ECU_ADDRESS 0x0000 /* @ECU_Address@rtDW_ADAS.GTDrivingMode_Sig@ */ /end MEASUREMENT
/begin MEASUREMENT rtDW_ADAS.GTDtLogDowLogicTrans "" UBYTE ADAS_CM_uint8 0 0 0 255 ECU_ADDRESS 0x0000 /* @ECU_Address@rtDW_ADAS.GTDtLogDowLogicTrans@ */ /end MEASUREMENT
/begin MEASUREMENT rtDW_ADAS.GTDtLogDowWarnReqTrans "" UBYTE ADAS_CM_uint8 0 0 0 255 ECU_ADDRESS 0x0000 /* @ECU_Address@rtDW_ADAS.GTDtLogDowWarnReqTrans@ */ /end MEASUREMENT
/begin MEASUREMENT rtDW_ADAS.GTDtLogDowWarnReqTransLeft "" UBYTE ADAS_CM_uint8 0 0 0 255 ECU_ADDRESS 0x0000 /* @ECU_Address@rtDW_ADAS.GTDtLogDowWarnReqTransLeft@ */ /end MEASUREMENT
/begin MEASUREMENT rtDW_ADAS.GTDtLogDowWarnReqTransRight "" UBYTE ADAS_CM_uint8 0 0 0 255 ECU_ADDRESS 0x0000 /* @ECU_Address@rtDW_ADAS.GTDtLogDowWarnReqTransRight@ */ /end MEASUREMENT
/begin MEASUREMENT rtDW_ADAS.GTDtLogDowWarnReqTrans_l "" UBYTE ADAS_CM_uint8 0 0 0 255 ECU_ADDRESS 0x0000 /* @ECU_Address@rtDW_ADAS.GTDtLogDowWarnReqTrans_l@ */ /end MEASUREMENT
/begin MEASUREMENT rtDW_ADAS.GTDynamicEmergency "" UBYTE ADAS_CM_uint8 0 0 0 255 ECU_ADDRESS 0x0000 /* @ECU_Address@rtDW_ADAS.GTDynamicEmergency@ */ /end MEASUREMENT
/begin MEASUREMENT rtDW_ADAS.GTErr_Speed_IC "" UBYTE ADAS_CM_uint8 0 0 0 255 ECU_ADDRESS 0x0000 /* @ECU_Address@rtDW_ADAS.GTErr_Speed_IC@ */ /end MEASUREMENT
/begin MEASUREMENT rtDW_ADAS.GTFail "" UBYTE ADAS_CM_uint8 0 0 0 255 ECU_ADDRESS 0x0000 /* @ECU_Address@rtDW_ADAS.GTFail@ */ /end MEASUREMENT
/begin MEASUREMENT rtDW_ADAS.GTFail_b "" UBYTE ADAS_CM_uint8 0 0 0 255 ECU_ADDRESS 0x0000 /* @ECU_Address@rtDW_ADAS.GTFail_b@ */ /end MEASUREMENT
/begin MEASUREMENT rtDW_ADAS.GTFcwErReq "" UBYTE ADAS_CM_uint8 0 0 0 255 ECU_ADDRESS 0x0000 /* @ECU_Address@rtDW_ADAS.GTFcwErReq@ */ /end MEASUREMENT
/begin MEASUREMENT rtDW_ADAS.GTFcwModeReq "" UBYTE ADAS_CM_uint8 0 0 0 255 ECU_ADDRESS 0x0000 /* @ECU_Address@rtDW_ADAS.GTFcwModeReq@ */ /end MEASUREMENT
/begin MEASUREMENT rtDW_ADAS.GTFcwVibrWarnReq "" UBYTE ADAS_CM_uint8 0 0 0 255 ECU_ADDRESS 0x0000 /* @ECU_Address@rtDW_ADAS.GTFcwVibrWarnReq@ */ /end MEASUREMENT
/begin MEASUREMENT rtDW_ADAS.GTFlag "" UBYTE ADAS_CM_uint8 0 0 0 255 ECU_ADDRESS 0x0000 /* @ECU_Address@rtDW_ADAS.GTFlag@ */ /end MEASUREMENT
/begin MEASUREMENT rtDW_ADAS.GTFrcuBlk "" UBYTE ADAS_CM_uint8 0 0 0 255 ECU_ADDRESS 0x0000 /* @ECU_Address@rtDW_ADAS.GTFrcuBlk@ */ /end MEASUREMENT
/begin MEASUREMENT rtDW_ADAS.GTGain "" FLOAT32_IEEE ADAS_CM_single 0 0 -3.4E+38 3.4E+38 ECU_ADDRESS 0x0000 /* @ECU_Address@rtDW_ADAS.GTGain@ */ /end MEASUREMENT
/begin MEASUREMENT rtDW_ADAS.GTGain2 "" FLOAT32_IEEE ADAS_CM_single 0 0 -3.4E+38 3.4E+38 ECU_ADDRESS 0x0000 /* @ECU_Address@rtDW_ADAS.GTGain2@ */ /end MEASUREMENT
/begin MEASUREMENT rtDW_ADAS.GTGain3 "" FLOAT32_IEEE ADAS_CM_single 0 0 -3.4E+38 3.4E+38 ECU_ADDRESS 0x0000 /* @ECU_Address@rtDW_ADAS.GTGain3@ */ /end MEASUREMENT
/begin MEASUREMENT rtDW_ADAS.GTGain4_m "" FLOAT32_IEEE ADAS_CM_single 0 0 -3.4E+38 3.4E+38 ECU_ADDRESS 0x0000 /* @ECU_Address@rtDW_ADAS.GTGain4_m@ */ /end MEASUREMENT
/begin MEASUREMENT rtDW_ADAS.GTGearManualModeSt "" UBYTE ADAS_CM_uint8 0 0 0 255 ECU_ADDRESS 0x0000 /* @ECU_Address@rtDW_ADAS.GTGearManualModeSt@ */ /end MEASUREMENT
/begin MEASUREMENT rtDW_ADAS.GTGearPosSt "" UBYTE ADAS_CM_uint8 0 0 0 255 ECU_ADDRESS 0x0000 /* @ECU_Address@rtDW_ADAS.GTGearPosSt@ */ /end MEASUREMENT
/begin MEASUREMENT rtDW_ADAS.GTHyster "" FLOAT32_IEEE ADAS_CM_single 0 0 -3.4E+38 3.4E+38 ECU_ADDRESS 0x0000 /* @ECU_Address@rtDW_ADAS.GTHyster@ */ /end MEASUREMENT
/begin MEASUREMENT rtDW_ADAS.GTHyster_Mode "" UBYTE ADAS_CM_logical 0 0 0 1 ECU_ADDRESS 0x0000 /* @ECU_Address@rtDW_ADAS.GTHyster_Mode@ */ /end MEASUREMENT
/begin MEASUREMENT rtDW_ADAS.GTIntegrator_DSTATE_o "" FLOAT32_IEEE ADAS_CM_single 0 0 -3.4E+38 3.4E+38 ECU_ADDRESS 0x0000 /* @ECU_Address@rtDW_ADAS.GTIntegrator_DSTATE_o@ */ /end MEASUREMENT
/begin MEASUREMENT rtDW_ADAS.GTLccAvail "" UBYTE ADAS_CM_uint8 0 0 0 255 ECU_ADDRESS 0x0000 /* @ECU_Address@rtDW_ADAS.GTLccAvail@ */ /end MEASUREMENT
/begin MEASUREMENT rtDW_ADAS.GTLccBt "" UBYTE ADAS_CM_uint8 0 0 0 255 ECU_ADDRESS 0x0000 /* @ECU_Address@rtDW_ADAS.GTLccBt@ */ /end MEASUREMENT
/begin MEASUREMENT rtDW_ADAS.GTLccErReq "" UBYTE ADAS_CM_uint8 0 0 0 255 ECU_ADDRESS 0x0000 /* @ECU_Address@rtDW_ADAS.GTLccErReq@ */ /end MEASUREMENT
/begin MEASUREMENT rtDW_ADAS.GTLccModeReq "" UBYTE ADAS_CM_uint8 0 0 0 255 ECU_ADDRESS 0x0000 /* @ECU_Address@rtDW_ADAS.GTLccModeReq@ */ /end MEASUREMENT
/begin MEASUREMENT rtDW_ADAS.GTLccSoundAlertReq "" UBYTE ADAS_CM_uint8 0 0 0 255 ECU_ADDRESS 0x0000 /* @ECU_Address@rtDW_ADAS.GTLccSoundAlertReq@ */ /end MEASUREMENT
/begin MEASUREMENT rtDW_ADAS.GTLccVibrationWarnReq "" UBYTE ADAS_CM_uint8 0 0 0 255 ECU_ADDRESS 0x0000 /* @ECU_Address@rtDW_ADAS.GTLccVibrationWarnReq@ */ /end MEASUREMENT
/begin MEASUREMENT rtDW_ADAS.GTLdpErReq "" UBYTE ADAS_CM_uint8 0 0 0 255 ECU_ADDRESS 0x0000 /* @ECU_Address@rtDW_ADAS.GTLdpErReq@ */ /end MEASUREMENT
/begin MEASUREMENT rtDW_ADAS.GTLdwAvail "" UBYTE ADAS_CM_uint8 0 0 0 255 ECU_ADDRESS 0x0000 /* @ECU_Address@rtDW_ADAS.GTLdwAvail@ */ /end MEASUREMENT
/begin MEASUREMENT rtDW_ADAS.GTLdwBt "" UBYTE ADAS_CM_uint8 0 0 0 255 ECU_ADDRESS 0x0000 /* @ECU_Address@rtDW_ADAS.GTLdwBt@ */ /end MEASUREMENT
/begin MEASUREMENT rtDW_ADAS.GTLdwErReq "" UBYTE ADAS_CM_uint8 0 0 0 255 ECU_ADDRESS 0x0000 /* @ECU_Address@rtDW_ADAS.GTLdwErReq@ */ /end MEASUREMENT
/begin MEASUREMENT rtDW_ADAS.GTLdwModeReq "" UBYTE ADAS_CM_uint8 0 0 0 255 ECU_ADDRESS 0x0000 /* @ECU_Address@rtDW_ADAS.GTLdwModeReq@ */ /end MEASUREMENT
/begin MEASUREMENT rtDW_ADAS.GTLdwSoundReq "" UBYTE ADAS_CM_uint8 0 0 0 255 ECU_ADDRESS 0x0000 /* @ECU_Address@rtDW_ADAS.GTLdwSoundReq@ */ /end MEASUREMENT
/begin MEASUREMENT rtDW_ADAS.GTLdwVibrReq "" UBYTE ADAS_CM_uint8 0 0 0 255 ECU_ADDRESS 0x0000 /* @ECU_Address@rtDW_ADAS.GTLdwVibrReq@ */ /end MEASUREMENT
/begin MEASUREMENT rtDW_ADAS.GTLimAvail "" UBYTE ADAS_CM_uint8 0 0 0 255 ECU_ADDRESS 0x0000 /* @ECU_Address@rtDW_ADAS.GTLimAvail@ */ /end MEASUREMENT
/begin MEASUREMENT rtDW_ADAS.GTLimErReq "" UBYTE ADAS_CM_uint8 0 0 0 255 ECU_ADDRESS 0x0000 /* @ECU_Address@rtDW_ADAS.GTLimErReq@ */ /end MEASUREMENT
/begin MEASUREMENT rtDW_ADAS.GTLimit_fl "" UBYTE ADAS_CM_uint8 0 0 0 255 ECU_ADDRESS 0x0000 /* @ECU_Address@rtDW_ADAS.GTLimit_fl@ */ /end MEASUREMENT
/begin MEASUREMENT rtDW_ADAS.GTLkaAvail "" UBYTE ADAS_CM_uint8 0 0 0 255 ECU_ADDRESS 0x0000 /* @ECU_Address@rtDW_ADAS.GTLkaAvail@ */ /end MEASUREMENT
/begin MEASUREMENT rtDW_ADAS.GTLkaErReq "" UBYTE ADAS_CM_uint8 0 0 0 255 ECU_ADDRESS 0x0000 /* @ECU_Address@rtDW_ADAS.GTLkaErReq@ */ /end MEASUREMENT
/begin MEASUREMENT rtDW_ADAS.GTMMot_Inc "" FLOAT32_IEEE ADAS_CM_single 0 0 -3.4E+38 3.4E+38 ECU_ADDRESS 0x0000 /* @ECU_Address@rtDW_ADAS.GTMMot_Inc@ */ /end MEASUREMENT
/begin MEASUREMENT rtDW_ADAS.GTMemTypeCC "" UBYTE ADAS_CM_uint8 0 0 0 255 ECU_ADDRESS 0x0000 /* @ECU_Address@rtDW_ADAS.GTMemTypeCC@ */ /end MEASUREMENT
/begin MEASUREMENT rtDW_ADAS.GTMemoryX_DSTATE "" FLOAT32_IEEE ADAS_CM_single 0 0 -3.4E+38 3.4E+38 ECU_ADDRESS 0x0000 /* @ECU_Address@rtDW_ADAS.GTMemoryX_DSTATE@ */ /end MEASUREMENT
/begin MEASUREMENT rtDW_ADAS.GTMemoryX_DSTATE_m "" FLOAT32_IEEE ADAS_CM_single 0 0 -3.4E+38 3.4E+38 ECU_ADDRESS 0x0000 /* @ECU_Address@rtDW_ADAS.GTMemoryX_DSTATE_m@ */ /end MEASUREMENT
/begin MEASUREMENT rtDW_ADAS.GTMotReq "" UBYTE ADAS_CM_uint8 0 0 0 255 ECU_ADDRESS 0x0000 /* @ECU_Address@rtDW_ADAS.GTMotReq@ */ /end MEASUREMENT
/begin MEASUREMENT rtDW_ADAS.GTNavigStsReq "" UBYTE ADAS_CM_uint8 0 0 0 255 ECU_ADDRESS 0x0000 /* @ECU_Address@rtDW_ADAS.GTNavigStsReq@ */ /end MEASUREMENT
/begin MEASUREMENT rtDW_ADAS.GTOVER "" FLOAT64_IEEE ADAS_CM_double 0 0 -1.7E+308 1.7E+308 ECU_ADDRESS 0x0000 /* @ECU_Address@rtDW_ADAS.GTOVER@ */ /end MEASUREMENT
/begin MEASUREMENT rtDW_ADAS.GTOtherObjStsReq "" UBYTE ADAS_CM_uint8 0 0 0 255 ECU_ADDRESS 0x0000 /* @ECU_Address@rtDW_ADAS.GTOtherObjStsReq@ */ /end MEASUREMENT
/begin MEASUREMENT rtDW_ADAS.GTOut "" UBYTE ADAS_CM_uint8 0 0 0 255 ECU_ADDRESS 0x0000 /* @ECU_Address@rtDW_ADAS.GTOut@ */ /end MEASUREMENT
/begin MEASUREMENT rtDW_ADAS.GTOut_ "" UBYTE ADAS_CM_uint8 0 0 0 255 ECU_ADDRESS 0x0000 /* @ECU_Address@rtDW_ADAS.GTOut_@ */ /end MEASUREMENT
/begin MEASUREMENT rtDW_ADAS.GTOut__h "" UBYTE ADAS_CM_uint8 0 0 0 255 ECU_ADDRESS 0x0000 /* @ECU_Address@rtDW_ADAS.GTOut__h@ */ /end MEASUREMENT
/begin MEASUREMENT rtDW_ADAS.GTOut__l "" UBYTE ADAS_CM_uint8 0 0 0 255 ECU_ADDRESS 0x0000 /* @ECU_Address@rtDW_ADAS.GTOut__l@ */ /end MEASUREMENT
/begin MEASUREMENT rtDW_ADAS.GTOut__o "" UBYTE ADAS_CM_uint8 0 0 0 255 ECU_ADDRESS 0x0000 /* @ECU_Address@rtDW_ADAS.GTOut__o@ */ /end MEASUREMENT
/begin MEASUREMENT rtDW_ADAS.GTOut_l "" UBYTE ADAS_CM_uint8 0 0 0 255 ECU_ADDRESS 0x0000 /* @ECU_Address@rtDW_ADAS.GTOut_l@ */ /end MEASUREMENT
/begin MEASUREMENT rtDW_ADAS.GTOut_m "" UBYTE ADAS_CM_logical 0 0 0 1 ECU_ADDRESS 0x0000 /* @ECU_Address@rtDW_ADAS.GTOut_m@ */ /end MEASUREMENT
/begin MEASUREMENT rtDW_ADAS.GTOutportBufferForWARNING "" UBYTE ADAS_CM_logical 0 0 0 1 ECU_ADDRESS 0x0000 /* @ECU_Address@rtDW_ADAS.GTOutportBufferForWARNING@ */ /end MEASUREMENT
/begin MEASUREMENT rtDW_ADAS.GTOutput_DSTATE "" UBYTE ADAS_CM_uint8 0 0 0 255 ECU_ADDRESS 0x0000 /* @ECU_Address@rtDW_ADAS.GTOutput_DSTATE@ */ /end MEASUREMENT
/begin MEASUREMENT rtDW_ADAS.GTOver_fl "" FLOAT64_IEEE ADAS_CM_double 0 0 -1.7E+308 1.7E+308 ECU_ADDRESS 0x0000 /* @ECU_Address@rtDW_ADAS.GTOver_fl@ */ /end MEASUREMENT
/begin MEASUREMENT rtDW_ADAS.GTP_memory "" FLOAT32_IEEE ADAS_CM_single 0 0 -3.4E+38 3.4E+38 ECU_ADDRESS 0x0000 /* @ECU_Address@rtDW_ADAS.GTP_memory@ */ /end MEASUREMENT
/begin MEASUREMENT rtDW_ADAS.GTParkBrakeSt "" UBYTE ADAS_CM_uint8 0 0 0 255 ECU_ADDRESS 0x0000 /* @ECU_Address@rtDW_ADAS.GTParkBrakeSt@ */ /end MEASUREMENT
/begin MEASUREMENT rtDW_ADAS.GTPrevY_a "" FLOAT32_IEEE ADAS_CM_single 0 0 -3.4E+38 3.4E+38 ECU_ADDRESS 0x0000 /* @ECU_Address@rtDW_ADAS.GTPrevY_a@ */ /end MEASUREMENT
/begin MEASUREMENT rtDW_ADAS.GTPrevY_ar "" FLOAT32_IEEE ADAS_CM_single 0 0 -3.4E+38 3.4E+38 ECU_ADDRESS 0x0000 /* @ECU_Address@rtDW_ADAS.GTPrevY_ar@ */ /end MEASUREMENT
/begin MEASUREMENT rtDW_ADAS.GTPrevY_b "" FLOAT32_IEEE ADAS_CM_single 0 0 -3.4E+38 3.4E+38 ECU_ADDRESS 0x0000 /* @ECU_Address@rtDW_ADAS.GTPrevY_b@ */ /end MEASUREMENT
/begin MEASUREMENT rtDW_ADAS.GTPrevY_cr "" FLOAT32_IEEE ADAS_CM_single 0 0 -3.4E+38 3.4E+38 ECU_ADDRESS 0x0000 /* @ECU_Address@rtDW_ADAS.GTPrevY_cr@ */ /end MEASUREMENT
/begin MEASUREMENT rtDW_ADAS.GTPrevY_d "" FLOAT32_IEEE ADAS_CM_single 0 0 -3.4E+38 3.4E+38 ECU_ADDRESS 0x0000 /* @ECU_Address@rtDW_ADAS.GTPrevY_d@ */ /end MEASUREMENT
/begin MEASUREMENT rtDW_ADAS.GTPrevY_f "" FLOAT32_IEEE ADAS_CM_single 0 0 -3.4E+38 3.4E+38 ECU_ADDRESS 0x0000 /* @ECU_Address@rtDW_ADAS.GTPrevY_f@ */ /end MEASUREMENT
/begin MEASUREMENT rtDW_ADAS.GTPrevY_fk "" FLOAT32_IEEE ADAS_CM_single 0 0 -3.4E+38 3.4E+38 ECU_ADDRESS 0x0000 /* @ECU_Address@rtDW_ADAS.GTPrevY_fk@ */ /end MEASUREMENT
/begin MEASUREMENT rtDW_ADAS.GTPrevY_fu "" FLOAT32_IEEE ADAS_CM_single 0 0 -3.4E+38 3.4E+38 ECU_ADDRESS 0x0000 /* @ECU_Address@rtDW_ADAS.GTPrevY_fu@ */ /end MEASUREMENT
/begin MEASUREMENT rtDW_ADAS.GTPrevY_g3 "" FLOAT32_IEEE ADAS_CM_single 0 0 -3.4E+38 3.4E+38 ECU_ADDRESS 0x0000 /* @ECU_Address@rtDW_ADAS.GTPrevY_g3@ */ /end MEASUREMENT
/begin MEASUREMENT rtDW_ADAS.GTPrevY_g5 "" FLOAT32_IEEE ADAS_CM_single 0 0 -3.4E+38 3.4E+38 ECU_ADDRESS 0x0000 /* @ECU_Address@rtDW_ADAS.GTPrevY_g5@ */ /end MEASUREMENT
/begin MEASUREMENT rtDW_ADAS.GTPrevY_i "" FLOAT32_IEEE ADAS_CM_single 0 0 -3.4E+38 3.4E+38 ECU_ADDRESS 0x0000 /* @ECU_Address@rtDW_ADAS.GTPrevY_i@ */ /end MEASUREMENT
/begin MEASUREMENT rtDW_ADAS.GTPrevY_io "" FLOAT32_IEEE ADAS_CM_single 0 0 -3.4E+38 3.4E+38 ECU_ADDRESS 0x0000 /* @ECU_Address@rtDW_ADAS.GTPrevY_io@ */ /end MEASUREMENT
/begin MEASUREMENT rtDW_ADAS.GTPrevY_l "" FLOAT32_IEEE ADAS_CM_single 0 0 -3.4E+38 3.4E+38 ECU_ADDRESS 0x0000 /* @ECU_Address@rtDW_ADAS.GTPrevY_l@ */ /end MEASUREMENT
/begin MEASUREMENT rtDW_ADAS.GTPrevY_m "" FLOAT32_IEEE ADAS_CM_single 0 0 -3.4E+38 3.4E+38 ECU_ADDRESS 0x0000 /* @ECU_Address@rtDW_ADAS.GTPrevY_m@ */ /end MEASUREMENT
/begin MEASUREMENT rtDW_ADAS.GTPrevY_m3 "" FLOAT32_IEEE ADAS_CM_single 0 0 -3.4E+38 3.4E+38 ECU_ADDRESS 0x0000 /* @ECU_Address@rtDW_ADAS.GTPrevY_m3@ */ /end MEASUREMENT
/begin MEASUREMENT rtDW_ADAS.GTPrevY_o "" FLOAT32_IEEE ADAS_CM_single 0 0 -3.4E+38 3.4E+38 ECU_ADDRESS 0x0000 /* @ECU_Address@rtDW_ADAS.GTPrevY_o@ */ /end MEASUREMENT
/begin MEASUREMENT rtDW_ADAS.GTPrevY_oz "" FLOAT32_IEEE ADAS_CM_single 0 0 -3.4E+38 3.4E+38 ECU_ADDRESS 0x0000 /* @ECU_Address@rtDW_ADAS.GTPrevY_oz@ */ /end MEASUREMENT
/begin MEASUREMENT rtDW_ADAS.GTPrevY_pk "" FLOAT32_IEEE ADAS_CM_single 0 0 -3.4E+38 3.4E+38 ECU_ADDRESS 0x0000 /* @ECU_Address@rtDW_ADAS.GTPrevY_pk@ */ /end MEASUREMENT
/begin MEASUREMENT rtDW_ADAS.GTPrevY_pz "" FLOAT32_IEEE ADAS_CM_single 0 0 -3.4E+38 3.4E+38 ECU_ADDRESS 0x0000 /* @ECU_Address@rtDW_ADAS.GTPrevY_pz@ */ /end MEASUREMENT
/begin MEASUREMENT rtDW_ADAS.GTProduct2 "" FLOAT32_IEEE ADAS_CM_single 0 0 -3.4E+38 3.4E+38 MATRIX_DIM 1 1 ECU_ADDRESS 0x0000 /* @ECU_Address@rtDW_ADAS.GTProduct2@ */ /end MEASUREMENT
/begin MEASUREMENT rtDW_ADAS.GTProduct2_b "" FLOAT32_IEEE ADAS_CM_single 0 0 -3.4E+38 3.4E+38 MATRIX_DIM 1 1 ECU_ADDRESS 0x0000 /* @ECU_Address@rtDW_ADAS.GTProduct2_b@ */ /end MEASUREMENT
/begin MEASUREMENT rtDW_ADAS.GTProduct3 "" FLOAT32_IEEE ADAS_CM_single 0 0 -3.4E+38 3.4E+38 MATRIX_DIM 1 1 ECU_ADDRESS 0x0000 /* @ECU_Address@rtDW_ADAS.GTProduct3@ */ /end MEASUREMENT
/begin MEASUREMENT rtDW_ADAS.GTProduct3_f "" FLOAT32_IEEE ADAS_CM_single 0 0 -3.4E+38 3.4E+38 MATRIX_DIM 1 1 ECU_ADDRESS 0x0000 /* @ECU_Address@rtDW_ADAS.GTProduct3_f@ */ /end MEASUREMENT
/begin MEASUREMENT rtDW_ADAS.GTProjectionOnARoadReq "" UBYTE ADAS_CM_uint8 0 0 0 255 ECU_ADDRESS 0x0000 /* @ECU_Address@rtDW_ADAS.GTProjectionOnARoadReq@ */ /end MEASUREMENT
/begin MEASUREMENT rtDW_ADAS.GTRDAAutoBrakeReq "" UBYTE ADAS_CM_uint8 0 0 0 255 ECU_ADDRESS 0x0000 /* @ECU_Address@rtDW_ADAS.GTRDAAutoBrakeReq@ */ /end MEASUREMENT
/begin MEASUREMENT rtDW_ADAS.GTRctcErReq "" UBYTE ADAS_CM_uint8 0 0 0 255 ECU_ADDRESS 0x0000 /* @ECU_Address@rtDW_ADAS.GTRctcErReq@ */ /end MEASUREMENT
/begin MEASUREMENT rtDW_ADAS.GTRdaErReq "" UBYTE ADAS_CM_uint8 0 0 0 255 ECU_ADDRESS 0x0000 /* @ECU_Address@rtDW_ADAS.GTRdaErReq@ */ /end MEASUREMENT
/begin MEASUREMENT rtDW_ADAS.GTRecErReq "" UBYTE ADAS_CM_uint8 0 0 0 255 ECU_ADDRESS 0x0000 /* @ECU_Address@rtDW_ADAS.GTRecErReq@ */ /end MEASUREMENT
/begin MEASUREMENT rtDW_ADAS.GTReject "" UBYTE ADAS_CM_uint8 0 0 0 255 ECU_ADDRESS 0x0000 /* @ECU_Address@rtDW_ADAS.GTReject@ */ /end MEASUREMENT
/begin MEASUREMENT rtDW_ADAS.GTReqToCc "" UBYTE ADAS_CM_uint8 0 0 0 255 ECU_ADDRESS 0x0000 /* @ECU_Address@rtDW_ADAS.GTReqToCc@ */ /end MEASUREMENT
/begin MEASUREMENT rtDW_ADAS.GTRoadSignStsReq "" UBYTE ADAS_CM_uint8 0 0 0 255 ECU_ADDRESS 0x0000 /* @ECU_Address@rtDW_ADAS.GTRoadSignStsReq@ */ /end MEASUREMENT
/begin MEASUREMENT rtDW_ADAS.GTS_coef "" UBYTE ADAS_CM_uint8 0 0 0 255 ECU_ADDRESS 0x0000 /* @ECU_Address@rtDW_ADAS.GTS_coef@ */ /end MEASUREMENT
/begin MEASUREMENT rtDW_ADAS.GTSetAaMode "" UBYTE ADAS_CM_uint8 0 0 0 255 ECU_ADDRESS 0x0000 /* @ECU_Address@rtDW_ADAS.GTSetAaMode@ */ /end MEASUREMENT
/begin MEASUREMENT rtDW_ADAS.GTSetAaSts "" UBYTE ADAS_CM_uint8 0 0 0 255 ECU_ADDRESS 0x0000 /* @ECU_Address@rtDW_ADAS.GTSetAaSts@ */ /end MEASUREMENT
/begin MEASUREMENT rtDW_ADAS.GTSetAebSts "" UBYTE ADAS_CM_uint8 0 0 0 255 ECU_ADDRESS 0x0000 /* @ECU_Address@rtDW_ADAS.GTSetAebSts@ */ /end MEASUREMENT
/begin MEASUREMENT rtDW_ADAS.GTSetAlccSts "" UBYTE ADAS_CM_uint8 0 0 0 255 ECU_ADDRESS 0x0000 /* @ECU_Address@rtDW_ADAS.GTSetAlccSts@ */ /end MEASUREMENT
/begin MEASUREMENT rtDW_ADAS.GTSetAslaOver "" FLOAT32_IEEE ADAS_CM_single 0 0 -3.4E+38 3.4E+38 ECU_ADDRESS 0x0000 /* @ECU_Address@rtDW_ADAS.GTSetAslaOver@ */ /end MEASUREMENT
/begin MEASUREMENT rtDW_ADAS.GTSetAslaSts "" UBYTE ADAS_CM_uint8 0 0 0 255 ECU_ADDRESS 0x0000 /* @ECU_Address@rtDW_ADAS.GTSetAslaSts@ */ /end MEASUREMENT
/begin MEASUREMENT rtDW_ADAS.GTSetCcCorrectSpd "" UBYTE ADAS_CM_uint8 0 0 0 255 ECU_ADDRESS 0x0000 /* @ECU_Address@rtDW_ADAS.GTSetCcCorrectSpd@ */ /end MEASUREMENT
/begin MEASUREMENT rtDW_ADAS.GTSetCcMode "" UBYTE ADAS_CM_uint8 0 0 0 255 ECU_ADDRESS 0x0000 /* @ECU_Address@rtDW_ADAS.GTSetCcMode@ */ /end MEASUREMENT
/begin MEASUREMENT rtDW_ADAS.GTSetCcType "" UBYTE ADAS_CM_uint8 0 0 0 255 ECU_ADDRESS 0x0000 /* @ECU_Address@rtDW_ADAS.GTSetCcType@ */ /end MEASUREMENT
/begin MEASUREMENT rtDW_ADAS.GTSetDowSound "" UBYTE ADAS_CM_uint8 0 0 0 255 ECU_ADDRESS 0x0000 /* @ECU_Address@rtDW_ADAS.GTSetDowSound@ */ /end MEASUREMENT
/begin MEASUREMENT rtDW_ADAS.GTSetDowSts "" UBYTE ADAS_CM_uint8 0 0 0 255 ECU_ADDRESS 0x0000 /* @ECU_Address@rtDW_ADAS.GTSetDowSts@ */ /end MEASUREMENT
/begin MEASUREMENT rtDW_ADAS.GTSetFcwMode "" UBYTE ADAS_CM_uint8 0 0 0 255 ECU_ADDRESS 0x0000 /* @ECU_Address@rtDW_ADAS.GTSetFcwMode@ */ /end MEASUREMENT
/begin MEASUREMENT rtDW_ADAS.GTSetFcwSts "" UBYTE ADAS_CM_uint8 0 0 0 255 ECU_ADDRESS 0x0000 /* @ECU_Address@rtDW_ADAS.GTSetFcwSts@ */ /end MEASUREMENT
/begin MEASUREMENT rtDW_ADAS.GTSetFcwVibration "" UBYTE ADAS_CM_uint8 0 0 0 255 ECU_ADDRESS 0x0000 /* @ECU_Address@rtDW_ADAS.GTSetFcwVibration@ */ /end MEASUREMENT
/begin MEASUREMENT rtDW_ADAS.GTSetLccMode "" UBYTE ADAS_CM_uint8 0 0 0 255 ECU_ADDRESS 0x0000 /* @ECU_Address@rtDW_ADAS.GTSetLccMode@ */ /end MEASUREMENT
/begin MEASUREMENT rtDW_ADAS.GTSetLccSound "" UBYTE ADAS_CM_uint8 0 0 0 255 ECU_ADDRESS 0x0000 /* @ECU_Address@rtDW_ADAS.GTSetLccSound@ */ /end MEASUREMENT
/begin MEASUREMENT rtDW_ADAS.GTSetLccSts "" UBYTE ADAS_CM_uint8 0 0 0 255 ECU_ADDRESS 0x0000 /* @ECU_Address@rtDW_ADAS.GTSetLccSts@ */ /end MEASUREMENT
/begin MEASUREMENT rtDW_ADAS.GTSetLccVibration "" UBYTE ADAS_CM_uint8 0 0 0 255 ECU_ADDRESS 0x0000 /* @ECU_Address@rtDW_ADAS.GTSetLccVibration@ */ /end MEASUREMENT
/begin MEASUREMENT rtDW_ADAS.GTSetLdpSts "" UBYTE ADAS_CM_uint8 0 0 0 255 ECU_ADDRESS 0x0000 /* @ECU_Address@rtDW_ADAS.GTSetLdpSts@ */ /end MEASUREMENT
/begin MEASUREMENT rtDW_ADAS.GTSetLdwMode "" UBYTE ADAS_CM_uint8 0 0 0 255 ECU_ADDRESS 0x0000 /* @ECU_Address@rtDW_ADAS.GTSetLdwMode@ */ /end MEASUREMENT
/begin MEASUREMENT rtDW_ADAS.GTSetLdwSound "" UBYTE ADAS_CM_uint8 0 0 0 255 ECU_ADDRESS 0x0000 /* @ECU_Address@rtDW_ADAS.GTSetLdwSound@ */ /end MEASUREMENT
/begin MEASUREMENT rtDW_ADAS.GTSetLdwSts "" UBYTE ADAS_CM_uint8 0 0 0 255 ECU_ADDRESS 0x0000 /* @ECU_Address@rtDW_ADAS.GTSetLdwSts@ */ /end MEASUREMENT
/begin MEASUREMENT rtDW_ADAS.GTSetLdwVibration "" UBYTE ADAS_CM_uint8 0 0 0 255 ECU_ADDRESS 0x0000 /* @ECU_Address@rtDW_ADAS.GTSetLdwVibration@ */ /end MEASUREMENT
/begin MEASUREMENT rtDW_ADAS.GTSetLkaSts "" UBYTE ADAS_CM_uint8 0 0 0 255 ECU_ADDRESS 0x0000 /* @ECU_Address@rtDW_ADAS.GTSetLkaSts@ */ /end MEASUREMENT
/begin MEASUREMENT rtDW_ADAS.GTSetNavigSts "" UBYTE ADAS_CM_uint8 0 0 0 255 ECU_ADDRESS 0x0000 /* @ECU_Address@rtDW_ADAS.GTSetNavigSts@ */ /end MEASUREMENT
/begin MEASUREMENT rtDW_ADAS.GTSetOtherObjSts "" UBYTE ADAS_CM_uint8 0 0 0 255 ECU_ADDRESS 0x0000 /* @ECU_Address@rtDW_ADAS.GTSetOtherObjSts@ */ /end MEASUREMENT
/begin MEASUREMENT rtDW_ADAS.GTSetProjectionOnARoadSts "" UBYTE ADAS_CM_uint8 0 0 0 255 ECU_ADDRESS 0x0000 /* @ECU_Address@rtDW_ADAS.GTSetProjectionOnARoadSts@ */ /end MEASUREMENT
/begin MEASUREMENT rtDW_ADAS.GTSetRDAAutoBrakeSts "" UBYTE ADAS_CM_uint8 0 0 0 255 ECU_ADDRESS 0x0000 /* @ECU_Address@rtDW_ADAS.GTSetRDAAutoBrakeSts@ */ /end MEASUREMENT
/begin MEASUREMENT rtDW_ADAS.GTSetRctcSts "" UBYTE ADAS_CM_uint8 0 0 0 255 ECU_ADDRESS 0x0000 /* @ECU_Address@rtDW_ADAS.GTSetRctcSts@ */ /end MEASUREMENT
/begin MEASUREMENT rtDW_ADAS.GTSetRdaSts "" UBYTE ADAS_CM_uint8 0 0 0 255 ECU_ADDRESS 0x0000 /* @ECU_Address@rtDW_ADAS.GTSetRdaSts@ */ /end MEASUREMENT
/begin MEASUREMENT rtDW_ADAS.GTSetRecSts "" UBYTE ADAS_CM_uint8 0 0 0 255 ECU_ADDRESS 0x0000 /* @ECU_Address@rtDW_ADAS.GTSetRecSts@ */ /end MEASUREMENT
/begin MEASUREMENT rtDW_ADAS.GTSetRoadSignSts "" UBYTE ADAS_CM_uint8 0 0 0 255 ECU_ADDRESS 0x0000 /* @ECU_Address@rtDW_ADAS.GTSetRoadSignSts@ */ /end MEASUREMENT
/begin MEASUREMENT rtDW_ADAS.GTSetSensCleanSts "" UBYTE ADAS_CM_uint8 0 0 0 255 ECU_ADDRESS 0x0000 /* @ECU_Address@rtDW_ADAS.GTSetSensCleanSts@ */ /end MEASUREMENT
/begin MEASUREMENT rtDW_ADAS.GTSetTsrSts "" UBYTE ADAS_CM_uint8 0 0 0 255 ECU_ADDRESS 0x0000 /* @ECU_Address@rtDW_ADAS.GTSetTsrSts@ */ /end MEASUREMENT
/begin MEASUREMENT rtDW_ADAS.GTSmax_coef "" UBYTE ADAS_CM_uint8 0 0 0 255 ECU_ADDRESS 0x0000 /* @ECU_Address@rtDW_ADAS.GTSmax_coef@ */ /end MEASUREMENT
/begin MEASUREMENT rtDW_ADAS.GTSmin_coef "" UBYTE ADAS_CM_uint8 0 0 0 255 ECU_ADDRESS 0x0000 /* @ECU_Address@rtDW_ADAS.GTSmin_coef@ */ /end MEASUREMENT
/begin MEASUREMENT rtDW_ADAS.GTSolverAct "" UBYTE ADAS_CM_logical 0 0 0 1 ECU_ADDRESS 0x0000 /* @ECU_Address@rtDW_ADAS.GTSolverAct@ */ /end MEASUREMENT
/begin MEASUREMENT rtDW_ADAS.GTSport_On "" UBYTE ADAS_CM_uint8 0 0 0 255 ECU_ADDRESS 0x0000 /* @ECU_Address@rtDW_ADAS.GTSport_On@ */ /end MEASUREMENT
/begin MEASUREMENT rtDW_ADAS.GTSt_Req_VLC "" UBYTE ADAS_CM_uint8 0 0 0 255 ECU_ADDRESS 0x0000 /* @ECU_Address@rtDW_ADAS.GTSt_Req_VLC@ */ /end MEASUREMENT
/begin MEASUREMENT rtDW_ADAS.GTStand_mode "" UBYTE ADAS_CM_uint8 0 0 0 255 ECU_ADDRESS 0x0000 /* @ECU_Address@rtDW_ADAS.GTStand_mode@ */ /end MEASUREMENT
/begin MEASUREMENT rtDW_ADAS.GTState_delay "" UBYTE ADAS_CM_logical 0 0 0 1 ECU_ADDRESS 0x0000 /* @ECU_Address@rtDW_ADAS.GTState_delay@ */ /end MEASUREMENT
/begin MEASUREMENT rtDW_ADAS.GTSteep_dist "" UBYTE ADAS_CM_uint8 0 0 0 255 ECU_ADDRESS 0x0000 /* @ECU_Address@rtDW_ADAS.GTSteep_dist@ */ /end MEASUREMENT
/begin MEASUREMENT rtDW_ADAS.GTSteep_speed "" FLOAT32_IEEE ADAS_CM_single 0 0 -3.4E+38 3.4E+38 ECU_ADDRESS 0x0000 /* @ECU_Address@rtDW_ADAS.GTSteep_speed@ */ /end MEASUREMENT
/begin MEASUREMENT rtDW_ADAS.GTSwitch "" FLOAT64_IEEE ADAS_CM_double 0 0 -1.7E+308 1.7E+308 ECU_ADDRESS 0x0000 /* @ECU_Address@rtDW_ADAS.GTSwitch@ */ /end MEASUREMENT
/begin MEASUREMENT rtDW_ADAS.GTSwitch1 "" FLOAT64_IEEE ADAS_CM_double 0 0 -1.7E+308 1.7E+308 ECU_ADDRESS 0x0000 /* @ECU_Address@rtDW_ADAS.GTSwitch1@ */ /end MEASUREMENT
/begin MEASUREMENT rtDW_ADAS.GTSwitch3 "" FLOAT32_IEEE ADAS_CM_single 0 0 -3.4E+38 3.4E+38 ECU_ADDRESS 0x0000 /* @ECU_Address@rtDW_ADAS.GTSwitch3@ */ /end MEASUREMENT
/begin MEASUREMENT rtDW_ADAS.GTSwitch3_m "" FLOAT32_IEEE ADAS_CM_single 0 0 -3.4E+38 3.4E+38 ECU_ADDRESS 0x0000 /* @ECU_Address@rtDW_ADAS.GTSwitch3_m@ */ /end MEASUREMENT
/begin MEASUREMENT rtDW_ADAS.GTSwitch5 "" FLOAT32_IEEE ADAS_CM_single 0 0 -3.4E+38 3.4E+38 ECU_ADDRESS 0x0000 /* @ECU_Address@rtDW_ADAS.GTSwitch5@ */ /end MEASUREMENT
/begin MEASUREMENT rtDW_ADAS.GTSwitch7 "" FLOAT32_IEEE ADAS_CM_single 0 0 -3.4E+38 3.4E+38 ECU_ADDRESS 0x0000 /* @ECU_Address@rtDW_ADAS.GTSwitch7@ */ /end MEASUREMENT
/begin MEASUREMENT rtDW_ADAS.GTSwitch_h "" UBYTE ADAS_CM_uint8 0 0 0 255 ECU_ADDRESS 0x0000 /* @ECU_Address@rtDW_ADAS.GTSwitch_h@ */ /end MEASUREMENT
/begin MEASUREMENT rtDW_ADAS.GTSwitch_i "" FLOAT32_IEEE ADAS_CM_single 0 0 -3.4E+38 3.4E+38 ECU_ADDRESS 0x0000 /* @ECU_Address@rtDW_ADAS.GTSwitch_i@ */ /end MEASUREMENT
/begin MEASUREMENT rtDW_ADAS.GTSwitch_p "" FLOAT32_IEEE ADAS_CM_single 0 0 -3.4E+38 3.4E+38 ECU_ADDRESS 0x0000 /* @ECU_Address@rtDW_ADAS.GTSwitch_p@ */ /end MEASUREMENT
/begin MEASUREMENT rtDW_ADAS.GTTakeOver "" UBYTE ADAS_CM_logical 0 0 0 1 ECU_ADDRESS 0x0000 /* @ECU_Address@rtDW_ADAS.GTTakeOver@ */ /end MEASUREMENT
/begin MEASUREMENT rtDW_ADAS.GTTestDataChgSts "" UBYTE ADAS_CM_uint8 0 0 0 255 ECU_ADDRESS 0x0000 /* @ECU_Address@rtDW_ADAS.GTTestDataChgSts@ */ /end MEASUREMENT
/begin MEASUREMENT rtDW_ADAS.GTTsrErReq "" UBYTE ADAS_CM_uint8 0 0 0 255 ECU_ADDRESS 0x0000 /* @ECU_Address@rtDW_ADAS.GTTsrErReq@ */ /end MEASUREMENT
/begin MEASUREMENT rtDW_ADAS.GTUD_DSTATE "" FLOAT32_IEEE ADAS_CM_single 0 0 -3.4E+38 3.4E+38 ECU_ADDRESS 0x0000 /* @ECU_Address@rtDW_ADAS.GTUD_DSTATE@ */ /end MEASUREMENT
/begin MEASUREMENT rtDW_ADAS.GTUD_DSTATE_b "" FLOAT32_IEEE ADAS_CM_single 0 0 -3.4E+38 3.4E+38 ECU_ADDRESS 0x0000 /* @ECU_Address@rtDW_ADAS.GTUD_DSTATE_b@ */ /end MEASUREMENT
/begin MEASUREMENT rtDW_ADAS.GTUD_DSTATE_d "" FLOAT32_IEEE ADAS_CM_single 0 0 -3.4E+38 3.4E+38 ECU_ADDRESS 0x0000 /* @ECU_Address@rtDW_ADAS.GTUD_DSTATE_d@ */ /end MEASUREMENT
/begin MEASUREMENT rtDW_ADAS.GTUD_DSTATE_e "" FLOAT32_IEEE ADAS_CM_single 0 0 -3.4E+38 3.4E+38 ECU_ADDRESS 0x0000 /* @ECU_Address@rtDW_ADAS.GTUD_DSTATE_e@ */ /end MEASUREMENT
/begin MEASUREMENT rtDW_ADAS.GTUD_DSTATE_es "" FLOAT32_IEEE ADAS_CM_single 0 0 -3.4E+38 3.4E+38 ECU_ADDRESS 0x0000 /* @ECU_Address@rtDW_ADAS.GTUD_DSTATE_es@ */ /end MEASUREMENT
/begin MEASUREMENT rtDW_ADAS.GTUD_DSTATE_f "" FLOAT32_IEEE ADAS_CM_single 0 0 -3.4E+38 3.4E+38 ECU_ADDRESS 0x0000 /* @ECU_Address@rtDW_ADAS.GTUD_DSTATE_f@ */ /end MEASUREMENT
/begin MEASUREMENT rtDW_ADAS.GTUD_DSTATE_fs "" FLOAT32_IEEE ADAS_CM_single 0 0 -3.4E+38 3.4E+38 ECU_ADDRESS 0x0000 /* @ECU_Address@rtDW_ADAS.GTUD_DSTATE_fs@ */ /end MEASUREMENT
/begin MEASUREMENT rtDW_ADAS.GTUD_DSTATE_g "" FLOAT32_IEEE ADAS_CM_single 0 0 -3.4E+38 3.4E+38 ECU_ADDRESS 0x0000 /* @ECU_Address@rtDW_ADAS.GTUD_DSTATE_g@ */ /end MEASUREMENT
/begin MEASUREMENT rtDW_ADAS.GTUD_DSTATE_ja "" FLOAT32_IEEE ADAS_CM_single 0 0 -3.4E+38 3.4E+38 ECU_ADDRESS 0x0000 /* @ECU_Address@rtDW_ADAS.GTUD_DSTATE_ja@ */ /end MEASUREMENT
/begin MEASUREMENT rtDW_ADAS.GTUD_DSTATE_kb "" FLOAT32_IEEE ADAS_CM_single 0 0 -3.4E+38 3.4E+38 ECU_ADDRESS 0x0000 /* @ECU_Address@rtDW_ADAS.GTUD_DSTATE_kb@ */ /end MEASUREMENT
/begin MEASUREMENT rtDW_ADAS.GTUD_DSTATE_kd "" FLOAT32_IEEE ADAS_CM_single 0 0 -3.4E+38 3.4E+38 ECU_ADDRESS 0x0000 /* @ECU_Address@rtDW_ADAS.GTUD_DSTATE_kd@ */ /end MEASUREMENT
/begin MEASUREMENT rtDW_ADAS.GTUD_DSTATE_kg "" FLOAT32_IEEE ADAS_CM_single 0 0 -3.4E+38 3.4E+38 ECU_ADDRESS 0x0000 /* @ECU_Address@rtDW_ADAS.GTUD_DSTATE_kg@ */ /end MEASUREMENT
/begin MEASUREMENT rtDW_ADAS.GTUD_DSTATE_kw "" FLOAT32_IEEE ADAS_CM_single 0 0 -3.4E+38 3.4E+38 ECU_ADDRESS 0x0000 /* @ECU_Address@rtDW_ADAS.GTUD_DSTATE_kw@ */ /end MEASUREMENT
/begin MEASUREMENT rtDW_ADAS.GTUD_DSTATE_l "" FLOAT32_IEEE ADAS_CM_single 0 0 -3.4E+38 3.4E+38 ECU_ADDRESS 0x0000 /* @ECU_Address@rtDW_ADAS.GTUD_DSTATE_l@ */ /end MEASUREMENT
/begin MEASUREMENT rtDW_ADAS.GTUD_DSTATE_lg "" FLOAT32_IEEE ADAS_CM_single 0 0 -3.4E+38 3.4E+38 ECU_ADDRESS 0x0000 /* @ECU_Address@rtDW_ADAS.GTUD_DSTATE_lg@ */ /end MEASUREMENT
/begin MEASUREMENT rtDW_ADAS.GTUD_DSTATE_lk "" FLOAT32_IEEE ADAS_CM_single 0 0 -3.4E+38 3.4E+38 ECU_ADDRESS 0x0000 /* @ECU_Address@rtDW_ADAS.GTUD_DSTATE_lk@ */ /end MEASUREMENT
/begin MEASUREMENT rtDW_ADAS.GTUD_DSTATE_m "" FLOAT32_IEEE ADAS_CM_single 0 0 -3.4E+38 3.4E+38 ECU_ADDRESS 0x0000 /* @ECU_Address@rtDW_ADAS.GTUD_DSTATE_m@ */ /end MEASUREMENT
/begin MEASUREMENT rtDW_ADAS.GTUD_DSTATE_o "" FLOAT32_IEEE ADAS_CM_single 0 0 -3.4E+38 3.4E+38 ECU_ADDRESS 0x0000 /* @ECU_Address@rtDW_ADAS.GTUD_DSTATE_o@ */ /end MEASUREMENT
/begin MEASUREMENT rtDW_ADAS.GTUD_DSTATE_p "" FLOAT32_IEEE ADAS_CM_single 0 0 -3.4E+38 3.4E+38 ECU_ADDRESS 0x0000 /* @ECU_Address@rtDW_ADAS.GTUD_DSTATE_p@ */ /end MEASUREMENT
/begin MEASUREMENT rtDW_ADAS.GTUD_DSTATE_pl "" FLOAT32_IEEE ADAS_CM_single 0 0 -3.4E+38 3.4E+38 ECU_ADDRESS 0x0000 /* @ECU_Address@rtDW_ADAS.GTUD_DSTATE_pl@ */ /end MEASUREMENT
/begin MEASUREMENT rtDW_ADAS.GTUP "" FLOAT64_IEEE ADAS_CM_double 0 0 -1.7E+308 1.7E+308 ECU_ADDRESS 0x0000 /* @ECU_Address@rtDW_ADAS.GTUP@ */ /end MEASUREMENT
/begin MEASUREMENT rtDW_ADAS.GTVLC_req_accel_ms "" FLOAT32_IEEE ADAS_CM_single 0 0 -3.4E+38 3.4E+38 ECU_ADDRESS 0x0000 /* @ECU_Address@rtDW_ADAS.GTVLC_req_accel_ms@ */ /end MEASUREMENT
/begin MEASUREMENT rtDW_ADAS.GTV_lead_kmh_safe "" FLOAT32_IEEE ADAS_CM_single 0 0 -3.4E+38 3.4E+38 ECU_ADDRESS 0x0000 /* @ECU_Address@rtDW_ADAS.GTV_lead_kmh_safe@ */ /end MEASUREMENT
/begin MEASUREMENT rtDW_ADAS.GTV_mem "" UBYTE ADAS_CM_uint8 0 0 0 255 ECU_ADDRESS 0x0000 /* @ECU_Address@rtDW_ADAS.GTV_mem@ */ /end MEASUREMENT
/begin MEASUREMENT rtDW_ADAS.GTV_newSpeed "" UBYTE ADAS_CM_uint8 0 0 0 255 ECU_ADDRESS 0x0000 /* @ECU_Address@rtDW_ADAS.GTV_newSpeed@ */ /end MEASUREMENT
/begin MEASUREMENT rtDW_ADAS.GTV_set "" FLOAT32_IEEE ADAS_CM_single 0 0 -3.4E+38 3.4E+38 ECU_ADDRESS 0x0000 /* @ECU_Address@rtDW_ADAS.GTV_set@ */ /end MEASUREMENT
/begin MEASUREMENT rtDW_ADAS.GTVmax "" FLOAT32_IEEE ADAS_CM_single 0 0 -3.4E+38 3.4E+38 ECU_ADDRESS 0x0000 /* @ECU_Address@rtDW_ADAS.GTVmax@ */ /end MEASUREMENT
/begin MEASUREMENT rtDW_ADAS.GTVmin "" FLOAT32_IEEE ADAS_CM_single 0 0 -3.4E+38 3.4E+38 ECU_ADDRESS 0x0000 /* @ECU_Address@rtDW_ADAS.GTVmin@ */ /end MEASUREMENT
/begin MEASUREMENT rtDW_ADAS.GTWarn "" UBYTE ADAS_CM_uint8 0 0 0 255 ECU_ADDRESS 0x0000 /* @ECU_Address@rtDW_ADAS.GTWarn@ */ /end MEASUREMENT
/begin MEASUREMENT rtDW_ADAS.GTcode_h "" UBYTE ADAS_CM_uint8 0 0 0 255 ECU_ADDRESS 0x0000 /* @ECU_Address@rtDW_ADAS.GTcode_h@ */ /end MEASUREMENT
/begin MEASUREMENT rtDW_ADAS.GTcount "" UBYTE ADAS_CM_uint8 0 0 0 255 ECU_ADDRESS 0x0000 /* @ECU_Address@rtDW_ADAS.GTcount@ */ /end MEASUREMENT
/begin MEASUREMENT rtDW_ADAS.GTdist "" FLOAT32_IEEE ADAS_CM_single 0 0 -3.4E+38 3.4E+38 ECU_ADDRESS 0x0000 /* @ECU_Address@rtDW_ADAS.GTdist@ */ /end MEASUREMENT
/begin MEASUREMENT rtDW_ADAS.GTdist_stand "" FLOAT32_IEEE ADAS_CM_single 0 0 -3.4E+38 3.4E+38 ECU_ADDRESS 0x0000 /* @ECU_Address@rtDW_ADAS.GTdist_stand@ */ /end MEASUREMENT
/begin MEASUREMENT rtDW_ADAS.GTgain_o "" FLOAT32_IEEE ADAS_CM_single 0 0 -3.4E+38 3.4E+38 ECU_ADDRESS 0x0000 /* @ECU_Address@rtDW_ADAS.GTgain_o@ */ /end MEASUREMENT
/begin MEASUREMENT rtDW_ADAS.GTicLoad "" UBYTE ADAS_CM_logical 0 0 0 1 ECU_ADDRESS 0x0000 /* @ECU_Address@rtDW_ADAS.GTicLoad@ */ /end MEASUREMENT
/begin MEASUREMENT rtDW_ADAS.GTicLoad_j "" UBYTE ADAS_CM_logical 0 0 0 1 ECU_ADDRESS 0x0000 /* @ECU_Address@rtDW_ADAS.GTicLoad_j@ */ /end MEASUREMENT
/begin MEASUREMENT rtDW_ADAS.GTisObjInDowZone_uint8 "" UBYTE ADAS_CM_uint8 0 0 0 255 ECU_ADDRESS 0x0000 /* @ECU_Address@rtDW_ADAS.GTisObjInDowZone_uint8@ */ /end MEASUREMENT
/begin MEASUREMENT rtDW_ADAS.GTisObjInDowZone_uint8_n "" UBYTE ADAS_CM_uint8 0 0 0 255 ECU_ADDRESS 0x0000 /* @ECU_Address@rtDW_ADAS.GTisObjInDowZone_uint8_n@ */ /end MEASUREMENT
/begin MEASUREMENT rtDW_ADAS.GTisObjInLeftZone "" UBYTE ADAS_CM_uint8 0 0 0 255 ECU_ADDRESS 0x0000 /* @ECU_Address@rtDW_ADAS.GTisObjInLeftZone@ */ /end MEASUREMENT
/begin MEASUREMENT rtDW_ADAS.GTisObjInRightZone "" UBYTE ADAS_CM_uint8 0 0 0 255 ECU_ADDRESS 0x0000 /* @ECU_Address@rtDW_ADAS.GTisObjInRightZone@ */ /end MEASUREMENT
/begin MEASUREMENT rtDW_ADAS.GTis_ACC_DIST_CHANGE_BUTTON_1 "" UBYTE ADAS_CM_uint8 0 0 0 255 ECU_ADDRESS 0x0000 /* @ECU_Address@rtDW_ADAS.GTis_ACC_DIST_CHANGE_BUTTON_1@ */ /end MEASUREMENT
/begin MEASUREMENT rtDW_ADAS.GTis_ACC_DIST_CHANGE_BUTTON_2 "" UBYTE ADAS_CM_uint8 0 0 0 255 ECU_ADDRESS 0x0000 /* @ECU_Address@rtDW_ADAS.GTis_ACC_DIST_CHANGE_BUTTON_2@ */ /end MEASUREMENT
/begin MEASUREMENT rtDW_ADAS.GTis_ACC_MODE "" UBYTE ADAS_CM_uint8 0 0 0 255 ECU_ADDRESS 0x0000 /* @ECU_Address@rtDW_ADAS.GTis_ACC_MODE@ */ /end MEASUREMENT
/begin MEASUREMENT rtDW_ADAS.GTis_ACC_MODE_k "" UBYTE ADAS_CM_uint8 0 0 0 255 ECU_ADDRESS 0x0000 /* @ECU_Address@rtDW_ADAS.GTis_ACC_MODE_k@ */ /end MEASUREMENT
/begin MEASUREMENT rtDW_ADAS.GTis_ACC_OVERRYDE_MODE "" UBYTE ADAS_CM_uint8 0 0 0 255 ECU_ADDRESS 0x0000 /* @ECU_Address@rtDW_ADAS.GTis_ACC_OVERRYDE_MODE@ */ /end MEASUREMENT
/begin MEASUREMENT rtDW_ADAS.GTis_ACC_WORK_STATE "" UBYTE ADAS_CM_uint8 0 0 0 255 ECU_ADDRESS 0x0000 /* @ECU_Address@rtDW_ADAS.GTis_ACC_WORK_STATE@ */ /end MEASUREMENT
/begin MEASUREMENT rtDW_ADAS.GTis_ACC_active_NORMAL_mode "" UBYTE ADAS_CM_uint8 0 0 0 255 ECU_ADDRESS 0x0000 /* @ECU_Address@rtDW_ADAS.GTis_ACC_active_NORMAL_mode@ */ /end MEASUREMENT
/begin MEASUREMENT rtDW_ADAS.GTis_ACC_active_NORMAL_mode_IC "" UBYTE ADAS_CM_uint8 0 0 0 255 ECU_ADDRESS 0x0000 /* @ECU_Address@rtDW_ADAS.GTis_ACC_active_NORMAL_mode_IC@ */ /end MEASUREMENT
/begin MEASUREMENT rtDW_ADAS.GTis_ACC_test_IC "" UBYTE ADAS_CM_uint8 0 0 0 255 ECU_ADDRESS 0x0000 /* @ECU_Address@rtDW_ADAS.GTis_ACC_test_IC@ */ /end MEASUREMENT
/begin MEASUREMENT rtDW_ADAS.GTis_ACTIVE_MODE "" UBYTE ADAS_CM_uint8 0 0 0 255 ECU_ADDRESS 0x0000 /* @ECU_Address@rtDW_ADAS.GTis_ACTIVE_MODE@ */ /end MEASUREMENT
/begin MEASUREMENT rtDW_ADAS.GTis_CCStsBtn "" UBYTE ADAS_CM_uint8 0 0 0 255 ECU_ADDRESS 0x0000 /* @ECU_Address@rtDW_ADAS.GTis_CCStsBtn@ */ /end MEASUREMENT
/begin MEASUREMENT rtDW_ADAS.GTis_CCStsBtn_o "" UBYTE ADAS_CM_uint8 0 0 0 255 ECU_ADDRESS 0x0000 /* @ECU_Address@rtDW_ADAS.GTis_CCStsBtn_o@ */ /end MEASUREMENT
/begin MEASUREMENT rtDW_ADAS.GTis_CC_MODE "" UBYTE ADAS_CM_uint8 0 0 0 255 ECU_ADDRESS 0x0000 /* @ECU_Address@rtDW_ADAS.GTis_CC_MODE@ */ /end MEASUREMENT
/begin MEASUREMENT rtDW_ADAS.GTis_CC_MODE_i "" UBYTE ADAS_CM_uint8 0 0 0 255 ECU_ADDRESS 0x0000 /* @ECU_Address@rtDW_ADAS.GTis_CC_MODE_i@ */ /end MEASUREMENT
/begin MEASUREMENT rtDW_ADAS.GTis_Cancel_sign "" UBYTE ADAS_CM_uint8 0 0 0 255 ECU_ADDRESS 0x0000 /* @ECU_Address@rtDW_ADAS.GTis_Cancel_sign@ */ /end MEASUREMENT
/begin MEASUREMENT rtDW_ADAS.GTis_CcSetDist "" UBYTE ADAS_CM_uint8 0 0 0 255 ECU_ADDRESS 0x0000 /* @ECU_Address@rtDW_ADAS.GTis_CcSetDist@ */ /end MEASUREMENT
/begin MEASUREMENT rtDW_ADAS.GTis_Contr "" UBYTE ADAS_CM_uint8 0 0 0 255 ECU_ADDRESS 0x0000 /* @ECU_Address@rtDW_ADAS.GTis_Contr@ */ /end MEASUREMENT
/begin MEASUREMENT rtDW_ADAS.GTis_Control_mode "" UBYTE ADAS_CM_uint8 0 0 0 255 ECU_ADDRESS 0x0000 /* @ECU_Address@rtDW_ADAS.GTis_Control_mode@ */ /end MEASUREMENT
/begin MEASUREMENT rtDW_ADAS.GTis_Fast_mode "" UBYTE ADAS_CM_uint8 0 0 0 255 ECU_ADDRESS 0x0000 /* @ECU_Address@rtDW_ADAS.GTis_Fast_mode@ */ /end MEASUREMENT
/begin MEASUREMENT rtDW_ADAS.GTis_Fiu_St "" UBYTE ADAS_CM_uint8 0 0 0 255 ECU_ADDRESS 0x0000 /* @ECU_Address@rtDW_ADAS.GTis_Fiu_St@ */ /end MEASUREMENT
/begin MEASUREMENT rtDW_ADAS.GTis_LIM_MODE "" UBYTE ADAS_CM_uint8 0 0 0 255 ECU_ADDRESS 0x0000 /* @ECU_Address@rtDW_ADAS.GTis_LIM_MODE@ */ /end MEASUREMENT
/begin MEASUREMENT rtDW_ADAS.GTis_LIM_MODE_k "" UBYTE ADAS_CM_uint8 0 0 0 255 ECU_ADDRESS 0x0000 /* @ECU_Address@rtDW_ADAS.GTis_LIM_MODE_k@ */ /end MEASUREMENT
/begin MEASUREMENT rtDW_ADAS.GTis_LccSts "" UBYTE ADAS_CM_uint8 0 0 0 255 ECU_ADDRESS 0x0000 /* @ECU_Address@rtDW_ADAS.GTis_LccSts@ */ /end MEASUREMENT
/begin MEASUREMENT rtDW_ADAS.GTis_LccStsBtn "" UBYTE ADAS_CM_uint8 0 0 0 255 ECU_ADDRESS 0x0000 /* @ECU_Address@rtDW_ADAS.GTis_LccStsBtn@ */ /end MEASUREMENT
/begin MEASUREMENT rtDW_ADAS.GTis_LdwSts "" UBYTE ADAS_CM_uint8 0 0 0 255 ECU_ADDRESS 0x0000 /* @ECU_Address@rtDW_ADAS.GTis_LdwSts@ */ /end MEASUREMENT
/begin MEASUREMENT rtDW_ADAS.GTis_LdwStsBtn "" UBYTE ADAS_CM_uint8 0 0 0 255 ECU_ADDRESS 0x0000 /* @ECU_Address@rtDW_ADAS.GTis_LdwStsBtn@ */ /end MEASUREMENT
/begin MEASUREMENT rtDW_ADAS.GTis_LkaStsBtn "" UBYTE ADAS_CM_uint8 0 0 0 255 ECU_ADDRESS 0x0000 /* @ECU_Address@rtDW_ADAS.GTis_LkaStsBtn@ */ /end MEASUREMENT
/begin MEASUREMENT rtDW_ADAS.GTis_MainState "" UBYTE ADAS_CM_uint8 0 0 0 255 ECU_ADDRESS 0x0000 /* @ECU_Address@rtDW_ADAS.GTis_MainState@ */ /end MEASUREMENT
/begin MEASUREMENT rtDW_ADAS.GTis_Monitor_ON_MAIN "" UBYTE ADAS_CM_uint8 0 0 0 255 ECU_ADDRESS 0x0000 /* @ECU_Address@rtDW_ADAS.GTis_Monitor_ON_MAIN@ */ /end MEASUREMENT
/begin MEASUREMENT rtDW_ADAS.GTis_OnMode "" UBYTE ADAS_CM_uint8 0 0 0 255 ECU_ADDRESS 0x0000 /* @ECU_Address@rtDW_ADAS.GTis_OnMode@ */ /end MEASUREMENT
/begin MEASUREMENT rtDW_ADAS.GTis_Release_mode "" UBYTE ADAS_CM_uint8 0 0 0 255 ECU_ADDRESS 0x0000 /* @ECU_Address@rtDW_ADAS.GTis_Release_mode@ */ /end MEASUREMENT
/begin MEASUREMENT rtDW_ADAS.GTis_Ride_mode "" UBYTE ADAS_CM_uint8 0 0 0 255 ECU_ADDRESS 0x0000 /* @ECU_Address@rtDW_ADAS.GTis_Ride_mode@ */ /end MEASUREMENT
/begin MEASUREMENT rtDW_ADAS.GTis_Slow_mode1 "" UBYTE ADAS_CM_uint8 0 0 0 255 ECU_ADDRESS 0x0000 /* @ECU_Address@rtDW_ADAS.GTis_Slow_mode1@ */ /end MEASUREMENT
/begin MEASUREMENT rtDW_ADAS.GTis_Stand_mode "" UBYTE ADAS_CM_uint8 0 0 0 255 ECU_ADDRESS 0x0000 /* @ECU_Address@rtDW_ADAS.GTis_Stand_mode@ */ /end MEASUREMENT
/begin MEASUREMENT rtDW_ADAS.GTis_TypeCCActiveMode "" UBYTE ADAS_CM_uint8 0 0 0 255 ECU_ADDRESS 0x0000 /* @ECU_Address@rtDW_ADAS.GTis_TypeCCActiveMode@ */ /end MEASUREMENT
/begin MEASUREMENT rtDW_ADAS.GTis_Type_on "" UBYTE ADAS_CM_uint8 0 0 0 255 ECU_ADDRESS 0x0000 /* @ECU_Address@rtDW_ADAS.GTis_Type_on@ */ /end MEASUREMENT
/begin MEASUREMENT rtDW_ADAS.GTis_Type_on_k "" UBYTE ADAS_CM_uint8 0 0 0 255 ECU_ADDRESS 0x0000 /* @ECU_Address@rtDW_ADAS.GTis_Type_on_k@ */ /end MEASUREMENT
/begin MEASUREMENT rtDW_ADAS.GTis_active_c103_ADAS "" UBYTE ADAS_CM_uint8 0 0 0 255 ECU_ADDRESS 0x0000 /* @ECU_Address@rtDW_ADAS.GTis_active_c103_ADAS@ */ /end MEASUREMENT
/begin MEASUREMENT rtDW_ADAS.GTis_active_c105_ADAS "" UBYTE ADAS_CM_uint8 0 0 0 255 ECU_ADDRESS 0x0000 /* @ECU_Address@rtDW_ADAS.GTis_active_c105_ADAS@ */ /end MEASUREMENT
/begin MEASUREMENT rtDW_ADAS.GTis_active_c11_ADAS "" UBYTE ADAS_CM_uint8 0 0 0 255 ECU_ADDRESS 0x0000 /* @ECU_Address@rtDW_ADAS.GTis_active_c11_ADAS@ */ /end MEASUREMENT
/begin MEASUREMENT rtDW_ADAS.GTis_active_c12_ADAS "" UBYTE ADAS_CM_uint8 0 0 0 255 ECU_ADDRESS 0x0000 /* @ECU_Address@rtDW_ADAS.GTis_active_c12_ADAS@ */ /end MEASUREMENT
/begin MEASUREMENT rtDW_ADAS.GTis_active_c13_ADAS "" UBYTE ADAS_CM_uint8 0 0 0 255 ECU_ADDRESS 0x0000 /* @ECU_Address@rtDW_ADAS.GTis_active_c13_ADAS@ */ /end MEASUREMENT
/begin MEASUREMENT rtDW_ADAS.GTis_active_c159_ADAS "" UBYTE ADAS_CM_uint8 0 0 0 255 ECU_ADDRESS 0x0000 /* @ECU_Address@rtDW_ADAS.GTis_active_c159_ADAS@ */ /end MEASUREMENT
/begin MEASUREMENT rtDW_ADAS.GTis_active_c1_ADAS "" UBYTE ADAS_CM_uint8 0 0 0 255 ECU_ADDRESS 0x0000 /* @ECU_Address@rtDW_ADAS.GTis_active_c1_ADAS@ */ /end MEASUREMENT
/begin MEASUREMENT rtDW_ADAS.GTis_active_c347_ADAS "" UBYTE ADAS_CM_uint8 0 0 0 255 ECU_ADDRESS 0x0000 /* @ECU_Address@rtDW_ADAS.GTis_active_c347_ADAS@ */ /end MEASUREMENT
/begin MEASUREMENT rtDW_ADAS.GTis_active_c44_ADAS "" UBYTE ADAS_CM_uint8 0 0 0 255 ECU_ADDRESS 0x0000 /* @ECU_Address@rtDW_ADAS.GTis_active_c44_ADAS@ */ /end MEASUREMENT
/begin MEASUREMENT rtDW_ADAS.GTis_active_c562_ADAS "" UBYTE ADAS_CM_uint8 0 0 0 255 ECU_ADDRESS 0x0000 /* @ECU_Address@rtDW_ADAS.GTis_active_c562_ADAS@ */ /end MEASUREMENT
/begin MEASUREMENT rtDW_ADAS.GTis_active_c63_ADAS "" UBYTE ADAS_CM_uint8 0 0 0 255 ECU_ADDRESS 0x0000 /* @ECU_Address@rtDW_ADAS.GTis_active_c63_ADAS@ */ /end MEASUREMENT
/begin MEASUREMENT rtDW_ADAS.GTis_active_c64_ADAS "" UBYTE ADAS_CM_uint8 0 0 0 255 ECU_ADDRESS 0x0000 /* @ECU_Address@rtDW_ADAS.GTis_active_c64_ADAS@ */ /end MEASUREMENT
/begin MEASUREMENT rtDW_ADAS.GTis_active_c66_ADAS "" UBYTE ADAS_CM_uint8 0 0 0 255 ECU_ADDRESS 0x0000 /* @ECU_Address@rtDW_ADAS.GTis_active_c66_ADAS@ */ /end MEASUREMENT
/begin MEASUREMENT rtDW_ADAS.GTis_active_c67_ADAS "" UBYTE ADAS_CM_uint8 0 0 0 255 ECU_ADDRESS 0x0000 /* @ECU_Address@rtDW_ADAS.GTis_active_c67_ADAS@ */ /end MEASUREMENT
/begin MEASUREMENT rtDW_ADAS.GTis_active_c68_ADAS "" UBYTE ADAS_CM_uint8 0 0 0 255 ECU_ADDRESS 0x0000 /* @ECU_Address@rtDW_ADAS.GTis_active_c68_ADAS@ */ /end MEASUREMENT
/begin MEASUREMENT rtDW_ADAS.GTis_active_c69_ADAS "" UBYTE ADAS_CM_uint8 0 0 0 255 ECU_ADDRESS 0x0000 /* @ECU_Address@rtDW_ADAS.GTis_active_c69_ADAS@ */ /end MEASUREMENT
/begin MEASUREMENT rtDW_ADAS.GTis_active_c70_ADAS "" UBYTE ADAS_CM_uint8 0 0 0 255 ECU_ADDRESS 0x0000 /* @ECU_Address@rtDW_ADAS.GTis_active_c70_ADAS@ */ /end MEASUREMENT
/begin MEASUREMENT rtDW_ADAS.GTis_active_c71_ADAS "" UBYTE ADAS_CM_uint8 0 0 0 255 ECU_ADDRESS 0x0000 /* @ECU_Address@rtDW_ADAS.GTis_active_c71_ADAS@ */ /end MEASUREMENT
/begin MEASUREMENT rtDW_ADAS.GTis_active_c72_ADAS "" UBYTE ADAS_CM_uint8 0 0 0 255 ECU_ADDRESS 0x0000 /* @ECU_Address@rtDW_ADAS.GTis_active_c72_ADAS@ */ /end MEASUREMENT
/begin MEASUREMENT rtDW_ADAS.GTis_active_c77_ADAS "" UBYTE ADAS_CM_uint8 0 0 0 255 ECU_ADDRESS 0x0000 /* @ECU_Address@rtDW_ADAS.GTis_active_c77_ADAS@ */ /end MEASUREMENT
/begin MEASUREMENT rtDW_ADAS.GTis_active_c78_ADAS "" UBYTE ADAS_CM_uint8 0 0 0 255 ECU_ADDRESS 0x0000 /* @ECU_Address@rtDW_ADAS.GTis_active_c78_ADAS@ */ /end MEASUREMENT
/begin MEASUREMENT rtDW_ADAS.GTis_active_c7_ADAS "" UBYTE ADAS_CM_uint8 0 0 0 255 ECU_ADDRESS 0x0000 /* @ECU_Address@rtDW_ADAS.GTis_active_c7_ADAS@ */ /end MEASUREMENT
/begin MEASUREMENT rtDW_ADAS.GTis_active_c80_ADAS "" UBYTE ADAS_CM_uint8 0 0 0 255 ECU_ADDRESS 0x0000 /* @ECU_Address@rtDW_ADAS.GTis_active_c80_ADAS@ */ /end MEASUREMENT
/begin MEASUREMENT rtDW_ADAS.GTis_active_c84_ADAS "" UBYTE ADAS_CM_uint8 0 0 0 255 ECU_ADDRESS 0x0000 /* @ECU_Address@rtDW_ADAS.GTis_active_c84_ADAS@ */ /end MEASUREMENT
/begin MEASUREMENT rtDW_ADAS.GTis_active_c85_ADAS "" UBYTE ADAS_CM_uint8 0 0 0 255 ECU_ADDRESS 0x0000 /* @ECU_Address@rtDW_ADAS.GTis_active_c85_ADAS@ */ /end MEASUREMENT
/begin MEASUREMENT rtDW_ADAS.GTis_active_c87_ADAS "" UBYTE ADAS_CM_uint8 0 0 0 255 ECU_ADDRESS 0x0000 /* @ECU_Address@rtDW_ADAS.GTis_active_c87_ADAS@ */ /end MEASUREMENT
/begin MEASUREMENT rtDW_ADAS.GTis_c103_ADAS "" UBYTE ADAS_CM_uint8 0 0 0 255 ECU_ADDRESS 0x0000 /* @ECU_Address@rtDW_ADAS.GTis_c103_ADAS@ */ /end MEASUREMENT
/begin MEASUREMENT rtDW_ADAS.GTis_c105_ADAS "" UBYTE ADAS_CM_uint8 0 0 0 255 ECU_ADDRESS 0x0000 /* @ECU_Address@rtDW_ADAS.GTis_c105_ADAS@ */ /end MEASUREMENT
/begin MEASUREMENT rtDW_ADAS.GTis_c11_ADAS "" UBYTE ADAS_CM_uint8 0 0 0 255 ECU_ADDRESS 0x0000 /* @ECU_Address@rtDW_ADAS.GTis_c11_ADAS@ */ /end MEASUREMENT
/begin MEASUREMENT rtDW_ADAS.GTis_c12_ADAS "" UBYTE ADAS_CM_uint8 0 0 0 255 ECU_ADDRESS 0x0000 /* @ECU_Address@rtDW_ADAS.GTis_c12_ADAS@ */ /end MEASUREMENT
/begin MEASUREMENT rtDW_ADAS.GTis_c13_ADAS "" UBYTE ADAS_CM_uint8 0 0 0 255 ECU_ADDRESS 0x0000 /* @ECU_Address@rtDW_ADAS.GTis_c13_ADAS@ */ /end MEASUREMENT
/begin MEASUREMENT rtDW_ADAS.GTis_c159_ADAS "" UBYTE ADAS_CM_uint8 0 0 0 255 ECU_ADDRESS 0x0000 /* @ECU_Address@rtDW_ADAS.GTis_c159_ADAS@ */ /end MEASUREMENT
/begin MEASUREMENT rtDW_ADAS.GTis_c1_ADAS "" UBYTE ADAS_CM_uint8 0 0 0 255 ECU_ADDRESS 0x0000 /* @ECU_Address@rtDW_ADAS.GTis_c1_ADAS@ */ /end MEASUREMENT
/begin MEASUREMENT rtDW_ADAS.GTis_c347_ADAS "" UBYTE ADAS_CM_uint8 0 0 0 255 ECU_ADDRESS 0x0000 /* @ECU_Address@rtDW_ADAS.GTis_c347_ADAS@ */ /end MEASUREMENT
/begin MEASUREMENT rtDW_ADAS.GTis_c44_ADAS "" UBYTE ADAS_CM_uint8 0 0 0 255 ECU_ADDRESS 0x0000 /* @ECU_Address@rtDW_ADAS.GTis_c44_ADAS@ */ /end MEASUREMENT
/begin MEASUREMENT rtDW_ADAS.GTis_c562_ADAS "" UBYTE ADAS_CM_uint8 0 0 0 255 ECU_ADDRESS 0x0000 /* @ECU_Address@rtDW_ADAS.GTis_c562_ADAS@ */ /end MEASUREMENT
/begin MEASUREMENT rtDW_ADAS.GTis_c63_ADAS "" UBYTE ADAS_CM_uint8 0 0 0 255 ECU_ADDRESS 0x0000 /* @ECU_Address@rtDW_ADAS.GTis_c63_ADAS@ */ /end MEASUREMENT
/begin MEASUREMENT rtDW_ADAS.GTis_c64_ADAS "" UBYTE ADAS_CM_uint8 0 0 0 255 ECU_ADDRESS 0x0000 /* @ECU_Address@rtDW_ADAS.GTis_c64_ADAS@ */ /end MEASUREMENT
/begin MEASUREMENT rtDW_ADAS.GTis_c66_ADAS "" UBYTE ADAS_CM_uint8 0 0 0 255 ECU_ADDRESS 0x0000 /* @ECU_Address@rtDW_ADAS.GTis_c66_ADAS@ */ /end MEASUREMENT
/begin MEASUREMENT rtDW_ADAS.GTis_c67_ADAS "" UBYTE ADAS_CM_uint8 0 0 0 255 ECU_ADDRESS 0x0000 /* @ECU_Address@rtDW_ADAS.GTis_c67_ADAS@ */ /end MEASUREMENT
/begin MEASUREMENT rtDW_ADAS.GTis_c68_ADAS "" UBYTE ADAS_CM_uint8 0 0 0 255 ECU_ADDRESS 0x0000 /* @ECU_Address@rtDW_ADAS.GTis_c68_ADAS@ */ /end MEASUREMENT
/begin MEASUREMENT rtDW_ADAS.GTis_c69_ADAS "" UBYTE ADAS_CM_uint8 0 0 0 255 ECU_ADDRESS 0x0000 /* @ECU_Address@rtDW_ADAS.GTis_c69_ADAS@ */ /end MEASUREMENT
/begin MEASUREMENT rtDW_ADAS.GTis_c70_ADAS "" UBYTE ADAS_CM_uint8 0 0 0 255 ECU_ADDRESS 0x0000 /* @ECU_Address@rtDW_ADAS.GTis_c70_ADAS@ */ /end MEASUREMENT
/begin MEASUREMENT rtDW_ADAS.GTis_c71_ADAS "" UBYTE ADAS_CM_uint8 0 0 0 255 ECU_ADDRESS 0x0000 /* @ECU_Address@rtDW_ADAS.GTis_c71_ADAS@ */ /end MEASUREMENT
/begin MEASUREMENT rtDW_ADAS.GTis_c72_ADAS "" UBYTE ADAS_CM_uint8 0 0 0 255 ECU_ADDRESS 0x0000 /* @ECU_Address@rtDW_ADAS.GTis_c72_ADAS@ */ /end MEASUREMENT
/begin MEASUREMENT rtDW_ADAS.GTis_c77_ADAS "" UBYTE ADAS_CM_uint8 0 0 0 255 ECU_ADDRESS 0x0000 /* @ECU_Address@rtDW_ADAS.GTis_c77_ADAS@ */ /end MEASUREMENT
/begin MEASUREMENT rtDW_ADAS.GTis_c78_ADAS "" UBYTE ADAS_CM_uint8 0 0 0 255 ECU_ADDRESS 0x0000 /* @ECU_Address@rtDW_ADAS.GTis_c78_ADAS@ */ /end MEASUREMENT
/begin MEASUREMENT rtDW_ADAS.GTis_c7_ADAS "" UBYTE ADAS_CM_uint8 0 0 0 255 ECU_ADDRESS 0x0000 /* @ECU_Address@rtDW_ADAS.GTis_c7_ADAS@ */ /end MEASUREMENT
/begin MEASUREMENT rtDW_ADAS.GTis_c80_ADAS "" UBYTE ADAS_CM_uint8 0 0 0 255 ECU_ADDRESS 0x0000 /* @ECU_Address@rtDW_ADAS.GTis_c80_ADAS@ */ /end MEASUREMENT
/begin MEASUREMENT rtDW_ADAS.GTis_c84_ADAS "" UBYTE ADAS_CM_uint8 0 0 0 255 ECU_ADDRESS 0x0000 /* @ECU_Address@rtDW_ADAS.GTis_c84_ADAS@ */ /end MEASUREMENT
/begin MEASUREMENT rtDW_ADAS.GTis_c85_ADAS "" UBYTE ADAS_CM_uint8 0 0 0 255 ECU_ADDRESS 0x0000 /* @ECU_Address@rtDW_ADAS.GTis_c85_ADAS@ */ /end MEASUREMENT
/begin MEASUREMENT rtDW_ADAS.GTis_c87_ADAS "" UBYTE ADAS_CM_uint8 0 0 0 255 ECU_ADDRESS 0x0000 /* @ECU_Address@rtDW_ADAS.GTis_c87_ADAS@ */ /end MEASUREMENT
/begin MEASUREMENT rtDW_ADAS.GTis_new_signUp_Request "" UBYTE ADAS_CM_uint8 0 0 0 255 ECU_ADDRESS 0x0000 /* @ECU_Address@rtDW_ADAS.GTis_new_signUp_Request@ */ /end MEASUREMENT
/begin MEASUREMENT rtDW_ADAS.GTis_wait_Fiu "" UBYTE ADAS_CM_uint8 0 0 0 255 ECU_ADDRESS 0x0000 /* @ECU_Address@rtDW_ADAS.GTis_wait_Fiu@ */ /end MEASUREMENT
/begin MEASUREMENT rtDW_ADAS.GTout_add "" FLOAT32_IEEE ADAS_CM_single 0 0 -3.4E+38 3.4E+38 ECU_ADDRESS 0x0000 /* @ECU_Address@rtDW_ADAS.GTout_add@ */ /end MEASUREMENT
/begin MEASUREMENT rtDW_ADAS.GTratAccPed "" FLOAT32_IEEE ADAS_CM_single 0 0 -3.4E+38 3.4E+38 ECU_ADDRESS 0x0000 /* @ECU_Address@rtDW_ADAS.GTratAccPed@ */ /end MEASUREMENT
/begin MEASUREMENT rtDW_ADAS.GTtemporalCounter_i1_aa "" UBYTE ADAS_CM_uint8 0 0 0 255 ECU_ADDRESS 0x0000 /* @ECU_Address@rtDW_ADAS.GTtemporalCounter_i1_aa@ */ /end MEASUREMENT
/begin MEASUREMENT rtDW_ADAS.GTtemporalCounter_i1_aj "" UBYTE ADAS_CM_uint8 0 0 0 255 ECU_ADDRESS 0x0000 /* @ECU_Address@rtDW_ADAS.GTtemporalCounter_i1_aj@ */ /end MEASUREMENT
/begin MEASUREMENT rtDW_ADAS.GTtemporalCounter_i1_bl "" ULONG ADAS_CM_uint32 0 0 0 4294967295 ECU_ADDRESS 0x0000 /* @ECU_Address@rtDW_ADAS.GTtemporalCounter_i1_bl@ */ /end MEASUREMENT
/begin MEASUREMENT rtDW_ADAS.GTtemporalCounter_i1_br "" ULONG ADAS_CM_uint32 0 0 0 4294967295 ECU_ADDRESS 0x0000 /* @ECU_Address@rtDW_ADAS.GTtemporalCounter_i1_br@ */ /end MEASUREMENT
/begin MEASUREMENT rtDW_ADAS.GTtemporalCounter_i1_d2 "" UBYTE ADAS_CM_uint8 0 0 0 255 ECU_ADDRESS 0x0000 /* @ECU_Address@rtDW_ADAS.GTtemporalCounter_i1_d2@ */ /end MEASUREMENT
/begin MEASUREMENT rtDW_ADAS.GTtemporalCounter_i1_dx "" UBYTE ADAS_CM_uint8 0 0 0 255 ECU_ADDRESS 0x0000 /* @ECU_Address@rtDW_ADAS.GTtemporalCounter_i1_dx@ */ /end MEASUREMENT
/begin MEASUREMENT rtDW_ADAS.GTtemporalCounter_i1_ev "" UBYTE ADAS_CM_uint8 0 0 0 255 ECU_ADDRESS 0x0000 /* @ECU_Address@rtDW_ADAS.GTtemporalCounter_i1_ev@ */ /end MEASUREMENT
/begin MEASUREMENT rtDW_ADAS.GTtemporalCounter_i1_fa "" ULONG ADAS_CM_uint32 0 0 0 4294967295 ECU_ADDRESS 0x0000 /* @ECU_Address@rtDW_ADAS.GTtemporalCounter_i1_fa@ */ /end MEASUREMENT
/begin MEASUREMENT rtDW_ADAS.GTtemporalCounter_i1_gc "" ULONG ADAS_CM_uint32 0 0 0 4294967295 ECU_ADDRESS 0x0000 /* @ECU_Address@rtDW_ADAS.GTtemporalCounter_i1_gc@ */ /end MEASUREMENT
/begin MEASUREMENT rtDW_ADAS.GTtemporalCounter_i1_jc "" UBYTE ADAS_CM_uint8 0 0 0 255 ECU_ADDRESS 0x0000 /* @ECU_Address@rtDW_ADAS.GTtemporalCounter_i1_jc@ */ /end MEASUREMENT
/begin MEASUREMENT rtDW_ADAS.GTtemporalCounter_i1_jn "" UBYTE ADAS_CM_uint8 0 0 0 255 ECU_ADDRESS 0x0000 /* @ECU_Address@rtDW_ADAS.GTtemporalCounter_i1_jn@ */ /end MEASUREMENT
/begin MEASUREMENT rtDW_ADAS.GTtemporalCounter_i1_k1 "" UBYTE ADAS_CM_uint8 0 0 0 255 ECU_ADDRESS 0x0000 /* @ECU_Address@rtDW_ADAS.GTtemporalCounter_i1_k1@ */ /end MEASUREMENT
/begin MEASUREMENT rtDW_ADAS.GTtemporalCounter_i1_ka "" UBYTE ADAS_CM_uint8 0 0 0 255 ECU_ADDRESS 0x0000 /* @ECU_Address@rtDW_ADAS.GTtemporalCounter_i1_ka@ */ /end MEASUREMENT
/begin MEASUREMENT rtDW_ADAS.GTtemporalCounter_i1_ki "" UBYTE ADAS_CM_uint8 0 0 0 255 ECU_ADDRESS 0x0000 /* @ECU_Address@rtDW_ADAS.GTtemporalCounter_i1_ki@ */ /end MEASUREMENT
/begin MEASUREMENT rtDW_ADAS.GTtemporalCounter_i1_l "" ULONG ADAS_CM_uint32 0 0 0 4294967295 ECU_ADDRESS 0x0000 /* @ECU_Address@rtDW_ADAS.GTtemporalCounter_i1_l@ */ /end MEASUREMENT
/begin MEASUREMENT rtDW_ADAS.GTtemporalCounter_i1_no "" UBYTE ADAS_CM_uint8 0 0 0 255 ECU_ADDRESS 0x0000 /* @ECU_Address@rtDW_ADAS.GTtemporalCounter_i1_no@ */ /end MEASUREMENT
/begin MEASUREMENT rtDW_ADAS.GTtemporalCounter_i1_o3 "" UBYTE ADAS_CM_uint8 0 0 0 255 ECU_ADDRESS 0x0000 /* @ECU_Address@rtDW_ADAS.GTtemporalCounter_i1_o3@ */ /end MEASUREMENT
/begin MEASUREMENT rtDW_ADAS.GTtemporalCounter_i1_ox "" ULONG ADAS_CM_uint32 0 0 0 4294967295 ECU_ADDRESS 0x0000 /* @ECU_Address@rtDW_ADAS.GTtemporalCounter_i1_ox@ */ /end MEASUREMENT
/begin MEASUREMENT rtDW_ADAS.GTtemporalCounter_i2_h "" ULONG ADAS_CM_uint32 0 0 0 4294967295 ECU_ADDRESS 0x0000 /* @ECU_Address@rtDW_ADAS.GTtemporalCounter_i2_h@ */ /end MEASUREMENT
/begin MEASUREMENT rtDW_ADAS.GTtemporalCounter_i2_h5 "" UWORD ADAS_CM_uint16 0 0 0 65535 ECU_ADDRESS 0x0000 /* @ECU_Address@rtDW_ADAS.GTtemporalCounter_i2_h5@ */ /end MEASUREMENT
/begin MEASUREMENT rtDW_ADAS.GTtemporalCounter_i2_n "" ULONG ADAS_CM_uint32 0 0 0 4294967295 ECU_ADDRESS 0x0000 /* @ECU_Address@rtDW_ADAS.GTtemporalCounter_i2_n@ */ /end MEASUREMENT
/begin MEASUREMENT rtDW_ADAS.GTtemporalCounter_i3 "" ULONG ADAS_CM_uint32 0 0 0 4294967295 ECU_ADDRESS 0x0000 /* @ECU_Address@rtDW_ADAS.GTtemporalCounter_i3@ */ /end MEASUREMENT
/begin MEASUREMENT rtDW_ADAS.GTtrans "" UBYTE ADAS_CM_uint8 0 0 0 255 ECU_ADDRESS 0x0000 /* @ECU_Address@rtDW_ADAS.GTtrans@ */ /end MEASUREMENT
/begin MEASUREMENT rtDW_ADAS.GTu2_15 "" FLOAT32_IEEE ADAS_CM_single 0 0 -3.4E+38 3.4E+38 ECU_ADDRESS 0x0000 /* @ECU_Address@rtDW_ADAS.GTu2_15@ */ /end MEASUREMENT
/begin MEASUREMENT rtDW_ADAS.GTu5_20 "" FLOAT32_IEEE ADAS_CM_single 0 0 -3.4E+38 3.4E+38 ECU_ADDRESS 0x0000 /* @ECU_Address@rtDW_ADAS.GTu5_20@ */ /end MEASUREMENT
/begin MEASUREMENT rtDW_ADAS.GTwarningReq_uint8 "" UBYTE ADAS_CM_uint8 0 0 0 255 MATRIX_DIM 1 1 ECU_ADDRESS 0x0000 /* @ECU_Address@rtDW_ADAS.GTwarningReq_uint8@ */ /end MEASUREMENT
/begin MEASUREMENT rtDW_ADAS.GTwarningReq_uint8_b "" UBYTE ADAS_CM_uint8 0 0 0 255 MATRIX_DIM 1 1 ECU_ADDRESS 0x0000 /* @ECU_Address@rtDW_ADAS.GTwarningReq_uint8_b@ */ /end MEASUREMENT
/begin COMPU_METHOD ADAS_CM_double "" IDENTICAL "%15.10" "" /end COMPU_METHOD
/begin COMPU_METHOD ADAS_CM_logical "" IDENTICAL "%1.0" "" /end COMPU_METHOD
/begin COMPU_METHOD ADAS_CM_single "" IDENTICAL "%8.6" "" /end COMPU_METHOD
/begin COMPU_METHOD ADAS_CM_uint16 "" IDENTICAL "%5.0" "" /end COMPU_METHOD
/begin COMPU_METHOD ADAS_CM_uint32 "" IDENTICAL "%10.0" "" /end COMPU_METHOD
/begin COMPU_METHOD ADAS_CM_uint8 "" IDENTICAL "%3.0" "" /end COMPU_METHOD
/begin GROUP ADAS "ADAS" ROOT
 /begin SUB_GROUP ADAS_Counter_Free_Running ADAS_EnableManager ADAS_ErrorManager ADAS_FuncLevel ADAS_Input ADAS_Output_new ADAS_ServiceManager /end SUB_GROUP
 /begin REF_MEASUREMENT DtDiagVerNumSoftWare /end REF_MEASUREMENT
/end GROUP
/begin GROUP ADAS_Counter_Free_Running "ADAS/Counter
Free-Running" /begin REF_MEASUREMENT rtDW_ADAS.GTOutput_DSTATE /end REF_MEASUREMENT /end GROUP
/begin GROUP ADAS_EnableManager "ADAS/EnableManager" /begin SUB_GROUP ADAS_EnableManager_EnaStatus ADAS_EnableManager_FiuManager /end SUB_GROUP /end GROUP
/begin GROUP ADAS_EnableManager_EnaStatus "ADAS/EnableManager/EnaStatus" /begin SUB_GROUP ADAS_EnableManager_EnaStatus_AccCcLimType /end SUB_GROUP
 /begin REF_MEASUREMENT rtDW_ADAS.GTAebErReq rtDW_ADAS.GTAlccErReq rtDW_ADAS.GTDowErReq rtDW_ADAS.GTFcwErReq rtDW_ADAS.GTLccErReq rtDW_ADAS.GTLdpErReq rtDW_ADAS.GTLdwErReq rtDW_ADAS.GTRctcErReq rtDW_ADAS.GTRdaErReq rtDW_ADAS.GTRecErReq rtDW_ADAS.GTSetAebSts rtDW_ADAS.GTSetAlccSts rtDW_ADAS.GTSetAslaSts rtDW_ADAS.GTSetDowSts rtDW_ADAS.GTSetFcwSts rtDW_ADAS.GTSetLccSts rtDW_ADAS.GTSetLdpSts rtDW_ADAS.GTSetLdwSts rtDW_ADAS.GTSetRctcSts rtDW_ADAS.GTSetRdaSts rtDW_ADAS.GTSetRecSts rtDW_ADAS.GTSetTsrSts rtDW_ADAS.GTTsrErReq /end REF_MEASUREMENT
/end GROUP
/begin GROUP ADAS_EnableManager_EnaStatus_AccCcLimType "ADAS/EnableManager/EnaStatus/AccCcLimType"
 /begin SUB_GROUP ADAS_EnableManager_EnaStatus_AccCcLimType_Compare_To_Constant2 ADAS_EnableManager_EnaStatus_AccCcLimType_Compare_To_Constant3 ADAS_EnableManager_EnaStatus_AccCcLimType_Compare_To_Constant4 ADAS_EnableManager_EnaStatus_AccCcLimType_Compare_To_Zero2 ADAS_EnableManager_EnaStatus_AccCcLimType_Compare_To_Zero3 ADAS_EnableManager_EnaStatus_AccCcLimType_Compare_To_Zero4 /end SUB_GROUP
/end GROUP
/begin GROUP ADAS_EnableManager_EnaStatus_AccCcLimType_Compare_To_Constant2 "ADAS/EnableManager/EnaStatus/AccCcLimType/Compare
To Constant2" /begin REF_MEASUREMENT rtDW_ADAS.GTSetCcType /end REF_MEASUREMENT /end GROUP
/begin GROUP ADAS_EnableManager_EnaStatus_AccCcLimType_Compare_To_Constant3 "ADAS/EnableManager/EnaStatus/AccCcLimType/Compare
To Constant3" /begin REF_MEASUREMENT rtDW_ADAS.GTSetCcType /end REF_MEASUREMENT /end GROUP
/begin GROUP ADAS_EnableManager_EnaStatus_AccCcLimType_Compare_To_Constant4 "ADAS/EnableManager/EnaStatus/AccCcLimType/Compare
To Constant4" /begin REF_MEASUREMENT rtDW_ADAS.GTSetCcType /end REF_MEASUREMENT /end GROUP
/begin GROUP ADAS_EnableManager_EnaStatus_AccCcLimType_Compare_To_Zero2 "ADAS/EnableManager/EnaStatus/AccCcLimType/Compare
To Zero2" /begin REF_MEASUREMENT rtDW_ADAS.GTAccErReq /end REF_MEASUREMENT /end GROUP
/begin GROUP ADAS_EnableManager_EnaStatus_AccCcLimType_Compare_To_Zero3 "ADAS/EnableManager/EnaStatus/AccCcLimType/Compare
To Zero3" /begin REF_MEASUREMENT rtDW_ADAS.GTCCErReq /end REF_MEASUREMENT /end GROUP
/begin GROUP ADAS_EnableManager_EnaStatus_AccCcLimType_Compare_To_Zero4 "ADAS/EnableManager/EnaStatus/AccCcLimType/Compare
To Zero4" /begin REF_MEASUREMENT rtDW_ADAS.GTLimErReq /end REF_MEASUREMENT /end GROUP
/begin GROUP ADAS_EnableManager_FiuManager "ADAS/EnableManager/FiuManager"
 /begin SUB_GROUP ADAS_EnableManager_FiuManager_Button_handler ADAS_EnableManager_FiuManager_ChangeFiuSts /end SUB_GROUP
 /begin REF_MEASUREMENT rtDW_ADAS.GTAAErReq rtDW_ADAS.GTAaModeReq rtDW_ADAS.GTAccAvail rtDW_ADAS.GTAccErReq rtDW_ADAS.GTAebErReq rtDW_ADAS.GTAlccErReq rtDW_ADAS.GTAslaDeltaReq rtDW_ADAS.GTAslaErReq rtDW_ADAS.GTB_ON rtDW_ADAS.GTButtonCnt rtDW_ADAS.GTButtonLcc rtDW_ADAS.GTButtonLdw rtDW_ADAS.GTCCErReq rtDW_ADAS.GTCcActSts rtDW_ADAS.GTCcAutoSpeedReq rtDW_ADAS.GTCcAvail rtDW_ADAS.GTCcTypeReq rtDW_ADAS.GTCcmodeReq rtDW_ADAS.GTCleanSensorReq rtDW_ADAS.GTDataTypeConversion1 rtDW_ADAS.GTDataTypeConversion3 rtDW_ADAS.GTDataTypeConversion3_g rtDW_ADAS.GTDataTypeConversion3_p rtDW_ADAS.GTDataTypeConversion4 rtDW_ADAS.GTDataTypeConversion4_i rtDW_ADAS.GTDataTypeConversion4_m rtDW_ADAS.GTDataTypeConversion_a rtDW_ADAS.GTDataTypeConversion_c rtDW_ADAS.GTDataTypeConversion_d rtDW_ADAS.GTDataTypeConversion_d1 rtDW_ADAS.GTDataTypeConversion_i rtDW_ADAS.GTDataTypeConversion_j rtDW_ADAS.GTDataTypeConversion_o rtDW_ADAS.GTDowErReq rtDW_ADAS.GTDowSoundWarnReq rtDW_ADAS.GTFcwErReq rtDW_ADAS.GTFcwModeReq rtDW_ADAS.GTFcwVibrWarnReq rtDW_ADAS.GTLccAvail rtDW_ADAS.GTLccBt rtDW_ADAS.GTLccErReq rtDW_ADAS.GTLccModeReq rtDW_ADAS.GTLccSoundAlertReq rtDW_ADAS.GTLccVibrationWarnReq rtDW_ADAS.GTLdpErReq rtDW_ADAS.GTLdwAvail rtDW_ADAS.GTLdwBt rtDW_ADAS.GTLdwErReq rtDW_ADAS.GTLdwModeReq rtDW_ADAS.GTLdwSoundReq rtDW_ADAS.GTLdwVibrReq rtDW_ADAS.GTLimAvail rtDW_ADAS.GTLimErReq rtDW_ADAS.GTLkaAvail rtDW_ADAS.GTLkaErReq rtDW_ADAS.GTMemTypeCC rtDW_ADAS.GTNavigStsReq rtDW_ADAS.GTOtherObjStsReq rtDW_ADAS.GTProjectionOnARoadReq rtDW_ADAS.GTRDAAutoBrakeReq rtDW_ADAS.GTRctcErReq rtDW_ADAS.GTRdaErReq rtDW_ADAS.GTRecErReq rtDW_ADAS.GTRoadSignStsReq rtDW_ADAS.GTSetAaMode rtDW_ADAS.GTSetAaSts rtDW_ADAS.GTSetAebSts rtDW_ADAS.GTSetAlccSts rtDW_ADAS.GTSetAslaOver rtDW_ADAS.GTSetAslaSts rtDW_ADAS.GTSetCcCorrectSpd rtDW_ADAS.GTSetCcMode rtDW_ADAS.GTSetCcType rtDW_ADAS.GTSetDowSound rtDW_ADAS.GTSetDowSts rtDW_ADAS.GTSetFcwMode rtDW_ADAS.GTSetFcwSts rtDW_ADAS.GTSetFcwVibration rtDW_ADAS.GTSetLccMode rtDW_ADAS.GTSetLccSound rtDW_ADAS.GTSetLccSts rtDW_ADAS.GTSetLccVibration rtDW_ADAS.GTSetLdpSts rtDW_ADAS.GTSetLdwMode rtDW_ADAS.GTSetLdwSound rtDW_ADAS.GTSetLdwSts rtDW_ADAS.GTSetLdwVibration rtDW_ADAS.GTSetLkaSts rtDW_ADAS.GTSetNavigSts rtDW_ADAS.GTSetOtherObjSts rtDW_ADAS.GTSetProjectionOnARoadSts rtDW_ADAS.GTSetRDAAutoBrakeSts rtDW_ADAS.GTSetRctcSts rtDW_ADAS.GTSetRdaSts rtDW_ADAS.GTSetRecSts rtDW_ADAS.GTSetRoadSignSts rtDW_ADAS.GTSetSensCleanSts rtDW_ADAS.GTSetTsrSts rtDW_ADAS.GTSwitch rtDW_ADAS.GTSwitch1 rtDW_ADAS.GTTestDataChgSts rtDW_ADAS.GTTsrErReq rtDW_ADAS.GTis_ACC_MODE rtDW_ADAS.GTis_ACC_MODE_k rtDW_ADAS.GTis_CCStsBtn rtDW_ADAS.GTis_CCStsBtn_o rtDW_ADAS.GTis_CC_MODE rtDW_ADAS.GTis_CC_MODE_i rtDW_ADAS.GTis_Fiu_St rtDW_ADAS.GTis_LIM_MODE rtDW_ADAS.GTis_LIM_MODE_k rtDW_ADAS.GTis_LccSts rtDW_ADAS.GTis_LccStsBtn rtDW_ADAS.GTis_LdwSts rtDW_ADAS.GTis_LdwStsBtn rtDW_ADAS.GTis_LkaStsBtn rtDW_ADAS.GTis_MainState rtDW_ADAS.GTis_Type_on rtDW_ADAS.GTis_Type_on_k rtDW_ADAS.GTis_active_c159_ADAS rtDW_ADAS.GTis_c159_ADAS rtDW_ADAS.GTis_wait_Fiu rtDW_ADAS.GTtemporalCounter_i1_ki /end REF_MEASUREMENT
/end GROUP
/begin GROUP ADAS_EnableManager_FiuManager_Button_handler "ADAS/EnableManager/FiuManager/Button handler"
 /begin SUB_GROUP ADAS_EnableManager_FiuManager_Button_handler_Compare_To_Constant /end SUB_GROUP
 /begin REF_MEASUREMENT rtDW_ADAS.GTSwitch rtDW_ADAS.GTSwitch1 /end REF_MEASUREMENT
/end GROUP
/begin GROUP ADAS_EnableManager_FiuManager_Button_handler_Compare_To_Constant "ADAS/EnableManager/FiuManager/Button handler/Compare
To Constant" /begin REF_MEASUREMENT rtDW_ADAS.GTB_ChType /end REF_MEASUREMENT /end GROUP
/begin GROUP ADAS_EnableManager_FiuManager_ChangeFiuSts "ADAS/EnableManager/FiuManager/ChangeFiuSts"
 /begin SUB_GROUP ADAS_EnableManager_FiuManager_ChangeFiuSts_AA_AFS ADAS_EnableManager_FiuManager_ChangeFiuSts_ASLA ADAS_EnableManager_FiuManager_ChangeFiuSts_CC_ACC_LIM ADAS_EnableManager_FiuManager_ChangeFiuSts_DOW ADAS_EnableManager_FiuManager_ChangeFiuSts_FCW_AEB ADAS_EnableManager_FiuManager_ChangeFiuSts_LCC___ALCC ADAS_EnableManager_FiuManager_ChangeFiuSts_LDW___LDP ADAS_EnableManager_FiuManager_ChangeFiuSts_LKA ADAS_EnableManager_FiuManager_ChangeFiuSts_RCW ADAS_EnableManager_FiuManager_ChangeFiuSts_RDC_RTSA ADAS_EnableManager_FiuManager_ChangeFiuSts_REC ADAS_EnableManager_FiuManager_ChangeFiuSts_TSR /end SUB_GROUP
/end GROUP
/begin GROUP ADAS_EnableManager_FiuManager_ChangeFiuSts_AA_AFS "ADAS/EnableManager/FiuManager/ChangeFiuSts/AA+AFS" /begin REF_MEASUREMENT rtDW_ADAS.GTDataTypeConversion_d /end REF_MEASUREMENT /end GROUP
/begin GROUP ADAS_EnableManager_FiuManager_ChangeFiuSts_ASLA "ADAS/EnableManager/FiuManager/ChangeFiuSts/ASLA" /begin REF_MEASUREMENT rtDW_ADAS.GTDataTypeConversion_j /end REF_MEASUREMENT /end GROUP
/begin GROUP ADAS_EnableManager_FiuManager_ChangeFiuSts_CC_ACC_LIM "ADAS/EnableManager/FiuManager/ChangeFiuSts/CC+ACC+LIM"
 /begin SUB_GROUP ADAS_EnableManager_FiuManager_ChangeFiuSts_CC_ACC_LIM_Compare_To_Constant ADAS_EnableManager_FiuManager_ChangeFiuSts_CC_ACC_LIM_Compare_To_Constant1 ADAS_EnableManager_FiuManager_ChangeFiuSts_CC_ACC_LIM_Compare_To_Constant13 ADAS_EnableManager_FiuManager_ChangeFiuSts_CC_ACC_LIM_Compare_To_Constant16 ADAS_EnableManager_FiuManager_ChangeFiuSts_CC_ACC_LIM_Compare_To_Constant17 ADAS_EnableManager_FiuManager_ChangeFiuSts_CC_ACC_LIM_Compare_To_Constant18 ADAS_EnableManager_FiuManager_ChangeFiuSts_CC_ACC_LIM_Compare_To_Constant2 /end SUB_GROUP
/end GROUP
/begin GROUP ADAS_EnableManager_FiuManager_ChangeFiuSts_CC_ACC_LIM_Compare_To_Constant "ADAS/EnableManager/FiuManager/ChangeFiuSts/CC+ACC+LIM/Compare
To Constant" /begin REF_MEASUREMENT rtDW_ADAS.GTAccAvail /end REF_MEASUREMENT /end GROUP
/begin GROUP ADAS_EnableManager_FiuManager_ChangeFiuSts_CC_ACC_LIM_Compare_To_Constant1 "ADAS/EnableManager/FiuManager/ChangeFiuSts/CC+ACC+LIM/Compare
To Constant1" /begin REF_MEASUREMENT rtDW_ADAS.GTLimAvail /end REF_MEASUREMENT /end GROUP
/begin GROUP ADAS_EnableManager_FiuManager_ChangeFiuSts_CC_ACC_LIM_Compare_To_Constant2 "ADAS/EnableManager/FiuManager/ChangeFiuSts/CC+ACC+LIM/Compare
To Constant2" /begin REF_MEASUREMENT rtDW_ADAS.GTCcAvail /end REF_MEASUREMENT /end GROUP
/begin GROUP ADAS_EnableManager_FiuManager_ChangeFiuSts_DOW "ADAS/EnableManager/FiuManager/ChangeFiuSts/DOW" /begin REF_MEASUREMENT rtDW_ADAS.GTDataTypeConversion_a /end REF_MEASUREMENT /end GROUP
/begin GROUP ADAS_EnableManager_FiuManager_ChangeFiuSts_FCW_AEB "ADAS/EnableManager/FiuManager/ChangeFiuSts/FCW+AEB"
 /begin REF_MEASUREMENT rtDW_ADAS.GTDataTypeConversion3_g rtDW_ADAS.GTDataTypeConversion_c /end REF_MEASUREMENT
/end GROUP
/begin GROUP ADAS_EnableManager_FiuManager_ChangeFiuSts_LCC___ALCC "ADAS/EnableManager/FiuManager/ChangeFiuSts/LCC + ALCC"
 /begin SUB_GROUP ADAS_EnableManager_FiuManager_ChangeFiuSts_LCC___ALCC_Compare_To_Constant1 /end SUB_GROUP
 /begin REF_MEASUREMENT rtDW_ADAS.GTDataTypeConversion3 rtDW_ADAS.GTDataTypeConversion4_i /end REF_MEASUREMENT
/end GROUP
/begin GROUP ADAS_EnableManager_FiuManager_ChangeFiuSts_LCC___ALCC_Compare_To_Constant1 "ADAS/EnableManager/FiuManager/ChangeFiuSts/LCC + ALCC/Compare
To Constant1" /begin REF_MEASUREMENT rtDW_ADAS.GTLccAvail /end REF_MEASUREMENT /end GROUP
/begin GROUP ADAS_EnableManager_FiuManager_ChangeFiuSts_LDW___LDP "ADAS/EnableManager/FiuManager/ChangeFiuSts/LDW + LDP"
 /begin SUB_GROUP ADAS_EnableManager_FiuManager_ChangeFiuSts_LDW___LDP_Compare_To_Constant1 /end SUB_GROUP
 /begin REF_MEASUREMENT rtDW_ADAS.GTDataTypeConversion3_p rtDW_ADAS.GTDataTypeConversion4_m /end REF_MEASUREMENT
/end GROUP
/begin GROUP ADAS_EnableManager_FiuManager_ChangeFiuSts_LDW___LDP_Compare_To_Constant1 "ADAS/EnableManager/FiuManager/ChangeFiuSts/LDW + LDP/Compare
To Constant1" /begin REF_MEASUREMENT rtDW_ADAS.GTLdwAvail /end REF_MEASUREMENT /end GROUP
/begin GROUP ADAS_EnableManager_FiuManager_ChangeFiuSts_LKA "ADAS/EnableManager/FiuManager/ChangeFiuSts/LKA"
 /begin SUB_GROUP ADAS_EnableManager_FiuManager_ChangeFiuSts_LKA_Compare_To_Constant1 ADAS_EnableManager_FiuManager_ChangeFiuSts_LKA_Compare_To_Constant2 /end SUB_GROUP
 /begin REF_MEASUREMENT rtDW_ADAS.GTDataTypeConversion4 /end REF_MEASUREMENT
/end GROUP
/begin GROUP ADAS_EnableManager_FiuManager_ChangeFiuSts_LKA_Compare_To_Constant2 "ADAS/EnableManager/FiuManager/ChangeFiuSts/LKA/Compare
To Constant2" /begin REF_MEASUREMENT rtDW_ADAS.GTLkaAvail /end REF_MEASUREMENT /end GROUP
/begin GROUP ADAS_EnableManager_FiuManager_ChangeFiuSts_RDC_RTSA "ADAS/EnableManager/FiuManager/ChangeFiuSts/RDC+RTSA"
 /begin REF_MEASUREMENT rtDW_ADAS.GTDataTypeConversion1 rtDW_ADAS.GTDataTypeConversion_d1 /end REF_MEASUREMENT
/end GROUP
/begin GROUP ADAS_EnableManager_FiuManager_ChangeFiuSts_REC "ADAS/EnableManager/FiuManager/ChangeFiuSts/REC" /begin REF_MEASUREMENT rtDW_ADAS.GTDataTypeConversion_o /end REF_MEASUREMENT /end GROUP
/begin GROUP ADAS_EnableManager_FiuManager_ChangeFiuSts_TSR "ADAS/EnableManager/FiuManager/ChangeFiuSts/TSR" /begin REF_MEASUREMENT rtDW_ADAS.GTDataTypeConversion_i /end REF_MEASUREMENT /end GROUP
/begin GROUP ADAS_ErrorManager "ADAS/ErrorManager"
 /begin SUB_GROUP ADAS_ErrorManager_DtcReqManager ADAS_ErrorManager_FuncError ADAS_ErrorManager_InputMonitor ADAS_ErrorManager_NotifError /end SUB_GROUP
/end GROUP
/begin GROUP ADAS_ErrorManager_DtcReqManager "ADAS/ErrorManager/DtcReqManager"
 /begin SUB_GROUP ADAS_ErrorManager_DtcReqManager_Perception_control ADAS_ErrorManager_DtcReqManager_Sticky_buttons_control_11_09_23 /end SUB_GROUP
/end GROUP
/begin GROUP ADAS_ErrorManager_DtcReqManager_Perception_control "ADAS/ErrorManager/DtcReqManager/Perception control"
 /begin SUB_GROUP ADAS_ErrorManager_DtcReqManager_Perception_control_Com ADAS_ErrorManager_DtcReqManager_Perception_control_Com1 ADAS_ErrorManager_DtcReqManager_Perception_control_Compare_To_Constant ADAS_ErrorManager_DtcReqManager_Perception_control_Compare_To_Constant1 ADAS_ErrorManager_DtcReqManager_Perception_control_Discrete_Derivative ADAS_ErrorManager_DtcReqManager_Perception_control_Transfer_Fcn_First_Order /end SUB_GROUP
 /begin REF_MEASUREMENT rtConstB_ADAS.GTCompare_i rtDW_ADAS.GTDelay_DSTATE_c rtDW_ADAS.GTcount rtDW_ADAS.GTis_active_c44_ADAS rtDW_ADAS.GTis_c44_ADAS rtDW_ADAS.GTtemporalCounter_i1_k1 /end REF_MEASUREMENT
/end GROUP
/begin GROUP ADAS_ErrorManager_DtcReqManager_Perception_control_Com1 "ADAS/ErrorManager/DtcReqManager/Perception control/Com1" /begin REF_MEASUREMENT rtConstB_ADAS.GTCompare_i /end REF_MEASUREMENT /end GROUP
/begin GROUP ADAS_ErrorManager_DtcReqManager_Perception_control_Discrete_Derivative "ADAS/ErrorManager/DtcReqManager/Perception control/Discrete Derivative" /begin REF_MEASUREMENT rtDW_ADAS.GTUD_DSTATE_fs /end REF_MEASUREMENT /end GROUP
/begin GROUP ADAS_ErrorManager_DtcReqManager_Perception_control_Transfer_Fcn_First_Order "ADAS/ErrorManager/DtcReqManager/Perception control/Transfer Fcn
First Order" /begin REF_MEASUREMENT rtDW_ADAS.GTUD_DSTATE_m /end REF_MEASUREMENT /end GROUP
/begin GROUP ADAS_ErrorManager_DtcReqManager_Sticky_buttons_control_11_09_23 "ADAS/ErrorManager/DtcReqManager/Sticky buttons control
11_09_23"
 /begin REF_MEASUREMENT rtDW_ADAS.GTB_ON rtDW_ADAS.GTBtSpdDec rtDW_ADAS.GTBtSpdInc rtDW_ADAS.GTLccBt rtDW_ADAS.GTLdwBt rtDW_ADAS.GTOut /end REF_MEASUREMENT
/end GROUP
/begin GROUP ADAS_ErrorManager_FuncError "ADAS/ErrorManager/FuncError" /begin SUB_GROUP ADAS_ErrorManager_FuncError_CC_ACC_LIM /end SUB_GROUP
 /begin REF_MEASUREMENT rtDW_ADAS.GTAebErReq rtDW_ADAS.GTFcwErReq rtDW_ADAS.GTSetAebSts rtDW_ADAS.GTSetFcwSts /end REF_MEASUREMENT
/end GROUP
/begin GROUP ADAS_ErrorManager_FuncError_CC_ACC_LIM "ADAS/ErrorManager/FuncError/CC+ACC+LIM"
 /begin REF_MEASUREMENT rtDW_ADAS.GTAccErReq rtDW_ADAS.GTCCErReq rtDW_ADAS.GTLimErReq /end REF_MEASUREMENT
/end GROUP
/begin GROUP ADAS_ErrorManager_InputMonitor "ADAS/ErrorManager/InputMonitor"
 /begin SUB_GROUP ADAS_ErrorManager_InputMonitor_BLS_Control ADAS_ErrorManager_InputMonitor_Speed_stability_control ADAS_ErrorManager_InputMonitor_Subsystem3 /end SUB_GROUP
/end GROUP
/begin GROUP ADAS_ErrorManager_InputMonitor_BLS_Control "ADAS/ErrorManager/InputMonitor/BLS_Control"
 /begin REF_MEASUREMENT rtDW_ADAS.GTCcActSts rtDW_ADAS.GTCddStandstillSt rtDW_ADAS.GTGearPosSt rtDW_ADAS.GTOut__h rtDW_ADAS.GTOut__o rtDW_ADAS.GTP_memory rtDW_ADAS.GTParkBrakeSt rtDW_ADAS.GTis_Monitor_ON_MAIN rtDW_ADAS.GTis_active_c80_ADAS rtDW_ADAS.GTis_active_c84_ADAS rtDW_ADAS.GTis_c80_ADAS rtDW_ADAS.GTis_c84_ADAS rtDW_ADAS.GTratAccPed rtDW_ADAS.GTtemporalCounter_i1_jn rtDW_ADAS.GTtemporalCounter_i1_ka rtDW_ADAS.GTtemporalCounter_i2_h5 /end REF_MEASUREMENT
/end GROUP
/begin GROUP ADAS_ErrorManager_InputMonitor_Speed_stability_control "ADAS/ErrorManager/InputMonitor/Speed stability control" /begin REF_MEASUREMENT rtDW_ADAS.GTFail_b /end REF_MEASUREMENT /end GROUP
/begin GROUP ADAS_ErrorManager_InputMonitor_Subsystem3 "ADAS/ErrorManager/InputMonitor/Subsystem3"
 /begin REF_MEASUREMENT rtDW_ADAS.GTOut__l rtDW_ADAS.GTis_active_c105_ADAS rtDW_ADAS.GTis_c105_ADAS rtDW_ADAS.GTtemporalCounter_i1_no /end REF_MEASUREMENT
/end GROUP
/begin GROUP ADAS_ErrorManager_NotifError "ADAS/ErrorManager/NotifError"
 /begin REF_MEASUREMENT rtDW_ADAS.GTAebErReq rtDW_ADAS.GTAlccErReq rtDW_ADAS.GTAslaErReq rtDW_ADAS.GTDowErReq rtDW_ADAS.GTFcwErReq rtDW_ADAS.GTLccAvail rtDW_ADAS.GTLccErReq rtDW_ADAS.GTLdpErReq rtDW_ADAS.GTLdwAvail rtDW_ADAS.GTLdwErReq rtDW_ADAS.GTLkaAvail rtDW_ADAS.GTLkaErReq rtDW_ADAS.GTRctcErReq rtDW_ADAS.GTRdaErReq rtDW_ADAS.GTSetAebSts rtDW_ADAS.GTSetAlccSts rtDW_ADAS.GTSetAslaSts rtDW_ADAS.GTSetDowSts rtDW_ADAS.GTSetFcwSts rtDW_ADAS.GTSetLccSts rtDW_ADAS.GTSetLdpSts rtDW_ADAS.GTSetLdwSts rtDW_ADAS.GTSetLkaSts rtDW_ADAS.GTSetRctcSts rtDW_ADAS.GTSetRdaSts rtDW_ADAS.GTSetTsrSts rtDW_ADAS.GTTsrErReq /end REF_MEASUREMENT
/end GROUP
/begin GROUP ADAS_FuncLevel "ADAS/FuncLevel"
 /begin SUB_GROUP ADAS_FuncLevel_ASLA ADAS_FuncLevel_CC_ACC_LIM ADAS_FuncLevel_DOW ADAS_FuncLevel_FCW_AEB ADAS_FuncLevel_LCC_ALCC ADAS_FuncLevel_LDW_LDP ADAS_FuncLevel_LKA ADAS_FuncLevel_MLIA ADAS_FuncLevel_NV ADAS_FuncLevel_RCW ADAS_FuncLevel_RDA_RCTC ADAS_FuncLevel_REC ADAS_FuncLevel_Subsystem ADAS_FuncLevel_TSR ADAS_FuncLevel_VIS /end SUB_GROUP
/end GROUP
/begin GROUP ADAS_FuncLevel_ASLA "ADAS/FuncLevel/ASLA" /begin SUB_GROUP ADAS_FuncLevel_ASLA_ASLA_Logic_21_02_2023 /end SUB_GROUP /end GROUP
/begin GROUP ADAS_FuncLevel_ASLA_ASLA_Logic_21_02_2023 "ADAS/FuncLevel/ASLA/ASLA Logic
21_02_2023" /begin SUB_GROUP ADAS_FuncLevel_ASLA_ASLA_Logic_21_02_2023_Subsystem3 /end SUB_GROUP
 /begin REF_MEASUREMENT rtDW_ADAS.GTDelay1_DSTATE_j rtDW_ADAS.GTFlag rtDW_ADAS.GTReqToCc rtDW_ADAS.GTV_mem rtDW_ADAS.GTV_newSpeed rtDW_ADAS.GTis_Cancel_sign rtDW_ADAS.GTis_OnMode rtDW_ADAS.GTis_active_c347_ADAS rtDW_ADAS.GTis_c347_ADAS rtDW_ADAS.GTis_new_signUp_Request rtDW_ADAS.GTtemporalCounter_i1_br rtDW_ADAS.GTtemporalCounter_i2_n /end REF_MEASUREMENT
/end GROUP
/begin GROUP ADAS_FuncLevel_ASLA_ASLA_Logic_21_02_2023_Subsystem3 "ADAS/FuncLevel/ASLA/ASLA Logic
21_02_2023/Subsystem3" /begin REF_MEASUREMENT rtDW_ADAS.GTDelay1_DSTATE_f /end REF_MEASUREMENT /end GROUP
/begin GROUP ADAS_FuncLevel_CC_ACC_LIM "ADAS/FuncLevel/CC_ACC_LIM"
 /begin SUB_GROUP ADAS_FuncLevel_CC_ACC_LIM_Deceleration_solver_28_05_2025 ADAS_FuncLevel_CC_ACC_LIM_Logic_28_05_2025 /end SUB_GROUP
 /begin REF_MEASUREMENT rtDW_ADAS.GTErr_Speed_IC rtDW_ADAS.GTSport_On /end REF_MEASUREMENT
/end GROUP
/begin GROUP ADAS_FuncLevel_CC_ACC_LIM_Deceleration_solver_28_05_2025 "ADAS/FuncLevel/CC_ACC_LIM/Deceleration_solver
28_05_2025"
 /begin SUB_GROUP ADAS_FuncLevel_CC_ACC_LIM_Deceleration_solver_28_05_2025_BLA_REQ_Algorithm ADAS_FuncLevel_CC_ACC_LIM_Deceleration_solver_28_05_2025_Calculating_data_of_the_leader ADAS_FuncLevel_CC_ACC_LIM_Deceleration_solver_28_05_2025_Calculation_of_warning_collision ADAS_FuncLevel_CC_ACC_LIM_Deceleration_solver_28_05_2025_Compare_To_Constant ADAS_FuncLevel_CC_ACC_LIM_Deceleration_solver_28_05_2025_Compare_To_Constant1 ADAS_FuncLevel_CC_ACC_LIM_Deceleration_solver_28_05_2025_Compare_To_Constant2 ADAS_FuncLevel_CC_ACC_LIM_Deceleration_solver_28_05_2025_Compare_To_Constant3 ADAS_FuncLevel_CC_ACC_LIM_Deceleration_solver_28_05_2025_Conversion_to_speed ADAS_FuncLevel_CC_ACC_LIM_Deceleration_solver_28_05_2025_Handler_of_PercData_20_03_25 ADAS_FuncLevel_CC_ACC_LIM_Deceleration_solver_28_05_2025_ID_change_correction_module ADAS_FuncLevel_CC_ACC_LIM_Deceleration_solver_28_05_2025_Setting_the_distance_04_04_23 ADAS_FuncLevel_CC_ACC_LIM_Deceleration_solver_28_05_2025_Solver_22_05_25 ADAS_FuncLevel_CC_ACC_LIM_Deceleration_solver_28_05_2025_Subsystem ADAS_FuncLevel_CC_ACC_LIM_Deceleration_solver_28_05_2025_Subsystem1 ADAS_FuncLevel_CC_ACC_LIM_Deceleration_solver_28_05_2025_Subsystem2 ADAS_FuncLevel_CC_ACC_LIM_Deceleration_solver_28_05_2025_Subsystem3 ADAS_FuncLevel_CC_ACC_LIM_Deceleration_solver_28_05_2025_Subsystem4 ADAS_FuncLevel_CC_ACC_LIM_Deceleration_solver_28_05_2025_VLC_Hill_req /end SUB_GROUP
 /begin REF_MEASUREMENT rtDW_ADAS.GTAccPlaussibCount rtDW_ADAS.GTAccel_lead rtDW_ADAS.GTActivSts rtDW_ADAS.GTBlsActive rtDW_ADAS.GTBtSpdDec rtDW_ADAS.GTBtSpdInc rtDW_ADAS.GTCDA_ReleaseReq rtDW_ADAS.GTCDA_StandReq rtDW_ADAS.GTCDA_Stand_Flag rtDW_ADAS.GTCDDReq rtDW_ADAS.GTCddStandstillSt rtDW_ADAS.GTDataT rtDW_ADAS.GTDataTypeConversion2 rtDW_ADAS.GTDelay_DSTATE_l rtDW_ADAS.GTDrive_off_VLC rtDW_ADAS.GTFail rtDW_ADAS.GTGain rtDW_ADAS.GTGain2 rtDW_ADAS.GTGain4_m rtDW_ADAS.GTGearPosSt rtDW_ADAS.GTMMot_Inc rtDW_ADAS.GTMotReq rtDW_ADAS.GTOver_fl rtDW_ADAS.GTParkBrakeSt rtDW_ADAS.GTPrevY_o rtDW_ADAS.GTSport_On rtDW_ADAS.GTSt_Req_VLC rtDW_ADAS.GTStand_mode rtDW_ADAS.GTState_delay rtDW_ADAS.GTSwitch3 rtDW_ADAS.GTSwitch3_m rtDW_ADAS.GTSwitch5 rtDW_ADAS.GTSwitch7 rtDW_ADAS.GTVLC_req_accel_ms rtDW_ADAS.GTV_set rtDW_ADAS.GTcode_h rtDW_ADAS.GTis_ACC_WORK_STATE rtDW_ADAS.GTis_Fast_mode rtDW_ADAS.GTis_Release_mode rtDW_ADAS.GTis_Ride_mode rtDW_ADAS.GTis_Slow_mode1 rtDW_ADAS.GTis_Stand_mode rtDW_ADAS.GTis_active_c68_ADAS rtDW_ADAS.GTis_active_c70_ADAS rtDW_ADAS.GTis_active_c71_ADAS rtDW_ADAS.GTis_active_c72_ADAS rtDW_ADAS.GTis_active_c77_ADAS rtDW_ADAS.GTis_c68_ADAS rtDW_ADAS.GTis_c70_ADAS rtDW_ADAS.GTis_c71_ADAS rtDW_ADAS.GTis_c72_ADAS rtDW_ADAS.GTis_c77_ADAS rtDW_ADAS.GTratAccPed rtDW_ADAS.GTtemporalCounter_i1_aj rtDW_ADAS.GTtemporalCounter_i1_fa rtDW_ADAS.GTtemporalCounter_i1_jc /end REF_MEASUREMENT
/end GROUP
/begin GROUP ADAS_FuncLevel_CC_ACC_LIM_Deceleration_solver_28_05_2025_BLA_REQ_Algorithm "ADAS/FuncLevel/CC_ACC_LIM/Deceleration_solver
28_05_2025/BLA_REQ_Algorithm"
 /begin REF_MEASUREMENT rtDW_ADAS.GTACC_BLA rtDW_ADAS.GTCDDReq rtDW_ADAS.GTSwitch5 rtDW_ADAS.GTSwitch7 rtDW_ADAS.GTis_active_c67_ADAS rtDW_ADAS.GTis_c67_ADAS /end REF_MEASUREMENT
/end GROUP
/begin GROUP ADAS_FuncLevel_CC_ACC_LIM_Deceleration_solver_28_05_2025_Calculating_data_of_the_leader "ADAS/FuncLevel/CC_ACC_LIM/Deceleration_solver
28_05_2025/Calculating data of the leader"
 /begin SUB_GROUP ADAS_FuncLevel_CC_ACC_LIM_Deceleration_solver_28_05_2025_Calculating_data_of_the_leader_Compare_To_Constant ADAS_FuncLevel_CC_ACC_LIM_Deceleration_solver_28_05_2025_Calculating_data_of_the_leader_Compare_To_Constant1 ADAS_FuncLevel_CC_ACC_LIM_Deceleration_solver_28_05_2025_Calculating_data_of_the_leader_Compare_To_Constant2 ADAS_FuncLevel_CC_ACC_LIM_Deceleration_solver_28_05_2025_Calculating_data_of_the_leader_Compare_To_Constant4 ADAS_FuncLevel_CC_ACC_LIM_Deceleration_solver_28_05_2025_Calculating_data_of_the_leader_Transfer_Fcn_First_Order1 /end SUB_GROUP
 /begin REF_MEASUREMENT rtDW_ADAS.GTDelay1_DSTATE_c rtDW_ADAS.GTDelay2_DSTATE_d3 rtDW_ADAS.GTDelay3_DSTATE_b rtDW_ADAS.GTDelay4_DSTATE_o rtDW_ADAS.GTDelay5_DSTATE_g rtDW_ADAS.GTDelay_DSTATE_j rtDW_ADAS.GTGain3 rtDW_ADAS.GTPrevY_fk rtDW_ADAS.GTPrevY_fu rtDW_ADAS.GTSwitch3_m /end REF_MEASUREMENT
/end GROUP
/begin GROUP ADAS_FuncLevel_CC_ACC_LIM_Deceleration_solver_28_05_2025_Calculating_data_of_the_leader_Transfer_Fcn_First_Order1 "ADAS/FuncLevel/CC_ACC_LIM/Deceleration_solver
28_05_2025/Calculating data of the leader/Transfer Fcn
First Order1" /begin REF_MEASUREMENT rtDW_ADAS.GTUD_DSTATE_lk /end REF_MEASUREMENT /end GROUP
/begin GROUP ADAS_FuncLevel_CC_ACC_LIM_Deceleration_solver_28_05_2025_Calculation_of_warning_collision "ADAS/FuncLevel/CC_ACC_LIM/Deceleration_solver
28_05_2025/Calculation of warning collision"
 /begin SUB_GROUP ADAS_FuncLevel_CC_ACC_LIM_Deceleration_solver_28_05_2025_Calculation_of_warning_collision_Collision_analysis ADAS_FuncLevel_CC_ACC_LIM_Deceleration_solver_28_05_2025_Calculation_of_warning_collision_Compare_To_Constant ADAS_FuncLevel_CC_ACC_LIM_Deceleration_solver_28_05_2025_Calculation_of_warning_collision_Cotant /end SUB_GROUP
 /begin REF_MEASUREMENT rtDW_ADAS.GTBlsActive rtDW_ADAS.GTDrTake rtDW_ADAS.GTGearPosSt rtDW_ADAS.GTOut__h rtDW_ADAS.GTOut_m rtDW_ADAS.GTOutportBufferForWARNING rtDW_ADAS.GTParkBrakeSt rtDW_ADAS.GTState_delay rtDW_ADAS.GTis_active_c69_ADAS rtDW_ADAS.GTis_active_c85_ADAS rtDW_ADAS.GTis_c69_ADAS rtDW_ADAS.GTis_c85_ADAS rtDW_ADAS.GTratAccPed rtDW_ADAS.GTtemporalCounter_i1_d2 rtDW_ADAS.GTtemporalCounter_i1_l /end REF_MEASUREMENT
/end GROUP
/begin GROUP ADAS_FuncLevel_CC_ACC_LIM_Deceleration_solver_28_05_2025_Calculation_of_warning_collision_Collision_analysis "ADAS/FuncLevel/CC_ACC_LIM/Deceleration_solver
28_05_2025/Calculation of warning collision/Collision analysis"
 /begin SUB_GROUP ADAS_FuncLevel_CC_ACC_LIM_Deceleration_solver_28_05_2025_Calculation_of_warning_collision_Collision_analysis_Calculating_of_potential_collision /end SUB_GROUP
 /begin REF_MEASUREMENT rtDW_ADAS.GTActivSts rtDW_ADAS.GTTakeOver rtDW_ADAS.GTis_active_c13_ADAS rtDW_ADAS.GTis_c13_ADAS rtDW_ADAS.GTtemporalCounter_i1_ox /end REF_MEASUREMENT
/end GROUP
/begin GROUP ADAS_FuncLevel_CC_ACC_LIM_Deceleration_solver_28_05_2025_Calculation_of_warning_collision_Collision_analysis_Calculating_of_potential_collision "ADAS/FuncLevel/CC_ACC_LIM/Deceleration_solver
28_05_2025/Calculation of warning collision/Collision analysis/Calculating of potential collision" /begin REF_MEASUREMENT rtDW_ADAS.GTSwitch7 /end REF_MEASUREMENT /end GROUP
/begin GROUP ADAS_FuncLevel_CC_ACC_LIM_Deceleration_solver_28_05_2025_Calculation_of_warning_collision_Cotant "ADAS/FuncLevel/CC_ACC_LIM/Deceleration_solver
28_05_2025/Calculation of warning collision/Cotant" /begin REF_MEASUREMENT rtDW_ADAS.GTActivSts /end REF_MEASUREMENT /end GROUP
/begin GROUP ADAS_FuncLevel_CC_ACC_LIM_Deceleration_solver_28_05_2025_Compare_To_Constant1 "ADAS/FuncLevel/CC_ACC_LIM/Deceleration_solver
28_05_2025/Compare
To Constant1" /begin REF_MEASUREMENT rtDW_ADAS.GTActivSts /end REF_MEASUREMENT /end GROUP
/begin GROUP ADAS_FuncLevel_CC_ACC_LIM_Deceleration_solver_28_05_2025_Compare_To_Constant3 "ADAS/FuncLevel/CC_ACC_LIM/Deceleration_solver
28_05_2025/Compare
To Constant3" /begin REF_MEASUREMENT rtDW_ADAS.GTStand_mode /end REF_MEASUREMENT /end GROUP
/begin GROUP ADAS_FuncLevel_CC_ACC_LIM_Deceleration_solver_28_05_2025_Conversion_to_speed "ADAS/FuncLevel/CC_ACC_LIM/Deceleration_solver
28_05_2025/Conversion to speed" /begin REF_MEASUREMENT rtDW_ADAS.GTV_set /end REF_MEASUREMENT /end GROUP
/begin GROUP ADAS_FuncLevel_CC_ACC_LIM_Deceleration_solver_28_05_2025_Handler_of_PercData_20_03_25 "ADAS/FuncLevel/CC_ACC_LIM/Deceleration_solver
28_05_2025/Handler of PercData
20.03.25"
 /begin REF_MEASUREMENT rtDW_ADAS.GTDelay1_DSTATE rtDW_ADAS.GTDelay2_DSTATE rtDW_ADAS.GTDelay3_DSTATE rtDW_ADAS.GTDelay5_DSTATE_i rtDW_ADAS.GTDelay6_DSTATE rtDW_ADAS.GTDelay7_DSTATE_l rtDW_ADAS.GTDelay8_DSTATE rtDW_ADAS.GTDelay9_DSTATE rtDW_ADAS.GTDelay_DSTATE rtDW_ADAS.GTOVER rtDW_ADAS.GTis_Contr rtDW_ADAS.GTis_active_c1_ADAS rtDW_ADAS.GTis_c1_ADAS /end REF_MEASUREMENT
/end GROUP
/begin GROUP ADAS_FuncLevel_CC_ACC_LIM_Deceleration_solver_28_05_2025_ID_change_correction_module "ADAS/FuncLevel/CC_ACC_LIM/Deceleration_solver
28_05_2025/ID change correction module"
 /begin SUB_GROUP ADAS_FuncLevel_CC_ACC_LIM_Deceleration_solver_28_05_2025_ID_change_correction_module_1 ADAS_FuncLevel_CC_ACC_LIM_Deceleration_solver_28_05_2025_ID_change_correction_module_3456 ADAS_FuncLevel_CC_ACC_LIM_Deceleration_solver_28_05_2025_ID_change_correction_module_Compare_To_Constant ADAS_FuncLevel_CC_ACC_LIM_Deceleration_solver_28_05_2025_ID_change_correction_module_Compare_To_Constant1 ADAS_FuncLevel_CC_ACC_LIM_Deceleration_solver_28_05_2025_ID_change_correction_module_Compare_To_Constant2 ADAS_FuncLevel_CC_ACC_LIM_Deceleration_solver_28_05_2025_ID_change_correction_module_Compare_To_Zero ADAS_FuncLevel_CC_ACC_LIM_Deceleration_solver_28_05_2025_ID_change_correction_module_Sport ADAS_FuncLevel_CC_ACC_LIM_Deceleration_solver_28_05_2025_ID_change_correction_module_Sport1 /end SUB_GROUP
 /begin REF_MEASUREMENT rtDW_ADAS.GTDataTypeConversion2 rtDW_ADAS.GTDelay1_DSTATE_i rtDW_ADAS.GTDelay2_DSTATE_l rtDW_ADAS.GTDelay_DSTATE_b rtDW_ADAS.GTPrevY_a rtDW_ADAS.GTPrevY_i rtDW_ADAS.GTPrevY_m3 rtDW_ADAS.GTWarn rtDW_ADAS.GTis_active_c78_ADAS rtDW_ADAS.GTis_active_c87_ADAS rtDW_ADAS.GTis_c78_ADAS rtDW_ADAS.GTis_c87_ADAS rtDW_ADAS.GTtemporalCounter_i1_ev rtDW_ADAS.GTtemporalCounter_i1_o3 /end REF_MEASUREMENT
/end GROUP
/begin GROUP ADAS_FuncLevel_CC_ACC_LIM_Deceleration_solver_28_05_2025_ID_change_correction_module_Sport "ADAS/FuncLevel/CC_ACC_LIM/Deceleration_solver
28_05_2025/ID change correction module/Sport" /begin REF_MEASUREMENT rtDW_ADAS.GTSport_On /end REF_MEASUREMENT /end GROUP
/begin GROUP ADAS_FuncLevel_CC_ACC_LIM_Deceleration_solver_28_05_2025_ID_change_correction_module_Sport1 "ADAS/FuncLevel/CC_ACC_LIM/Deceleration_solver
28_05_2025/ID change correction module/Sport1" /begin REF_MEASUREMENT rtDW_ADAS.GTSport_On /end REF_MEASUREMENT /end GROUP
/begin GROUP ADAS_FuncLevel_CC_ACC_LIM_Deceleration_solver_28_05_2025_Setting_the_distance_04_04_23 "ADAS/FuncLevel/CC_ACC_LIM/Deceleration_solver
28_05_2025/Setting the distance
04_04_23"
 /begin SUB_GROUP ADAS_FuncLevel_CC_ACC_LIM_Deceleration_solver_28_05_2025_Setting_the_distance_04_04_23_Compare_To_Constant ADAS_FuncLevel_CC_ACC_LIM_Deceleration_solver_28_05_2025_Setting_the_distance_04_04_23_Sport_changed_ ADAS_FuncLevel_CC_ACC_LIM_Deceleration_solver_28_05_2025_Setting_the_distance_04_04_23_Transfer_Fcn_First_Order /end SUB_GROUP
 /begin REF_MEASUREMENT rtDW_ADAS.GTPrevY_b rtDW_ADAS.GTPrevY_l rtDW_ADAS.GTPrevY_m rtDW_ADAS.GTS_coef rtDW_ADAS.GTdist rtDW_ADAS.GTdist_stand rtDW_ADAS.GTis_active_c11_ADAS rtDW_ADAS.GTis_active_c12_ADAS rtDW_ADAS.GTis_c11_ADAS rtDW_ADAS.GTis_c12_ADAS rtDW_ADAS.GTout_add rtDW_ADAS.GTtemporalCounter_i1_dx /end REF_MEASUREMENT
/end GROUP
/begin GROUP ADAS_FuncLevel_CC_ACC_LIM_Deceleration_solver_28_05_2025_Setting_the_distance_04_04_23_Sport_changed_ "ADAS/FuncLevel/CC_ACC_LIM/Deceleration_solver
28_05_2025/Setting the distance
04_04_23/Sport_changed!" /begin REF_MEASUREMENT rtDW_ADAS.GTSport_On /end REF_MEASUREMENT /end GROUP
/begin GROUP ADAS_FuncLevel_CC_ACC_LIM_Deceleration_solver_28_05_2025_Setting_the_distance_04_04_23_Transfer_Fcn_First_Order "ADAS/FuncLevel/CC_ACC_LIM/Deceleration_solver
28_05_2025/Setting the distance
04_04_23/Transfer Fcn
First Order" /begin REF_MEASUREMENT rtDW_ADAS.GTUD_DSTATE_f /end REF_MEASUREMENT /end GROUP
/begin GROUP ADAS_FuncLevel_CC_ACC_LIM_Deceleration_solver_28_05_2025_Solver_22_05_25 "ADAS/FuncLevel/CC_ACC_LIM/Deceleration_solver
28_05_2025/Solver 22_05_25"
 /begin SUB_GROUP ADAS_FuncLevel_CC_ACC_LIM_Deceleration_solver_28_05_2025_Solver_22_05_25_Calculating_the_target_acceleration_for_ACC ADAS_FuncLevel_CC_ACC_LIM_Deceleration_solver_28_05_2025_Solver_22_05_25_Calculating_the_target_deceleration_to_hold_the_car ADAS_FuncLevel_CC_ACC_LIM_Deceleration_solver_28_05_2025_Solver_22_05_25_Calculation_of_the_speed_at_which_it_is_necessary_to_switch_to_stop_mode ADAS_FuncLevel_CC_ACC_LIM_Deceleration_solver_28_05_2025_Solver_22_05_25_Compare_To_Constant ADAS_FuncLevel_CC_ACC_LIM_Deceleration_solver_28_05_2025_Solver_22_05_25_Discretization ADAS_FuncLevel_CC_ACC_LIM_Deceleration_solver_28_05_2025_Solver_22_05_25_Limiting_of_request_of_speed ADAS_FuncLevel_CC_ACC_LIM_Deceleration_solver_28_05_2025_Solver_22_05_25_Rate_Limiter_Dynamic ADAS_FuncLevel_CC_ACC_LIM_Deceleration_solver_28_05_2025_Solver_22_05_25_Request_limit ADAS_FuncLevel_CC_ACC_LIM_Deceleration_solver_28_05_2025_Solver_22_05_25_Smooth_reset_when_shutting_down ADAS_FuncLevel_CC_ACC_LIM_Deceleration_solver_28_05_2025_Solver_22_05_25_Sport ADAS_FuncLevel_CC_ACC_LIM_Deceleration_solver_28_05_2025_Solver_22_05_25_Subsystem3 ADAS_FuncLevel_CC_ACC_LIM_Deceleration_solver_28_05_2025_Solver_22_05_25_Tr0_3 /end SUB_GROUP
 /begin REF_MEASUREMENT rtDW_ADAS.GTPrevY_cr rtDW_ADAS.GTPrevY_f rtDW_ADAS.GTPrevY_g3 rtDW_ADAS.GTPrevY_oz rtDW_ADAS.GTPrevY_pk rtDW_ADAS.GTPrevY_pz rtDW_ADAS.GTSwitch3 rtDW_ADAS.GTSwitch7 rtDW_ADAS.GTV_set /end REF_MEASUREMENT
/end GROUP
/begin GROUP ADAS_FuncLevel_CC_ACC_LIM_Deceleration_solver_28_05_2025_Solver_22_05_25_Calculating_the_target_acceleration_for_ACC "ADAS/FuncLevel/CC_ACC_LIM/Deceleration_solver
28_05_2025/Solver 22_05_25/Calculating the target
acceleration for ACC"
 /begin SUB_GROUP ADAS_FuncLevel_CC_ACC_LIM_Deceleration_solver_28_05_2025_Solver_22_05_25_Calculating_the_target_acceleration_for_ACC_Die2 ADAS_FuncLevel_CC_ACC_LIM_Deceleration_solver_28_05_2025_Solver_22_05_25_Calculating_the_target_acceleration_for_ACC_Discrete_PID_Controller2 ADAS_FuncLevel_CC_ACC_LIM_Deceleration_solver_28_05_2025_Solver_22_05_25_Calculating_the_target_acceleration_for_ACC_EMP032021 ADAS_FuncLevel_CC_ACC_LIM_Deceleration_solver_28_05_2025_Solver_22_05_25_Calculating_the_target_acceleration_for_ACC_Kalman_Filter1 ADAS_FuncLevel_CC_ACC_LIM_Deceleration_solver_28_05_2025_Solver_22_05_25_Calculating_the_target_acceleration_for_ACC_Soft_for_target_acceleration_ /end SUB_GROUP
 /begin REF_MEASUREMENT rtDW_ADAS.GTGain3 rtDW_ADAS.GTPrevY_io /end REF_MEASUREMENT
/end GROUP
/begin GROUP ADAS_FuncLevel_CC_ACC_LIM_Deceleration_solver_28_05_2025_Solver_22_05_25_Calculating_the_target_acceleration_for_ACC_Die2 "ADAS/FuncLevel/CC_ACC_LIM/Deceleration_solver
28_05_2025/Solver 22_05_25/Calculating the target
acceleration for ACC/Die2" /begin REF_MEASUREMENT rtDW_ADAS.GTUD_DSTATE_pl /end REF_MEASUREMENT /end GROUP
/begin GROUP ADAS_FuncLevel_CC_ACC_LIM_Deceleration_solver_28_05_2025_Solver_22_05_25_Calculating_the_target_acceleration_for_ACC_Discrete_PID_Controller2 "ADAS/FuncLevel/CC_ACC_LIM/Deceleration_solver
28_05_2025/Solver 22_05_25/Calculating the target
acceleration for ACC/Discrete PID Controller2"
 /begin SUB_GROUP ADAS_FuncLevel_CC_ACC_LIM_Deceleration_solver_28_05_2025_Solver_22_05_25_Calculating_the_target_acceleration_for_ACC_Discrete_PID_Controller2_Anti_windup ADAS_FuncLevel_CC_ACC_LIM_Deceleration_solver_28_05_2025_Solver_22_05_25_Calculating_the_target_acceleration_for_ACC_Discrete_PID_Controller2_D_Gain ADAS_FuncLevel_CC_ACC_LIM_Deceleration_solver_28_05_2025_Solver_22_05_25_Calculating_the_target_acceleration_for_ACC_Discrete_PID_Controller2_Filter ADAS_FuncLevel_CC_ACC_LIM_Deceleration_solver_28_05_2025_Solver_22_05_25_Calculating_the_target_acceleration_for_ACC_Discrete_PID_Controller2_Filter_ICs ADAS_FuncLevel_CC_ACC_LIM_Deceleration_solver_28_05_2025_Solver_22_05_25_Calculating_the_target_acceleration_for_ACC_Discrete_PID_Controller2_I_Gain ADAS_FuncLevel_CC_ACC_LIM_Deceleration_solver_28_05_2025_Solver_22_05_25_Calculating_the_target_acceleration_for_ACC_Discrete_PID_Controller2_Ideal_P_Gain ADAS_FuncLevel_CC_ACC_LIM_Deceleration_solver_28_05_2025_Solver_22_05_25_Calculating_the_target_acceleration_for_ACC_Discrete_PID_Controller2_Ideal_P_Gain_Fdbk ADAS_FuncLevel_CC_ACC_LIM_Deceleration_solver_28_05_2025_Solver_22_05_25_Calculating_the_target_acceleration_for_ACC_Discrete_PID_Controller2_Integrator /end SUB_GROUP
/end GROUP
/begin GROUP ADAS_FuncLevel_CC_ACC_LIM_Deceleration_solver_28_05_2025_Solver_22_05_25_Calculating_the_target_acceleration_for_ACC_Discrete_PID_Controller2_Filter "ADAS/FuncLevel/CC_ACC_LIM/Deceleration_solver
28_05_2025/Solver 22_05_25/Calculating the target
acceleration for ACC/Discrete PID Controller2/Filter"
 /begin SUB_GROUP ADAS_FuncLevel_CC_ACC_LIM_Deceleration_solver_28_05_2025_Solver_22_05_25_Calculating_the_target_acceleration_for_ACC_Discrete_PID_Controller2_Filter_Differentiator /end SUB_GROUP
/end GROUP
/begin GROUP ADAS_FuncLevel_CC_ACC_LIM_Deceleration_solver_28_05_2025_Solver_22_05_25_Calculating_the_target_acceleration_for_ACC_Discrete_PID_Controller2_Filter_Differentiator "ADAS/FuncLevel/CC_ACC_LIM/Deceleration_solver
28_05_2025/Solver 22_05_25/Calculating the target
acceleration for ACC/Discrete PID Controller2/Filter/Differentiator" /begin REF_MEASUREMENT rtDW_ADAS.GTUD_DSTATE_e /end REF_MEASUREMENT /end GROUP
/begin GROUP ADAS_FuncLevel_CC_ACC_LIM_Deceleration_solver_28_05_2025_Solver_22_05_25_Calculating_the_target_acceleration_for_ACC_Discrete_PID_Controller2_Integrator "ADAS/FuncLevel/CC_ACC_LIM/Deceleration_solver
28_05_2025/Solver 22_05_25/Calculating the target
acceleration for ACC/Discrete PID Controller2/Integrator"
 /begin SUB_GROUP ADAS_FuncLevel_CC_ACC_LIM_Deceleration_solver_28_05_2025_Solver_22_05_25_Calculating_the_target_acceleration_for_ACC_Discrete_PID_Controller2_Integrator_Discrete /end SUB_GROUP
/end GROUP
/begin GROUP ADAS_FuncLevel_CC_ACC_LIM_Deceleration_solver_28_05_2025_Solver_22_05_25_Calculating_the_target_acceleration_for_ACC_Discrete_PID_Controller2_Integrator_Discrete "ADAS/FuncLevel/CC_ACC_LIM/Deceleration_solver
28_05_2025/Solver 22_05_25/Calculating the target
acceleration for ACC/Discrete PID Controller2/Integrator/Discrete" /begin REF_MEASUREMENT rtDW_ADAS.GTIntegrator_DSTATE_o /end REF_MEASUREMENT /end GROUP
/begin GROUP ADAS_FuncLevel_CC_ACC_LIM_Deceleration_solver_28_05_2025_Solver_22_05_25_Calculating_the_target_acceleration_for_ACC_EMP032021 "ADAS/FuncLevel/CC_ACC_LIM/Deceleration_solver
28_05_2025/Solver 22_05_25/Calculating the target
acceleration for ACC/EMP032021"
 /begin SUB_GROUP ADAS_FuncLevel_CC_ACC_LIM_Deceleration_solver_28_05_2025_Solver_22_05_25_Calculating_the_target_acceleration_for_ACC_EMP032021_121 ADAS_FuncLevel_CC_ACC_LIM_Deceleration_solver_28_05_2025_Solver_22_05_25_Calculating_the_target_acceleration_for_ACC_EMP032021_456_ ADAS_FuncLevel_CC_ACC_LIM_Deceleration_solver_28_05_2025_Solver_22_05_25_Calculating_the_target_acceleration_for_ACC_EMP032021_At_very_close_distance ADAS_FuncLevel_CC_ACC_LIM_Deceleration_solver_28_05_2025_Solver_22_05_25_Calculating_the_target_acceleration_for_ACC_EMP032021_Distance_adaptation ADAS_FuncLevel_CC_ACC_LIM_Deceleration_solver_28_05_2025_Solver_22_05_25_Calculating_the_target_acceleration_for_ACC_EMP032021_Distance_correction ADAS_FuncLevel_CC_ACC_LIM_Deceleration_solver_28_05_2025_Solver_22_05_25_Calculating_the_target_acceleration_for_ACC_EMP032021_Leader_deceleration_analysis ADAS_FuncLevel_CC_ACC_LIM_Deceleration_solver_28_05_2025_Solver_22_05_25_Calculating_the_target_acceleration_for_ACC_EMP032021_Speed_adaptation_ ADAS_FuncLevel_CC_ACC_LIM_Deceleration_solver_28_05_2025_Solver_22_05_25_Calculating_the_target_acceleration_for_ACC_EMP032021_Transfer_Fcn_First_Order1 ADAS_FuncLevel_CC_ACC_LIM_Deceleration_solver_28_05_2025_Solver_22_05_25_Calculating_the_target_acceleration_for_ACC_EMP032021_Transfer_Fcn_First_Order2 ADAS_FuncLevel_CC_ACC_LIM_Deceleration_solver_28_05_2025_Solver_22_05_25_Calculating_the_target_acceleration_for_ACC_EMP032021_Transfer_Fcn_First_Order3 ADAS_FuncLevel_CC_ACC_LIM_Deceleration_solver_28_05_2025_Solver_22_05_25_Calculating_the_target_acceleration_for_ACC_EMP032021_Transfer_Fcn_First_Order4 ADAS_FuncLevel_CC_ACC_LIM_Deceleration_solver_28_05_2025_Solver_22_05_25_Calculating_the_target_acceleration_for_ACC_EMP032021__23 ADAS_FuncLevel_CC_ACC_LIM_Deceleration_solver_28_05_2025_Solver_22_05_25_Calculating_the_target_acceleration_for_ACC_EMP032021_hfghfgh ADAS_FuncLevel_CC_ACC_LIM_Deceleration_solver_28_05_2025_Solver_22_05_25_Calculating_the_target_acceleration_for_ACC_EMP032021_sdsd /end SUB_GROUP
 /begin REF_MEASUREMENT rtDW_ADAS.GTSwitch7 rtDW_ADAS.GTgain_o rtDW_ADAS.GTis_active_c63_ADAS rtDW_ADAS.GTis_c63_ADAS /end REF_MEASUREMENT
/end GROUP
/begin GROUP ADAS_FuncLevel_CC_ACC_LIM_Deceleration_solver_28_05_2025_Solver_22_05_25_Calculating_the_target_acceleration_for_ACC_EMP032021_121 "ADAS/FuncLevel/CC_ACC_LIM/Deceleration_solver
28_05_2025/Solver 22_05_25/Calculating the target
acceleration for ACC/EMP032021/121"
 /begin SUB_GROUP ADAS_FuncLevel_CC_ACC_LIM_Deceleration_solver_28_05_2025_Solver_22_05_25_Calculating_the_target_acceleration_for_ACC_EMP032021_121_Transfer_Fcn_First_Order1 /end SUB_GROUP
/end GROUP
/begin GROUP ADAS_FuncLevel_CC_ACC_LIM_Deceleration_solver_28_05_2025_Solver_22_05_25_Calculating_the_target_acceleration_for_ACC_EMP032021_121_Transfer_Fcn_First_Order1 "ADAS/FuncLevel/CC_ACC_LIM/Deceleration_solver
28_05_2025/Solver 22_05_25/Calculating the target
acceleration for ACC/EMP032021/121/Transfer Fcn
First Order1" /begin REF_MEASUREMENT rtDW_ADAS.GTUD_DSTATE_ja /end REF_MEASUREMENT /end GROUP
/begin GROUP ADAS_FuncLevel_CC_ACC_LIM_Deceleration_solver_28_05_2025_Solver_22_05_25_Calculating_the_target_acceleration_for_ACC_EMP032021_At_very_close_distance "ADAS/FuncLevel/CC_ACC_LIM/Deceleration_solver
28_05_2025/Solver 22_05_25/Calculating the target
acceleration for ACC/EMP032021/At_very_close_distance"
 /begin SUB_GROUP ADAS_FuncLevel_CC_ACC_LIM_Deceleration_solver_28_05_2025_Solver_22_05_25_Calculating_the_target_acceleration_for_ACC_EMP032021_At_very_close_distance_Transfer_Fcn_First_Order /end SUB_GROUP
 /begin REF_MEASUREMENT rtDW_ADAS.GTGain3 /end REF_MEASUREMENT
/end GROUP
/begin GROUP ADAS_FuncLevel_CC_ACC_LIM_Deceleration_solver_28_05_2025_Solver_22_05_25_Calculating_the_target_acceleration_for_ACC_EMP032021_At_very_close_distance_Transfer_Fcn_First_Order "ADAS/FuncLevel/CC_ACC_LIM/Deceleration_solver
28_05_2025/Solver 22_05_25/Calculating the target
acceleration for ACC/EMP032021/At_very_close_distance/Transfer Fcn
First Order" /begin REF_MEASUREMENT rtDW_ADAS.GTUD_DSTATE_d /end REF_MEASUREMENT /end GROUP
/begin GROUP ADAS_FuncLevel_CC_ACC_LIM_Deceleration_solver_28_05_2025_Solver_22_05_25_Calculating_the_target_acceleration_for_ACC_EMP032021_Distance_adaptation "ADAS/FuncLevel/CC_ACC_LIM/Deceleration_solver
28_05_2025/Solver 22_05_25/Calculating the target
acceleration for ACC/EMP032021/Distance_adaptation" /begin REF_MEASUREMENT rtDW_ADAS.GTGain3 /end REF_MEASUREMENT /end GROUP
/begin GROUP ADAS_FuncLevel_CC_ACC_LIM_Deceleration_solver_28_05_2025_Solver_22_05_25_Calculating_the_target_acceleration_for_ACC_EMP032021_Distance_correction "ADAS/FuncLevel/CC_ACC_LIM/Deceleration_solver
28_05_2025/Solver 22_05_25/Calculating the target
acceleration for ACC/EMP032021/Distance_correction"
 /begin SUB_GROUP ADAS_FuncLevel_CC_ACC_LIM_Deceleration_solver_28_05_2025_Solver_22_05_25_Calculating_the_target_acceleration_for_ACC_EMP032021_Distance_correction_Transfer_Fcn_First_Order6 /end SUB_GROUP
/end GROUP
/begin GROUP ADAS_FuncLevel_CC_ACC_LIM_Deceleration_solver_28_05_2025_Solver_22_05_25_Calculating_the_target_acceleration_for_ACC_EMP032021_Distance_correction_Transfer_Fcn_First_Order6 "ADAS/FuncLevel/CC_ACC_LIM/Deceleration_solver
28_05_2025/Solver 22_05_25/Calculating the target
acceleration for ACC/EMP032021/Distance_correction/Transfer Fcn
First Order6" /begin REF_MEASUREMENT rtDW_ADAS.GTUD_DSTATE_kg /end REF_MEASUREMENT /end GROUP
/begin GROUP ADAS_FuncLevel_CC_ACC_LIM_Deceleration_solver_28_05_2025_Solver_22_05_25_Calculating_the_target_acceleration_for_ACC_EMP032021_Transfer_Fcn_First_Order1 "ADAS/FuncLevel/CC_ACC_LIM/Deceleration_solver
28_05_2025/Solver 22_05_25/Calculating the target
acceleration for ACC/EMP032021/Transfer Fcn
First Order1" /begin REF_MEASUREMENT rtDW_ADAS.GTUD_DSTATE_es /end REF_MEASUREMENT /end GROUP
/begin GROUP ADAS_FuncLevel_CC_ACC_LIM_Deceleration_solver_28_05_2025_Solver_22_05_25_Calculating_the_target_acceleration_for_ACC_EMP032021_Transfer_Fcn_First_Order2 "ADAS/FuncLevel/CC_ACC_LIM/Deceleration_solver
28_05_2025/Solver 22_05_25/Calculating the target
acceleration for ACC/EMP032021/Transfer Fcn
First Order2" /begin REF_MEASUREMENT rtDW_ADAS.GTGain3 rtDW_ADAS.GTUD_DSTATE_o /end REF_MEASUREMENT /end GROUP
/begin GROUP ADAS_FuncLevel_CC_ACC_LIM_Deceleration_solver_28_05_2025_Solver_22_05_25_Calculating_the_target_acceleration_for_ACC_EMP032021_Transfer_Fcn_First_Order3 "ADAS/FuncLevel/CC_ACC_LIM/Deceleration_solver
28_05_2025/Solver 22_05_25/Calculating the target
acceleration for ACC/EMP032021/Transfer Fcn
First Order3" /begin REF_MEASUREMENT rtDW_ADAS.GTUD_DSTATE_kw /end REF_MEASUREMENT /end GROUP
/begin GROUP ADAS_FuncLevel_CC_ACC_LIM_Deceleration_solver_28_05_2025_Solver_22_05_25_Calculating_the_target_acceleration_for_ACC_EMP032021_Transfer_Fcn_First_Order4 "ADAS/FuncLevel/CC_ACC_LIM/Deceleration_solver
28_05_2025/Solver 22_05_25/Calculating the target
acceleration for ACC/EMP032021/Transfer Fcn
First Order4" /begin REF_MEASUREMENT rtDW_ADAS.GTUD_DSTATE_lg /end REF_MEASUREMENT /end GROUP
/begin GROUP ADAS_FuncLevel_CC_ACC_LIM_Deceleration_solver_28_05_2025_Solver_22_05_25_Calculating_the_target_acceleration_for_ACC_EMP032021__23 "ADAS/FuncLevel/CC_ACC_LIM/Deceleration_solver
28_05_2025/Solver 22_05_25/Calculating the target
acceleration for ACC/EMP032021/К23"
 /begin SUB_GROUP ADAS_FuncLevel_CC_ACC_LIM_Deceleration_solver_28_05_2025_Solver_22_05_25_Calculating_the_target_acceleration_for_ACC_EMP032021__23_Transfer_Fcn_First_Order /end SUB_GROUP
 /begin REF_MEASUREMENT rtDW_ADAS.GTGain3 /end REF_MEASUREMENT
/end GROUP
/begin GROUP ADAS_FuncLevel_CC_ACC_LIM_Deceleration_solver_28_05_2025_Solver_22_05_25_Calculating_the_target_acceleration_for_ACC_EMP032021__23_Transfer_Fcn_First_Order "ADAS/FuncLevel/CC_ACC_LIM/Deceleration_solver
28_05_2025/Solver 22_05_25/Calculating the target
acceleration for ACC/EMP032021/К23/Transfer Fcn
First Order" /begin REF_MEASUREMENT rtDW_ADAS.GTUD_DSTATE_kd /end REF_MEASUREMENT /end GROUP
/begin GROUP ADAS_FuncLevel_CC_ACC_LIM_Deceleration_solver_28_05_2025_Solver_22_05_25_Calculating_the_target_acceleration_for_ACC_EMP032021_hfghfgh "ADAS/FuncLevel/CC_ACC_LIM/Deceleration_solver
28_05_2025/Solver 22_05_25/Calculating the target
acceleration for ACC/EMP032021/hfghfgh"
 /begin SUB_GROUP ADAS_FuncLevel_CC_ACC_LIM_Deceleration_solver_28_05_2025_Solver_22_05_25_Calculating_the_target_acceleration_for_ACC_EMP032021_hfghfgh_Transfer_Fcn_First_Order /end SUB_GROUP
 /begin REF_MEASUREMENT rtDW_ADAS.GTGain3 /end REF_MEASUREMENT
/end GROUP
/begin GROUP ADAS_FuncLevel_CC_ACC_LIM_Deceleration_solver_28_05_2025_Solver_22_05_25_Calculating_the_target_acceleration_for_ACC_EMP032021_hfghfgh_Transfer_Fcn_First_Order "ADAS/FuncLevel/CC_ACC_LIM/Deceleration_solver
28_05_2025/Solver 22_05_25/Calculating the target
acceleration for ACC/EMP032021/hfghfgh/Transfer Fcn
First Order" /begin REF_MEASUREMENT rtDW_ADAS.GTUD_DSTATE_g /end REF_MEASUREMENT /end GROUP
/begin GROUP ADAS_FuncLevel_CC_ACC_LIM_Deceleration_solver_28_05_2025_Solver_22_05_25_Calculating_the_target_acceleration_for_ACC_EMP032021_sdsd "ADAS/FuncLevel/CC_ACC_LIM/Deceleration_solver
28_05_2025/Solver 22_05_25/Calculating the target
acceleration for ACC/EMP032021/sdsd"
 /begin SUB_GROUP ADAS_FuncLevel_CC_ACC_LIM_Deceleration_solver_28_05_2025_Solver_22_05_25_Calculating_the_target_acceleration_for_ACC_EMP032021_sdsd_Transfer_Fcn_First_Order ADAS_FuncLevel_CC_ACC_LIM_Deceleration_solver_28_05_2025_Solver_22_05_25_Calculating_the_target_acceleration_for_ACC_EMP032021_sdsd_Transfer_Fcn_First_Order1 /end SUB_GROUP
/end GROUP
/begin GROUP ADAS_FuncLevel_CC_ACC_LIM_Deceleration_solver_28_05_2025_Solver_22_05_25_Calculating_the_target_acceleration_for_ACC_EMP032021_sdsd_Transfer_Fcn_First_Order "ADAS/FuncLevel/CC_ACC_LIM/Deceleration_solver
28_05_2025/Solver 22_05_25/Calculating the target
acceleration for ACC/EMP032021/sdsd/Transfer Fcn
First Order" /begin REF_MEASUREMENT rtDW_ADAS.GTUD_DSTATE_kb /end REF_MEASUREMENT /end GROUP
/begin GROUP ADAS_FuncLevel_CC_ACC_LIM_Deceleration_solver_28_05_2025_Solver_22_05_25_Calculating_the_target_acceleration_for_ACC_EMP032021_sdsd_Transfer_Fcn_First_Order1 "ADAS/FuncLevel/CC_ACC_LIM/Deceleration_solver
28_05_2025/Solver 22_05_25/Calculating the target
acceleration for ACC/EMP032021/sdsd/Transfer Fcn
First Order1" /begin REF_MEASUREMENT rtDW_ADAS.GTUD_DSTATE_b /end REF_MEASUREMENT /end GROUP
/begin GROUP ADAS_FuncLevel_CC_ACC_LIM_Deceleration_solver_28_05_2025_Solver_22_05_25_Calculating_the_target_acceleration_for_ACC_Kalman_Filter1 "ADAS/FuncLevel/CC_ACC_LIM/Deceleration_solver
28_05_2025/Solver 22_05_25/Calculating the target
acceleration for ACC/Kalman Filter1"
 /begin SUB_GROUP ADAS_FuncLevel_CC_ACC_LIM_Deceleration_solver_28_05_2025_Solver_22_05_25_Calculating_the_target_acceleration_for_ACC_Kalman_Filter1_CalculatePL ADAS_FuncLevel_CC_ACC_LIM_Deceleration_solver_28_05_2025_Solver_22_05_25_Calculating_the_target_acceleration_for_ACC_Kalman_Filter1_CalculateYhat ADAS_FuncLevel_CC_ACC_LIM_Deceleration_solver_28_05_2025_Solver_22_05_25_Calculating_the_target_acceleration_for_ACC_Kalman_Filter1_CovarianceOutputConfigurator ADAS_FuncLevel_CC_ACC_LIM_Deceleration_solver_28_05_2025_Solver_22_05_25_Calculating_the_target_acceleration_for_ACC_Kalman_Filter1_DataTypeConversionA ADAS_FuncLevel_CC_ACC_LIM_Deceleration_solver_28_05_2025_Solver_22_05_25_Calculating_the_target_acceleration_for_ACC_Kalman_Filter1_DataTypeConversionB ADAS_FuncLevel_CC_ACC_LIM_Deceleration_solver_28_05_2025_Solver_22_05_25_Calculating_the_target_acceleration_for_ACC_Kalman_Filter1_DataTypeConversionC ADAS_FuncLevel_CC_ACC_LIM_Deceleration_solver_28_05_2025_Solver_22_05_25_Calculating_the_target_acceleration_for_ACC_Kalman_Filter1_DataTypeConversionD ADAS_FuncLevel_CC_ACC_LIM_Deceleration_solver_28_05_2025_Solver_22_05_25_Calculating_the_target_acceleration_for_ACC_Kalman_Filter1_DataTypeConversionEnable ADAS_FuncLevel_CC_ACC_LIM_Deceleration_solver_28_05_2025_Solver_22_05_25_Calculating_the_target_acceleration_for_ACC_Kalman_Filter1_DataTypeConversionG ADAS_FuncLevel_CC_ACC_LIM_Deceleration_solver_28_05_2025_Solver_22_05_25_Calculating_the_target_acceleration_for_ACC_Kalman_Filter1_DataTypeConversionH ADAS_FuncLevel_CC_ACC_LIM_Deceleration_solver_28_05_2025_Solver_22_05_25_Calculating_the_target_acceleration_for_ACC_Kalman_Filter1_DataTypeConversionN ADAS_FuncLevel_CC_ACC_LIM_Deceleration_solver_28_05_2025_Solver_22_05_25_Calculating_the_target_acceleration_for_ACC_Kalman_Filter1_DataTypeConversionP ADAS_FuncLevel_CC_ACC_LIM_Deceleration_solver_28_05_2025_Solver_22_05_25_Calculating_the_target_acceleration_for_ACC_Kalman_Filter1_DataTypeConversionP0 ADAS_FuncLevel_CC_ACC_LIM_Deceleration_solver_28_05_2025_Solver_22_05_25_Calculating_the_target_acceleration_for_ACC_Kalman_Filter1_DataTypeConversionQ ADAS_FuncLevel_CC_ACC_LIM_Deceleration_solver_28_05_2025_Solver_22_05_25_Calculating_the_target_acceleration_for_ACC_Kalman_Filter1_DataTypeConversionR ADAS_FuncLevel_CC_ACC_LIM_Deceleration_solver_28_05_2025_Solver_22_05_25_Calculating_the_target_acceleration_for_ACC_Kalman_Filter1_DataTypeConversionReset ADAS_FuncLevel_CC_ACC_LIM_Deceleration_solver_28_05_2025_Solver_22_05_25_Calculating_the_target_acceleration_for_ACC_Kalman_Filter1_DataTypeConversionX ADAS_FuncLevel_CC_ACC_LIM_Deceleration_solver_28_05_2025_Solver_22_05_25_Calculating_the_target_acceleration_for_ACC_Kalman_Filter1_DataTypeConversionX0 ADAS_FuncLevel_CC_ACC_LIM_Deceleration_solver_28_05_2025_Solver_22_05_25_Calculating_the_target_acceleration_for_ACC_Kalman_Filter1_DataTypeConversionu ADAS_FuncLevel_CC_ACC_LIM_Deceleration_solver_28_05_2025_Solver_22_05_25_Calculating_the_target_acceleration_for_ACC_Kalman_Filter1_MemoryP ADAS_FuncLevel_CC_ACC_LIM_Deceleration_solver_28_05_2025_Solver_22_05_25_Calculating_the_target_acceleration_for_ACC_Kalman_Filter1_Observer ADAS_FuncLevel_CC_ACC_LIM_Deceleration_solver_28_05_2025_Solver_22_05_25_Calculating_the_target_acceleration_for_ACC_Kalman_Filter1_ReducedQRN ADAS_FuncLevel_CC_ACC_LIM_Deceleration_solver_28_05_2025_Solver_22_05_25_Calculating_the_target_acceleration_for_ACC_Kalman_Filter1_Reset ADAS_FuncLevel_CC_ACC_LIM_Deceleration_solver_28_05_2025_Solver_22_05_25_Calculating_the_target_acceleration_for_ACC_Kalman_Filter1_Reshapeyhat ADAS_FuncLevel_CC_ACC_LIM_Deceleration_solver_28_05_2025_Solver_22_05_25_Calculating_the_target_acceleration_for_ACC_Kalman_Filter1_ScalarExpansionP0 ADAS_FuncLevel_CC_ACC_LIM_Deceleration_solver_28_05_2025_Solver_22_05_25_Calculating_the_target_acceleration_for_ACC_Kalman_Filter1_ScalarExpansionQ ADAS_FuncLevel_CC_ACC_LIM_Deceleration_solver_28_05_2025_Solver_22_05_25_Calculating_the_target_acceleration_for_ACC_Kalman_Filter1_ScalarExpansionR ADAS_FuncLevel_CC_ACC_LIM_Deceleration_solver_28_05_2025_Solver_22_05_25_Calculating_the_target_acceleration_for_ACC_Kalman_Filter1_UseCurrentEstimator /end SUB_GROUP
 /begin REF_MEASUREMENT rtDW_ADAS.GTMemoryX_DSTATE rtDW_ADAS.GTicLoad /end REF_MEASUREMENT
/end GROUP
/begin GROUP ADAS_FuncLevel_CC_ACC_LIM_Deceleration_solver_28_05_2025_Solver_22_05_25_Calculating_the_target_acceleration_for_ACC_Kalman_Filter1_CalculatePL "ADAS/FuncLevel/CC_ACC_LIM/Deceleration_solver
28_05_2025/Solver 22_05_25/Calculating the target
acceleration for ACC/Kalman Filter1/CalculatePL"
 /begin SUB_GROUP ADAS_FuncLevel_CC_ACC_LIM_Deceleration_solver_28_05_2025_Solver_22_05_25_Calculating_the_target_acceleration_for_ACC_Kalman_Filter1_CalculatePL_DataTypeConversionL ADAS_FuncLevel_CC_ACC_LIM_Deceleration_solver_28_05_2025_Solver_22_05_25_Calculating_the_target_acceleration_for_ACC_Kalman_Filter1_CalculatePL_DataTypeConversionM ADAS_FuncLevel_CC_ACC_LIM_Deceleration_solver_28_05_2025_Solver_22_05_25_Calculating_the_target_acceleration_for_ACC_Kalman_Filter1_CalculatePL_DataTypeConversionP ADAS_FuncLevel_CC_ACC_LIM_Deceleration_solver_28_05_2025_Solver_22_05_25_Calculating_the_target_acceleration_for_ACC_Kalman_Filter1_CalculatePL_DataTypeConversionZ /end SUB_GROUP
/end GROUP
/begin GROUP ADAS_FuncLevel_CC_ACC_LIM_Deceleration_solver_28_05_2025_Solver_22_05_25_Calculating_the_target_acceleration_for_ACC_Kalman_Filter1_CalculatePL_DataTypeConversionL "ADAS/FuncLevel/CC_ACC_LIM/Deceleration_solver
28_05_2025/Solver 22_05_25/Calculating the target
acceleration for ACC/Kalman Filter1/CalculatePL/DataTypeConversionL" /begin REF_MEASUREMENT rtConstB_ADAS.GTConversion /end REF_MEASUREMENT /end GROUP
/begin GROUP ADAS_FuncLevel_CC_ACC_LIM_Deceleration_solver_28_05_2025_Solver_22_05_25_Calculating_the_target_acceleration_for_ACC_Kalman_Filter1_CalculatePL_DataTypeConversionM "ADAS/FuncLevel/CC_ACC_LIM/Deceleration_solver
28_05_2025/Solver 22_05_25/Calculating the target
acceleration for ACC/Kalman Filter1/CalculatePL/DataTypeConversionM" /begin REF_MEASUREMENT rtConstB_ADAS.GTConversion_b /end REF_MEASUREMENT /end GROUP
/begin GROUP ADAS_FuncLevel_CC_ACC_LIM_Deceleration_solver_28_05_2025_Solver_22_05_25_Calculating_the_target_acceleration_for_ACC_Kalman_Filter1_CalculatePL_DataTypeConversionZ "ADAS/FuncLevel/CC_ACC_LIM/Deceleration_solver
28_05_2025/Solver 22_05_25/Calculating the target
acceleration for ACC/Kalman Filter1/CalculatePL/DataTypeConversionZ" /begin REF_MEASUREMENT rtConstB_ADAS.GTConversion_j /end REF_MEASUREMENT /end GROUP
/begin GROUP ADAS_FuncLevel_CC_ACC_LIM_Deceleration_solver_28_05_2025_Solver_22_05_25_Calculating_the_target_acceleration_for_ACC_Kalman_Filter1_CovarianceOutputConfigurator "ADAS/FuncLevel/CC_ACC_LIM/Deceleration_solver
28_05_2025/Solver 22_05_25/Calculating the target
acceleration for ACC/Kalman Filter1/CovarianceOutputConfigurator"
 /begin SUB_GROUP ADAS_FuncLevel_CC_ACC_LIM_Deceleration_solver_28_05_2025_Solver_22_05_25_Calculating_the_target_acceleration_for_ACC_Kalman_Filter1_CovarianceOutputConfigurator_decideOutput /end SUB_GROUP
/end GROUP
/begin GROUP ADAS_FuncLevel_CC_ACC_LIM_Deceleration_solver_28_05_2025_Solver_22_05_25_Calculating_the_target_acceleration_for_ACC_Kalman_Filter1_CovarianceOutputConfigurator_decideOutput "ADAS/FuncLevel/CC_ACC_LIM/Deceleration_solver
28_05_2025/Solver 22_05_25/Calculating the target
acceleration for ACC/Kalman Filter1/CovarianceOutputConfigurator/decideOutput" /begin REF_MEASUREMENT rtConstB_ADAS.GTConversion_j /end REF_MEASUREMENT /end GROUP
/begin GROUP ADAS_FuncLevel_CC_ACC_LIM_Deceleration_solver_28_05_2025_Solver_22_05_25_Calculating_the_target_acceleration_for_ACC_Kalman_Filter1_Observer "ADAS/FuncLevel/CC_ACC_LIM/Deceleration_solver
28_05_2025/Solver 22_05_25/Calculating the target
acceleration for ACC/Kalman Filter1/Observer"
 /begin SUB_GROUP ADAS_FuncLevel_CC_ACC_LIM_Deceleration_solver_28_05_2025_Solver_22_05_25_Calculating_the_target_acceleration_for_ACC_Kalman_Filter1_Observer_MeasurementUpdate /end SUB_GROUP
 /begin REF_MEASUREMENT rtDW_ADAS.GTProduct3_f /end REF_MEASUREMENT
/end GROUP
/begin GROUP ADAS_FuncLevel_CC_ACC_LIM_Deceleration_solver_28_05_2025_Solver_22_05_25_Calculating_the_target_acceleration_for_ACC_Kalman_Filter1_Observer_MeasurementUpdate "ADAS/FuncLevel/CC_ACC_LIM/Deceleration_solver
28_05_2025/Solver 22_05_25/Calculating the target
acceleration for ACC/Kalman Filter1/Observer/MeasurementUpdate" /begin REF_MEASUREMENT rtConstB_ADAS.GTConversion rtDW_ADAS.GTProduct3_f /end REF_MEASUREMENT /end GROUP
/begin GROUP ADAS_FuncLevel_CC_ACC_LIM_Deceleration_solver_28_05_2025_Solver_22_05_25_Calculating_the_target_acceleration_for_ACC_Kalman_Filter1_UseCurrentEstimator "ADAS/FuncLevel/CC_ACC_LIM/Deceleration_solver
28_05_2025/Solver 22_05_25/Calculating the target
acceleration for ACC/Kalman Filter1/UseCurrentEstimator"
 /begin SUB_GROUP ADAS_FuncLevel_CC_ACC_LIM_Deceleration_solver_28_05_2025_Solver_22_05_25_Calculating_the_target_acceleration_for_ACC_Kalman_Filter1_UseCurrentEstimator_Enabled_Subsystem /end SUB_GROUP
 /begin REF_MEASUREMENT rtDW_ADAS.GTProduct2_b /end REF_MEASUREMENT
/end GROUP
/begin GROUP ADAS_FuncLevel_CC_ACC_LIM_Deceleration_solver_28_05_2025_Solver_22_05_25_Calculating_the_target_acceleration_for_ACC_Kalman_Filter1_UseCurrentEstimator_Enabled_Subsystem "ADAS/FuncLevel/CC_ACC_LIM/Deceleration_solver
28_05_2025/Solver 22_05_25/Calculating the target
acceleration for ACC/Kalman Filter1/UseCurrentEstimator/Enabled
Subsystem" /begin REF_MEASUREMENT rtConstB_ADAS.GTConversion_b rtDW_ADAS.GTProduct2_b /end REF_MEASUREMENT /end GROUP
/begin GROUP ADAS_FuncLevel_CC_ACC_LIM_Deceleration_solver_28_05_2025_Solver_22_05_25_Calculating_the_target_acceleration_for_ACC_Soft_for_target_acceleration_ "ADAS/FuncLevel/CC_ACC_LIM/Deceleration_solver
28_05_2025/Solver 22_05_25/Calculating the target
acceleration for ACC/Soft for target acceleration "
 /begin SUB_GROUP ADAS_FuncLevel_CC_ACC_LIM_Deceleration_solver_28_05_2025_Solver_22_05_25_Calculating_the_target_acceleration_for_ACC_Soft_for_target_acceleration__Compare_To_Constant ADAS_FuncLevel_CC_ACC_LIM_Deceleration_solver_28_05_2025_Solver_22_05_25_Calculating_the_target_acceleration_for_ACC_Soft_for_target_acceleration__Transfer_Fcn_First_Order /end SUB_GROUP
/end GROUP
/begin GROUP ADAS_FuncLevel_CC_ACC_LIM_Deceleration_solver_28_05_2025_Solver_22_05_25_Calculating_the_target_acceleration_for_ACC_Soft_for_target_acceleration__Transfer_Fcn_First_Order "ADAS/FuncLevel/CC_ACC_LIM/Deceleration_solver
28_05_2025/Solver 22_05_25/Calculating the target
acceleration for ACC/Soft for target acceleration /Transfer Fcn
First Order" /begin REF_MEASUREMENT rtDW_ADAS.GTUD_DSTATE_l /end REF_MEASUREMENT /end GROUP
/begin GROUP ADAS_FuncLevel_CC_ACC_LIM_Deceleration_solver_28_05_2025_Solver_22_05_25_Calculating_the_target_deceleration_to_hold_the_car "ADAS/FuncLevel/CC_ACC_LIM/Deceleration_solver
28_05_2025/Solver 22_05_25/Calculating the target
deceleration to hold the car"
 /begin REF_MEASUREMENT rtDW_ADAS.GTAccel_Out rtDW_ADAS.GTPrevY_ar rtDW_ADAS.GTSwitch3 rtDW_ADAS.GTis_active_c66_ADAS rtDW_ADAS.GTis_c66_ADAS /end REF_MEASUREMENT
/end GROUP
/begin GROUP ADAS_FuncLevel_CC_ACC_LIM_Deceleration_solver_28_05_2025_Solver_22_05_25_Calculation_of_the_speed_at_which_it_is_necessary_to_switch_to_stop_mode "ADAS/FuncLevel/CC_ACC_LIM/Deceleration_solver
28_05_2025/Solver 22_05_25/Calculation of the speed at which it is necessary
to switch to stop mode" /begin REF_MEASUREMENT rtDW_ADAS.GTGain4_m /end REF_MEASUREMENT /end GROUP
/begin GROUP ADAS_FuncLevel_CC_ACC_LIM_Deceleration_solver_28_05_2025_Solver_22_05_25_Limiting_of_request_of_speed "ADAS/FuncLevel/CC_ACC_LIM/Deceleration_solver
28_05_2025/Solver 22_05_25/Limiting of request of speed"
 /begin SUB_GROUP ADAS_FuncLevel_CC_ACC_LIM_Deceleration_solver_28_05_2025_Solver_22_05_25_Limiting_of_request_of_speed_Compare_To_Zero ADAS_FuncLevel_CC_ACC_LIM_Deceleration_solver_28_05_2025_Solver_22_05_25_Limiting_of_request_of_speed_Sport /end SUB_GROUP
/end GROUP
/begin GROUP ADAS_FuncLevel_CC_ACC_LIM_Deceleration_solver_28_05_2025_Solver_22_05_25_Limiting_of_request_of_speed_Sport "ADAS/FuncLevel/CC_ACC_LIM/Deceleration_solver
28_05_2025/Solver 22_05_25/Limiting of request of speed/Sport" /begin REF_MEASUREMENT rtDW_ADAS.GTSport_On /end REF_MEASUREMENT /end GROUP
/begin GROUP ADAS_FuncLevel_CC_ACC_LIM_Deceleration_solver_28_05_2025_Solver_22_05_25_Rate_Limiter_Dynamic "ADAS/FuncLevel/CC_ACC_LIM/Deceleration_solver
28_05_2025/Solver 22_05_25/Rate Limiter
Dynamic" /begin REF_MEASUREMENT rtDW_ADAS.GTDelayInput2_DSTATE_a /end REF_MEASUREMENT /end GROUP
/begin GROUP ADAS_FuncLevel_CC_ACC_LIM_Deceleration_solver_28_05_2025_Solver_22_05_25_Request_limit "ADAS/FuncLevel/CC_ACC_LIM/Deceleration_solver
28_05_2025/Solver 22_05_25/Request limit"
 /begin SUB_GROUP ADAS_FuncLevel_CC_ACC_LIM_Deceleration_solver_28_05_2025_Solver_22_05_25_Request_limit_Max ADAS_FuncLevel_CC_ACC_LIM_Deceleration_solver_28_05_2025_Solver_22_05_25_Request_limit_Min1 ADAS_FuncLevel_CC_ACC_LIM_Deceleration_solver_28_05_2025_Solver_22_05_25_Request_limit_Rate_Limiter_Dynamic ADAS_FuncLevel_CC_ACC_LIM_Deceleration_solver_28_05_2025_Solver_22_05_25_Request_limit_Rate_Limiter_Dynamic1 ADAS_FuncLevel_CC_ACC_LIM_Deceleration_solver_28_05_2025_Solver_22_05_25_Request_limit_Rate_Limiter_Dynamic2 ADAS_FuncLevel_CC_ACC_LIM_Deceleration_solver_28_05_2025_Solver_22_05_25_Request_limit_Subsystem ADAS_FuncLevel_CC_ACC_LIM_Deceleration_solver_28_05_2025_Solver_22_05_25_Request_limit_The_algorithm_of_replace_of_the_target_speed_in_turns /end SUB_GROUP
/end GROUP
/begin GROUP ADAS_FuncLevel_CC_ACC_LIM_Deceleration_solver_28_05_2025_Solver_22_05_25_Request_limit_Rate_Limiter_Dynamic "ADAS/FuncLevel/CC_ACC_LIM/Deceleration_solver
28_05_2025/Solver 22_05_25/Request limit/Rate Limiter
Dynamic" /begin REF_MEASUREMENT rtDW_ADAS.GTDelayInput2_DSTATE_ag /end REF_MEASUREMENT /end GROUP
/begin GROUP ADAS_FuncLevel_CC_ACC_LIM_Deceleration_solver_28_05_2025_Solver_22_05_25_Request_limit_Rate_Limiter_Dynamic1 "ADAS/FuncLevel/CC_ACC_LIM/Deceleration_solver
28_05_2025/Solver 22_05_25/Request limit/Rate Limiter
Dynamic1" /begin REF_MEASUREMENT rtDW_ADAS.GTDelayInput2_DSTATE_lk /end REF_MEASUREMENT /end GROUP
/begin GROUP ADAS_FuncLevel_CC_ACC_LIM_Deceleration_solver_28_05_2025_Solver_22_05_25_Request_limit_Rate_Limiter_Dynamic2 "ADAS/FuncLevel/CC_ACC_LIM/Deceleration_solver
28_05_2025/Solver 22_05_25/Request limit/Rate Limiter
Dynamic2" /begin REF_MEASUREMENT rtDW_ADAS.GTDelayInput2_DSTATE_o /end REF_MEASUREMENT /end GROUP
/begin GROUP ADAS_FuncLevel_CC_ACC_LIM_Deceleration_solver_28_05_2025_Solver_22_05_25_Request_limit_Subsystem "ADAS/FuncLevel/CC_ACC_LIM/Deceleration_solver
28_05_2025/Solver 22_05_25/Request limit/Subsystem"
 /begin SUB_GROUP ADAS_FuncLevel_CC_ACC_LIM_Deceleration_solver_28_05_2025_Solver_22_05_25_Request_limit_Subsystem_Kalman_Filter1 /end SUB_GROUP
/end GROUP
/begin GROUP ADAS_FuncLevel_CC_ACC_LIM_Deceleration_solver_28_05_2025_Solver_22_05_25_Request_limit_Subsystem_Kalman_Filter1 "ADAS/FuncLevel/CC_ACC_LIM/Deceleration_solver
28_05_2025/Solver 22_05_25/Request limit/Subsystem/Kalman Filter1"
 /begin SUB_GROUP ADAS_FuncLevel_CC_ACC_LIM_Deceleration_solver_28_05_2025_Solver_22_05_25_Request_limit_Subsystem_Kalman_Filter1_CalculatePL ADAS_FuncLevel_CC_ACC_LIM_Deceleration_solver_28_05_2025_Solver_22_05_25_Request_limit_Subsystem_Kalman_Filter1_CalculateYhat ADAS_FuncLevel_CC_ACC_LIM_Deceleration_solver_28_05_2025_Solver_22_05_25_Request_limit_Subsystem_Kalman_Filter1_CovarianceOutputConfigurator ADAS_FuncLevel_CC_ACC_LIM_Deceleration_solver_28_05_2025_Solver_22_05_25_Request_limit_Subsystem_Kalman_Filter1_DataTypeConversionA ADAS_FuncLevel_CC_ACC_LIM_Deceleration_solver_28_05_2025_Solver_22_05_25_Request_limit_Subsystem_Kalman_Filter1_DataTypeConversionB ADAS_FuncLevel_CC_ACC_LIM_Deceleration_solver_28_05_2025_Solver_22_05_25_Request_limit_Subsystem_Kalman_Filter1_DataTypeConversionC ADAS_FuncLevel_CC_ACC_LIM_Deceleration_solver_28_05_2025_Solver_22_05_25_Request_limit_Subsystem_Kalman_Filter1_DataTypeConversionD ADAS_FuncLevel_CC_ACC_LIM_Deceleration_solver_28_05_2025_Solver_22_05_25_Request_limit_Subsystem_Kalman_Filter1_DataTypeConversionEnable ADAS_FuncLevel_CC_ACC_LIM_Deceleration_solver_28_05_2025_Solver_22_05_25_Request_limit_Subsystem_Kalman_Filter1_DataTypeConversionG ADAS_FuncLevel_CC_ACC_LIM_Deceleration_solver_28_05_2025_Solver_22_05_25_Request_limit_Subsystem_Kalman_Filter1_DataTypeConversionH ADAS_FuncLevel_CC_ACC_LIM_Deceleration_solver_28_05_2025_Solver_22_05_25_Request_limit_Subsystem_Kalman_Filter1_DataTypeConversionN ADAS_FuncLevel_CC_ACC_LIM_Deceleration_solver_28_05_2025_Solver_22_05_25_Request_limit_Subsystem_Kalman_Filter1_DataTypeConversionP ADAS_FuncLevel_CC_ACC_LIM_Deceleration_solver_28_05_2025_Solver_22_05_25_Request_limit_Subsystem_Kalman_Filter1_DataTypeConversionP0 ADAS_FuncLevel_CC_ACC_LIM_Deceleration_solver_28_05_2025_Solver_22_05_25_Request_limit_Subsystem_Kalman_Filter1_DataTypeConversionQ ADAS_FuncLevel_CC_ACC_LIM_Deceleration_solver_28_05_2025_Solver_22_05_25_Request_limit_Subsystem_Kalman_Filter1_DataTypeConversionR ADAS_FuncLevel_CC_ACC_LIM_Deceleration_solver_28_05_2025_Solver_22_05_25_Request_limit_Subsystem_Kalman_Filter1_DataTypeConversionReset ADAS_FuncLevel_CC_ACC_LIM_Deceleration_solver_28_05_2025_Solver_22_05_25_Request_limit_Subsystem_Kalman_Filter1_DataTypeConversionX ADAS_FuncLevel_CC_ACC_LIM_Deceleration_solver_28_05_2025_Solver_22_05_25_Request_limit_Subsystem_Kalman_Filter1_DataTypeConversionX0 ADAS_FuncLevel_CC_ACC_LIM_Deceleration_solver_28_05_2025_Solver_22_05_25_Request_limit_Subsystem_Kalman_Filter1_DataTypeConversionu ADAS_FuncLevel_CC_ACC_LIM_Deceleration_solver_28_05_2025_Solver_22_05_25_Request_limit_Subsystem_Kalman_Filter1_MemoryP ADAS_FuncLevel_CC_ACC_LIM_Deceleration_solver_28_05_2025_Solver_22_05_25_Request_limit_Subsystem_Kalman_Filter1_Observer ADAS_FuncLevel_CC_ACC_LIM_Deceleration_solver_28_05_2025_Solver_22_05_25_Request_limit_Subsystem_Kalman_Filter1_ReducedQRN ADAS_FuncLevel_CC_ACC_LIM_Deceleration_solver_28_05_2025_Solver_22_05_25_Request_limit_Subsystem_Kalman_Filter1_Reset ADAS_FuncLevel_CC_ACC_LIM_Deceleration_solver_28_05_2025_Solver_22_05_25_Request_limit_Subsystem_Kalman_Filter1_Reshapeyhat ADAS_FuncLevel_CC_ACC_LIM_Deceleration_solver_28_05_2025_Solver_22_05_25_Request_limit_Subsystem_Kalman_Filter1_ScalarExpansionP0 ADAS_FuncLevel_CC_ACC_LIM_Deceleration_solver_28_05_2025_Solver_22_05_25_Request_limit_Subsystem_Kalman_Filter1_ScalarExpansionQ ADAS_FuncLevel_CC_ACC_LIM_Deceleration_solver_28_05_2025_Solver_22_05_25_Request_limit_Subsystem_Kalman_Filter1_ScalarExpansionR ADAS_FuncLevel_CC_ACC_LIM_Deceleration_solver_28_05_2025_Solver_22_05_25_Request_limit_Subsystem_Kalman_Filter1_UseCurrentEstimator /end SUB_GROUP
 /begin REF_MEASUREMENT rtDW_ADAS.GTMemoryX_DSTATE_m rtDW_ADAS.GTicLoad_j /end REF_MEASUREMENT
/end GROUP
/begin GROUP ADAS_FuncLevel_CC_ACC_LIM_Deceleration_solver_28_05_2025_Solver_22_05_25_Request_limit_Subsystem_Kalman_Filter1_CalculatePL "ADAS/FuncLevel/CC_ACC_LIM/Deceleration_solver
28_05_2025/Solver 22_05_25/Request limit/Subsystem/Kalman Filter1/CalculatePL"
 /begin SUB_GROUP ADAS_FuncLevel_CC_ACC_LIM_Deceleration_solver_28_05_2025_Solver_22_05_25_Request_limit_Subsystem_Kalman_Filter1_CalculatePL_DataTypeConversionL ADAS_FuncLevel_CC_ACC_LIM_Deceleration_solver_28_05_2025_Solver_22_05_25_Request_limit_Subsystem_Kalman_Filter1_CalculatePL_DataTypeConversionM ADAS_FuncLevel_CC_ACC_LIM_Deceleration_solver_28_05_2025_Solver_22_05_25_Request_limit_Subsystem_Kalman_Filter1_CalculatePL_DataTypeConversionP ADAS_FuncLevel_CC_ACC_LIM_Deceleration_solver_28_05_2025_Solver_22_05_25_Request_limit_Subsystem_Kalman_Filter1_CalculatePL_DataTypeConversionZ /end SUB_GROUP
/end GROUP
/begin GROUP ADAS_FuncLevel_CC_ACC_LIM_Deceleration_solver_28_05_2025_Solver_22_05_25_Request_limit_Subsystem_Kalman_Filter1_CalculatePL_DataTypeConversionL "ADAS/FuncLevel/CC_ACC_LIM/Deceleration_solver
28_05_2025/Solver 22_05_25/Request limit/Subsystem/Kalman Filter1/CalculatePL/DataTypeConversionL" /begin REF_MEASUREMENT rtConstB_ADAS.GTConversion_k /end REF_MEASUREMENT /end GROUP
/begin GROUP ADAS_FuncLevel_CC_ACC_LIM_Deceleration_solver_28_05_2025_Solver_22_05_25_Request_limit_Subsystem_Kalman_Filter1_CalculatePL_DataTypeConversionM "ADAS/FuncLevel/CC_ACC_LIM/Deceleration_solver
28_05_2025/Solver 22_05_25/Request limit/Subsystem/Kalman Filter1/CalculatePL/DataTypeConversionM" /begin REF_MEASUREMENT rtConstB_ADAS.GTConversion_be /end REF_MEASUREMENT /end GROUP
/begin GROUP ADAS_FuncLevel_CC_ACC_LIM_Deceleration_solver_28_05_2025_Solver_22_05_25_Request_limit_Subsystem_Kalman_Filter1_CalculatePL_DataTypeConversionZ "ADAS/FuncLevel/CC_ACC_LIM/Deceleration_solver
28_05_2025/Solver 22_05_25/Request limit/Subsystem/Kalman Filter1/CalculatePL/DataTypeConversionZ" /begin REF_MEASUREMENT rtConstB_ADAS.GTConversion_h /end REF_MEASUREMENT /end GROUP
/begin GROUP ADAS_FuncLevel_CC_ACC_LIM_Deceleration_solver_28_05_2025_Solver_22_05_25_Request_limit_Subsystem_Kalman_Filter1_CovarianceOutputConfigurator "ADAS/FuncLevel/CC_ACC_LIM/Deceleration_solver
28_05_2025/Solver 22_05_25/Request limit/Subsystem/Kalman Filter1/CovarianceOutputConfigurator"
 /begin SUB_GROUP ADAS_FuncLevel_CC_ACC_LIM_Deceleration_solver_28_05_2025_Solver_22_05_25_Request_limit_Subsystem_Kalman_Filter1_CovarianceOutputConfigurator_decideOutput /end SUB_GROUP
/end GROUP
/begin GROUP ADAS_FuncLevel_CC_ACC_LIM_Deceleration_solver_28_05_2025_Solver_22_05_25_Request_limit_Subsystem_Kalman_Filter1_CovarianceOutputConfigurator_decideOutput "ADAS/FuncLevel/CC_ACC_LIM/Deceleration_solver
28_05_2025/Solver 22_05_25/Request limit/Subsystem/Kalman Filter1/CovarianceOutputConfigurator/decideOutput" /begin REF_MEASUREMENT rtConstB_ADAS.GTConversion_h /end REF_MEASUREMENT /end GROUP
/begin GROUP ADAS_FuncLevel_CC_ACC_LIM_Deceleration_solver_28_05_2025_Solver_22_05_25_Request_limit_Subsystem_Kalman_Filter1_Observer "ADAS/FuncLevel/CC_ACC_LIM/Deceleration_solver
28_05_2025/Solver 22_05_25/Request limit/Subsystem/Kalman Filter1/Observer"
 /begin SUB_GROUP ADAS_FuncLevel_CC_ACC_LIM_Deceleration_solver_28_05_2025_Solver_22_05_25_Request_limit_Subsystem_Kalman_Filter1_Observer_MeasurementUpdate /end SUB_GROUP
 /begin REF_MEASUREMENT rtDW_ADAS.GTProduct3 /end REF_MEASUREMENT
/end GROUP
/begin GROUP ADAS_FuncLevel_CC_ACC_LIM_Deceleration_solver_28_05_2025_Solver_22_05_25_Request_limit_Subsystem_Kalman_Filter1_Observer_MeasurementUpdate "ADAS/FuncLevel/CC_ACC_LIM/Deceleration_solver
28_05_2025/Solver 22_05_25/Request limit/Subsystem/Kalman Filter1/Observer/MeasurementUpdate" /begin REF_MEASUREMENT rtConstB_ADAS.GTConversion_k rtDW_ADAS.GTProduct3 /end REF_MEASUREMENT /end GROUP
/begin GROUP ADAS_FuncLevel_CC_ACC_LIM_Deceleration_solver_28_05_2025_Solver_22_05_25_Request_limit_Subsystem_Kalman_Filter1_UseCurrentEstimator "ADAS/FuncLevel/CC_ACC_LIM/Deceleration_solver
28_05_2025/Solver 22_05_25/Request limit/Subsystem/Kalman Filter1/UseCurrentEstimator"
 /begin SUB_GROUP ADAS_FuncLevel_CC_ACC_LIM_Deceleration_solver_28_05_2025_Solver_22_05_25_Request_limit_Subsystem_Kalman_Filter1_UseCurrentEstimator_Enabled_Subsystem /end SUB_GROUP
 /begin REF_MEASUREMENT rtDW_ADAS.GTProduct2 /end REF_MEASUREMENT
/end GROUP
/begin GROUP ADAS_FuncLevel_CC_ACC_LIM_Deceleration_solver_28_05_2025_Solver_22_05_25_Request_limit_Subsystem_Kalman_Filter1_UseCurrentEstimator_Enabled_Subsystem "ADAS/FuncLevel/CC_ACC_LIM/Deceleration_solver
28_05_2025/Solver 22_05_25/Request limit/Subsystem/Kalman Filter1/UseCurrentEstimator/Enabled
Subsystem" /begin REF_MEASUREMENT rtConstB_ADAS.GTConversion_be rtDW_ADAS.GTProduct2 /end REF_MEASUREMENT /end GROUP
/begin GROUP ADAS_FuncLevel_CC_ACC_LIM_Deceleration_solver_28_05_2025_Solver_22_05_25_Request_limit_The_algorithm_of_replace_of_the_target_speed_in_turns "ADAS/FuncLevel/CC_ACC_LIM/Deceleration_solver
28_05_2025/Solver 22_05_25/Request limit/The algorithm of replace of the target speed in turns"
 /begin SUB_GROUP ADAS_FuncLevel_CC_ACC_LIM_Deceleration_solver_28_05_2025_Solver_22_05_25_Request_limit_The_algorithm_of_replace_of_the_target_speed_in_turns_Compare_To_Constant1 ADAS_FuncLevel_CC_ACC_LIM_Deceleration_solver_28_05_2025_Solver_22_05_25_Request_limit_The_algorithm_of_replace_of_the_target_speed_in_turns_Compare_To_Constant3 ADAS_FuncLevel_CC_ACC_LIM_Deceleration_solver_28_05_2025_Solver_22_05_25_Request_limit_The_algorithm_of_replace_of_the_target_speed_in_turns_Compare_To_Constant4 /end SUB_GROUP
 /begin REF_MEASUREMENT rtDW_ADAS.GTDelay1_DSTATE_h rtDW_ADAS.GTDelay_DSTATE_o rtDW_ADAS.GTLimit_fl rtDW_ADAS.GTV_lead_kmh_safe rtDW_ADAS.GTV_set rtDW_ADAS.GTis_Control_mode rtDW_ADAS.GTis_active_c64_ADAS rtDW_ADAS.GTis_c64_ADAS rtDW_ADAS.GTtemporalCounter_i1_aa /end REF_MEASUREMENT
/end GROUP
/begin GROUP ADAS_FuncLevel_CC_ACC_LIM_Deceleration_solver_28_05_2025_Solver_22_05_25_Request_limit_The_algorithm_of_replace_of_the_target_speed_in_turns_Compare_To_Constant1 "ADAS/FuncLevel/CC_ACC_LIM/Deceleration_solver
28_05_2025/Solver 22_05_25/Request limit/The algorithm of replace of the target speed in turns/Compare
To Constant1" /begin REF_MEASUREMENT rtDW_ADAS.GTV_set /end REF_MEASUREMENT /end GROUP
/begin GROUP ADAS_FuncLevel_CC_ACC_LIM_Deceleration_solver_28_05_2025_Solver_22_05_25_Request_limit_The_algorithm_of_replace_of_the_target_speed_in_turns_Compare_To_Constant3 "ADAS/FuncLevel/CC_ACC_LIM/Deceleration_solver
28_05_2025/Solver 22_05_25/Request limit/The algorithm of replace of the target speed in turns/Compare
To Constant3" /begin REF_MEASUREMENT rtDW_ADAS.GTOut_l /end REF_MEASUREMENT /end GROUP
/begin GROUP ADAS_FuncLevel_CC_ACC_LIM_Deceleration_solver_28_05_2025_Solver_22_05_25_Request_limit_The_algorithm_of_replace_of_the_target_speed_in_turns_Compare_To_Constant4 "ADAS/FuncLevel/CC_ACC_LIM/Deceleration_solver
28_05_2025/Solver 22_05_25/Request limit/The algorithm of replace of the target speed in turns/Compare
To Constant4" /begin REF_MEASUREMENT rtDW_ADAS.GTOut_l /end REF_MEASUREMENT /end GROUP
/begin GROUP ADAS_FuncLevel_CC_ACC_LIM_Deceleration_solver_28_05_2025_Solver_22_05_25_Smooth_reset_when_shutting_down "ADAS/FuncLevel/CC_ACC_LIM/Deceleration_solver
28_05_2025/Solver 22_05_25/Smooth reset when shutting down" /begin REF_MEASUREMENT rtDW_ADAS.GTPrevY_g5 /end REF_MEASUREMENT /end GROUP
/begin GROUP ADAS_FuncLevel_CC_ACC_LIM_Deceleration_solver_28_05_2025_Solver_22_05_25_Sport "ADAS/FuncLevel/CC_ACC_LIM/Deceleration_solver
28_05_2025/Solver 22_05_25/Sport" /begin REF_MEASUREMENT rtDW_ADAS.GTSport_On /end REF_MEASUREMENT /end GROUP
/begin GROUP ADAS_FuncLevel_CC_ACC_LIM_Deceleration_solver_28_05_2025_Solver_22_05_25_Tr0_3 "ADAS/FuncLevel/CC_ACC_LIM/Deceleration_solver
28_05_2025/Solver 22_05_25/Tr0,3" /begin REF_MEASUREMENT rtDW_ADAS.GTUD_DSTATE_p /end REF_MEASUREMENT /end GROUP
/begin GROUP ADAS_FuncLevel_CC_ACC_LIM_Deceleration_solver_28_05_2025_Subsystem1 "ADAS/FuncLevel/CC_ACC_LIM/Deceleration_solver
28_05_2025/Subsystem1" /begin REF_MEASUREMENT rtDW_ADAS.GTSwitch5 /end REF_MEASUREMENT /end GROUP
/begin GROUP ADAS_FuncLevel_CC_ACC_LIM_Deceleration_solver_28_05_2025_Subsystem2 "ADAS/FuncLevel/CC_ACC_LIM/Deceleration_solver
28_05_2025/Subsystem2"
 /begin REF_MEASUREMENT rtDW_ADAS.GTAccPlaussibCount rtDW_ADAS.GTDataT rtDW_ADAS.GTDelay_DSTATE_e /end REF_MEASUREMENT
/end GROUP
/begin GROUP ADAS_FuncLevel_CC_ACC_LIM_Deceleration_solver_28_05_2025_Subsystem3 "ADAS/FuncLevel/CC_ACC_LIM/Deceleration_solver
28_05_2025/Subsystem3"
 /begin SUB_GROUP ADAS_FuncLevel_CC_ACC_LIM_Deceleration_solver_28_05_2025_Subsystem3_Tr /end SUB_GROUP
/end GROUP
/begin GROUP ADAS_FuncLevel_CC_ACC_LIM_Deceleration_solver_28_05_2025_Subsystem3_Tr "ADAS/FuncLevel/CC_ACC_LIM/Deceleration_solver
28_05_2025/Subsystem3/Tr" /begin REF_MEASUREMENT rtDW_ADAS.GTUD_DSTATE /end REF_MEASUREMENT /end GROUP
/begin GROUP ADAS_FuncLevel_CC_ACC_LIM_Deceleration_solver_28_05_2025_VLC_Hill_req "ADAS/FuncLevel/CC_ACC_LIM/Deceleration_solver
28_05_2025/VLC_Hill_req" /begin REF_MEASUREMENT rtDW_ADAS.GTPrevY_d rtDW_ADAS.GTSwitch7 /end REF_MEASUREMENT /end GROUP
/begin GROUP ADAS_FuncLevel_CC_ACC_LIM_Logic_28_05_2025 "ADAS/FuncLevel/CC_ACC_LIM/Logic
28_05_2025"
 /begin SUB_GROUP ADAS_FuncLevel_CC_ACC_LIM_Logic_28_05_2025_Compare ADAS_FuncLevel_CC_ACC_LIM_Logic_28_05_2025_Compare_To_Constant ADAS_FuncLevel_CC_ACC_LIM_Logic_28_05_2025_Compare_To_Constant1 ADAS_FuncLevel_CC_ACC_LIM_Logic_28_05_2025_Compare_To_Constant4 ADAS_FuncLevel_CC_ACC_LIM_Logic_28_05_2025_For_EMS ADAS_FuncLevel_CC_ACC_LIM_Logic_28_05_2025_Subsystem ADAS_FuncLevel_CC_ACC_LIM_Logic_28_05_2025_Subsystem4 ADAS_FuncLevel_CC_ACC_LIM_Logic_28_05_2025_Subsystem5 ADAS_FuncLevel_CC_ACC_LIM_Logic_28_05_2025_Subsystem6 ADAS_FuncLevel_CC_ACC_LIM_Logic_28_05_2025_Subsystem7 ADAS_FuncLevel_CC_ACC_LIM_Logic_28_05_2025_enter ADAS_FuncLevel_CC_ACC_LIM_Logic_28_05_2025_max_speed ADAS_FuncLevel_CC_ACC_LIM_Logic_28_05_2025_min_max_dist1 ADAS_FuncLevel_CC_ACC_LIM_Logic_28_05_2025_min_max_dist2 ADAS_FuncLevel_CC_ACC_LIM_Logic_28_05_2025_min_max_dist3 ADAS_FuncLevel_CC_ACC_LIM_Logic_28_05_2025_min_max_speed_step ADAS_FuncLevel_CC_ACC_LIM_Logic_28_05_2025_min_speed ADAS_FuncLevel_CC_ACC_LIM_Logic_28_05_2025_min_speed1 ADAS_FuncLevel_CC_ACC_LIM_Logic_28_05_2025_wait /end SUB_GROUP
 /begin REF_MEASUREMENT rtDW_ADAS.GTActivSts rtDW_ADAS.GTAdd rtDW_ADAS.GTB_ChType rtDW_ADAS.GTB_ON rtDW_ADAS.GTBlsActive rtDW_ADAS.GTBtSpdDec rtDW_ADAS.GTBtSpdInc rtDW_ADAS.GTCddAvailable rtDW_ADAS.GTCddStandstillSt rtDW_ADAS.GTCode_logic rtDW_ADAS.GTCompare rtDW_ADAS.GTCompare_i rtDW_ADAS.GTDataTypeConversion rtDW_ADAS.GTDoor rtDW_ADAS.GTDrTake rtDW_ADAS.GTDrivingMode_Sig rtDW_ADAS.GTDynamicEmergency rtDW_ADAS.GTFrcuBlk rtDW_ADAS.GTGearManualModeSt rtDW_ADAS.GTGearPosSt rtDW_ADAS.GTHyster rtDW_ADAS.GTHyster_Mode rtDW_ADAS.GTMMot_Inc rtDW_ADAS.GTOut rtDW_ADAS.GTOut_ rtDW_ADAS.GTOut__l rtDW_ADAS.GTOut__o rtDW_ADAS.GTParkBrakeSt rtDW_ADAS.GTReject rtDW_ADAS.GTReqToCc rtDW_ADAS.GTS_coef rtDW_ADAS.GTSmax_coef rtDW_ADAS.GTSmin_coef rtDW_ADAS.GTSolverAct rtDW_ADAS.GTSport_On rtDW_ADAS.GTSteep_dist rtDW_ADAS.GTSteep_speed rtDW_ADAS.GTSwitch_h rtDW_ADAS.GTSwitch_i rtDW_ADAS.GTSwitch_p rtDW_ADAS.GTUP rtDW_ADAS.GTV_newSpeed rtDW_ADAS.GTV_set rtDW_ADAS.GTVmax rtDW_ADAS.GTVmin rtDW_ADAS.GTis_ACC_DIST_CHANGE_BUTTON_1 rtDW_ADAS.GTis_ACC_DIST_CHANGE_BUTTON_2 rtDW_ADAS.GTis_ACC_OVERRYDE_MODE rtDW_ADAS.GTis_ACC_active_NORMAL_mode rtDW_ADAS.GTis_ACC_active_NORMAL_mode_IC rtDW_ADAS.GTis_ACC_test_IC rtDW_ADAS.GTis_ACTIVE_MODE rtDW_ADAS.GTis_CcSetDist rtDW_ADAS.GTis_TypeCCActiveMode rtDW_ADAS.GTis_active_c7_ADAS rtDW_ADAS.GTis_c7_ADAS rtDW_ADAS.GTratAccPed rtDW_ADAS.GTtemporalCounter_i1_gc rtDW_ADAS.GTtemporalCounter_i2_h rtDW_ADAS.GTtemporalCounter_i3 rtDW_ADAS.GTtrans rtDW_ADAS.GTu2_15 rtDW_ADAS.GTu5_20 /end REF_MEASUREMENT
/end GROUP
/begin GROUP ADAS_FuncLevel_CC_ACC_LIM_Logic_28_05_2025_Compare "ADAS/FuncLevel/CC_ACC_LIM/Logic
28_05_2025/Compare" /begin REF_MEASUREMENT rtDW_ADAS.GTDrivingMode_Sig /end REF_MEASUREMENT /end GROUP
/begin GROUP ADAS_FuncLevel_CC_ACC_LIM_Logic_28_05_2025_Compare_To_Constant "ADAS/FuncLevel/CC_ACC_LIM/Logic
28_05_2025/Compare
To Constant" /begin REF_MEASUREMENT rtDW_ADAS.GTCompare_i /end REF_MEASUREMENT /end GROUP
/begin GROUP ADAS_FuncLevel_CC_ACC_LIM_Logic_28_05_2025_Compare_To_Constant1 "ADAS/FuncLevel/CC_ACC_LIM/Logic
28_05_2025/Compare
To Constant1" /begin REF_MEASUREMENT rtDW_ADAS.GTActivSts /end REF_MEASUREMENT /end GROUP
/begin GROUP ADAS_FuncLevel_CC_ACC_LIM_Logic_28_05_2025_Compare_To_Constant4 "ADAS/FuncLevel/CC_ACC_LIM/Logic
28_05_2025/Compare
To Constant4" /begin REF_MEASUREMENT rtDW_ADAS.GTCCErReq rtDW_ADAS.GTCompare /end REF_MEASUREMENT /end GROUP
/begin GROUP ADAS_FuncLevel_CC_ACC_LIM_Logic_28_05_2025_For_EMS "ADAS/FuncLevel/CC_ACC_LIM/Logic
28_05_2025/For EMS" /begin REF_MEASUREMENT rtConstB_ADAS.GTGain1_h /end REF_MEASUREMENT /end GROUP
/begin GROUP ADAS_FuncLevel_CC_ACC_LIM_Logic_28_05_2025_Subsystem "ADAS/FuncLevel/CC_ACC_LIM/Logic
28_05_2025/Subsystem" /begin REF_MEASUREMENT rtDW_ADAS.GTFail_b rtDW_ADAS.GTSwitch_p /end REF_MEASUREMENT /end GROUP
/begin GROUP ADAS_FuncLevel_CC_ACC_LIM_Logic_28_05_2025_Subsystem4 "ADAS/FuncLevel/CC_ACC_LIM/Logic
28_05_2025/Subsystem4"
 /begin SUB_GROUP ADAS_FuncLevel_CC_ACC_LIM_Logic_28_05_2025_Subsystem4_Compare_To_Constant /end SUB_GROUP
 /begin REF_MEASUREMENT rtDW_ADAS.GTS_coef rtDW_ADAS.GTV_set /end REF_MEASUREMENT
/end GROUP
/begin GROUP ADAS_FuncLevel_CC_ACC_LIM_Logic_28_05_2025_Subsystem4_Compare_To_Constant "ADAS/FuncLevel/CC_ACC_LIM/Logic
28_05_2025/Subsystem4/Compare
To Constant" /begin REF_MEASUREMENT rtDW_ADAS.GTActivSts /end REF_MEASUREMENT /end GROUP
/begin GROUP ADAS_FuncLevel_CC_ACC_LIM_Logic_28_05_2025_Subsystem5 "ADAS/FuncLevel/CC_ACC_LIM/Logic
28_05_2025/Subsystem5"
 /begin SUB_GROUP ADAS_FuncLevel_CC_ACC_LIM_Logic_28_05_2025_Subsystem5_Compare_To_Constant ADAS_FuncLevel_CC_ACC_LIM_Logic_28_05_2025_Subsystem5_Compare_To_Constant1 /end SUB_GROUP
 /begin REF_MEASUREMENT rtDW_ADAS.GTAdd /end REF_MEASUREMENT
/end GROUP
/begin GROUP ADAS_FuncLevel_CC_ACC_LIM_Logic_28_05_2025_Subsystem5_Compare_To_Constant "ADAS/FuncLevel/CC_ACC_LIM/Logic
28_05_2025/Subsystem5/Compare
To Constant" /begin REF_MEASUREMENT rtDW_ADAS.GTBtSpdInc /end REF_MEASUREMENT /end GROUP
/begin GROUP ADAS_FuncLevel_CC_ACC_LIM_Logic_28_05_2025_Subsystem5_Compare_To_Constant1 "ADAS/FuncLevel/CC_ACC_LIM/Logic
28_05_2025/Subsystem5/Compare
To Constant1" /begin REF_MEASUREMENT rtDW_ADAS.GTBtSpdDec /end REF_MEASUREMENT /end GROUP
/begin GROUP ADAS_FuncLevel_CC_ACC_LIM_Logic_28_05_2025_Subsystem6 "ADAS/FuncLevel/CC_ACC_LIM/Logic
28_05_2025/Subsystem6"
 /begin REF_MEASUREMENT rtDW_ADAS.GTOut_ rtDW_ADAS.GTis_active_c103_ADAS rtDW_ADAS.GTis_c103_ADAS rtDW_ADAS.GTtemporalCounter_i1_bl /end REF_MEASUREMENT
/end GROUP
/begin GROUP ADAS_FuncLevel_CC_ACC_LIM_Logic_28_05_2025_Subsystem7 "ADAS/FuncLevel/CC_ACC_LIM/Logic
28_05_2025/Subsystem7" /begin REF_MEASUREMENT rtDW_ADAS.GTSwitch_h /end REF_MEASUREMENT /end GROUP
/begin GROUP ADAS_FuncLevel_CC_ACC_LIM_Logic_28_05_2025_enter "ADAS/FuncLevel/CC_ACC_LIM/Logic
28_05_2025/enter" /begin REF_MEASUREMENT rtDW_ADAS.GTu5_20 /end REF_MEASUREMENT /end GROUP
/begin GROUP ADAS_FuncLevel_CC_ACC_LIM_Logic_28_05_2025_min_speed "ADAS/FuncLevel/CC_ACC_LIM/Logic
28_05_2025/min_speed" /begin REF_MEASUREMENT rtDW_ADAS.GTSwitch_i /end REF_MEASUREMENT /end GROUP
/begin GROUP ADAS_FuncLevel_CC_ACC_LIM_Logic_28_05_2025_wait "ADAS/FuncLevel/CC_ACC_LIM/Logic
28_05_2025/wait" /begin REF_MEASUREMENT rtDW_ADAS.GTu2_15 /end REF_MEASUREMENT /end GROUP
/begin GROUP ADAS_FuncLevel_DOW "ADAS/FuncLevel/DOW" /begin SUB_GROUP ADAS_FuncLevel_DOW_Mode_selector ADAS_FuncLevel_DOW_Solver /end SUB_GROUP /end GROUP
/begin GROUP ADAS_FuncLevel_DOW_Mode_selector "ADAS/FuncLevel/DOW/Mode selector"
 /begin REF_MEASUREMENT rtDW_ADAS.GTDtLogDowLogicTrans rtDW_ADAS.GTis_active_c562_ADAS rtDW_ADAS.GTis_c562_ADAS /end REF_MEASUREMENT
/end GROUP
/begin GROUP ADAS_FuncLevel_DOW_Solver "ADAS/FuncLevel/DOW/Solver"
 /begin SUB_GROUP ADAS_FuncLevel_DOW_Solver_CarParameters ADAS_FuncLevel_DOW_Solver_DOW_solver ADAS_FuncLevel_DOW_Solver_DOW_warning_requester_left ADAS_FuncLevel_DOW_Solver_DOW_warning_requester_right /end SUB_GROUP
 /begin REF_MEASUREMENT rtDW_ADAS.GTDowLeftLedReq rtDW_ADAS.GTDowLeftWarnReq rtDW_ADAS.GTDowRightLedReq rtDW_ADAS.GTDowRightWarnReq rtDW_ADAS.GTDowSoundReq rtDW_ADAS.GTDtLogDowWarnReqTrans rtDW_ADAS.GTDtLogDowWarnReqTransLeft rtDW_ADAS.GTDtLogDowWarnReqTransRight rtDW_ADAS.GTDtLogDowWarnReqTrans_l rtDW_ADAS.GTSetLccSound rtDW_ADAS.GTisObjInDowZone_uint8 rtDW_ADAS.GTisObjInDowZone_uint8_n rtDW_ADAS.GTisObjInLeftZone rtDW_ADAS.GTisObjInRightZone rtDW_ADAS.GTwarningReq_uint8 rtDW_ADAS.GTwarningReq_uint8_b /end REF_MEASUREMENT
/end GROUP
/begin GROUP ADAS_FuncLevel_DOW_Solver_DOW_solver "ADAS/FuncLevel/DOW/Solver/DOW_solver"
 /begin SUB_GROUP ADAS_FuncLevel_DOW_Solver_DOW_solver_DOW_CVW_OneSide_Left ADAS_FuncLevel_DOW_Solver_DOW_solver_DOW_CVW_OneSide_Right /end SUB_GROUP
/end GROUP
/begin GROUP ADAS_FuncLevel_DOW_Solver_DOW_solver_DOW_CVW_OneSide_Left "ADAS/FuncLevel/DOW/Solver/DOW_solver/DOW_CVW_OneSide_Left"
 /begin SUB_GROUP ADAS_FuncLevel_DOW_Solver_DOW_solver_DOW_CVW_OneSide_Left_Compare_To_Constant1 ADAS_FuncLevel_DOW_Solver_DOW_solver_DOW_CVW_OneSide_Left_Compare_To_Constant2 ADAS_FuncLevel_DOW_Solver_DOW_solver_DOW_CVW_OneSide_Left_Compare_To_Constant3 ADAS_FuncLevel_DOW_Solver_DOW_solver_DOW_CVW_OneSide_Left_Compare_To_Constant4 ADAS_FuncLevel_DOW_Solver_DOW_solver_DOW_CVW_OneSide_Left_Compare_To_Constant5 ADAS_FuncLevel_DOW_Solver_DOW_solver_DOW_CVW_OneSide_Left_DOW_OneSide_solver /end SUB_GROUP
/end GROUP
/begin GROUP ADAS_FuncLevel_DOW_Solver_DOW_solver_DOW_CVW_OneSide_Left_DOW_OneSide_solver "ADAS/FuncLevel/DOW/Solver/DOW_solver/DOW_CVW_OneSide_Left/DOW_OneSide_solver"
 /begin REF_MEASUREMENT rtDW_ADAS.GTisObjInDowZone_uint8_n rtDW_ADAS.GTwarningReq_uint8_b /end REF_MEASUREMENT
/end GROUP
/begin GROUP ADAS_FuncLevel_DOW_Solver_DOW_solver_DOW_CVW_OneSide_Right "ADAS/FuncLevel/DOW/Solver/DOW_solver/DOW_CVW_OneSide_Right"
 /begin SUB_GROUP ADAS_FuncLevel_DOW_Solver_DOW_solver_DOW_CVW_OneSide_Right_Compare_To_Constant1 ADAS_FuncLevel_DOW_Solver_DOW_solver_DOW_CVW_OneSide_Right_Compare_To_Constant2 ADAS_FuncLevel_DOW_Solver_DOW_solver_DOW_CVW_OneSide_Right_Compare_To_Constant3 ADAS_FuncLevel_DOW_Solver_DOW_solver_DOW_CVW_OneSide_Right_Compare_To_Constant4 ADAS_FuncLevel_DOW_Solver_DOW_solver_DOW_CVW_OneSide_Right_Compare_To_Constant5 ADAS_FuncLevel_DOW_Solver_DOW_solver_DOW_CVW_OneSide_Right_DOW_OneSide_solver /end SUB_GROUP
/end GROUP
/begin GROUP ADAS_FuncLevel_DOW_Solver_DOW_solver_DOW_CVW_OneSide_Right_DOW_OneSide_solver "ADAS/FuncLevel/DOW/Solver/DOW_solver/DOW_CVW_OneSide_Right/DOW_OneSide_solver"
 /begin REF_MEASUREMENT rtDW_ADAS.GTisObjInDowZone_uint8 rtDW_ADAS.GTwarningReq_uint8 /end REF_MEASUREMENT
/end GROUP
/begin GROUP ADAS_FuncLevel_DOW_Solver_DOW_warning_requester_left "ADAS/FuncLevel/DOW/Solver/DOW_warning_requester_left" /begin REF_MEASUREMENT rtDW_ADAS.GTDtLogDowWarnReqTrans_l /end REF_MEASUREMENT /end GROUP
/begin GROUP ADAS_FuncLevel_DOW_Solver_DOW_warning_requester_right "ADAS/FuncLevel/DOW/Solver/DOW_warning_requester_right" /begin REF_MEASUREMENT rtDW_ADAS.GTDtLogDowWarnReqTrans /end REF_MEASUREMENT /end GROUP
/begin GROUP ADAS_FuncLevel_FCW_AEB "ADAS/FuncLevel/FCW_AEB"
 /begin SUB_GROUP ADAS_FuncLevel_FCW_AEB_Compare_To_Constant1 ADAS_FuncLevel_FCW_AEB_Compare_To_Constant2 ADAS_FuncLevel_FCW_AEB_Compare_To_Constant3 ADAS_FuncLevel_FCW_AEB_Compare_To_Constant9 ADAS_FuncLevel_FCW_AEB_Solver /end SUB_GROUP
 /begin REF_MEASUREMENT rtDW_ADAS.GTFrcuBlk /end REF_MEASUREMENT
/end GROUP
/begin GROUP ADAS_FuncLevel_FCW_AEB_Compare_To_Constant1 "ADAS/FuncLevel/FCW_AEB/Compare
To Constant1" /begin REF_MEASUREMENT rtDW_ADAS.GTGearPosSt /end REF_MEASUREMENT /end GROUP
/begin GROUP ADAS_FuncLevel_FCW_AEB_Compare_To_Constant2 "ADAS/FuncLevel/FCW_AEB/Compare
To Constant2" /begin REF_MEASUREMENT rtDW_ADAS.GTGearPosSt /end REF_MEASUREMENT /end GROUP
/begin GROUP ADAS_FuncLevel_FCW_AEB_Solver "ADAS/FuncLevel/FCW_AEB/Solver" /begin REF_MEASUREMENT rtDW_ADAS.GTratAccPed /end REF_MEASUREMENT /end GROUP
/begin GROUP ADAS_FuncLevel_LCC_ALCC_Mode_selector_Drive "ADAS/FuncLevel/LCC_ALCC/Mode selector/Drive" /begin REF_MEASUREMENT rtDW_ADAS.GTGearPosSt /end REF_MEASUREMENT /end GROUP
/begin GROUP ADAS_FuncLevel_LCC_ALCC_Mode_selector_Neutral "ADAS/FuncLevel/LCC_ALCC/Mode selector/Neutral" /begin REF_MEASUREMENT rtDW_ADAS.GTGearPosSt /end REF_MEASUREMENT /end GROUP
/begin GROUP ADAS_FuncLevel_LCC_ALCC_Solver "ADAS/FuncLevel/LCC_ALCC/Solver" /begin REF_MEASUREMENT rtDW_ADAS.GTSetLccSound rtDW_ADAS.GTSetLccVibration /end REF_MEASUREMENT /end GROUP
/begin GROUP ADAS_FuncLevel_LCC_ALCC_Solver_BSW_and_CVW_LccModeChanger "ADAS/FuncLevel/LCC_ALCC/Solver/BSW_and_CVW/LccModeChanger" /begin REF_MEASUREMENT rtDW_ADAS.GTSetLccMode /end REF_MEASUREMENT /end GROUP
/begin GROUP ADAS_FuncLevel_LDW_LDP_LDW_calculation_29_05_2025 "ADAS/FuncLevel/LDW_LDP/LDW calculation
29_05_2025" /begin REF_MEASUREMENT rtDW_ADAS.GTSetLdwSound /end REF_MEASUREMENT /end GROUP
/begin GROUP ADAS_FuncLevel_LDW_LDP_LDW_calculation_29_05_2025_LEFT_SIDE_SOLVER_LDW_side_solver "ADAS/FuncLevel/LDW_LDP/LDW calculation
29_05_2025/LEFT SIDE SOLVER/LDW side solver" /begin REF_MEASUREMENT rtDW_ADAS.GTSetLdwMode rtDW_ADAS.GTratAccPed /end REF_MEASUREMENT /end GROUP
/begin GROUP ADAS_FuncLevel_LDW_LDP_LDW_calculation_29_05_2025_RIGHT_SIDE_SOLVER_LDW_side_solver "ADAS/FuncLevel/LDW_LDP/LDW calculation
29_05_2025/RIGHT SIDE SOLVER/LDW side solver" /begin REF_MEASUREMENT rtDW_ADAS.GTSetLdwMode rtDW_ADAS.GTratAccPed /end REF_MEASUREMENT /end GROUP
/begin GROUP ADAS_FuncLevel_MLIA_Compare_To_Constant1 "ADAS/FuncLevel/MLIA/Compare
To Constant1" /begin REF_MEASUREMENT rtDW_ADAS.GTSetProjectionOnARoadSts /end REF_MEASUREMENT /end GROUP
/begin GROUP ADAS_FuncLevel_MLIA_MLIA_MLIA_mode_Compare_To_Constant1 "ADAS/FuncLevel/MLIA/MLIA/MLIA mode/Compare
To Constant1" /begin REF_MEASUREMENT rtDW_ADAS.GTGearPosSt /end REF_MEASUREMENT /end GROUP
/begin GROUP ADAS_FuncLevel_RDA_RCTC_Logic_RCTC_Compare_To_Constant1 "ADAS/FuncLevel/RDA_RCTC/Logic
RCTC/Compare
To Constant1" /begin REF_MEASUREMENT rtDW_ADAS.GTGearPosSt /end REF_MEASUREMENT /end GROUP
/begin GROUP ADAS_FuncLevel_RDA_RCTC_Logic_RDA_Compare_To_Constant1 "ADAS/FuncLevel/RDA_RCTC/Logic
RDA/Compare
To Constant1" /begin REF_MEASUREMENT rtDW_ADAS.GTGearPosSt /end REF_MEASUREMENT /end GROUP
/begin GROUP ADAS_FuncLevel_RDA_RCTC_MRRX_RCTC_Prototype_Compare_To_Constant3 "ADAS/FuncLevel/RDA_RCTC/MRRX_RCTC_Prototype/Compare
To Constant3" /begin REF_MEASUREMENT rtDW_ADAS.GTGearPosSt /end REF_MEASUREMENT /end GROUP
/begin GROUP ADAS_FuncLevel_RDA_RCTC_Solver_RDA "ADAS/FuncLevel/RDA_RCTC/Solver
RDA" /begin REF_MEASUREMENT rtDW_ADAS.GTSetRDAAutoBrakeSts /end REF_MEASUREMENT /end GROUP
/begin GROUP ADAS_Input_CarData_Bcm "ADAS/Input/CarData/Bcm" /begin REF_MEASUREMENT rtDW_ADAS.GTLccBt rtDW_ADAS.GTLdwBt rtDW_ADAS.GTOut_l /end REF_MEASUREMENT /end GROUP
/begin GROUP ADAS_Input_CarData_DAS_STATUS "ADAS/Input/CarData/DAS_STATUS" /begin REF_MEASUREMENT rtDW_ADAS.GTCcActSts rtDW_ADAS.GTMMot_Inc /end REF_MEASUREMENT /end GROUP
/begin GROUP ADAS_Input_CarData_DMF "ADAS/Input/CarData/DMF" /begin REF_MEASUREMENT rtDW_ADAS.GTDoor /end REF_MEASUREMENT /end GROUP
/begin GROUP ADAS_Input_CarData_Dms "ADAS/Input/CarData/Dms" /begin REF_MEASUREMENT rtDW_ADAS.GTDrivingMode_Sig /end REF_MEASUREMENT /end GROUP
/begin GROUP ADAS_Input_CarData_ESC "ADAS/Input/CarData/ESC"
 /begin REF_MEASUREMENT rtDW_ADAS.GTBlsActive rtDW_ADAS.GTCddAvailable rtDW_ADAS.GTCddStandstillSt /end REF_MEASUREMENT
/end GROUP
/begin GROUP ADAS_Input_CarData_Ems "ADAS/Input/CarData/Ems" /begin REF_MEASUREMENT rtDW_ADAS.GTratAccPed /end REF_MEASUREMENT /end GROUP
/begin GROUP ADAS_Input_CarData_Epb "ADAS/Input/CarData/Epb" /begin REF_MEASUREMENT rtDW_ADAS.GTDynamicEmergency rtDW_ADAS.GTParkBrakeSt /end REF_MEASUREMENT /end GROUP
/begin GROUP ADAS_Input_CarData_Fiu "ADAS/Input/CarData/Fiu"
 /begin REF_MEASUREMENT rtDW_ADAS.GTAaModeReq rtDW_ADAS.GTAslaDeltaReq rtDW_ADAS.GTCcAutoSpeedReq rtDW_ADAS.GTCcTypeReq rtDW_ADAS.GTCcmodeReq rtDW_ADAS.GTCleanSensorReq rtDW_ADAS.GTDowSoundWarnReq rtDW_ADAS.GTFcwModeReq rtDW_ADAS.GTFcwVibrWarnReq rtDW_ADAS.GTLccModeReq rtDW_ADAS.GTLccSoundAlertReq rtDW_ADAS.GTLccVibrationWarnReq rtDW_ADAS.GTLdwModeReq rtDW_ADAS.GTLdwSoundReq rtDW_ADAS.GTLdwVibrReq rtDW_ADAS.GTNavigStsReq rtDW_ADAS.GTOtherObjStsReq rtDW_ADAS.GTProjectionOnARoadReq rtDW_ADAS.GTRDAAutoBrakeReq rtDW_ADAS.GTRoadSignStsReq /end REF_MEASUREMENT
/end GROUP
/begin GROUP ADAS_Input_CarData_SWM "ADAS/Input/CarData/SWM"
 /begin REF_MEASUREMENT rtDW_ADAS.GTB_ChType rtDW_ADAS.GTB_ON rtDW_ADAS.GTBtSpdDec rtDW_ADAS.GTBtSpdInc rtDW_ADAS.GTOut /end REF_MEASUREMENT
/end GROUP
/begin GROUP ADAS_Input_CarData_Tcu "ADAS/Input/CarData/Tcu" /begin REF_MEASUREMENT rtDW_ADAS.GTGearManualModeSt rtDW_ADAS.GTGearPosSt /end REF_MEASUREMENT /end GROUP
/begin GROUP ADAS_Input_DiagConfData "ADAS/Input/DiagConfData"
 /begin REF_MEASUREMENT rtDW_ADAS.GTAccAvail rtDW_ADAS.GTCcAvail rtDW_ADAS.GTLccAvail rtDW_ADAS.GTLdwAvail rtDW_ADAS.GTLimAvail rtDW_ADAS.GTLkaAvail /end REF_MEASUREMENT
/end GROUP
/begin GROUP ADAS_Input_DiagErrorData "ADAS/Input/DiagErrorData"
 /begin REF_MEASUREMENT rtDW_ADAS.GTAAErReq rtDW_ADAS.GTAccErReq rtDW_ADAS.GTAebErReq rtDW_ADAS.GTAlccErReq rtDW_ADAS.GTAslaErReq rtDW_ADAS.GTCCErReq rtDW_ADAS.GTDowErReq rtDW_ADAS.GTFcwErReq rtDW_ADAS.GTLccErReq rtDW_ADAS.GTLdpErReq rtDW_ADAS.GTLdwErReq rtDW_ADAS.GTLimErReq rtDW_ADAS.GTLkaErReq rtDW_ADAS.GTRctcErReq rtDW_ADAS.GTRdaErReq rtDW_ADAS.GTRecErReq rtDW_ADAS.GTTsrErReq /end REF_MEASUREMENT
/end GROUP
/begin GROUP ADAS_Input_VlcData "ADAS/Input/VlcData" /begin REF_MEASUREMENT rtDW_ADAS.GTAccPlaussibCount /end REF_MEASUREMENT /end GROUP
/begin GROUP ADAS_Output_new_CC__ACC__LIM "ADAS/Output_new/CC//ACC//LIM"
 /begin REF_MEASUREMENT rtDW_ADAS.GTActivSts rtDW_ADAS.GTCDA_ReleaseReq rtDW_ADAS.GTCDDReq rtDW_ADAS.GTCode_logic rtDW_ADAS.GTReject rtDW_ADAS.GTStand_mode rtDW_ADAS.GTSwitch7 rtDW_ADAS.GTcode_h rtDW_ADAS.GTtrans /end REF_MEASUREMENT
/end GROUP
/begin GROUP ADAS_Output_new_FCW__AEB_LimDemo_Compare_To_Constant1 "ADAS/Output_new/FCW//AEB/LimDemo/Compare
To Constant1" /begin REF_MEASUREMENT rtDW_ADAS.GTActivSts /end REF_MEASUREMENT /end GROUP
/begin GROUP ADAS_Output_new_FIU "ADAS/Output_new/FIU"
 /begin REF_MEASUREMENT rtDW_ADAS.GTSetAaMode rtDW_ADAS.GTSetAaSts rtDW_ADAS.GTSetAebSts rtDW_ADAS.GTSetAlccSts rtDW_ADAS.GTSetAslaSts rtDW_ADAS.GTSetCcCorrectSpd rtDW_ADAS.GTSetCcMode rtDW_ADAS.GTSetCcType rtDW_ADAS.GTSetDowSound rtDW_ADAS.GTSetDowSts rtDW_ADAS.GTSetFcwMode rtDW_ADAS.GTSetFcwSts rtDW_ADAS.GTSetFcwVibration rtDW_ADAS.GTSetLccMode rtDW_ADAS.GTSetLccSound rtDW_ADAS.GTSetLccSts rtDW_ADAS.GTSetLccVibration rtDW_ADAS.GTSetLdpSts rtDW_ADAS.GTSetLdwMode rtDW_ADAS.GTSetLdwSound rtDW_ADAS.GTSetLdwSts rtDW_ADAS.GTSetLdwVibration rtDW_ADAS.GTSetLkaSts rtDW_ADAS.GTSetNavigSts rtDW_ADAS.GTSetOtherObjSts rtDW_ADAS.GTSetProjectionOnARoadSts rtDW_ADAS.GTSetRctcSts rtDW_ADAS.GTSetRdaSts rtDW_ADAS.GTSetRecSts rtDW_ADAS.GTSetRoadSignSts rtDW_ADAS.GTSetSensCleanSts rtDW_ADAS.GTSetTsrSts rtDW_ADAS.GTTestDataChgSts /end REF_MEASUREMENT
/end GROUP
/begin GROUP ADAS_Output_new_LCC__ALCC__DOW "ADAS/Output_new/LCC//ALCC//DOW"
 /begin REF_MEASUREMENT rtDW_ADAS.GTDowLeftLedReq rtDW_ADAS.GTDowLeftWarnReq rtDW_ADAS.GTDowRightLedReq rtDW_ADAS.GTDowRightWarnReq rtDW_ADAS.GTDowSoundReq rtDW_ADAS.GTDtLogDowLogicTrans rtDW_ADAS.GTDtLogDowWarnReqTransLeft rtDW_ADAS.GTDtLogDowWarnReqTransRight rtDW_ADAS.GTSetLccMode rtDW_ADAS.GTSetLccSound rtDW_ADAS.GTSetLccVibration rtDW_ADAS.GTisObjInLeftZone rtDW_ADAS.GTisObjInRightZone /end REF_MEASUREMENT
/end GROUP
/begin GROUP ADAS_Output_new_SENSORS "ADAS/Output_new/SENSORS" /begin REF_MEASUREMENT rtDW_ADAS.GTFrcuBlk /end REF_MEASUREMENT /end GROUP
/begin GROUP ADAS_Output_new_VLC_OUT "ADAS/Output_new/VLC_OUT"
 /begin REF_MEASUREMENT rtDW_ADAS.GTActivSts rtDW_ADAS.GTDrive_off_VLC rtDW_ADAS.GTSt_Req_VLC /end REF_MEASUREMENT
/end GROUP
/begin GROUP ADAS_ServiceManager_SensManager_Sens_08_05_24_HCS_02_05_24 "ADAS/ServiceManager/SensManager/Sens_08.05.24/HCS_02.05.24" /begin REF_MEASUREMENT rtDW_ADAS.GTGearPosSt /end REF_MEASUREMENT /end GROUP
/begin GROUP ADAS_ServiceManager_SensManager_Sens_08_05_24_USSM_06_05_24_Compare_To_Constant1 "ADAS/ServiceManager/SensManager/Sens_08.05.24/USSM_06.05.24/Compare
To Constant1" /begin REF_MEASUREMENT rtDW_ADAS.GTGearPosSt /end REF_MEASUREMENT /end GROUP
/begin GROUP ADAS_ServiceManager_SensManager_Sens_08_05_24_USSM_06_05_24_Compare_To_Constant3 "ADAS/ServiceManager/SensManager/Sens_08.05.24/USSM_06.05.24/Compare
To Constant3" /begin REF_MEASUREMENT rtDW_ADAS.GTGearPosSt /end REF_MEASUREMENT /end GROUP
/begin GROUP ADAS_ServiceManager_SensManager_Sens_08_05_24_WFS_08_05_24 "ADAS/ServiceManager/SensManager/Sens_08.05.24/WFS_08.05.24" /begin REF_MEASUREMENT rtDW_ADAS.GTFrcuBlk rtDW_ADAS.GTSetSensCleanSts /end REF_MEASUREMENT /end GROUP
/begin GROUP ADAS_ServiceManager_SensManager_Sens_08_05_24_WFS_08_05_24_Wash_Degradation_23_10_24 "ADAS/ServiceManager/SensManager/Sens_08.05.24/WFS_08.05.24/Wash Degradation_23.10.24" /begin REF_MEASUREMENT rtDW_ADAS.GTFrcuBlk /end REF_MEASUREMENT /end GROUP
/end MODULE
/end PROJECT
