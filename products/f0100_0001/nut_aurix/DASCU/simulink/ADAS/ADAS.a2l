ASAP2_VERSION 1 71
/begin PROJECT ProjectName "Project Comment Goes Here"
/begin HEADER "Header Comments go here" /end HEADER
/begin MODULE ModuleName "Module Comment Goes Here"
/begin MOD_COMMON "Mod Common Comment Here" BYTE_ORDER MSB_LAST ALIGNMENT_BYTE 1 ALIGNMENT_WORD 2 ALIGNMENT_LONG 4 ALIGNMENT_FLOAT32_IEEE 4 ALIGNMENT_FLOAT64_IEEE 8 ALIGNMENT_INT64 8 /end MOD_COMMON
/begin MEASUREMENT rtDW_ADAS.GTHLR_Y1_Obj2_h "" FLOAT32_IEEE ADAS_CM_single 0 0 -3.4E+38 3.4E+38 ECU_ADDRESS 0x0000 /* @ECU_Address@rtDW_ADAS.GTHLR_Y1_Obj2_h@ */ /end MEASUREMENT
/begin MEASUREMENT rtDW_ADAS.GTHLR_Y1_Obj3 "" FLOAT32_IEEE ADAS_CM_single 0 0 -3.4E+38 3.4E+38 ECU_ADDRESS 0x0000 /* @ECU_Address@rtDW_ADAS.GTHLR_Y1_Obj3@ */ /end MEASUREMENT
/begin MEASUREMENT rtDW_ADAS.GTHLR_Y1_Obj3_g "" FLOAT32_IEEE ADAS_CM_single 0 0 -3.4E+38 3.4E+38 ECU_ADDRESS 0x0000 /* @ECU_Address@rtDW_ADAS.GTHLR_Y1_Obj3_g@ */ /end MEASUREMENT
/begin MEASUREMENT rtDW_ADAS.GTHLR_Y1_Obj4 "" FLOAT32_IEEE ADAS_CM_single 0 0 -3.4E+38 3.4E+38 ECU_ADDRESS 0x0000 /* @ECU_Address@rtDW_ADAS.GTHLR_Y1_Obj4@ */ /end MEASUREMENT
/begin MEASUREMENT rtDW_ADAS.GTHLR_Y1_Obj4_n "" FLOAT32_IEEE ADAS_CM_single 0 0 -3.4E+38 3.4E+38 ECU_ADDRESS 0x0000 /* @ECU_Address@rtDW_ADAS.GTHLR_Y1_Obj4_n@ */ /end MEASUREMENT
/begin MEASUREMENT rtDW_ADAS.GTHLR_Y1_Obj5 "" FLOAT32_IEEE ADAS_CM_single 0 0 -3.4E+38 3.4E+38 ECU_ADDRESS 0x0000 /* @ECU_Address@rtDW_ADAS.GTHLR_Y1_Obj5@ */ /end MEASUREMENT
/begin MEASUREMENT rtDW_ADAS.GTHLR_Y1_Obj5_m "" FLOAT32_IEEE ADAS_CM_single 0 0 -3.4E+38 3.4E+38 ECU_ADDRESS 0x0000 /* @ECU_Address@rtDW_ADAS.GTHLR_Y1_Obj5_m@ */ /end MEASUREMENT
/begin MEASUREMENT rtDW_ADAS.GTHLR_Y1_Obj6 "" FLOAT32_IEEE ADAS_CM_single 0 0 -3.4E+38 3.4E+38 ECU_ADDRESS 0x0000 /* @ECU_Address@rtDW_ADAS.GTHLR_Y1_Obj6@ */ /end MEASUREMENT
/begin MEASUREMENT rtDW_ADAS.GTHLR_Y1_Obj6_p "" FLOAT32_IEEE ADAS_CM_single 0 0 -3.4E+38 3.4E+38 ECU_ADDRESS 0x0000 /* @ECU_Address@rtDW_ADAS.GTHLR_Y1_Obj6_p@ */ /end MEASUREMENT
/begin MEASUREMENT rtDW_ADAS.GTHLR_Y1_Obj7 "" FLOAT32_IEEE ADAS_CM_single 0 0 -3.4E+38 3.4E+38 ECU_ADDRESS 0x0000 /* @ECU_Address@rtDW_ADAS.GTHLR_Y1_Obj7@ */ /end MEASUREMENT
/begin MEASUREMENT rtDW_ADAS.GTHLR_Y1_Obj7_o "" FLOAT32_IEEE ADAS_CM_single 0 0 -3.4E+38 3.4E+38 ECU_ADDRESS 0x0000 /* @ECU_Address@rtDW_ADAS.GTHLR_Y1_Obj7_o@ */ /end MEASUREMENT
/begin MEASUREMENT rtDW_ADAS.GTHLR_Y1_Obj8 "" FLOAT32_IEEE ADAS_CM_single 0 0 -3.4E+38 3.4E+38 ECU_ADDRESS 0x0000 /* @ECU_Address@rtDW_ADAS.GTHLR_Y1_Obj8@ */ /end MEASUREMENT
/begin MEASUREMENT rtDW_ADAS.GTHLR_Y1_Obj8_n "" FLOAT32_IEEE ADAS_CM_single 0 0 -3.4E+38 3.4E+38 ECU_ADDRESS 0x0000 /* @ECU_Address@rtDW_ADAS.GTHLR_Y1_Obj8_n@ */ /end MEASUREMENT
/begin MEASUREMENT rtDW_ADAS.GTHLR_Y1_Obj9 "" FLOAT32_IEEE ADAS_CM_single 0 0 -3.4E+38 3.4E+38 ECU_ADDRESS 0x0000 /* @ECU_Address@rtDW_ADAS.GTHLR_Y1_Obj9@ */ /end MEASUREMENT
/begin MEASUREMENT rtDW_ADAS.GTHLR_Y1_Obj9_a "" FLOAT32_IEEE ADAS_CM_single 0 0 -3.4E+38 3.4E+38 ECU_ADDRESS 0x0000 /* @ECU_Address@rtDW_ADAS.GTHLR_Y1_Obj9_a@ */ /end MEASUREMENT
/begin MEASUREMENT rtDW_ADAS.GTHLR_Y2_Obj1 "" FLOAT32_IEEE ADAS_CM_single 0 0 -3.4E+38 3.4E+38 ECU_ADDRESS 0x0000 /* @ECU_Address@rtDW_ADAS.GTHLR_Y2_Obj1@ */ /end MEASUREMENT
/begin MEASUREMENT rtDW_ADAS.GTHLR_Y2_Obj10 "" FLOAT32_IEEE ADAS_CM_single 0 0 -3.4E+38 3.4E+38 ECU_ADDRESS 0x0000 /* @ECU_Address@rtDW_ADAS.GTHLR_Y2_Obj10@ */ /end MEASUREMENT
/begin MEASUREMENT rtDW_ADAS.GTHLR_Y2_Obj10_e "" FLOAT32_IEEE ADAS_CM_single 0 0 -3.4E+38 3.4E+38 ECU_ADDRESS 0x0000 /* @ECU_Address@rtDW_ADAS.GTHLR_Y2_Obj10_e@ */ /end MEASUREMENT
/begin MEASUREMENT rtDW_ADAS.GTHLR_Y2_Obj1_c "" FLOAT32_IEEE ADAS_CM_single 0 0 -3.4E+38 3.4E+38 ECU_ADDRESS 0x0000 /* @ECU_Address@rtDW_ADAS.GTHLR_Y2_Obj1_c@ */ /end MEASUREMENT
/begin MEASUREMENT rtDW_ADAS.GTHLR_Y2_Obj2 "" FLOAT32_IEEE ADAS_CM_single 0 0 -3.4E+38 3.4E+38 ECU_ADDRESS 0x0000 /* @ECU_Address@rtDW_ADAS.GTHLR_Y2_Obj2@ */ /end MEASUREMENT
/begin MEASUREMENT rtDW_ADAS.GTHLR_Y2_Obj2_g "" FLOAT32_IEEE ADAS_CM_single 0 0 -3.4E+38 3.4E+38 ECU_ADDRESS 0x0000 /* @ECU_Address@rtDW_ADAS.GTHLR_Y2_Obj2_g@ */ /end MEASUREMENT
/begin MEASUREMENT rtDW_ADAS.GTHLR_Y2_Obj3 "" FLOAT32_IEEE ADAS_CM_single 0 0 -3.4E+38 3.4E+38 ECU_ADDRESS 0x0000 /* @ECU_Address@rtDW_ADAS.GTHLR_Y2_Obj3@ */ /end MEASUREMENT
/begin MEASUREMENT rtDW_ADAS.GTHLR_Y2_Obj3_b "" FLOAT32_IEEE ADAS_CM_single 0 0 -3.4E+38 3.4E+38 ECU_ADDRESS 0x0000 /* @ECU_Address@rtDW_ADAS.GTHLR_Y2_Obj3_b@ */ /end MEASUREMENT
/begin MEASUREMENT rtDW_ADAS.GTHLR_Y2_Obj4 "" FLOAT32_IEEE ADAS_CM_single 0 0 -3.4E+38 3.4E+38 ECU_ADDRESS 0x0000 /* @ECU_Address@rtDW_ADAS.GTHLR_Y2_Obj4@ */ /end MEASUREMENT
/begin MEASUREMENT rtDW_ADAS.GTHLR_Y2_Obj4_a "" FLOAT32_IEEE ADAS_CM_single 0 0 -3.4E+38 3.4E+38 ECU_ADDRESS 0x0000 /* @ECU_Address@rtDW_ADAS.GTHLR_Y2_Obj4_a@ */ /end MEASUREMENT
/begin MEASUREMENT rtDW_ADAS.GTHLR_Y2_Obj5 "" FLOAT32_IEEE ADAS_CM_single 0 0 -3.4E+38 3.4E+38 ECU_ADDRESS 0x0000 /* @ECU_Address@rtDW_ADAS.GTHLR_Y2_Obj5@ */ /end MEASUREMENT
/begin MEASUREMENT rtDW_ADAS.GTHLR_Y2_Obj5_e "" FLOAT32_IEEE ADAS_CM_single 0 0 -3.4E+38 3.4E+38 ECU_ADDRESS 0x0000 /* @ECU_Address@rtDW_ADAS.GTHLR_Y2_Obj5_e@ */ /end MEASUREMENT
/begin MEASUREMENT rtDW_ADAS.GTHLR_Y2_Obj6 "" FLOAT32_IEEE ADAS_CM_single 0 0 -3.4E+38 3.4E+38 ECU_ADDRESS 0x0000 /* @ECU_Address@rtDW_ADAS.GTHLR_Y2_Obj6@ */ /end MEASUREMENT
/begin MEASUREMENT rtDW_ADAS.GTHLR_Y2_Obj6_d "" FLOAT32_IEEE ADAS_CM_single 0 0 -3.4E+38 3.4E+38 ECU_ADDRESS 0x0000 /* @ECU_Address@rtDW_ADAS.GTHLR_Y2_Obj6_d@ */ /end MEASUREMENT
/begin MEASUREMENT rtDW_ADAS.GTHLR_Y2_Obj7 "" FLOAT32_IEEE ADAS_CM_single 0 0 -3.4E+38 3.4E+38 ECU_ADDRESS 0x0000 /* @ECU_Address@rtDW_ADAS.GTHLR_Y2_Obj7@ */ /end MEASUREMENT
/begin MEASUREMENT rtDW_ADAS.GTHLR_Y2_Obj7_h "" FLOAT32_IEEE ADAS_CM_single 0 0 -3.4E+38 3.4E+38 ECU_ADDRESS 0x0000 /* @ECU_Address@rtDW_ADAS.GTHLR_Y2_Obj7_h@ */ /end MEASUREMENT
/begin MEASUREMENT rtDW_ADAS.GTHLR_Y2_Obj8 "" FLOAT32_IEEE ADAS_CM_single 0 0 -3.4E+38 3.4E+38 ECU_ADDRESS 0x0000 /* @ECU_Address@rtDW_ADAS.GTHLR_Y2_Obj8@ */ /end MEASUREMENT
/begin MEASUREMENT rtDW_ADAS.GTHLR_Y2_Obj8_g "" FLOAT32_IEEE ADAS_CM_single 0 0 -3.4E+38 3.4E+38 ECU_ADDRESS 0x0000 /* @ECU_Address@rtDW_ADAS.GTHLR_Y2_Obj8_g@ */ /end MEASUREMENT
/begin MEASUREMENT rtDW_ADAS.GTHLR_Y2_Obj9 "" FLOAT32_IEEE ADAS_CM_single 0 0 -3.4E+38 3.4E+38 ECU_ADDRESS 0x0000 /* @ECU_Address@rtDW_ADAS.GTHLR_Y2_Obj9@ */ /end MEASUREMENT
/begin MEASUREMENT rtDW_ADAS.GTHLR_Y2_Obj9_f "" FLOAT32_IEEE ADAS_CM_single 0 0 -3.4E+38 3.4E+38 ECU_ADDRESS 0x0000 /* @ECU_Address@rtDW_ADAS.GTHLR_Y2_Obj9_f@ */ /end MEASUREMENT
/begin MEASUREMENT rtDW_ADAS.GTHLR_Z1_Obj1 "" UBYTE ADAS_CM_uint8 0 0 0 255 ECU_ADDRESS 0x0000 /* @ECU_Address@rtDW_ADAS.GTHLR_Z1_Obj1@ */ /end MEASUREMENT
/begin MEASUREMENT rtDW_ADAS.GTHLR_Z1_Obj10 "" UBYTE ADAS_CM_uint8 0 0 0 255 ECU_ADDRESS 0x0000 /* @ECU_Address@rtDW_ADAS.GTHLR_Z1_Obj10@ */ /end MEASUREMENT
/begin MEASUREMENT rtDW_ADAS.GTHLR_Z1_Obj10_k "" UBYTE ADAS_CM_uint8 0 0 0 255 ECU_ADDRESS 0x0000 /* @ECU_Address@rtDW_ADAS.GTHLR_Z1_Obj10_k@ */ /end MEASUREMENT
/begin MEASUREMENT rtDW_ADAS.GTHLR_Z1_Obj1_h "" UBYTE ADAS_CM_uint8 0 0 0 255 ECU_ADDRESS 0x0000 /* @ECU_Address@rtDW_ADAS.GTHLR_Z1_Obj1_h@ */ /end MEASUREMENT
/begin MEASUREMENT rtDW_ADAS.GTHLR_Z1_Obj2 "" UBYTE ADAS_CM_uint8 0 0 0 255 ECU_ADDRESS 0x0000 /* @ECU_Address@rtDW_ADAS.GTHLR_Z1_Obj2@ */ /end MEASUREMENT
/begin MEASUREMENT rtDW_ADAS.GTHLR_Z1_Obj2_o "" UBYTE ADAS_CM_uint8 0 0 0 255 ECU_ADDRESS 0x0000 /* @ECU_Address@rtDW_ADAS.GTHLR_Z1_Obj2_o@ */ /end MEASUREMENT
/begin MEASUREMENT rtDW_ADAS.GTHLR_Z1_Obj3 "" UBYTE ADAS_CM_uint8 0 0 0 255 ECU_ADDRESS 0x0000 /* @ECU_Address@rtDW_ADAS.GTHLR_Z1_Obj3@ */ /end MEASUREMENT
/begin MEASUREMENT rtDW_ADAS.GTHLR_Z1_Obj3_h "" UBYTE ADAS_CM_uint8 0 0 0 255 ECU_ADDRESS 0x0000 /* @ECU_Address@rtDW_ADAS.GTHLR_Z1_Obj3_h@ */ /end MEASUREMENT
/begin MEASUREMENT rtDW_ADAS.GTHLR_Z1_Obj4 "" UBYTE ADAS_CM_uint8 0 0 0 255 ECU_ADDRESS 0x0000 /* @ECU_Address@rtDW_ADAS.GTHLR_Z1_Obj4@ */ /end MEASUREMENT
/begin MEASUREMENT rtDW_ADAS.GTHLR_Z1_Obj4_d "" UBYTE ADAS_CM_uint8 0 0 0 255 ECU_ADDRESS 0x0000 /* @ECU_Address@rtDW_ADAS.GTHLR_Z1_Obj4_d@ */ /end MEASUREMENT
/begin MEASUREMENT rtDW_ADAS.GTHLR_Z1_Obj5 "" UBYTE ADAS_CM_uint8 0 0 0 255 ECU_ADDRESS 0x0000 /* @ECU_Address@rtDW_ADAS.GTHLR_Z1_Obj5@ */ /end MEASUREMENT
/begin MEASUREMENT rtDW_ADAS.GTHLR_Z1_Obj5_f "" UBYTE ADAS_CM_uint8 0 0 0 255 ECU_ADDRESS 0x0000 /* @ECU_Address@rtDW_ADAS.GTHLR_Z1_Obj5_f@ */ /end MEASUREMENT
/begin MEASUREMENT rtDW_ADAS.GTHLR_Z1_Obj6 "" UBYTE ADAS_CM_uint8 0 0 0 255 ECU_ADDRESS 0x0000 /* @ECU_Address@rtDW_ADAS.GTHLR_Z1_Obj6@ */ /end MEASUREMENT
/begin MEASUREMENT rtDW_ADAS.GTHLR_Z1_Obj6_g "" UBYTE ADAS_CM_uint8 0 0 0 255 ECU_ADDRESS 0x0000 /* @ECU_Address@rtDW_ADAS.GTHLR_Z1_Obj6_g@ */ /end MEASUREMENT
/begin MEASUREMENT rtDW_ADAS.GTHLR_Z1_Obj7 "" UBYTE ADAS_CM_uint8 0 0 0 255 ECU_ADDRESS 0x0000 /* @ECU_Address@rtDW_ADAS.GTHLR_Z1_Obj7@ */ /end MEASUREMENT
/begin MEASUREMENT rtDW_ADAS.GTHLR_Z1_Obj7_h "" UBYTE ADAS_CM_uint8 0 0 0 255 ECU_ADDRESS 0x0000 /* @ECU_Address@rtDW_ADAS.GTHLR_Z1_Obj7_h@ */ /end MEASUREMENT
/begin MEASUREMENT rtDW_ADAS.GTHLR_Z1_Obj8 "" UBYTE ADAS_CM_uint8 0 0 0 255 ECU_ADDRESS 0x0000 /* @ECU_Address@rtDW_ADAS.GTHLR_Z1_Obj8@ */ /end MEASUREMENT
/begin MEASUREMENT rtDW_ADAS.GTHLR_Z1_Obj8_o "" UBYTE ADAS_CM_uint8 0 0 0 255 ECU_ADDRESS 0x0000 /* @ECU_Address@rtDW_ADAS.GTHLR_Z1_Obj8_o@ */ /end MEASUREMENT
/begin MEASUREMENT rtDW_ADAS.GTHLR_Z1_Obj9 "" UBYTE ADAS_CM_uint8 0 0 0 255 ECU_ADDRESS 0x0000 /* @ECU_Address@rtDW_ADAS.GTHLR_Z1_Obj9@ */ /end MEASUREMENT
/begin MEASUREMENT rtDW_ADAS.GTHLR_Z1_Obj9_p "" UBYTE ADAS_CM_uint8 0 0 0 255 ECU_ADDRESS 0x0000 /* @ECU_Address@rtDW_ADAS.GTHLR_Z1_Obj9_p@ */ /end MEASUREMENT
/begin MEASUREMENT rtDW_ADAS.GTHLR_Z2_Obj1 "" UBYTE ADAS_CM_uint8 0 0 0 255 ECU_ADDRESS 0x0000 /* @ECU_Address@rtDW_ADAS.GTHLR_Z2_Obj1@ */ /end MEASUREMENT
/begin MEASUREMENT rtDW_ADAS.GTHLR_Z2_Obj10 "" UBYTE ADAS_CM_uint8 0 0 0 255 ECU_ADDRESS 0x0000 /* @ECU_Address@rtDW_ADAS.GTHLR_Z2_Obj10@ */ /end MEASUREMENT
/begin MEASUREMENT rtDW_ADAS.GTHLR_Z2_Obj10_k "" UBYTE ADAS_CM_uint8 0 0 0 255 ECU_ADDRESS 0x0000 /* @ECU_Address@rtDW_ADAS.GTHLR_Z2_Obj10_k@ */ /end MEASUREMENT
/begin MEASUREMENT rtDW_ADAS.GTHLR_Z2_Obj1_o "" UBYTE ADAS_CM_uint8 0 0 0 255 ECU_ADDRESS 0x0000 /* @ECU_Address@rtDW_ADAS.GTHLR_Z2_Obj1_o@ */ /end MEASUREMENT
/begin MEASUREMENT rtDW_ADAS.GTHLR_Z2_Obj2 "" UBYTE ADAS_CM_uint8 0 0 0 255 ECU_ADDRESS 0x0000 /* @ECU_Address@rtDW_ADAS.GTHLR_Z2_Obj2@ */ /end MEASUREMENT
/begin MEASUREMENT rtDW_ADAS.GTHLR_Z2_Obj2_c "" UBYTE ADAS_CM_uint8 0 0 0 255 ECU_ADDRESS 0x0000 /* @ECU_Address@rtDW_ADAS.GTHLR_Z2_Obj2_c@ */ /end MEASUREMENT
/begin MEASUREMENT rtDW_ADAS.GTHLR_Z2_Obj3 "" UBYTE ADAS_CM_uint8 0 0 0 255 ECU_ADDRESS 0x0000 /* @ECU_Address@rtDW_ADAS.GTHLR_Z2_Obj3@ */ /end MEASUREMENT
/begin MEASUREMENT rtDW_ADAS.GTHLR_Z2_Obj3_k "" UBYTE ADAS_CM_uint8 0 0 0 255 ECU_ADDRESS 0x0000 /* @ECU_Address@rtDW_ADAS.GTHLR_Z2_Obj3_k@ */ /end MEASUREMENT
/begin MEASUREMENT rtDW_ADAS.GTHLR_Z2_Obj4 "" UBYTE ADAS_CM_uint8 0 0 0 255 ECU_ADDRESS 0x0000 /* @ECU_Address@rtDW_ADAS.GTHLR_Z2_Obj4@ */ /end MEASUREMENT
/begin MEASUREMENT rtDW_ADAS.GTHLR_Z2_Obj4_c "" UBYTE ADAS_CM_uint8 0 0 0 255 ECU_ADDRESS 0x0000 /* @ECU_Address@rtDW_ADAS.GTHLR_Z2_Obj4_c@ */ /end MEASUREMENT
/begin MEASUREMENT rtDW_ADAS.GTHLR_Z2_Obj5 "" UBYTE ADAS_CM_uint8 0 0 0 255 ECU_ADDRESS 0x0000 /* @ECU_Address@rtDW_ADAS.GTHLR_Z2_Obj5@ */ /end MEASUREMENT
/begin MEASUREMENT rtDW_ADAS.GTHLR_Z2_Obj5_g "" UBYTE ADAS_CM_uint8 0 0 0 255 ECU_ADDRESS 0x0000 /* @ECU_Address@rtDW_ADAS.GTHLR_Z2_Obj5_g@ */ /end MEASUREMENT
/begin MEASUREMENT rtDW_ADAS.GTHLR_Z2_Obj6 "" UBYTE ADAS_CM_uint8 0 0 0 255 ECU_ADDRESS 0x0000 /* @ECU_Address@rtDW_ADAS.GTHLR_Z2_Obj6@ */ /end MEASUREMENT
/begin MEASUREMENT rtDW_ADAS.GTHLR_Z2_Obj6_j "" UBYTE ADAS_CM_uint8 0 0 0 255 ECU_ADDRESS 0x0000 /* @ECU_Address@rtDW_ADAS.GTHLR_Z2_Obj6_j@ */ /end MEASUREMENT
/begin MEASUREMENT rtDW_ADAS.GTHLR_Z2_Obj7 "" UBYTE ADAS_CM_uint8 0 0 0 255 ECU_ADDRESS 0x0000 /* @ECU_Address@rtDW_ADAS.GTHLR_Z2_Obj7@ */ /end MEASUREMENT
/begin MEASUREMENT rtDW_ADAS.GTHLR_Z2_Obj7_h "" UBYTE ADAS_CM_uint8 0 0 0 255 ECU_ADDRESS 0x0000 /* @ECU_Address@rtDW_ADAS.GTHLR_Z2_Obj7_h@ */ /end MEASUREMENT
/begin MEASUREMENT rtDW_ADAS.GTHLR_Z2_Obj8 "" UBYTE ADAS_CM_uint8 0 0 0 255 ECU_ADDRESS 0x0000 /* @ECU_Address@rtDW_ADAS.GTHLR_Z2_Obj8@ */ /end MEASUREMENT
/begin MEASUREMENT rtDW_ADAS.GTHLR_Z2_Obj8_b "" UBYTE ADAS_CM_uint8 0 0 0 255 ECU_ADDRESS 0x0000 /* @ECU_Address@rtDW_ADAS.GTHLR_Z2_Obj8_b@ */ /end MEASUREMENT
/begin MEASUREMENT rtDW_ADAS.GTHLR_Z2_Obj9 "" UBYTE ADAS_CM_uint8 0 0 0 255 ECU_ADDRESS 0x0000 /* @ECU_Address@rtDW_ADAS.GTHLR_Z2_Obj9@ */ /end MEASUREMENT
/begin MEASUREMENT rtDW_ADAS.GTHLR_Z2_Obj9_o "" UBYTE ADAS_CM_uint8 0 0 0 255 ECU_ADDRESS 0x0000 /* @ECU_Address@rtDW_ADAS.GTHLR_Z2_Obj9_o@ */ /end MEASUREMENT
/begin MEASUREMENT rtDW_ADAS.GTLDWcalculation29_05_2025_MODE "" UBYTE ADAS_CM_logical 0 0 0 1 ECU_ADDRESS 0x0000 /* @ECU_Address@rtDW_ADAS.GTLDWcalculation29_05_2025_MODE@ */ /end MEASUREMENT
/begin MEASUREMENT rtDW_ADAS.GTLDWsidesolver_MODE "" UBYTE ADAS_CM_logical 0 0 0 1 ECU_ADDRESS 0x0000 /* @ECU_Address@rtDW_ADAS.GTLDWsidesolver_MODE@ */ /end MEASUREMENT
/begin MEASUREMENT rtDW_ADAS.GTLDWsidesolver_MODE_m "" UBYTE ADAS_CM_logical 0 0 0 1 ECU_ADDRESS 0x0000 /* @ECU_Address@rtDW_ADAS.GTLDWsidesolver_MODE_m@ */ /end MEASUREMENT
/begin MEASUREMENT rtDW_ADAS.GTMLIAcalculation_MODE "" UBYTE ADAS_CM_logical 0 0 0 1 ECU_ADDRESS 0x0000 /* @ECU_Address@rtDW_ADAS.GTMLIAcalculation_MODE@ */ /end MEASUREMENT
/begin MEASUREMENT rtDW_ADAS.GTMeasurementUpdate.GTMeasurementUpdate_MODE "" UBYTE ADAS_CM_logical 0 0 0 1 ECU_ADDRESS 0x0000 /* @ECU_Address@rtDW_ADAS.GTMeasurementUpdate.GTMeasurementUpdate_MODE@ */ /end MEASUREMENT
/begin MEASUREMENT rtDW_ADAS.GTMeasurementUpdate_n.GTMeasurementUpdate_MODE "" UBYTE ADAS_CM_logical 0 0 0 1 ECU_ADDRESS 0x0000 /* @ECU_Address@rtDW_ADAS.GTMeasurementUpdate_n.GTMeasurementUpdate_MODE@ */ /end MEASUREMENT
/begin MEASUREMENT rtDW_ADAS.GTMliaMode "" UBYTE ADAS_CM_uint8 0 0 0 255 ECU_ADDRESS 0x0000 /* @ECU_Address@rtDW_ADAS.GTMliaMode@ */ /end MEASUREMENT
/begin MEASUREMENT rtDW_ADAS.GTObj12_MODE "" UBYTE ADAS_CM_logical 0 0 0 1 ECU_ADDRESS 0x0000 /* @ECU_Address@rtDW_ADAS.GTObj12_MODE@ */ /end MEASUREMENT
/begin MEASUREMENT rtDW_ADAS.GTObj14_MODE "" UBYTE ADAS_CM_logical 0 0 0 1 ECU_ADDRESS 0x0000 /* @ECU_Address@rtDW_ADAS.GTObj14_MODE@ */ /end MEASUREMENT
/begin MEASUREMENT rtDW_ADAS.GTObjectpositionineachHLcoordin "" UBYTE ADAS_CM_logical 0 0 0 1 ECU_ADDRESS 0x0000 /* @ECU_Address@rtDW_ADAS.GTObjectpositionineachHLcoordin@ */ /end MEASUREMENT
/begin MEASUREMENT rtDW_ADAS.GTPREDICTION.GTDivide "" FLOAT32_IEEE ADAS_CM_single 0 0 -3.4E+38 3.4E+38 ECU_ADDRESS 0x0000 /* @ECU_Address@rtDW_ADAS.GTPREDICTION.GTDivide@ */ /end MEASUREMENT
/begin MEASUREMENT rtDW_ADAS.GTPREDICTION.GTPREDICTION_MODE "" UBYTE ADAS_CM_logical 0 0 0 1 ECU_ADDRESS 0x0000 /* @ECU_Address@rtDW_ADAS.GTPREDICTION.GTPREDICTION_MODE@ */ /end MEASUREMENT
/begin MEASUREMENT rtDW_ADAS.GTPREDICTION.GTSubsystem_MODE "" UBYTE ADAS_CM_logical 0 0 0 1 ECU_ADDRESS 0x0000 /* @ECU_Address@rtDW_ADAS.GTPREDICTION.GTSubsystem_MODE@ */ /end MEASUREMENT
/begin MEASUREMENT rtDW_ADAS.GTPREDICTION_p.GTDivide "" FLOAT32_IEEE ADAS_CM_single 0 0 -3.4E+38 3.4E+38 ECU_ADDRESS 0x0000 /* @ECU_Address@rtDW_ADAS.GTPREDICTION_p.GTDivide@ */ /end MEASUREMENT
/begin MEASUREMENT rtDW_ADAS.GTPREDICTION_p.GTPREDICTION_MODE "" UBYTE ADAS_CM_logical 0 0 0 1 ECU_ADDRESS 0x0000 /* @ECU_Address@rtDW_ADAS.GTPREDICTION_p.GTPREDICTION_MODE@ */ /end MEASUREMENT
/begin MEASUREMENT rtDW_ADAS.GTPREDICTION_p.GTSubsystem_MODE "" UBYTE ADAS_CM_logical 0 0 0 1 ECU_ADDRESS 0x0000 /* @ECU_Address@rtDW_ADAS.GTPREDICTION_p.GTSubsystem_MODE@ */ /end MEASUREMENT
/begin MEASUREMENT rtDW_ADAS.GTPROJECTION_MODE "" UBYTE ADAS_CM_logical 0 0 0 1 ECU_ADDRESS 0x0000 /* @ECU_Address@rtDW_ADAS.GTPROJECTION_MODE@ */ /end MEASUREMENT
/begin MEASUREMENT rtDW_ADAS.GTSolver21_02_2023_MODE "" UBYTE ADAS_CM_logical 0 0 0 1 ECU_ADDRESS 0x0000 /* @ECU_Address@rtDW_ADAS.GTSolver21_02_2023_MODE@ */ /end MEASUREMENT
/begin MEASUREMENT rtDW_ADAS.GTSolver22_05_25_MODE "" UBYTE ADAS_CM_logical 0 0 0 1 ECU_ADDRESS 0x0000 /* @ECU_Address@rtDW_ADAS.GTSolver22_05_25_MODE@ */ /end MEASUREMENT
/begin MEASUREMENT rtDW_ADAS.GTSolver23_04_2024_MODE "" UBYTE ADAS_CM_logical 0 0 0 1 ECU_ADDRESS 0x0000 /* @ECU_Address@rtDW_ADAS.GTSolver23_04_2024_MODE@ */ /end MEASUREMENT
/begin MEASUREMENT rtDW_ADAS.GTSolverRCTC_MODE "" UBYTE ADAS_CM_logical 0 0 0 1 ECU_ADDRESS 0x0000 /* @ECU_Address@rtDW_ADAS.GTSolverRCTC_MODE@ */ /end MEASUREMENT
/begin MEASUREMENT rtDW_ADAS.GTSolverRDA_MODE "" UBYTE ADAS_CM_logical 0 0 0 1 ECU_ADDRESS 0x0000 /* @ECU_Address@rtDW_ADAS.GTSolverRDA_MODE@ */ /end MEASUREMENT
/begin MEASUREMENT rtDW_ADAS.GTSolver_101024_MODE "" UBYTE ADAS_CM_logical 0 0 0 1 ECU_ADDRESS 0x0000 /* @ECU_Address@rtDW_ADAS.GTSolver_101024_MODE@ */ /end MEASUREMENT
/begin MEASUREMENT rtDW_ADAS.GTSolver_MODE "" UBYTE ADAS_CM_logical 0 0 0 1 ECU_ADDRESS 0x0000 /* @ECU_Address@rtDW_ADAS.GTSolver_MODE@ */ /end MEASUREMENT
/begin MEASUREMENT rtDW_ADAS.GTSolver_MODE_c "" UBYTE ADAS_CM_logical 0 0 0 1 ECU_ADDRESS 0x0000 /* @ECU_Address@rtDW_ADAS.GTSolver_MODE_c@ */ /end MEASUREMENT
/begin MEASUREMENT rtDW_ADAS.GTSolver_MODE_l "" UBYTE ADAS_CM_logical 0 0 0 1 ECU_ADDRESS 0x0000 /* @ECU_Address@rtDW_ADAS.GTSolver_MODE_l@ */ /end MEASUREMENT
/begin MEASUREMENT rtDW_ADAS.GTSubsystem1_MODE "" UBYTE ADAS_CM_logical 0 0 0 1 ECU_ADDRESS 0x0000 /* @ECU_Address@rtDW_ADAS.GTSubsystem1_MODE@ */ /end MEASUREMENT
/begin MEASUREMENT rtDW_ADAS.GTSubsystem1_a.GTSubsystem1_MODE "" UBYTE ADAS_CM_logical 0 0 0 1 ECU_ADDRESS 0x0000 /* @ECU_Address@rtDW_ADAS.GTSubsystem1_a.GTSubsystem1_MODE@ */ /end MEASUREMENT
/begin MEASUREMENT rtDW_ADAS.GTSubsystem1_d.GTSubsystem1_MODE "" UBYTE ADAS_CM_logical 0 0 0 1 ECU_ADDRESS 0x0000 /* @ECU_Address@rtDW_ADAS.GTSubsystem1_d.GTSubsystem1_MODE@ */ /end MEASUREMENT
/begin MEASUREMENT rtDW_ADAS.GTSubsystem_MODE "" UBYTE ADAS_CM_logical 0 0 0 1 ECU_ADDRESS 0x0000 /* @ECU_Address@rtDW_ADAS.GTSubsystem_MODE@ */ /end MEASUREMENT
/begin MEASUREMENT rtDW_ADAS.GTSubsystem_MODE_c "" UBYTE ADAS_CM_logical 0 0 0 1 ECU_ADDRESS 0x0000 /* @ECU_Address@rtDW_ADAS.GTSubsystem_MODE_c@ */ /end MEASUREMENT
/begin MEASUREMENT rtDW_ADAS.GTTTLC_c "" FLOAT32_IEEE ADAS_CM_single 0 0 -3.4E+38 3.4E+38 ECU_ADDRESS 0x0000 /* @ECU_Address@rtDW_ADAS.GTTTLC_c@ */ /end MEASUREMENT
/begin MEASUREMENT rtDW_ADAS.GTTarget1Selection1_MODE "" UBYTE ADAS_CM_logical 0 0 0 1 ECU_ADDRESS 0x0000 /* @ECU_Address@rtDW_ADAS.GTTarget1Selection1_MODE@ */ /end MEASUREMENT
/begin MEASUREMENT rtDW_ADAS.GTTarget1Selection2_MODE "" UBYTE ADAS_CM_logical 0 0 0 1 ECU_ADDRESS 0x0000 /* @ECU_Address@rtDW_ADAS.GTTarget1Selection2_MODE@ */ /end MEASUREMENT
/begin MEASUREMENT rtDW_ADAS.GTTargetLEDs_MODE "" UBYTE ADAS_CM_logical 0 0 0 1 ECU_ADDRESS 0x0000 /* @ECU_Address@rtDW_ADAS.GTTargetLEDs_MODE@ */ /end MEASUREMENT
/begin MEASUREMENT rtDW_ADAS.GTTransTTLC_a "" UBYTE ADAS_CM_uint8 0 0 0 255 ECU_ADDRESS 0x0000 /* @ECU_Address@rtDW_ADAS.GTTransTTLC_a@ */ /end MEASUREMENT
/begin MEASUREMENT rtDW_ADAS.GTTransVehPosition_e "" UBYTE ADAS_CM_uint8 0 0 0 255 ECU_ADDRESS 0x0000 /* @ECU_Address@rtDW_ADAS.GTTransVehPosition_e@ */ /end MEASUREMENT
/begin MEASUREMENT rtDW_ADAS.GTTransVehPosition_p "" UBYTE ADAS_CM_uint8 0 0 0 255 ECU_ADDRESS 0x0000 /* @ECU_Address@rtDW_ADAS.GTTransVehPosition_p@ */ /end MEASUREMENT
/begin MEASUREMENT rtDW_ADAS.GTTransWarnBlock_b "" UBYTE ADAS_CM_uint8 0 0 0 255 ECU_ADDRESS 0x0000 /* @ECU_Address@rtDW_ADAS.GTTransWarnBlock_b@ */ /end MEASUREMENT
/begin MEASUREMENT rtDW_ADAS.GTTurnRadius_i "" FLOAT32_IEEE ADAS_CM_single 0 0 -3.4E+38 3.4E+38 ECU_ADDRESS 0x0000 /* @ECU_Address@rtDW_ADAS.GTTurnRadius_i@ */ /end MEASUREMENT
/begin MEASUREMENT rtDW_ADAS.GTVAngle_obj9_10 "" FLOAT32_IEEE ADAS_CM_single 0 0 -3.4E+38 3.4E+38 ECU_ADDRESS 0x0000 /* @ECU_Address@rtDW_ADAS.GTVAngle_obj9_10@ */ /end MEASUREMENT
/begin MEASUREMENT rtDW_ADAS.GTVAngle_obj9_10_h "" FLOAT32_IEEE ADAS_CM_single 0 0 -3.4E+38 3.4E+38 ECU_ADDRESS 0x0000 /* @ECU_Address@rtDW_ADAS.GTVAngle_obj9_10_h@ */ /end MEASUREMENT
/begin MEASUREMENT rtDW_ADAS.GTVAngle_obj9_10_k "" FLOAT32_IEEE ADAS_CM_single 0 0 -3.4E+38 3.4E+38 ECU_ADDRESS 0x0000 /* @ECU_Address@rtDW_ADAS.GTVAngle_obj9_10_k@ */ /end MEASUREMENT
/begin MEASUREMENT rtDW_ADAS.GTVAngle_obj9_10_ki "" FLOAT32_IEEE ADAS_CM_single 0 0 -3.4E+38 3.4E+38 ECU_ADDRESS 0x0000 /* @ECU_Address@rtDW_ADAS.GTVAngle_obj9_10_ki@ */ /end MEASUREMENT
/begin MEASUREMENT rtDW_ADAS.GTVAngle_obj9_10_kiv "" FLOAT32_IEEE ADAS_CM_single 0 0 -3.4E+38 3.4E+38 ECU_ADDRESS 0x0000 /* @ECU_Address@rtDW_ADAS.GTVAngle_obj9_10_kiv@ */ /end MEASUREMENT
/begin MEASUREMENT rtDW_ADAS.GTVAngle_obj9_10_kivi "" FLOAT32_IEEE ADAS_CM_single 0 0 -3.4E+38 3.4E+38 ECU_ADDRESS 0x0000 /* @ECU_Address@rtDW_ADAS.GTVAngle_obj9_10_kivi@ */ /end MEASUREMENT
/begin MEASUREMENT rtDW_ADAS.GTVdepart_a "" FLOAT32_IEEE ADAS_CM_single 0 0 -3.4E+38 3.4E+38 ECU_ADDRESS 0x0000 /* @ECU_Address@rtDW_ADAS.GTVdepart_a@ */ /end MEASUREMENT
/begin MEASUREMENT rtDW_ADAS.GTWarnDist_l "" UBYTE ADAS_CM_uint8 0 0 0 255 ECU_ADDRESS 0x0000 /* @ECU_Address@rtDW_ADAS.GTWarnDist_l@ */ /end MEASUREMENT
/begin MEASUREMENT rtDW_ADAS.GTWarnDist_p "" UBYTE ADAS_CM_uint8 0 0 0 255 ECU_ADDRESS 0x0000 /* @ECU_Address@rtDW_ADAS.GTWarnDist_p@ */ /end MEASUREMENT
/begin MEASUREMENT rtDW_ADAS.GTWarnPredict_a "" UBYTE ADAS_CM_uint8 0 0 0 255 ECU_ADDRESS 0x0000 /* @ECU_Address@rtDW_ADAS.GTWarnPredict_a@ */ /end MEASUREMENT
/begin MEASUREMENT rtDW_ADAS.GTWarnPredict_g "" UBYTE ADAS_CM_uint8 0 0 0 255 ECU_ADDRESS 0x0000 /* @ECU_Address@rtDW_ADAS.GTWarnPredict_g@ */ /end MEASUREMENT
/begin MEASUREMENT rtDW_ADAS.GTWarnTime_g "" UBYTE ADAS_CM_uint8 0 0 0 255 ECU_ADDRESS 0x0000 /* @ECU_Address@rtDW_ADAS.GTWarnTime_g@ */ /end MEASUREMENT
/begin MEASUREMENT rtDW_ADAS.GTWarnTime_p "" UBYTE ADAS_CM_uint8 0 0 0 255 ECU_ADDRESS 0x0000 /* @ECU_Address@rtDW_ADAS.GTWarnTime_p@ */ /end MEASUREMENT
/begin MEASUREMENT rtDW_ADAS.GTWelcomeSts "" UBYTE ADAS_CM_uint8 0 0 0 255 ECU_ADDRESS 0x0000 /* @ECU_Address@rtDW_ADAS.GTWelcomeSts@ */ /end MEASUREMENT
/begin MEASUREMENT rtDW_ADAS.GTWelcomeSts_g "" UBYTE ADAS_CM_uint8 0 0 0 255 ECU_ADDRESS 0x0000 /* @ECU_Address@rtDW_ADAS.GTWelcomeSts_g@ */ /end MEASUREMENT
/begin MEASUREMENT rtDW_ADAS.GTWelcomeSts_p "" UBYTE ADAS_CM_uint8 0 0 0 255 ECU_ADDRESS 0x0000 /* @ECU_Address@rtDW_ADAS.GTWelcomeSts_p@ */ /end MEASUREMENT
/begin MEASUREMENT rtDW_ADAS.GTWelcomeSts_pw "" UBYTE ADAS_CM_uint8 0 0 0 255 ECU_ADDRESS 0x0000 /* @ECU_Address@rtDW_ADAS.GTWelcomeSts_pw@ */ /end MEASUREMENT
/begin MEASUREMENT rtDW_ADAS.GTWelcomeSts_pwn "" UBYTE ADAS_CM_uint8 0 0 0 255 ECU_ADDRESS 0x0000 /* @ECU_Address@rtDW_ADAS.GTWelcomeSts_pwn@ */ /end MEASUREMENT
/begin MEASUREMENT rtDW_ADAS.GTWelcometype_MODE "" UBYTE ADAS_CM_logical 0 0 0 1 ECU_ADDRESS 0x0000 /* @ECU_Address@rtDW_ADAS.GTWelcometype_MODE@ */ /end MEASUREMENT
/begin MEASUREMENT rtDW_ADAS.GTWelcometypefromcentertoedge_M "" UBYTE ADAS_CM_logical 0 0 0 1 ECU_ADDRESS 0x0000 /* @ECU_Address@rtDW_ADAS.GTWelcometypefromcentertoedge_M@ */ /end MEASUREMENT
/begin MEASUREMENT rtDW_ADAS.GTWelcometypefromedgetocenter_M "" UBYTE ADAS_CM_logical 0 0 0 1 ECU_ADDRESS 0x0000 /* @ECU_Address@rtDW_ADAS.GTWelcometypefromedgetocenter_M@ */ /end MEASUREMENT
/begin MEASUREMENT rtDW_ADAS.GTYawRate_dt_f "" FLOAT32_IEEE ADAS_CM_single 0 0 -3.4E+38 3.4E+38 ECU_ADDRESS 0x0000 /* @ECU_Address@rtDW_ADAS.GTYawRate_dt_f@ */ /end MEASUREMENT
/begin MEASUREMENT rtDW_ADAS.GTalfa_L_obj10 "" FLOAT32_IEEE ADAS_CM_single 0 0 -3.4E+38 3.4E+38 ECU_ADDRESS 0x0000 /* @ECU_Address@rtDW_ADAS.GTalfa_L_obj10@ */ /end MEASUREMENT
/begin MEASUREMENT rtDW_ADAS.GTalfa_L_obj10_f "" FLOAT32_IEEE ADAS_CM_single 0 0 -3.4E+38 3.4E+38 ECU_ADDRESS 0x0000 /* @ECU_Address@rtDW_ADAS.GTalfa_L_obj10_f@ */ /end MEASUREMENT
/begin MEASUREMENT rtDW_ADAS.GTalfa_L_obj10_fq "" FLOAT32_IEEE ADAS_CM_single 0 0 -3.4E+38 3.4E+38 ECU_ADDRESS 0x0000 /* @ECU_Address@rtDW_ADAS.GTalfa_L_obj10_fq@ */ /end MEASUREMENT
/begin MEASUREMENT rtDW_ADAS.GTalfa_L_obj10_n "" FLOAT32_IEEE ADAS_CM_single 0 0 -3.4E+38 3.4E+38 ECU_ADDRESS 0x0000 /* @ECU_Address@rtDW_ADAS.GTalfa_L_obj10_n@ */ /end MEASUREMENT
/begin MEASUREMENT rtDW_ADAS.GTalfa_L_obj9 "" FLOAT32_IEEE ADAS_CM_single 0 0 -3.4E+38 3.4E+38 ECU_ADDRESS 0x0000 /* @ECU_Address@rtDW_ADAS.GTalfa_L_obj9@ */ /end MEASUREMENT
/begin MEASUREMENT rtDW_ADAS.GTalfa_L_obj9_j "" FLOAT32_IEEE ADAS_CM_single 0 0 -3.4E+38 3.4E+38 ECU_ADDRESS 0x0000 /* @ECU_Address@rtDW_ADAS.GTalfa_L_obj9_j@ */ /end MEASUREMENT
/begin MEASUREMENT rtDW_ADAS.GTalfa_L_obj9_k "" FLOAT32_IEEE ADAS_CM_single 0 0 -3.4E+38 3.4E+38 ECU_ADDRESS 0x0000 /* @ECU_Address@rtDW_ADAS.GTalfa_L_obj9_k@ */ /end MEASUREMENT
/begin MEASUREMENT rtDW_ADAS.GTalfa_L_obj9_ku "" FLOAT32_IEEE ADAS_CM_single 0 0 -3.4E+38 3.4E+38 ECU_ADDRESS 0x0000 /* @ECU_Address@rtDW_ADAS.GTalfa_L_obj9_ku@ */ /end MEASUREMENT
/begin MEASUREMENT rtDW_ADAS.GTalfa_R_obj10 "" FLOAT32_IEEE ADAS_CM_single 0 0 -3.4E+38 3.4E+38 ECU_ADDRESS 0x0000 /* @ECU_Address@rtDW_ADAS.GTalfa_R_obj10@ */ /end MEASUREMENT
/begin MEASUREMENT rtDW_ADAS.GTalfa_R_obj10_b "" FLOAT32_IEEE ADAS_CM_single 0 0 -3.4E+38 3.4E+38 ECU_ADDRESS 0x0000 /* @ECU_Address@rtDW_ADAS.GTalfa_R_obj10_b@ */ /end MEASUREMENT
/begin MEASUREMENT rtDW_ADAS.GTalfa_R_obj10_bx "" FLOAT32_IEEE ADAS_CM_single 0 0 -3.4E+38 3.4E+38 ECU_ADDRESS 0x0000 /* @ECU_Address@rtDW_ADAS.GTalfa_R_obj10_bx@ */ /end MEASUREMENT
/begin MEASUREMENT rtDW_ADAS.GTalfa_R_obj10_m "" FLOAT32_IEEE ADAS_CM_single 0 0 -3.4E+38 3.4E+38 ECU_ADDRESS 0x0000 /* @ECU_Address@rtDW_ADAS.GTalfa_R_obj10_m@ */ /end MEASUREMENT
/begin MEASUREMENT rtDW_ADAS.GTalfa_R_obj9 "" FLOAT32_IEEE ADAS_CM_single 0 0 -3.4E+38 3.4E+38 ECU_ADDRESS 0x0000 /* @ECU_Address@rtDW_ADAS.GTalfa_R_obj9@ */ /end MEASUREMENT
/begin MEASUREMENT rtDW_ADAS.GTalfa_R_obj9_f "" FLOAT32_IEEE ADAS_CM_single 0 0 -3.4E+38 3.4E+38 ECU_ADDRESS 0x0000 /* @ECU_Address@rtDW_ADAS.GTalfa_R_obj9_f@ */ /end MEASUREMENT
/begin MEASUREMENT rtDW_ADAS.GTalfa_R_obj9_f3 "" FLOAT32_IEEE ADAS_CM_single 0 0 -3.4E+38 3.4E+38 ECU_ADDRESS 0x0000 /* @ECU_Address@rtDW_ADAS.GTalfa_R_obj9_f3@ */ /end MEASUREMENT
/begin MEASUREMENT rtDW_ADAS.GTalfa_R_obj9_i "" FLOAT32_IEEE ADAS_CM_single 0 0 -3.4E+38 3.4E+38 ECU_ADDRESS 0x0000 /* @ECU_Address@rtDW_ADAS.GTalfa_R_obj9_i@ */ /end MEASUREMENT
/begin MEASUREMENT rtDW_ADAS.GTmLEDfilterobj1.GTDelay6_DSTATE "" FLOAT32_IEEE ADAS_CM_single 0 0 -3.4E+38 3.4E+38 ECU_ADDRESS 0x0000 /* @ECU_Address@rtDW_ADAS.GTmLEDfilterobj1.GTDelay6_DSTATE@ */ /end MEASUREMENT
/begin MEASUREMENT rtDW_ADAS.GTmLEDfilterobj1.GTDelay7_DSTATE "" FLOAT32_IEEE ADAS_CM_single 0 0 -3.4E+38 3.4E+38 ECU_ADDRESS 0x0000 /* @ECU_Address@rtDW_ADAS.GTmLEDfilterobj1.GTDelay7_DSTATE@ */ /end MEASUREMENT
/begin MEASUREMENT rtDW_ADAS.GTmLEDfilterobj1.GTDelay8_DSTATE "" FLOAT32_IEEE ADAS_CM_single 0 0 -3.4E+38 3.4E+38 ECU_ADDRESS 0x0000 /* @ECU_Address@rtDW_ADAS.GTmLEDfilterobj1.GTDelay8_DSTATE@ */ /end MEASUREMENT
/begin MEASUREMENT rtDW_ADAS.GTmLEDfilterobj1.GTDelay9_DSTATE "" FLOAT32_IEEE ADAS_CM_single 0 0 -3.4E+38 3.4E+38 ECU_ADDRESS 0x0000 /* @ECU_Address@rtDW_ADAS.GTmLEDfilterobj1.GTDelay9_DSTATE@ */ /end MEASUREMENT
/begin MEASUREMENT rtDW_ADAS.GTmLEDfilterobj1.GTDelayInput1_DSTATE "" UBYTE ADAS_CM_uint8 0 0 0 255 ECU_ADDRESS 0x0000 /* @ECU_Address@rtDW_ADAS.GTmLEDfilterobj1.GTDelayInput1_DSTATE@ */ /end MEASUREMENT
/begin MEASUREMENT rtDW_ADAS.GTmLEDfilterobj1.GTDelayInput1_DSTATE_e "" UBYTE ADAS_CM_uint8 0 0 0 255 ECU_ADDRESS 0x0000 /* @ECU_Address@rtDW_ADAS.GTmLEDfilterobj1.GTDelayInput1_DSTATE_e@ */ /end MEASUREMENT
/begin MEASUREMENT rtDW_ADAS.GTmLEDfilterobj1.GTDelayInput2_DSTATE "" FLOAT32_IEEE ADAS_CM_single 0 0 -3.4E+38 3.4E+38 ECU_ADDRESS 0x0000 /* @ECU_Address@rtDW_ADAS.GTmLEDfilterobj1.GTDelayInput2_DSTATE@ */ /end MEASUREMENT
/begin MEASUREMENT rtDW_ADAS.GTmLEDfilterobj1.GTDelayInput2_DSTATE_f "" FLOAT32_IEEE ADAS_CM_single 0 0 -3.4E+38 3.4E+38 ECU_ADDRESS 0x0000 /* @ECU_Address@rtDW_ADAS.GTmLEDfilterobj1.GTDelayInput2_DSTATE_f@ */ /end MEASUREMENT
/begin MEASUREMENT rtDW_ADAS.GTmLEDfilterobj1_m.GTDelay6_DSTATE "" FLOAT32_IEEE ADAS_CM_single 0 0 -3.4E+38 3.4E+38 ECU_ADDRESS 0x0000 /* @ECU_Address@rtDW_ADAS.GTmLEDfilterobj1_m.GTDelay6_DSTATE@ */ /end MEASUREMENT
/begin MEASUREMENT rtDW_ADAS.GTmLEDfilterobj1_m.GTDelay7_DSTATE "" FLOAT32_IEEE ADAS_CM_single 0 0 -3.4E+38 3.4E+38 ECU_ADDRESS 0x0000 /* @ECU_Address@rtDW_ADAS.GTmLEDfilterobj1_m.GTDelay7_DSTATE@ */ /end MEASUREMENT
/begin MEASUREMENT rtDW_ADAS.GTmLEDfilterobj1_m.GTDelay8_DSTATE "" FLOAT32_IEEE ADAS_CM_single 0 0 -3.4E+38 3.4E+38 ECU_ADDRESS 0x0000 /* @ECU_Address@rtDW_ADAS.GTmLEDfilterobj1_m.GTDelay8_DSTATE@ */ /end MEASUREMENT
/begin MEASUREMENT rtDW_ADAS.GTmLEDfilterobj1_m.GTDelay9_DSTATE "" FLOAT32_IEEE ADAS_CM_single 0 0 -3.4E+38 3.4E+38 ECU_ADDRESS 0x0000 /* @ECU_Address@rtDW_ADAS.GTmLEDfilterobj1_m.GTDelay9_DSTATE@ */ /end MEASUREMENT
/begin MEASUREMENT rtDW_ADAS.GTmLEDfilterobj1_m.GTDelayInput1_DSTATE "" UBYTE ADAS_CM_uint8 0 0 0 255 ECU_ADDRESS 0x0000 /* @ECU_Address@rtDW_ADAS.GTmLEDfilterobj1_m.GTDelayInput1_DSTATE@ */ /end MEASUREMENT
/begin MEASUREMENT rtDW_ADAS.GTmLEDfilterobj1_m.GTDelayInput1_DSTATE_e "" UBYTE ADAS_CM_uint8 0 0 0 255 ECU_ADDRESS 0x0000 /* @ECU_Address@rtDW_ADAS.GTmLEDfilterobj1_m.GTDelayInput1_DSTATE_e@ */ /end MEASUREMENT
/begin MEASUREMENT rtDW_ADAS.GTmLEDfilterobj1_m.GTDelayInput2_DSTATE "" FLOAT32_IEEE ADAS_CM_single 0 0 -3.4E+38 3.4E+38 ECU_ADDRESS 0x0000 /* @ECU_Address@rtDW_ADAS.GTmLEDfilterobj1_m.GTDelayInput2_DSTATE@ */ /end MEASUREMENT
/begin MEASUREMENT rtDW_ADAS.GTmLEDfilterobj1_m.GTDelayInput2_DSTATE_f "" FLOAT32_IEEE ADAS_CM_single 0 0 -3.4E+38 3.4E+38 ECU_ADDRESS 0x0000 /* @ECU_Address@rtDW_ADAS.GTmLEDfilterobj1_m.GTDelayInput2_DSTATE_f@ */ /end MEASUREMENT
/begin MEASUREMENT rtDW_ADAS.GTmLEDfilterobj2.GTDelay6_DSTATE "" FLOAT32_IEEE ADAS_CM_single 0 0 -3.4E+38 3.4E+38 ECU_ADDRESS 0x0000 /* @ECU_Address@rtDW_ADAS.GTmLEDfilterobj2.GTDelay6_DSTATE@ */ /end MEASUREMENT
/begin MEASUREMENT rtDW_ADAS.GTmLEDfilterobj2.GTDelay7_DSTATE "" FLOAT32_IEEE ADAS_CM_single 0 0 -3.4E+38 3.4E+38 ECU_ADDRESS 0x0000 /* @ECU_Address@rtDW_ADAS.GTmLEDfilterobj2.GTDelay7_DSTATE@ */ /end MEASUREMENT
/begin MEASUREMENT rtDW_ADAS.GTmLEDfilterobj2.GTDelay8_DSTATE "" FLOAT32_IEEE ADAS_CM_single 0 0 -3.4E+38 3.4E+38 ECU_ADDRESS 0x0000 /* @ECU_Address@rtDW_ADAS.GTmLEDfilterobj2.GTDelay8_DSTATE@ */ /end MEASUREMENT
/begin MEASUREMENT rtDW_ADAS.GTmLEDfilterobj2.GTDelay9_DSTATE "" FLOAT32_IEEE ADAS_CM_single 0 0 -3.4E+38 3.4E+38 ECU_ADDRESS 0x0000 /* @ECU_Address@rtDW_ADAS.GTmLEDfilterobj2.GTDelay9_DSTATE@ */ /end MEASUREMENT
/begin MEASUREMENT rtDW_ADAS.GTmLEDfilterobj2.GTDelayInput1_DSTATE "" UBYTE ADAS_CM_uint8 0 0 0 255 ECU_ADDRESS 0x0000 /* @ECU_Address@rtDW_ADAS.GTmLEDfilterobj2.GTDelayInput1_DSTATE@ */ /end MEASUREMENT
/begin MEASUREMENT rtDW_ADAS.GTmLEDfilterobj2.GTDelayInput1_DSTATE_e "" UBYTE ADAS_CM_uint8 0 0 0 255 ECU_ADDRESS 0x0000 /* @ECU_Address@rtDW_ADAS.GTmLEDfilterobj2.GTDelayInput1_DSTATE_e@ */ /end MEASUREMENT
/begin MEASUREMENT rtDW_ADAS.GTmLEDfilterobj2.GTDelayInput2_DSTATE "" FLOAT32_IEEE ADAS_CM_single 0 0 -3.4E+38 3.4E+38 ECU_ADDRESS 0x0000 /* @ECU_Address@rtDW_ADAS.GTmLEDfilterobj2.GTDelayInput2_DSTATE@ */ /end MEASUREMENT
/begin MEASUREMENT rtDW_ADAS.GTmLEDfilterobj2.GTDelayInput2_DSTATE_f "" FLOAT32_IEEE ADAS_CM_single 0 0 -3.4E+38 3.4E+38 ECU_ADDRESS 0x0000 /* @ECU_Address@rtDW_ADAS.GTmLEDfilterobj2.GTDelayInput2_DSTATE_f@ */ /end MEASUREMENT
/begin MEASUREMENT rtDW_ADAS.GTmLEDfilterobj2_j.GTDelay6_DSTATE "" FLOAT32_IEEE ADAS_CM_single 0 0 -3.4E+38 3.4E+38 ECU_ADDRESS 0x0000 /* @ECU_Address@rtDW_ADAS.GTmLEDfilterobj2_j.GTDelay6_DSTATE@ */ /end MEASUREMENT
/begin MEASUREMENT rtDW_ADAS.GTmLEDfilterobj2_j.GTDelay7_DSTATE "" FLOAT32_IEEE ADAS_CM_single 0 0 -3.4E+38 3.4E+38 ECU_ADDRESS 0x0000 /* @ECU_Address@rtDW_ADAS.GTmLEDfilterobj2_j.GTDelay7_DSTATE@ */ /end MEASUREMENT
/begin MEASUREMENT rtDW_ADAS.GTmLEDfilterobj2_j.GTDelay8_DSTATE "" FLOAT32_IEEE ADAS_CM_single 0 0 -3.4E+38 3.4E+38 ECU_ADDRESS 0x0000 /* @ECU_Address@rtDW_ADAS.GTmLEDfilterobj2_j.GTDelay8_DSTATE@ */ /end MEASUREMENT
/begin MEASUREMENT rtDW_ADAS.GTmLEDfilterobj2_j.GTDelay9_DSTATE "" FLOAT32_IEEE ADAS_CM_single 0 0 -3.4E+38 3.4E+38 ECU_ADDRESS 0x0000 /* @ECU_Address@rtDW_ADAS.GTmLEDfilterobj2_j.GTDelay9_DSTATE@ */ /end MEASUREMENT
/begin MEASUREMENT rtDW_ADAS.GTmLEDfilterobj2_j.GTDelayInput1_DSTATE "" UBYTE ADAS_CM_uint8 0 0 0 255 ECU_ADDRESS 0x0000 /* @ECU_Address@rtDW_ADAS.GTmLEDfilterobj2_j.GTDelayInput1_DSTATE@ */ /end MEASUREMENT
/begin MEASUREMENT rtDW_ADAS.GTmLEDfilterobj2_j.GTDelayInput1_DSTATE_e "" UBYTE ADAS_CM_uint8 0 0 0 255 ECU_ADDRESS 0x0000 /* @ECU_Address@rtDW_ADAS.GTmLEDfilterobj2_j.GTDelayInput1_DSTATE_e@ */ /end MEASUREMENT
/begin MEASUREMENT rtDW_ADAS.GTmLEDfilterobj2_j.GTDelayInput2_DSTATE "" FLOAT32_IEEE ADAS_CM_single 0 0 -3.4E+38 3.4E+38 ECU_ADDRESS 0x0000 /* @ECU_Address@rtDW_ADAS.GTmLEDfilterobj2_j.GTDelayInput2_DSTATE@ */ /end MEASUREMENT
/begin MEASUREMENT rtDW_ADAS.GTmLEDfilterobj2_j.GTDelayInput2_DSTATE_f "" FLOAT32_IEEE ADAS_CM_single 0 0 -3.4E+38 3.4E+38 ECU_ADDRESS 0x0000 /* @ECU_Address@rtDW_ADAS.GTmLEDfilterobj2_j.GTDelayInput2_DSTATE_f@ */ /end MEASUREMENT
/begin MEASUREMENT rtDW_ADAS.GTmLEDfilterobj3.GTDelay6_DSTATE "" FLOAT32_IEEE ADAS_CM_single 0 0 -3.4E+38 3.4E+38 ECU_ADDRESS 0x0000 /* @ECU_Address@rtDW_ADAS.GTmLEDfilterobj3.GTDelay6_DSTATE@ */ /end MEASUREMENT
/begin MEASUREMENT rtDW_ADAS.GTmLEDfilterobj3.GTDelay7_DSTATE "" FLOAT32_IEEE ADAS_CM_single 0 0 -3.4E+38 3.4E+38 ECU_ADDRESS 0x0000 /* @ECU_Address@rtDW_ADAS.GTmLEDfilterobj3.GTDelay7_DSTATE@ */ /end MEASUREMENT
/begin MEASUREMENT rtDW_ADAS.GTmLEDfilterobj3.GTDelay8_DSTATE "" FLOAT32_IEEE ADAS_CM_single 0 0 -3.4E+38 3.4E+38 ECU_ADDRESS 0x0000 /* @ECU_Address@rtDW_ADAS.GTmLEDfilterobj3.GTDelay8_DSTATE@ */ /end MEASUREMENT
/begin MEASUREMENT rtDW_ADAS.GTmLEDfilterobj3.GTDelay9_DSTATE "" FLOAT32_IEEE ADAS_CM_single 0 0 -3.4E+38 3.4E+38 ECU_ADDRESS 0x0000 /* @ECU_Address@rtDW_ADAS.GTmLEDfilterobj3.GTDelay9_DSTATE@ */ /end MEASUREMENT
/begin MEASUREMENT rtDW_ADAS.GTmLEDfilterobj3.GTDelayInput1_DSTATE "" UBYTE ADAS_CM_uint8 0 0 0 255 ECU_ADDRESS 0x0000 /* @ECU_Address@rtDW_ADAS.GTmLEDfilterobj3.GTDelayInput1_DSTATE@ */ /end MEASUREMENT
/begin MEASUREMENT rtDW_ADAS.GTmLEDfilterobj3.GTDelayInput1_DSTATE_e "" UBYTE ADAS_CM_uint8 0 0 0 255 ECU_ADDRESS 0x0000 /* @ECU_Address@rtDW_ADAS.GTmLEDfilterobj3.GTDelayInput1_DSTATE_e@ */ /end MEASUREMENT
/begin MEASUREMENT rtDW_ADAS.GTmLEDfilterobj3.GTDelayInput2_DSTATE "" FLOAT32_IEEE ADAS_CM_single 0 0 -3.4E+38 3.4E+38 ECU_ADDRESS 0x0000 /* @ECU_Address@rtDW_ADAS.GTmLEDfilterobj3.GTDelayInput2_DSTATE@ */ /end MEASUREMENT
/begin MEASUREMENT rtDW_ADAS.GTmLEDfilterobj3.GTDelayInput2_DSTATE_f "" FLOAT32_IEEE ADAS_CM_single 0 0 -3.4E+38 3.4E+38 ECU_ADDRESS 0x0000 /* @ECU_Address@rtDW_ADAS.GTmLEDfilterobj3.GTDelayInput2_DSTATE_f@ */ /end MEASUREMENT
/begin MEASUREMENT rtDW_ADAS.GTmLEDfilterobj3_n.GTDelay6_DSTATE "" FLOAT32_IEEE ADAS_CM_single 0 0 -3.4E+38 3.4E+38 ECU_ADDRESS 0x0000 /* @ECU_Address@rtDW_ADAS.GTmLEDfilterobj3_n.GTDelay6_DSTATE@ */ /end MEASUREMENT
/begin MEASUREMENT rtDW_ADAS.GTmLEDfilterobj3_n.GTDelay7_DSTATE "" FLOAT32_IEEE ADAS_CM_single 0 0 -3.4E+38 3.4E+38 ECU_ADDRESS 0x0000 /* @ECU_Address@rtDW_ADAS.GTmLEDfilterobj3_n.GTDelay7_DSTATE@ */ /end MEASUREMENT
/begin MEASUREMENT rtDW_ADAS.GTmLEDfilterobj3_n.GTDelay8_DSTATE "" FLOAT32_IEEE ADAS_CM_single 0 0 -3.4E+38 3.4E+38 ECU_ADDRESS 0x0000 /* @ECU_Address@rtDW_ADAS.GTmLEDfilterobj3_n.GTDelay8_DSTATE@ */ /end MEASUREMENT
/begin MEASUREMENT rtDW_ADAS.GTmLEDfilterobj3_n.GTDelay9_DSTATE "" FLOAT32_IEEE ADAS_CM_single 0 0 -3.4E+38 3.4E+38 ECU_ADDRESS 0x0000 /* @ECU_Address@rtDW_ADAS.GTmLEDfilterobj3_n.GTDelay9_DSTATE@ */ /end MEASUREMENT
/begin MEASUREMENT rtDW_ADAS.GTmLEDfilterobj3_n.GTDelayInput1_DSTATE "" UBYTE ADAS_CM_uint8 0 0 0 255 ECU_ADDRESS 0x0000 /* @ECU_Address@rtDW_ADAS.GTmLEDfilterobj3_n.GTDelayInput1_DSTATE@ */ /end MEASUREMENT
/begin MEASUREMENT rtDW_ADAS.GTmLEDfilterobj3_n.GTDelayInput1_DSTATE_e "" UBYTE ADAS_CM_uint8 0 0 0 255 ECU_ADDRESS 0x0000 /* @ECU_Address@rtDW_ADAS.GTmLEDfilterobj3_n.GTDelayInput1_DSTATE_e@ */ /end MEASUREMENT
/begin MEASUREMENT rtDW_ADAS.GTmLEDfilterobj3_n.GTDelayInput2_DSTATE "" FLOAT32_IEEE ADAS_CM_single 0 0 -3.4E+38 3.4E+38 ECU_ADDRESS 0x0000 /* @ECU_Address@rtDW_ADAS.GTmLEDfilterobj3_n.GTDelayInput2_DSTATE@ */ /end MEASUREMENT
/begin MEASUREMENT rtDW_ADAS.GTmLEDfilterobj3_n.GTDelayInput2_DSTATE_f "" FLOAT32_IEEE ADAS_CM_single 0 0 -3.4E+38 3.4E+38 ECU_ADDRESS 0x0000 /* @ECU_Address@rtDW_ADAS.GTmLEDfilterobj3_n.GTDelayInput2_DSTATE_f@ */ /end MEASUREMENT
/begin MEASUREMENT rtDW_ADAS.GTmLEDfilterobj4.GTDelay6_DSTATE "" FLOAT32_IEEE ADAS_CM_single 0 0 -3.4E+38 3.4E+38 ECU_ADDRESS 0x0000 /* @ECU_Address@rtDW_ADAS.GTmLEDfilterobj4.GTDelay6_DSTATE@ */ /end MEASUREMENT
/begin MEASUREMENT rtDW_ADAS.GTmLEDfilterobj4.GTDelay7_DSTATE "" FLOAT32_IEEE ADAS_CM_single 0 0 -3.4E+38 3.4E+38 ECU_ADDRESS 0x0000 /* @ECU_Address@rtDW_ADAS.GTmLEDfilterobj4.GTDelay7_DSTATE@ */ /end MEASUREMENT
/begin MEASUREMENT rtDW_ADAS.GTmLEDfilterobj4.GTDelay8_DSTATE "" FLOAT32_IEEE ADAS_CM_single 0 0 -3.4E+38 3.4E+38 ECU_ADDRESS 0x0000 /* @ECU_Address@rtDW_ADAS.GTmLEDfilterobj4.GTDelay8_DSTATE@ */ /end MEASUREMENT
/begin MEASUREMENT rtDW_ADAS.GTmLEDfilterobj4.GTDelay9_DSTATE "" FLOAT32_IEEE ADAS_CM_single 0 0 -3.4E+38 3.4E+38 ECU_ADDRESS 0x0000 /* @ECU_Address@rtDW_ADAS.GTmLEDfilterobj4.GTDelay9_DSTATE@ */ /end MEASUREMENT
/begin MEASUREMENT rtDW_ADAS.GTmLEDfilterobj4.GTDelayInput1_DSTATE "" UBYTE ADAS_CM_uint8 0 0 0 255 ECU_ADDRESS 0x0000 /* @ECU_Address@rtDW_ADAS.GTmLEDfilterobj4.GTDelayInput1_DSTATE@ */ /end MEASUREMENT
/begin MEASUREMENT rtDW_ADAS.GTmLEDfilterobj4.GTDelayInput1_DSTATE_e "" UBYTE ADAS_CM_uint8 0 0 0 255 ECU_ADDRESS 0x0000 /* @ECU_Address@rtDW_ADAS.GTmLEDfilterobj4.GTDelayInput1_DSTATE_e@ */ /end MEASUREMENT
/begin MEASUREMENT rtDW_ADAS.GTmLEDfilterobj4.GTDelayInput2_DSTATE "" FLOAT32_IEEE ADAS_CM_single 0 0 -3.4E+38 3.4E+38 ECU_ADDRESS 0x0000 /* @ECU_Address@rtDW_ADAS.GTmLEDfilterobj4.GTDelayInput2_DSTATE@ */ /end MEASUREMENT
/begin MEASUREMENT rtDW_ADAS.GTmLEDfilterobj4.GTDelayInput2_DSTATE_f "" FLOAT32_IEEE ADAS_CM_single 0 0 -3.4E+38 3.4E+38 ECU_ADDRESS 0x0000 /* @ECU_Address@rtDW_ADAS.GTmLEDfilterobj4.GTDelayInput2_DSTATE_f@ */ /end MEASUREMENT
/begin MEASUREMENT rtDW_ADAS.GTmLEDfilterobj4_j.GTDelay6_DSTATE "" FLOAT32_IEEE ADAS_CM_single 0 0 -3.4E+38 3.4E+38 ECU_ADDRESS 0x0000 /* @ECU_Address@rtDW_ADAS.GTmLEDfilterobj4_j.GTDelay6_DSTATE@ */ /end MEASUREMENT
/begin MEASUREMENT rtDW_ADAS.GTmLEDfilterobj4_j.GTDelay7_DSTATE "" FLOAT32_IEEE ADAS_CM_single 0 0 -3.4E+38 3.4E+38 ECU_ADDRESS 0x0000 /* @ECU_Address@rtDW_ADAS.GTmLEDfilterobj4_j.GTDelay7_DSTATE@ */ /end MEASUREMENT
/begin MEASUREMENT rtDW_ADAS.GTmLEDfilterobj4_j.GTDelay8_DSTATE "" FLOAT32_IEEE ADAS_CM_single 0 0 -3.4E+38 3.4E+38 ECU_ADDRESS 0x0000 /* @ECU_Address@rtDW_ADAS.GTmLEDfilterobj4_j.GTDelay8_DSTATE@ */ /end MEASUREMENT
/begin MEASUREMENT rtDW_ADAS.GTmLEDfilterobj4_j.GTDelay9_DSTATE "" FLOAT32_IEEE ADAS_CM_single 0 0 -3.4E+38 3.4E+38 ECU_ADDRESS 0x0000 /* @ECU_Address@rtDW_ADAS.GTmLEDfilterobj4_j.GTDelay9_DSTATE@ */ /end MEASUREMENT
/begin MEASUREMENT rtDW_ADAS.GTmLEDfilterobj4_j.GTDelayInput1_DSTATE "" UBYTE ADAS_CM_uint8 0 0 0 255 ECU_ADDRESS 0x0000 /* @ECU_Address@rtDW_ADAS.GTmLEDfilterobj4_j.GTDelayInput1_DSTATE@ */ /end MEASUREMENT
/begin MEASUREMENT rtDW_ADAS.GTmLEDfilterobj4_j.GTDelayInput1_DSTATE_e "" UBYTE ADAS_CM_uint8 0 0 0 255 ECU_ADDRESS 0x0000 /* @ECU_Address@rtDW_ADAS.GTmLEDfilterobj4_j.GTDelayInput1_DSTATE_e@ */ /end MEASUREMENT
/begin MEASUREMENT rtDW_ADAS.GTmLEDfilterobj4_j.GTDelayInput2_DSTATE "" FLOAT32_IEEE ADAS_CM_single 0 0 -3.4E+38 3.4E+38 ECU_ADDRESS 0x0000 /* @ECU_Address@rtDW_ADAS.GTmLEDfilterobj4_j.GTDelayInput2_DSTATE@ */ /end MEASUREMENT
/begin MEASUREMENT rtDW_ADAS.GTmLEDfilterobj4_j.GTDelayInput2_DSTATE_f "" FLOAT32_IEEE ADAS_CM_single 0 0 -3.4E+38 3.4E+38 ECU_ADDRESS 0x0000 /* @ECU_Address@rtDW_ADAS.GTmLEDfilterobj4_j.GTDelayInput2_DSTATE_f@ */ /end MEASUREMENT
/begin MEASUREMENT rtDW_ADAS.GTmLEDfilterobj5.GTDelay6_DSTATE "" FLOAT32_IEEE ADAS_CM_single 0 0 -3.4E+38 3.4E+38 ECU_ADDRESS 0x0000 /* @ECU_Address@rtDW_ADAS.GTmLEDfilterobj5.GTDelay6_DSTATE@ */ /end MEASUREMENT
/begin MEASUREMENT rtDW_ADAS.GTmLEDfilterobj5.GTDelay7_DSTATE "" FLOAT32_IEEE ADAS_CM_single 0 0 -3.4E+38 3.4E+38 ECU_ADDRESS 0x0000 /* @ECU_Address@rtDW_ADAS.GTmLEDfilterobj5.GTDelay7_DSTATE@ */ /end MEASUREMENT
/begin MEASUREMENT rtDW_ADAS.GTmLEDfilterobj5.GTDelay8_DSTATE "" FLOAT32_IEEE ADAS_CM_single 0 0 -3.4E+38 3.4E+38 ECU_ADDRESS 0x0000 /* @ECU_Address@rtDW_ADAS.GTmLEDfilterobj5.GTDelay8_DSTATE@ */ /end MEASUREMENT
/begin MEASUREMENT rtDW_ADAS.GTmLEDfilterobj5.GTDelay9_DSTATE "" FLOAT32_IEEE ADAS_CM_single 0 0 -3.4E+38 3.4E+38 ECU_ADDRESS 0x0000 /* @ECU_Address@rtDW_ADAS.GTmLEDfilterobj5.GTDelay9_DSTATE@ */ /end MEASUREMENT
/begin MEASUREMENT rtDW_ADAS.GTmLEDfilterobj5.GTDelayInput1_DSTATE "" UBYTE ADAS_CM_uint8 0 0 0 255 ECU_ADDRESS 0x0000 /* @ECU_Address@rtDW_ADAS.GTmLEDfilterobj5.GTDelayInput1_DSTATE@ */ /end MEASUREMENT
/begin MEASUREMENT rtDW_ADAS.GTmLEDfilterobj5.GTDelayInput1_DSTATE_e "" UBYTE ADAS_CM_uint8 0 0 0 255 ECU_ADDRESS 0x0000 /* @ECU_Address@rtDW_ADAS.GTmLEDfilterobj5.GTDelayInput1_DSTATE_e@ */ /end MEASUREMENT
/begin MEASUREMENT rtDW_ADAS.GTmLEDfilterobj5.GTDelayInput2_DSTATE "" FLOAT32_IEEE ADAS_CM_single 0 0 -3.4E+38 3.4E+38 ECU_ADDRESS 0x0000 /* @ECU_Address@rtDW_ADAS.GTmLEDfilterobj5.GTDelayInput2_DSTATE@ */ /end MEASUREMENT
/begin MEASUREMENT rtDW_ADAS.GTmLEDfilterobj5.GTDelayInput2_DSTATE_f "" FLOAT32_IEEE ADAS_CM_single 0 0 -3.4E+38 3.4E+38 ECU_ADDRESS 0x0000 /* @ECU_Address@rtDW_ADAS.GTmLEDfilterobj5.GTDelayInput2_DSTATE_f@ */ /end MEASUREMENT
/begin MEASUREMENT rtDW_ADAS.GTmLEDfilterobj5_n.GTDelay6_DSTATE "" FLOAT32_IEEE ADAS_CM_single 0 0 -3.4E+38 3.4E+38 ECU_ADDRESS 0x0000 /* @ECU_Address@rtDW_ADAS.GTmLEDfilterobj5_n.GTDelay6_DSTATE@ */ /end MEASUREMENT
/begin MEASUREMENT rtDW_ADAS.GTmLEDfilterobj5_n.GTDelay7_DSTATE "" FLOAT32_IEEE ADAS_CM_single 0 0 -3.4E+38 3.4E+38 ECU_ADDRESS 0x0000 /* @ECU_Address@rtDW_ADAS.GTmLEDfilterobj5_n.GTDelay7_DSTATE@ */ /end MEASUREMENT
/begin MEASUREMENT rtDW_ADAS.GTmLEDfilterobj5_n.GTDelay8_DSTATE "" FLOAT32_IEEE ADAS_CM_single 0 0 -3.4E+38 3.4E+38 ECU_ADDRESS 0x0000 /* @ECU_Address@rtDW_ADAS.GTmLEDfilterobj5_n.GTDelay8_DSTATE@ */ /end MEASUREMENT
/begin MEASUREMENT rtDW_ADAS.GTmLEDfilterobj5_n.GTDelay9_DSTATE "" FLOAT32_IEEE ADAS_CM_single 0 0 -3.4E+38 3.4E+38 ECU_ADDRESS 0x0000 /* @ECU_Address@rtDW_ADAS.GTmLEDfilterobj5_n.GTDelay9_DSTATE@ */ /end MEASUREMENT
/begin MEASUREMENT rtDW_ADAS.GTmLEDfilterobj5_n.GTDelayInput1_DSTATE "" UBYTE ADAS_CM_uint8 0 0 0 255 ECU_ADDRESS 0x0000 /* @ECU_Address@rtDW_ADAS.GTmLEDfilterobj5_n.GTDelayInput1_DSTATE@ */ /end MEASUREMENT
/begin MEASUREMENT rtDW_ADAS.GTmLEDfilterobj5_n.GTDelayInput1_DSTATE_e "" UBYTE ADAS_CM_uint8 0 0 0 255 ECU_ADDRESS 0x0000 /* @ECU_Address@rtDW_ADAS.GTmLEDfilterobj5_n.GTDelayInput1_DSTATE_e@ */ /end MEASUREMENT
/begin MEASUREMENT rtDW_ADAS.GTmLEDfilterobj5_n.GTDelayInput2_DSTATE "" FLOAT32_IEEE ADAS_CM_single 0 0 -3.4E+38 3.4E+38 ECU_ADDRESS 0x0000 /* @ECU_Address@rtDW_ADAS.GTmLEDfilterobj5_n.GTDelayInput2_DSTATE@ */ /end MEASUREMENT
/begin MEASUREMENT rtDW_ADAS.GTmLEDfilterobj5_n.GTDelayInput2_DSTATE_f "" FLOAT32_IEEE ADAS_CM_single 0 0 -3.4E+38 3.4E+38 ECU_ADDRESS 0x0000 /* @ECU_Address@rtDW_ADAS.GTmLEDfilterobj5_n.GTDelayInput2_DSTATE_f@ */ /end MEASUREMENT
/begin MEASUREMENT rtDW_ADAS.GTmLEDfilterobj6.GTDelay6_DSTATE "" FLOAT32_IEEE ADAS_CM_single 0 0 -3.4E+38 3.4E+38 ECU_ADDRESS 0x0000 /* @ECU_Address@rtDW_ADAS.GTmLEDfilterobj6.GTDelay6_DSTATE@ */ /end MEASUREMENT
/begin MEASUREMENT rtDW_ADAS.GTmLEDfilterobj6.GTDelay7_DSTATE "" FLOAT32_IEEE ADAS_CM_single 0 0 -3.4E+38 3.4E+38 ECU_ADDRESS 0x0000 /* @ECU_Address@rtDW_ADAS.GTmLEDfilterobj6.GTDelay7_DSTATE@ */ /end MEASUREMENT
/begin MEASUREMENT rtDW_ADAS.GTmLEDfilterobj6.GTDelay8_DSTATE "" FLOAT32_IEEE ADAS_CM_single 0 0 -3.4E+38 3.4E+38 ECU_ADDRESS 0x0000 /* @ECU_Address@rtDW_ADAS.GTmLEDfilterobj6.GTDelay8_DSTATE@ */ /end MEASUREMENT
/begin MEASUREMENT rtDW_ADAS.GTmLEDfilterobj6.GTDelay9_DSTATE "" FLOAT32_IEEE ADAS_CM_single 0 0 -3.4E+38 3.4E+38 ECU_ADDRESS 0x0000 /* @ECU_Address@rtDW_ADAS.GTmLEDfilterobj6.GTDelay9_DSTATE@ */ /end MEASUREMENT
/begin MEASUREMENT rtDW_ADAS.GTmLEDfilterobj6.GTDelayInput1_DSTATE "" UBYTE ADAS_CM_uint8 0 0 0 255 ECU_ADDRESS 0x0000 /* @ECU_Address@rtDW_ADAS.GTmLEDfilterobj6.GTDelayInput1_DSTATE@ */ /end MEASUREMENT
/begin MEASUREMENT rtDW_ADAS.GTmLEDfilterobj6.GTDelayInput1_DSTATE_e "" UBYTE ADAS_CM_uint8 0 0 0 255 ECU_ADDRESS 0x0000 /* @ECU_Address@rtDW_ADAS.GTmLEDfilterobj6.GTDelayInput1_DSTATE_e@ */ /end MEASUREMENT
/begin MEASUREMENT rtDW_ADAS.GTmLEDfilterobj6.GTDelayInput2_DSTATE "" FLOAT32_IEEE ADAS_CM_single 0 0 -3.4E+38 3.4E+38 ECU_ADDRESS 0x0000 /* @ECU_Address@rtDW_ADAS.GTmLEDfilterobj6.GTDelayInput2_DSTATE@ */ /end MEASUREMENT
/begin MEASUREMENT rtDW_ADAS.GTmLEDfilterobj6.GTDelayInput2_DSTATE_f "" FLOAT32_IEEE ADAS_CM_single 0 0 -3.4E+38 3.4E+38 ECU_ADDRESS 0x0000 /* @ECU_Address@rtDW_ADAS.GTmLEDfilterobj6.GTDelayInput2_DSTATE_f@ */ /end MEASUREMENT
/begin MEASUREMENT rtDW_ADAS.GTmLEDfilterobj6_b.GTDelay6_DSTATE "" FLOAT32_IEEE ADAS_CM_single 0 0 -3.4E+38 3.4E+38 ECU_ADDRESS 0x0000 /* @ECU_Address@rtDW_ADAS.GTmLEDfilterobj6_b.GTDelay6_DSTATE@ */ /end MEASUREMENT
/begin MEASUREMENT rtDW_ADAS.GTmLEDfilterobj6_b.GTDelay7_DSTATE "" FLOAT32_IEEE ADAS_CM_single 0 0 -3.4E+38 3.4E+38 ECU_ADDRESS 0x0000 /* @ECU_Address@rtDW_ADAS.GTmLEDfilterobj6_b.GTDelay7_DSTATE@ */ /end MEASUREMENT
/begin MEASUREMENT rtDW_ADAS.GTmLEDfilterobj6_b.GTDelay8_DSTATE "" FLOAT32_IEEE ADAS_CM_single 0 0 -3.4E+38 3.4E+38 ECU_ADDRESS 0x0000 /* @ECU_Address@rtDW_ADAS.GTmLEDfilterobj6_b.GTDelay8_DSTATE@ */ /end MEASUREMENT
/begin MEASUREMENT rtDW_ADAS.GTmLEDfilterobj6_b.GTDelay9_DSTATE "" FLOAT32_IEEE ADAS_CM_single 0 0 -3.4E+38 3.4E+38 ECU_ADDRESS 0x0000 /* @ECU_Address@rtDW_ADAS.GTmLEDfilterobj6_b.GTDelay9_DSTATE@ */ /end MEASUREMENT
/begin MEASUREMENT rtDW_ADAS.GTmLEDfilterobj6_b.GTDelayInput1_DSTATE "" UBYTE ADAS_CM_uint8 0 0 0 255 ECU_ADDRESS 0x0000 /* @ECU_Address@rtDW_ADAS.GTmLEDfilterobj6_b.GTDelayInput1_DSTATE@ */ /end MEASUREMENT
/begin MEASUREMENT rtDW_ADAS.GTmLEDfilterobj6_b.GTDelayInput1_DSTATE_e "" UBYTE ADAS_CM_uint8 0 0 0 255 ECU_ADDRESS 0x0000 /* @ECU_Address@rtDW_ADAS.GTmLEDfilterobj6_b.GTDelayInput1_DSTATE_e@ */ /end MEASUREMENT
/begin MEASUREMENT rtDW_ADAS.GTmLEDfilterobj6_b.GTDelayInput2_DSTATE "" FLOAT32_IEEE ADAS_CM_single 0 0 -3.4E+38 3.4E+38 ECU_ADDRESS 0x0000 /* @ECU_Address@rtDW_ADAS.GTmLEDfilterobj6_b.GTDelayInput2_DSTATE@ */ /end MEASUREMENT
/begin MEASUREMENT rtDW_ADAS.GTmLEDfilterobj6_b.GTDelayInput2_DSTATE_f "" FLOAT32_IEEE ADAS_CM_single 0 0 -3.4E+38 3.4E+38 ECU_ADDRESS 0x0000 /* @ECU_Address@rtDW_ADAS.GTmLEDfilterobj6_b.GTDelayInput2_DSTATE_f@ */ /end MEASUREMENT
/begin MEASUREMENT rtDW_ADAS.GTmLEDfilterobj7.GTDelay6_DSTATE "" FLOAT32_IEEE ADAS_CM_single 0 0 -3.4E+38 3.4E+38 ECU_ADDRESS 0x0000 /* @ECU_Address@rtDW_ADAS.GTmLEDfilterobj7.GTDelay6_DSTATE@ */ /end MEASUREMENT
/begin MEASUREMENT rtDW_ADAS.GTmLEDfilterobj7.GTDelay7_DSTATE "" FLOAT32_IEEE ADAS_CM_single 0 0 -3.4E+38 3.4E+38 ECU_ADDRESS 0x0000 /* @ECU_Address@rtDW_ADAS.GTmLEDfilterobj7.GTDelay7_DSTATE@ */ /end MEASUREMENT
/begin MEASUREMENT rtDW_ADAS.GTmLEDfilterobj7.GTDelay8_DSTATE "" FLOAT32_IEEE ADAS_CM_single 0 0 -3.4E+38 3.4E+38 ECU_ADDRESS 0x0000 /* @ECU_Address@rtDW_ADAS.GTmLEDfilterobj7.GTDelay8_DSTATE@ */ /end MEASUREMENT
/begin MEASUREMENT rtDW_ADAS.GTmLEDfilterobj7.GTDelay9_DSTATE "" FLOAT32_IEEE ADAS_CM_single 0 0 -3.4E+38 3.4E+38 ECU_ADDRESS 0x0000 /* @ECU_Address@rtDW_ADAS.GTmLEDfilterobj7.GTDelay9_DSTATE@ */ /end MEASUREMENT
/begin MEASUREMENT rtDW_ADAS.GTmLEDfilterobj7.GTDelayInput1_DSTATE "" UBYTE ADAS_CM_uint8 0 0 0 255 ECU_ADDRESS 0x0000 /* @ECU_Address@rtDW_ADAS.GTmLEDfilterobj7.GTDelayInput1_DSTATE@ */ /end MEASUREMENT
/begin MEASUREMENT rtDW_ADAS.GTmLEDfilterobj7.GTDelayInput1_DSTATE_e "" UBYTE ADAS_CM_uint8 0 0 0 255 ECU_ADDRESS 0x0000 /* @ECU_Address@rtDW_ADAS.GTmLEDfilterobj7.GTDelayInput1_DSTATE_e@ */ /end MEASUREMENT
/begin MEASUREMENT rtDW_ADAS.GTmLEDfilterobj7.GTDelayInput2_DSTATE "" FLOAT32_IEEE ADAS_CM_single 0 0 -3.4E+38 3.4E+38 ECU_ADDRESS 0x0000 /* @ECU_Address@rtDW_ADAS.GTmLEDfilterobj7.GTDelayInput2_DSTATE@ */ /end MEASUREMENT
/begin MEASUREMENT rtDW_ADAS.GTmLEDfilterobj7.GTDelayInput2_DSTATE_f "" FLOAT32_IEEE ADAS_CM_single 0 0 -3.4E+38 3.4E+38 ECU_ADDRESS 0x0000 /* @ECU_Address@rtDW_ADAS.GTmLEDfilterobj7.GTDelayInput2_DSTATE_f@ */ /end MEASUREMENT
/begin MEASUREMENT rtDW_ADAS.GTmLEDfilterobj7_l.GTDelay6_DSTATE "" FLOAT32_IEEE ADAS_CM_single 0 0 -3.4E+38 3.4E+38 ECU_ADDRESS 0x0000 /* @ECU_Address@rtDW_ADAS.GTmLEDfilterobj7_l.GTDelay6_DSTATE@ */ /end MEASUREMENT
/begin MEASUREMENT rtDW_ADAS.GTmLEDfilterobj7_l.GTDelay7_DSTATE "" FLOAT32_IEEE ADAS_CM_single 0 0 -3.4E+38 3.4E+38 ECU_ADDRESS 0x0000 /* @ECU_Address@rtDW_ADAS.GTmLEDfilterobj7_l.GTDelay7_DSTATE@ */ /end MEASUREMENT
/begin MEASUREMENT rtDW_ADAS.GTmLEDfilterobj7_l.GTDelay8_DSTATE "" FLOAT32_IEEE ADAS_CM_single 0 0 -3.4E+38 3.4E+38 ECU_ADDRESS 0x0000 /* @ECU_Address@rtDW_ADAS.GTmLEDfilterobj7_l.GTDelay8_DSTATE@ */ /end MEASUREMENT
/begin MEASUREMENT rtDW_ADAS.GTmLEDfilterobj7_l.GTDelay9_DSTATE "" FLOAT32_IEEE ADAS_CM_single 0 0 -3.4E+38 3.4E+38 ECU_ADDRESS 0x0000 /* @ECU_Address@rtDW_ADAS.GTmLEDfilterobj7_l.GTDelay9_DSTATE@ */ /end MEASUREMENT
/begin MEASUREMENT rtDW_ADAS.GTmLEDfilterobj7_l.GTDelayInput1_DSTATE "" UBYTE ADAS_CM_uint8 0 0 0 255 ECU_ADDRESS 0x0000 /* @ECU_Address@rtDW_ADAS.GTmLEDfilterobj7_l.GTDelayInput1_DSTATE@ */ /end MEASUREMENT
/begin MEASUREMENT rtDW_ADAS.GTmLEDfilterobj7_l.GTDelayInput1_DSTATE_e "" UBYTE ADAS_CM_uint8 0 0 0 255 ECU_ADDRESS 0x0000 /* @ECU_Address@rtDW_ADAS.GTmLEDfilterobj7_l.GTDelayInput1_DSTATE_e@ */ /end MEASUREMENT
/begin MEASUREMENT rtDW_ADAS.GTmLEDfilterobj7_l.GTDelayInput2_DSTATE "" FLOAT32_IEEE ADAS_CM_single 0 0 -3.4E+38 3.4E+38 ECU_ADDRESS 0x0000 /* @ECU_Address@rtDW_ADAS.GTmLEDfilterobj7_l.GTDelayInput2_DSTATE@ */ /end MEASUREMENT
/begin MEASUREMENT rtDW_ADAS.GTmLEDfilterobj7_l.GTDelayInput2_DSTATE_f "" FLOAT32_IEEE ADAS_CM_single 0 0 -3.4E+38 3.4E+38 ECU_ADDRESS 0x0000 /* @ECU_Address@rtDW_ADAS.GTmLEDfilterobj7_l.GTDelayInput2_DSTATE_f@ */ /end MEASUREMENT
/begin MEASUREMENT rtDW_ADAS.GTmLEDfilterobj8.GTDelay6_DSTATE "" FLOAT32_IEEE ADAS_CM_single 0 0 -3.4E+38 3.4E+38 ECU_ADDRESS 0x0000 /* @ECU_Address@rtDW_ADAS.GTmLEDfilterobj8.GTDelay6_DSTATE@ */ /end MEASUREMENT
/begin MEASUREMENT rtDW_ADAS.GTmLEDfilterobj8.GTDelay7_DSTATE "" FLOAT32_IEEE ADAS_CM_single 0 0 -3.4E+38 3.4E+38 ECU_ADDRESS 0x0000 /* @ECU_Address@rtDW_ADAS.GTmLEDfilterobj8.GTDelay7_DSTATE@ */ /end MEASUREMENT
/begin MEASUREMENT rtDW_ADAS.GTmLEDfilterobj8.GTDelay8_DSTATE "" FLOAT32_IEEE ADAS_CM_single 0 0 -3.4E+38 3.4E+38 ECU_ADDRESS 0x0000 /* @ECU_Address@rtDW_ADAS.GTmLEDfilterobj8.GTDelay8_DSTATE@ */ /end MEASUREMENT
/begin MEASUREMENT rtDW_ADAS.GTmLEDfilterobj8.GTDelay9_DSTATE "" FLOAT32_IEEE ADAS_CM_single 0 0 -3.4E+38 3.4E+38 ECU_ADDRESS 0x0000 /* @ECU_Address@rtDW_ADAS.GTmLEDfilterobj8.GTDelay9_DSTATE@ */ /end MEASUREMENT
/begin MEASUREMENT rtDW_ADAS.GTmLEDfilterobj8.GTDelayInput1_DSTATE "" UBYTE ADAS_CM_uint8 0 0 0 255 ECU_ADDRESS 0x0000 /* @ECU_Address@rtDW_ADAS.GTmLEDfilterobj8.GTDelayInput1_DSTATE@ */ /end MEASUREMENT
/begin MEASUREMENT rtDW_ADAS.GTmLEDfilterobj8.GTDelayInput1_DSTATE_e "" UBYTE ADAS_CM_uint8 0 0 0 255 ECU_ADDRESS 0x0000 /* @ECU_Address@rtDW_ADAS.GTmLEDfilterobj8.GTDelayInput1_DSTATE_e@ */ /end MEASUREMENT
/begin MEASUREMENT rtDW_ADAS.GTmLEDfilterobj8.GTDelayInput2_DSTATE "" FLOAT32_IEEE ADAS_CM_single 0 0 -3.4E+38 3.4E+38 ECU_ADDRESS 0x0000 /* @ECU_Address@rtDW_ADAS.GTmLEDfilterobj8.GTDelayInput2_DSTATE@ */ /end MEASUREMENT
/begin MEASUREMENT rtDW_ADAS.GTmLEDfilterobj8.GTDelayInput2_DSTATE_f "" FLOAT32_IEEE ADAS_CM_single 0 0 -3.4E+38 3.4E+38 ECU_ADDRESS 0x0000 /* @ECU_Address@rtDW_ADAS.GTmLEDfilterobj8.GTDelayInput2_DSTATE_f@ */ /end MEASUREMENT
/begin MEASUREMENT rtDW_ADAS.GTmLEDfilterobj8_m.GTDelay6_DSTATE "" FLOAT32_IEEE ADAS_CM_single 0 0 -3.4E+38 3.4E+38 ECU_ADDRESS 0x0000 /* @ECU_Address@rtDW_ADAS.GTmLEDfilterobj8_m.GTDelay6_DSTATE@ */ /end MEASUREMENT
/begin MEASUREMENT rtDW_ADAS.GTmLEDfilterobj8_m.GTDelay7_DSTATE "" FLOAT32_IEEE ADAS_CM_single 0 0 -3.4E+38 3.4E+38 ECU_ADDRESS 0x0000 /* @ECU_Address@rtDW_ADAS.GTmLEDfilterobj8_m.GTDelay7_DSTATE@ */ /end MEASUREMENT
/begin MEASUREMENT rtDW_ADAS.GTmLEDfilterobj8_m.GTDelay8_DSTATE "" FLOAT32_IEEE ADAS_CM_single 0 0 -3.4E+38 3.4E+38 ECU_ADDRESS 0x0000 /* @ECU_Address@rtDW_ADAS.GTmLEDfilterobj8_m.GTDelay8_DSTATE@ */ /end MEASUREMENT
/begin MEASUREMENT rtDW_ADAS.GTmLEDfilterobj8_m.GTDelay9_DSTATE "" FLOAT32_IEEE ADAS_CM_single 0 0 -3.4E+38 3.4E+38 ECU_ADDRESS 0x0000 /* @ECU_Address@rtDW_ADAS.GTmLEDfilterobj8_m.GTDelay9_DSTATE@ */ /end MEASUREMENT
/begin MEASUREMENT rtDW_ADAS.GTmLEDfilterobj8_m.GTDelayInput1_DSTATE "" UBYTE ADAS_CM_uint8 0 0 0 255 ECU_ADDRESS 0x0000 /* @ECU_Address@rtDW_ADAS.GTmLEDfilterobj8_m.GTDelayInput1_DSTATE@ */ /end MEASUREMENT
/begin MEASUREMENT rtDW_ADAS.GTmLEDfilterobj8_m.GTDelayInput1_DSTATE_e "" UBYTE ADAS_CM_uint8 0 0 0 255 ECU_ADDRESS 0x0000 /* @ECU_Address@rtDW_ADAS.GTmLEDfilterobj8_m.GTDelayInput1_DSTATE_e@ */ /end MEASUREMENT
/begin MEASUREMENT rtDW_ADAS.GTmLEDfilterobj8_m.GTDelayInput2_DSTATE "" FLOAT32_IEEE ADAS_CM_single 0 0 -3.4E+38 3.4E+38 ECU_ADDRESS 0x0000 /* @ECU_Address@rtDW_ADAS.GTmLEDfilterobj8_m.GTDelayInput2_DSTATE@ */ /end MEASUREMENT
/begin MEASUREMENT rtDW_ADAS.GTmLEDfilterobj8_m.GTDelayInput2_DSTATE_f "" FLOAT32_IEEE ADAS_CM_single 0 0 -3.4E+38 3.4E+38 ECU_ADDRESS 0x0000 /* @ECU_Address@rtDW_ADAS.GTmLEDfilterobj8_m.GTDelayInput2_DSTATE_f@ */ /end MEASUREMENT
/begin MEASUREMENT rtDW_ADAS.GTsf_1.GTcount "" UBYTE ADAS_CM_uint8 0 0 0 255 ECU_ADDRESS 0x0000 /* @ECU_Address@rtDW_ADAS.GTsf_1.GTcount@ */ /end MEASUREMENT
/begin MEASUREMENT rtDW_ADAS.GTsf_1.GTis_active_c14_ADAS "" UBYTE ADAS_CM_uint8 0 0 0 255 ECU_ADDRESS 0x0000 /* @ECU_Address@rtDW_ADAS.GTsf_1.GTis_active_c14_ADAS@ */ /end MEASUREMENT
/begin MEASUREMENT rtDW_ADAS.GTsf_1.GTis_c14_ADAS "" UBYTE ADAS_CM_uint8 0 0 0 255 ECU_ADDRESS 0x0000 /* @ECU_Address@rtDW_ADAS.GTsf_1.GTis_c14_ADAS@ */ /end MEASUREMENT
/begin MEASUREMENT rtDW_ADAS.GTsf_1.GTtemporalCounter_i1 "" UBYTE ADAS_CM_uint8 0 0 0 255 ECU_ADDRESS 0x0000 /* @ECU_Address@rtDW_ADAS.GTsf_1.GTtemporalCounter_i1@ */ /end MEASUREMENT
/begin MEASUREMENT rtDW_ADAS.GTsf_2.GTcount "" UBYTE ADAS_CM_uint8 0 0 0 255 ECU_ADDRESS 0x0000 /* @ECU_Address@rtDW_ADAS.GTsf_2.GTcount@ */ /end MEASUREMENT
/begin MEASUREMENT rtDW_ADAS.GTsf_2.GTis_active_c14_ADAS "" UBYTE ADAS_CM_uint8 0 0 0 255 ECU_ADDRESS 0x0000 /* @ECU_Address@rtDW_ADAS.GTsf_2.GTis_active_c14_ADAS@ */ /end MEASUREMENT
/begin MEASUREMENT rtDW_ADAS.GTsf_2.GTis_c14_ADAS "" UBYTE ADAS_CM_uint8 0 0 0 255 ECU_ADDRESS 0x0000 /* @ECU_Address@rtDW_ADAS.GTsf_2.GTis_c14_ADAS@ */ /end MEASUREMENT
/begin MEASUREMENT rtDW_ADAS.GTsf_2.GTtemporalCounter_i1 "" UBYTE ADAS_CM_uint8 0 0 0 255 ECU_ADDRESS 0x0000 /* @ECU_Address@rtDW_ADAS.GTsf_2.GTtemporalCounter_i1@ */ /end MEASUREMENT
/begin MEASUREMENT rtDW_ADAS.GTsf_3.GTcount "" UBYTE ADAS_CM_uint8 0 0 0 255 ECU_ADDRESS 0x0000 /* @ECU_Address@rtDW_ADAS.GTsf_3.GTcount@ */ /end MEASUREMENT
/begin MEASUREMENT rtDW_ADAS.GTsf_3.GTis_active_c14_ADAS "" UBYTE ADAS_CM_uint8 0 0 0 255 ECU_ADDRESS 0x0000 /* @ECU_Address@rtDW_ADAS.GTsf_3.GTis_active_c14_ADAS@ */ /end MEASUREMENT
/begin MEASUREMENT rtDW_ADAS.GTsf_3.GTis_c14_ADAS "" UBYTE ADAS_CM_uint8 0 0 0 255 ECU_ADDRESS 0x0000 /* @ECU_Address@rtDW_ADAS.GTsf_3.GTis_c14_ADAS@ */ /end MEASUREMENT
/begin MEASUREMENT rtDW_ADAS.GTsf_3.GTtemporalCounter_i1 "" UBYTE ADAS_CM_uint8 0 0 0 255 ECU_ADDRESS 0x0000 /* @ECU_Address@rtDW_ADAS.GTsf_3.GTtemporalCounter_i1@ */ /end MEASUREMENT
/begin MEASUREMENT rtDW_ADAS.GTsf_4.GTcount "" UBYTE ADAS_CM_uint8 0 0 0 255 ECU_ADDRESS 0x0000 /* @ECU_Address@rtDW_ADAS.GTsf_4.GTcount@ */ /end MEASUREMENT
/begin MEASUREMENT rtDW_ADAS.GTsf_4.GTis_active_c14_ADAS "" UBYTE ADAS_CM_uint8 0 0 0 255 ECU_ADDRESS 0x0000 /* @ECU_Address@rtDW_ADAS.GTsf_4.GTis_active_c14_ADAS@ */ /end MEASUREMENT
/begin MEASUREMENT rtDW_ADAS.GTsf_4.GTis_c14_ADAS "" UBYTE ADAS_CM_uint8 0 0 0 255 ECU_ADDRESS 0x0000 /* @ECU_Address@rtDW_ADAS.GTsf_4.GTis_c14_ADAS@ */ /end MEASUREMENT
/begin MEASUREMENT rtDW_ADAS.GTsf_4.GTtemporalCounter_i1 "" UBYTE ADAS_CM_uint8 0 0 0 255 ECU_ADDRESS 0x0000 /* @ECU_Address@rtDW_ADAS.GTsf_4.GTtemporalCounter_i1@ */ /end MEASUREMENT
/begin MEASUREMENT rtDW_ADAS.GTsf_Diodeblinkdetector.GTBlinkCount "" UBYTE ADAS_CM_uint8 0 0 0 255 ECU_ADDRESS 0x0000 /* @ECU_Address@rtDW_ADAS.GTsf_Diodeblinkdetector.GTBlinkCount@ */ /end MEASUREMENT
/begin MEASUREMENT rtDW_ADAS.GTsf_Diodeblinkdetector.GTis_COUNTING "" UBYTE ADAS_CM_uint8 0 0 0 255 ECU_ADDRESS 0x0000 /* @ECU_Address@rtDW_ADAS.GTsf_Diodeblinkdetector.GTis_COUNTING@ */ /end MEASUREMENT
/begin MEASUREMENT rtDW_ADAS.GTsf_Diodeblinkdetector.GTis_WORK "" UBYTE ADAS_CM_uint8 0 0 0 255 ECU_ADDRESS 0x0000 /* @ECU_Address@rtDW_ADAS.GTsf_Diodeblinkdetector.GTis_WORK@ */ /end MEASUREMENT
/begin MEASUREMENT rtDW_ADAS.GTsf_Diodeblinkdetector.GTis_active_c471_ADAS "" UBYTE ADAS_CM_uint8 0 0 0 255 ECU_ADDRESS 0x0000 /* @ECU_Address@rtDW_ADAS.GTsf_Diodeblinkdetector.GTis_active_c471_ADAS@ */ /end MEASUREMENT
/begin MEASUREMENT rtDW_ADAS.GTsf_Diodeblinkdetector.GTis_c471_ADAS "" UBYTE ADAS_CM_uint8 0 0 0 255 ECU_ADDRESS 0x0000 /* @ECU_Address@rtDW_ADAS.GTsf_Diodeblinkdetector.GTis_c471_ADAS@ */ /end MEASUREMENT
/begin MEASUREMENT rtDW_ADAS.GTsf_Diodeblinkdetector.GTtemporalCounter_i1 "" ULONG ADAS_CM_uint32 0 0 0 4294967295 ECU_ADDRESS 0x0000 /* @ECU_Address@rtDW_ADAS.GTsf_Diodeblinkdetector.GTtemporalCounter_i1@ */ /end MEASUREMENT
/begin MEASUREMENT rtDW_ADAS.GTsf_Diodeblinkdetector_a.GTBlinkCount "" UBYTE ADAS_CM_uint8 0 0 0 255 ECU_ADDRESS 0x0000 /* @ECU_Address@rtDW_ADAS.GTsf_Diodeblinkdetector_a.GTBlinkCount@ */ /end MEASUREMENT
/begin MEASUREMENT rtDW_ADAS.GTsf_Diodeblinkdetector_a.GTis_COUNTING "" UBYTE ADAS_CM_uint8 0 0 0 255 ECU_ADDRESS 0x0000 /* @ECU_Address@rtDW_ADAS.GTsf_Diodeblinkdetector_a.GTis_COUNTING@ */ /end MEASUREMENT
/begin MEASUREMENT rtDW_ADAS.GTsf_Diodeblinkdetector_a.GTis_WORK "" UBYTE ADAS_CM_uint8 0 0 0 255 ECU_ADDRESS 0x0000 /* @ECU_Address@rtDW_ADAS.GTsf_Diodeblinkdetector_a.GTis_WORK@ */ /end MEASUREMENT
/begin MEASUREMENT rtDW_ADAS.GTsf_Diodeblinkdetector_a.GTis_active_c471_ADAS "" UBYTE ADAS_CM_uint8 0 0 0 255 ECU_ADDRESS 0x0000 /* @ECU_Address@rtDW_ADAS.GTsf_Diodeblinkdetector_a.GTis_active_c471_ADAS@ */ /end MEASUREMENT
/begin MEASUREMENT rtDW_ADAS.GTsf_Diodeblinkdetector_a.GTis_c471_ADAS "" UBYTE ADAS_CM_uint8 0 0 0 255 ECU_ADDRESS 0x0000 /* @ECU_Address@rtDW_ADAS.GTsf_Diodeblinkdetector_a.GTis_c471_ADAS@ */ /end MEASUREMENT
/begin MEASUREMENT rtDW_ADAS.GTsf_Diodeblinkdetector_a.GTtemporalCounter_i1 "" ULONG ADAS_CM_uint32 0 0 0 4294967295 ECU_ADDRESS 0x0000 /* @ECU_Address@rtDW_ADAS.GTsf_Diodeblinkdetector_a.GTtemporalCounter_i1@ */ /end MEASUREMENT
/begin MEASUREMENT rtDW_ADAS.GTsf_Diodeblinkdetector_b.GTBlinkCount "" UBYTE ADAS_CM_uint8 0 0 0 255 ECU_ADDRESS 0x0000 /* @ECU_Address@rtDW_ADAS.GTsf_Diodeblinkdetector_b.GTBlinkCount@ */ /end MEASUREMENT
/begin MEASUREMENT rtDW_ADAS.GTsf_Diodeblinkdetector_b.GTis_COUNTING "" UBYTE ADAS_CM_uint8 0 0 0 255 ECU_ADDRESS 0x0000 /* @ECU_Address@rtDW_ADAS.GTsf_Diodeblinkdetector_b.GTis_COUNTING@ */ /end MEASUREMENT
/begin MEASUREMENT rtDW_ADAS.GTsf_Diodeblinkdetector_b.GTis_WORK "" UBYTE ADAS_CM_uint8 0 0 0 255 ECU_ADDRESS 0x0000 /* @ECU_Address@rtDW_ADAS.GTsf_Diodeblinkdetector_b.GTis_WORK@ */ /end MEASUREMENT
/begin MEASUREMENT rtDW_ADAS.GTsf_Diodeblinkdetector_b.GTis_active_c471_ADAS "" UBYTE ADAS_CM_uint8 0 0 0 255 ECU_ADDRESS 0x0000 /* @ECU_Address@rtDW_ADAS.GTsf_Diodeblinkdetector_b.GTis_active_c471_ADAS@ */ /end MEASUREMENT
/begin MEASUREMENT rtDW_ADAS.GTsf_Diodeblinkdetector_b.GTis_c471_ADAS "" UBYTE ADAS_CM_uint8 0 0 0 255 ECU_ADDRESS 0x0000 /* @ECU_Address@rtDW_ADAS.GTsf_Diodeblinkdetector_b.GTis_c471_ADAS@ */ /end MEASUREMENT
/begin MEASUREMENT rtDW_ADAS.GTsf_Diodeblinkdetector_b.GTtemporalCounter_i1 "" ULONG ADAS_CM_uint32 0 0 0 4294967295 ECU_ADDRESS 0x0000 /* @ECU_Address@rtDW_ADAS.GTsf_Diodeblinkdetector_b.GTtemporalCounter_i1@ */ /end MEASUREMENT
/begin MEASUREMENT rtDW_ADAS.GTsf_Diodeblinkdetector_b3.GTBlinkCount "" UBYTE ADAS_CM_uint8 0 0 0 255 ECU_ADDRESS 0x0000 /* @ECU_Address@rtDW_ADAS.GTsf_Diodeblinkdetector_b3.GTBlinkCount@ */ /end MEASUREMENT
/begin MEASUREMENT rtDW_ADAS.GTsf_Diodeblinkdetector_b3.GTis_COUNTING "" UBYTE ADAS_CM_uint8 0 0 0 255 ECU_ADDRESS 0x0000 /* @ECU_Address@rtDW_ADAS.GTsf_Diodeblinkdetector_b3.GTis_COUNTING@ */ /end MEASUREMENT
/begin MEASUREMENT rtDW_ADAS.GTsf_Diodeblinkdetector_b3.GTis_WORK "" UBYTE ADAS_CM_uint8 0 0 0 255 ECU_ADDRESS 0x0000 /* @ECU_Address@rtDW_ADAS.GTsf_Diodeblinkdetector_b3.GTis_WORK@ */ /end MEASUREMENT
/begin MEASUREMENT rtDW_ADAS.GTsf_Diodeblinkdetector_b3.GTis_active_c471_ADAS "" UBYTE ADAS_CM_uint8 0 0 0 255 ECU_ADDRESS 0x0000 /* @ECU_Address@rtDW_ADAS.GTsf_Diodeblinkdetector_b3.GTis_active_c471_ADAS@ */ /end MEASUREMENT
/begin MEASUREMENT rtDW_ADAS.GTsf_Diodeblinkdetector_b3.GTis_c471_ADAS "" UBYTE ADAS_CM_uint8 0 0 0 255 ECU_ADDRESS 0x0000 /* @ECU_Address@rtDW_ADAS.GTsf_Diodeblinkdetector_b3.GTis_c471_ADAS@ */ /end MEASUREMENT
/begin MEASUREMENT rtDW_ADAS.GTsf_Diodeblinkdetector_b3.GTtemporalCounter_i1 "" ULONG ADAS_CM_uint32 0 0 0 4294967295 ECU_ADDRESS 0x0000 /* @ECU_Address@rtDW_ADAS.GTsf_Diodeblinkdetector_b3.GTtemporalCounter_i1@ */ /end MEASUREMENT
/begin MEASUREMENT rtDW_ADAS.GTsf_Diodeblinkdetector_b4.GTBlinkCount "" UBYTE ADAS_CM_uint8 0 0 0 255 ECU_ADDRESS 0x0000 /* @ECU_Address@rtDW_ADAS.GTsf_Diodeblinkdetector_b4.GTBlinkCount@ */ /end MEASUREMENT
/begin MEASUREMENT rtDW_ADAS.GTsf_Diodeblinkdetector_b4.GTis_COUNTING "" UBYTE ADAS_CM_uint8 0 0 0 255 ECU_ADDRESS 0x0000 /* @ECU_Address@rtDW_ADAS.GTsf_Diodeblinkdetector_b4.GTis_COUNTING@ */ /end MEASUREMENT
/begin MEASUREMENT rtDW_ADAS.GTsf_Diodeblinkdetector_b4.GTis_WORK "" UBYTE ADAS_CM_uint8 0 0 0 255 ECU_ADDRESS 0x0000 /* @ECU_Address@rtDW_ADAS.GTsf_Diodeblinkdetector_b4.GTis_WORK@ */ /end MEASUREMENT
/begin MEASUREMENT rtDW_ADAS.GTsf_Diodeblinkdetector_b4.GTis_active_c471_ADAS "" UBYTE ADAS_CM_uint8 0 0 0 255 ECU_ADDRESS 0x0000 /* @ECU_Address@rtDW_ADAS.GTsf_Diodeblinkdetector_b4.GTis_active_c471_ADAS@ */ /end MEASUREMENT
/begin MEASUREMENT rtDW_ADAS.GTsf_Diodeblinkdetector_b4.GTis_c471_ADAS "" UBYTE ADAS_CM_uint8 0 0 0 255 ECU_ADDRESS 0x0000 /* @ECU_Address@rtDW_ADAS.GTsf_Diodeblinkdetector_b4.GTis_c471_ADAS@ */ /end MEASUREMENT
/begin MEASUREMENT rtDW_ADAS.GTsf_Diodeblinkdetector_b4.GTtemporalCounter_i1 "" ULONG ADAS_CM_uint32 0 0 0 4294967295 ECU_ADDRESS 0x0000 /* @ECU_Address@rtDW_ADAS.GTsf_Diodeblinkdetector_b4.GTtemporalCounter_i1@ */ /end MEASUREMENT
/begin MEASUREMENT rtDW_ADAS.GTsf_Diodeblinkdetector_bb.GTBlinkCount "" UBYTE ADAS_CM_uint8 0 0 0 255 ECU_ADDRESS 0x0000 /* @ECU_Address@rtDW_ADAS.GTsf_Diodeblinkdetector_bb.GTBlinkCount@ */ /end MEASUREMENT
/begin MEASUREMENT rtDW_ADAS.GTsf_Diodeblinkdetector_bb.GTis_COUNTING "" UBYTE ADAS_CM_uint8 0 0 0 255 ECU_ADDRESS 0x0000 /* @ECU_Address@rtDW_ADAS.GTsf_Diodeblinkdetector_bb.GTis_COUNTING@ */ /end MEASUREMENT
/begin MEASUREMENT rtDW_ADAS.GTsf_Diodeblinkdetector_bb.GTis_WORK "" UBYTE ADAS_CM_uint8 0 0 0 255 ECU_ADDRESS 0x0000 /* @ECU_Address@rtDW_ADAS.GTsf_Diodeblinkdetector_bb.GTis_WORK@ */ /end MEASUREMENT
/begin MEASUREMENT rtDW_ADAS.GTsf_Diodeblinkdetector_bb.GTis_active_c471_ADAS "" UBYTE ADAS_CM_uint8 0 0 0 255 ECU_ADDRESS 0x0000 /* @ECU_Address@rtDW_ADAS.GTsf_Diodeblinkdetector_bb.GTis_active_c471_ADAS@ */ /end MEASUREMENT
/begin MEASUREMENT rtDW_ADAS.GTsf_Diodeblinkdetector_bb.GTis_c471_ADAS "" UBYTE ADAS_CM_uint8 0 0 0 255 ECU_ADDRESS 0x0000 /* @ECU_Address@rtDW_ADAS.GTsf_Diodeblinkdetector_bb.GTis_c471_ADAS@ */ /end MEASUREMENT
/begin MEASUREMENT rtDW_ADAS.GTsf_Diodeblinkdetector_bb.GTtemporalCounter_i1 "" ULONG ADAS_CM_uint32 0 0 0 4294967295 ECU_ADDRESS 0x0000 /* @ECU_Address@rtDW_ADAS.GTsf_Diodeblinkdetector_bb.GTtemporalCounter_i1@ */ /end MEASUREMENT
/begin MEASUREMENT rtDW_ADAS.GTsf_Diodeblinkdetector_bq.GTBlinkCount "" UBYTE ADAS_CM_uint8 0 0 0 255 ECU_ADDRESS 0x0000 /* @ECU_Address@rtDW_ADAS.GTsf_Diodeblinkdetector_bq.GTBlinkCount@ */ /end MEASUREMENT
/begin MEASUREMENT rtDW_ADAS.GTsf_Diodeblinkdetector_bq.GTis_COUNTING "" UBYTE ADAS_CM_uint8 0 0 0 255 ECU_ADDRESS 0x0000 /* @ECU_Address@rtDW_ADAS.GTsf_Diodeblinkdetector_bq.GTis_COUNTING@ */ /end MEASUREMENT
/begin MEASUREMENT rtDW_ADAS.GTsf_Diodeblinkdetector_bq.GTis_WORK "" UBYTE ADAS_CM_uint8 0 0 0 255 ECU_ADDRESS 0x0000 /* @ECU_Address@rtDW_ADAS.GTsf_Diodeblinkdetector_bq.GTis_WORK@ */ /end MEASUREMENT
/begin MEASUREMENT rtDW_ADAS.GTsf_Diodeblinkdetector_bq.GTis_active_c471_ADAS "" UBYTE ADAS_CM_uint8 0 0 0 255 ECU_ADDRESS 0x0000 /* @ECU_Address@rtDW_ADAS.GTsf_Diodeblinkdetector_bq.GTis_active_c471_ADAS@ */ /end MEASUREMENT
/begin MEASUREMENT rtDW_ADAS.GTsf_Diodeblinkdetector_bq.GTis_c471_ADAS "" UBYTE ADAS_CM_uint8 0 0 0 255 ECU_ADDRESS 0x0000 /* @ECU_Address@rtDW_ADAS.GTsf_Diodeblinkdetector_bq.GTis_c471_ADAS@ */ /end MEASUREMENT
/begin MEASUREMENT rtDW_ADAS.GTsf_Diodeblinkdetector_bq.GTtemporalCounter_i1 "" ULONG ADAS_CM_uint32 0 0 0 4294967295 ECU_ADDRESS 0x0000 /* @ECU_Address@rtDW_ADAS.GTsf_Diodeblinkdetector_bq.GTtemporalCounter_i1@ */ /end MEASUREMENT
/begin MEASUREMENT rtDW_ADAS.GTsf_Diodeblinkdetector_br.GTBlinkCount "" UBYTE ADAS_CM_uint8 0 0 0 255 ECU_ADDRESS 0x0000 /* @ECU_Address@rtDW_ADAS.GTsf_Diodeblinkdetector_br.GTBlinkCount@ */ /end MEASUREMENT
/begin MEASUREMENT rtDW_ADAS.GTsf_Diodeblinkdetector_br.GTis_COUNTING "" UBYTE ADAS_CM_uint8 0 0 0 255 ECU_ADDRESS 0x0000 /* @ECU_Address@rtDW_ADAS.GTsf_Diodeblinkdetector_br.GTis_COUNTING@ */ /end MEASUREMENT
/begin MEASUREMENT rtDW_ADAS.GTsf_Diodeblinkdetector_br.GTis_WORK "" UBYTE ADAS_CM_uint8 0 0 0 255 ECU_ADDRESS 0x0000 /* @ECU_Address@rtDW_ADAS.GTsf_Diodeblinkdetector_br.GTis_WORK@ */ /end MEASUREMENT
/begin MEASUREMENT rtDW_ADAS.GTsf_Diodeblinkdetector_br.GTis_active_c471_ADAS "" UBYTE ADAS_CM_uint8 0 0 0 255 ECU_ADDRESS 0x0000 /* @ECU_Address@rtDW_ADAS.GTsf_Diodeblinkdetector_br.GTis_active_c471_ADAS@ */ /end MEASUREMENT
/begin MEASUREMENT rtDW_ADAS.GTsf_Diodeblinkdetector_br.GTis_c471_ADAS "" UBYTE ADAS_CM_uint8 0 0 0 255 ECU_ADDRESS 0x0000 /* @ECU_Address@rtDW_ADAS.GTsf_Diodeblinkdetector_br.GTis_c471_ADAS@ */ /end MEASUREMENT
/begin MEASUREMENT rtDW_ADAS.GTsf_Diodeblinkdetector_br.GTtemporalCounter_i1 "" ULONG ADAS_CM_uint32 0 0 0 4294967295 ECU_ADDRESS 0x0000 /* @ECU_Address@rtDW_ADAS.GTsf_Diodeblinkdetector_br.GTtemporalCounter_i1@ */ /end MEASUREMENT
/begin MEASUREMENT rtDW_ADAS.GTsf_Diodeblinkdetector_c.GTBlinkCount "" UBYTE ADAS_CM_uint8 0 0 0 255 ECU_ADDRESS 0x0000 /* @ECU_Address@rtDW_ADAS.GTsf_Diodeblinkdetector_c.GTBlinkCount@ */ /end MEASUREMENT
/begin MEASUREMENT rtDW_ADAS.GTsf_Diodeblinkdetector_c.GTis_COUNTING "" UBYTE ADAS_CM_uint8 0 0 0 255 ECU_ADDRESS 0x0000 /* @ECU_Address@rtDW_ADAS.GTsf_Diodeblinkdetector_c.GTis_COUNTING@ */ /end MEASUREMENT
/begin MEASUREMENT rtDW_ADAS.GTsf_Diodeblinkdetector_c.GTis_WORK "" UBYTE ADAS_CM_uint8 0 0 0 255 ECU_ADDRESS 0x0000 /* @ECU_Address@rtDW_ADAS.GTsf_Diodeblinkdetector_c.GTis_WORK@ */ /end MEASUREMENT
/begin MEASUREMENT rtDW_ADAS.GTsf_Diodeblinkdetector_c.GTis_active_c471_ADAS "" UBYTE ADAS_CM_uint8 0 0 0 255 ECU_ADDRESS 0x0000 /* @ECU_Address@rtDW_ADAS.GTsf_Diodeblinkdetector_c.GTis_active_c471_ADAS@ */ /end MEASUREMENT
/begin MEASUREMENT rtDW_ADAS.GTsf_Diodeblinkdetector_c.GTis_c471_ADAS "" UBYTE ADAS_CM_uint8 0 0 0 255 ECU_ADDRESS 0x0000 /* @ECU_Address@rtDW_ADAS.GTsf_Diodeblinkdetector_c.GTis_c471_ADAS@ */ /end MEASUREMENT
/begin MEASUREMENT rtDW_ADAS.GTsf_Diodeblinkdetector_c.GTtemporalCounter_i1 "" ULONG ADAS_CM_uint32 0 0 0 4294967295 ECU_ADDRESS 0x0000 /* @ECU_Address@rtDW_ADAS.GTsf_Diodeblinkdetector_c.GTtemporalCounter_i1@ */ /end MEASUREMENT
/begin MEASUREMENT rtDW_ADAS.GTsf_Diodeblinkdetector_d.GTBlinkCount "" UBYTE ADAS_CM_uint8 0 0 0 255 ECU_ADDRESS 0x0000 /* @ECU_Address@rtDW_ADAS.GTsf_Diodeblinkdetector_d.GTBlinkCount@ */ /end MEASUREMENT
/begin MEASUREMENT rtDW_ADAS.GTsf_Diodeblinkdetector_d.GTis_COUNTING "" UBYTE ADAS_CM_uint8 0 0 0 255 ECU_ADDRESS 0x0000 /* @ECU_Address@rtDW_ADAS.GTsf_Diodeblinkdetector_d.GTis_COUNTING@ */ /end MEASUREMENT
/begin MEASUREMENT rtDW_ADAS.GTsf_Diodeblinkdetector_d.GTis_WORK "" UBYTE ADAS_CM_uint8 0 0 0 255 ECU_ADDRESS 0x0000 /* @ECU_Address@rtDW_ADAS.GTsf_Diodeblinkdetector_d.GTis_WORK@ */ /end MEASUREMENT
/begin MEASUREMENT rtDW_ADAS.GTsf_Diodeblinkdetector_d.GTis_active_c471_ADAS "" UBYTE ADAS_CM_uint8 0 0 0 255 ECU_ADDRESS 0x0000 /* @ECU_Address@rtDW_ADAS.GTsf_Diodeblinkdetector_d.GTis_active_c471_ADAS@ */ /end MEASUREMENT
/begin MEASUREMENT rtDW_ADAS.GTsf_Diodeblinkdetector_d.GTis_c471_ADAS "" UBYTE ADAS_CM_uint8 0 0 0 255 ECU_ADDRESS 0x0000 /* @ECU_Address@rtDW_ADAS.GTsf_Diodeblinkdetector_d.GTis_c471_ADAS@ */ /end MEASUREMENT
/begin MEASUREMENT rtDW_ADAS.GTsf_Diodeblinkdetector_d.GTtemporalCounter_i1 "" ULONG ADAS_CM_uint32 0 0 0 4294967295 ECU_ADDRESS 0x0000 /* @ECU_Address@rtDW_ADAS.GTsf_Diodeblinkdetector_d.GTtemporalCounter_i1@ */ /end MEASUREMENT
/begin MEASUREMENT rtDW_ADAS.GTsf_Diodeblinkdetector_e.GTBlinkCount "" UBYTE ADAS_CM_uint8 0 0 0 255 ECU_ADDRESS 0x0000 /* @ECU_Address@rtDW_ADAS.GTsf_Diodeblinkdetector_e.GTBlinkCount@ */ /end MEASUREMENT
/begin MEASUREMENT rtDW_ADAS.GTsf_Diodeblinkdetector_e.GTis_COUNTING "" UBYTE ADAS_CM_uint8 0 0 0 255 ECU_ADDRESS 0x0000 /* @ECU_Address@rtDW_ADAS.GTsf_Diodeblinkdetector_e.GTis_COUNTING@ */ /end MEASUREMENT
/begin MEASUREMENT rtDW_ADAS.GTsf_Diodeblinkdetector_e.GTis_WORK "" UBYTE ADAS_CM_uint8 0 0 0 255 ECU_ADDRESS 0x0000 /* @ECU_Address@rtDW_ADAS.GTsf_Diodeblinkdetector_e.GTis_WORK@ */ /end MEASUREMENT
/begin MEASUREMENT rtDW_ADAS.GTsf_Diodeblinkdetector_e.GTis_active_c471_ADAS "" UBYTE ADAS_CM_uint8 0 0 0 255 ECU_ADDRESS 0x0000 /* @ECU_Address@rtDW_ADAS.GTsf_Diodeblinkdetector_e.GTis_active_c471_ADAS@ */ /end MEASUREMENT
/begin MEASUREMENT rtDW_ADAS.GTsf_Diodeblinkdetector_e.GTis_c471_ADAS "" UBYTE ADAS_CM_uint8 0 0 0 255 ECU_ADDRESS 0x0000 /* @ECU_Address@rtDW_ADAS.GTsf_Diodeblinkdetector_e.GTis_c471_ADAS@ */ /end MEASUREMENT
/begin MEASUREMENT rtDW_ADAS.GTsf_Diodeblinkdetector_e.GTtemporalCounter_i1 "" ULONG ADAS_CM_uint32 0 0 0 4294967295 ECU_ADDRESS 0x0000 /* @ECU_Address@rtDW_ADAS.GTsf_Diodeblinkdetector_e.GTtemporalCounter_i1@ */ /end MEASUREMENT
/begin MEASUREMENT rtDW_ADAS.GTsf_Diodeblinkdetector_eg.GTBlinkCount "" UBYTE ADAS_CM_uint8 0 0 0 255 ECU_ADDRESS 0x0000 /* @ECU_Address@rtDW_ADAS.GTsf_Diodeblinkdetector_eg.GTBlinkCount@ */ /end MEASUREMENT
/begin MEASUREMENT rtDW_ADAS.GTsf_Diodeblinkdetector_eg.GTis_COUNTING "" UBYTE ADAS_CM_uint8 0 0 0 255 ECU_ADDRESS 0x0000 /* @ECU_Address@rtDW_ADAS.GTsf_Diodeblinkdetector_eg.GTis_COUNTING@ */ /end MEASUREMENT
/begin MEASUREMENT rtDW_ADAS.GTsf_Diodeblinkdetector_eg.GTis_WORK "" UBYTE ADAS_CM_uint8 0 0 0 255 ECU_ADDRESS 0x0000 /* @ECU_Address@rtDW_ADAS.GTsf_Diodeblinkdetector_eg.GTis_WORK@ */ /end MEASUREMENT
/begin MEASUREMENT rtDW_ADAS.GTsf_Diodeblinkdetector_eg.GTis_active_c471_ADAS "" UBYTE ADAS_CM_uint8 0 0 0 255 ECU_ADDRESS 0x0000 /* @ECU_Address@rtDW_ADAS.GTsf_Diodeblinkdetector_eg.GTis_active_c471_ADAS@ */ /end MEASUREMENT
/begin MEASUREMENT rtDW_ADAS.GTsf_Diodeblinkdetector_eg.GTis_c471_ADAS "" UBYTE ADAS_CM_uint8 0 0 0 255 ECU_ADDRESS 0x0000 /* @ECU_Address@rtDW_ADAS.GTsf_Diodeblinkdetector_eg.GTis_c471_ADAS@ */ /end MEASUREMENT
/begin MEASUREMENT rtDW_ADAS.GTsf_Diodeblinkdetector_eg.GTtemporalCounter_i1 "" ULONG ADAS_CM_uint32 0 0 0 4294967295 ECU_ADDRESS 0x0000 /* @ECU_Address@rtDW_ADAS.GTsf_Diodeblinkdetector_eg.GTtemporalCounter_i1@ */ /end MEASUREMENT
/begin MEASUREMENT rtDW_ADAS.GTsf_Diodeblinkdetector_em.GTBlinkCount "" UBYTE ADAS_CM_uint8 0 0 0 255 ECU_ADDRESS 0x0000 /* @ECU_Address@rtDW_ADAS.GTsf_Diodeblinkdetector_em.GTBlinkCount@ */ /end MEASUREMENT
/begin MEASUREMENT rtDW_ADAS.GTsf_Diodeblinkdetector_em.GTis_COUNTING "" UBYTE ADAS_CM_uint8 0 0 0 255 ECU_ADDRESS 0x0000 /* @ECU_Address@rtDW_ADAS.GTsf_Diodeblinkdetector_em.GTis_COUNTING@ */ /end MEASUREMENT
/begin MEASUREMENT rtDW_ADAS.GTsf_Diodeblinkdetector_em.GTis_WORK "" UBYTE ADAS_CM_uint8 0 0 0 255 ECU_ADDRESS 0x0000 /* @ECU_Address@rtDW_ADAS.GTsf_Diodeblinkdetector_em.GTis_WORK@ */ /end MEASUREMENT
/begin MEASUREMENT rtDW_ADAS.GTsf_Diodeblinkdetector_em.GTis_active_c471_ADAS "" UBYTE ADAS_CM_uint8 0 0 0 255 ECU_ADDRESS 0x0000 /* @ECU_Address@rtDW_ADAS.GTsf_Diodeblinkdetector_em.GTis_active_c471_ADAS@ */ /end MEASUREMENT
/begin MEASUREMENT rtDW_ADAS.GTsf_Diodeblinkdetector_em.GTis_c471_ADAS "" UBYTE ADAS_CM_uint8 0 0 0 255 ECU_ADDRESS 0x0000 /* @ECU_Address@rtDW_ADAS.GTsf_Diodeblinkdetector_em.GTis_c471_ADAS@ */ /end MEASUREMENT
/begin MEASUREMENT rtDW_ADAS.GTsf_Diodeblinkdetector_em.GTtemporalCounter_i1 "" ULONG ADAS_CM_uint32 0 0 0 4294967295 ECU_ADDRESS 0x0000 /* @ECU_Address@rtDW_ADAS.GTsf_Diodeblinkdetector_em.GTtemporalCounter_i1@ */ /end MEASUREMENT
/begin MEASUREMENT rtDW_ADAS.GTsf_Diodeblinkdetector_f.GTBlinkCount "" UBYTE ADAS_CM_uint8 0 0 0 255 ECU_ADDRESS 0x0000 /* @ECU_Address@rtDW_ADAS.GTsf_Diodeblinkdetector_f.GTBlinkCount@ */ /end MEASUREMENT
/begin MEASUREMENT rtDW_ADAS.GTsf_Diodeblinkdetector_f.GTis_COUNTING "" UBYTE ADAS_CM_uint8 0 0 0 255 ECU_ADDRESS 0x0000 /* @ECU_Address@rtDW_ADAS.GTsf_Diodeblinkdetector_f.GTis_COUNTING@ */ /end MEASUREMENT
/begin MEASUREMENT rtDW_ADAS.GTsf_Diodeblinkdetector_f.GTis_WORK "" UBYTE ADAS_CM_uint8 0 0 0 255 ECU_ADDRESS 0x0000 /* @ECU_Address@rtDW_ADAS.GTsf_Diodeblinkdetector_f.GTis_WORK@ */ /end MEASUREMENT
/begin MEASUREMENT rtDW_ADAS.GTsf_Diodeblinkdetector_f.GTis_active_c471_ADAS "" UBYTE ADAS_CM_uint8 0 0 0 255 ECU_ADDRESS 0x0000 /* @ECU_Address@rtDW_ADAS.GTsf_Diodeblinkdetector_f.GTis_active_c471_ADAS@ */ /end MEASUREMENT
/begin MEASUREMENT rtDW_ADAS.GTsf_Diodeblinkdetector_f.GTis_c471_ADAS "" UBYTE ADAS_CM_uint8 0 0 0 255 ECU_ADDRESS 0x0000 /* @ECU_Address@rtDW_ADAS.GTsf_Diodeblinkdetector_f.GTis_c471_ADAS@ */ /end MEASUREMENT
/begin MEASUREMENT rtDW_ADAS.GTsf_Diodeblinkdetector_f.GTtemporalCounter_i1 "" ULONG ADAS_CM_uint32 0 0 0 4294967295 ECU_ADDRESS 0x0000 /* @ECU_Address@rtDW_ADAS.GTsf_Diodeblinkdetector_f.GTtemporalCounter_i1@ */ /end MEASUREMENT
/begin MEASUREMENT rtDW_ADAS.GTsf_Diodeblinkdetector_g.GTBlinkCount "" UBYTE ADAS_CM_uint8 0 0 0 255 ECU_ADDRESS 0x0000 /* @ECU_Address@rtDW_ADAS.GTsf_Diodeblinkdetector_g.GTBlinkCount@ */ /end MEASUREMENT
/begin MEASUREMENT rtDW_ADAS.GTsf_Diodeblinkdetector_g.GTis_COUNTING "" UBYTE ADAS_CM_uint8 0 0 0 255 ECU_ADDRESS 0x0000 /* @ECU_Address@rtDW_ADAS.GTsf_Diodeblinkdetector_g.GTis_COUNTING@ */ /end MEASUREMENT
/begin MEASUREMENT rtDW_ADAS.GTsf_Diodeblinkdetector_g.GTis_WORK "" UBYTE ADAS_CM_uint8 0 0 0 255 ECU_ADDRESS 0x0000 /* @ECU_Address@rtDW_ADAS.GTsf_Diodeblinkdetector_g.GTis_WORK@ */ /end MEASUREMENT
/begin MEASUREMENT rtDW_ADAS.GTsf_Diodeblinkdetector_g.GTis_active_c471_ADAS "" UBYTE ADAS_CM_uint8 0 0 0 255 ECU_ADDRESS 0x0000 /* @ECU_Address@rtDW_ADAS.GTsf_Diodeblinkdetector_g.GTis_active_c471_ADAS@ */ /end MEASUREMENT
/begin MEASUREMENT rtDW_ADAS.GTsf_Diodeblinkdetector_g.GTis_c471_ADAS "" UBYTE ADAS_CM_uint8 0 0 0 255 ECU_ADDRESS 0x0000 /* @ECU_Address@rtDW_ADAS.GTsf_Diodeblinkdetector_g.GTis_c471_ADAS@ */ /end MEASUREMENT
/begin MEASUREMENT rtDW_ADAS.GTsf_Diodeblinkdetector_g.GTtemporalCounter_i1 "" ULONG ADAS_CM_uint32 0 0 0 4294967295 ECU_ADDRESS 0x0000 /* @ECU_Address@rtDW_ADAS.GTsf_Diodeblinkdetector_g.GTtemporalCounter_i1@ */ /end MEASUREMENT
/begin MEASUREMENT rtDW_ADAS.GTsf_Diodeblinkdetector_g0.GTBlinkCount "" UBYTE ADAS_CM_uint8 0 0 0 255 ECU_ADDRESS 0x0000 /* @ECU_Address@rtDW_ADAS.GTsf_Diodeblinkdetector_g0.GTBlinkCount@ */ /end MEASUREMENT
/begin MEASUREMENT rtDW_ADAS.GTsf_Diodeblinkdetector_g0.GTis_COUNTING "" UBYTE ADAS_CM_uint8 0 0 0 255 ECU_ADDRESS 0x0000 /* @ECU_Address@rtDW_ADAS.GTsf_Diodeblinkdetector_g0.GTis_COUNTING@ */ /end MEASUREMENT
/begin MEASUREMENT rtDW_ADAS.GTsf_Diodeblinkdetector_g0.GTis_WORK "" UBYTE ADAS_CM_uint8 0 0 0 255 ECU_ADDRESS 0x0000 /* @ECU_Address@rtDW_ADAS.GTsf_Diodeblinkdetector_g0.GTis_WORK@ */ /end MEASUREMENT
/begin MEASUREMENT rtDW_ADAS.GTsf_Diodeblinkdetector_g0.GTis_active_c471_ADAS "" UBYTE ADAS_CM_uint8 0 0 0 255 ECU_ADDRESS 0x0000 /* @ECU_Address@rtDW_ADAS.GTsf_Diodeblinkdetector_g0.GTis_active_c471_ADAS@ */ /end MEASUREMENT
/begin MEASUREMENT rtDW_ADAS.GTsf_Diodeblinkdetector_g0.GTis_c471_ADAS "" UBYTE ADAS_CM_uint8 0 0 0 255 ECU_ADDRESS 0x0000 /* @ECU_Address@rtDW_ADAS.GTsf_Diodeblinkdetector_g0.GTis_c471_ADAS@ */ /end MEASUREMENT
/begin MEASUREMENT rtDW_ADAS.GTsf_Diodeblinkdetector_g0.GTtemporalCounter_i1 "" ULONG ADAS_CM_uint32 0 0 0 4294967295 ECU_ADDRESS 0x0000 /* @ECU_Address@rtDW_ADAS.GTsf_Diodeblinkdetector_g0.GTtemporalCounter_i1@ */ /end MEASUREMENT
/begin MEASUREMENT rtDW_ADAS.GTsf_Diodeblinkdetector_i.GTBlinkCount "" UBYTE ADAS_CM_uint8 0 0 0 255 ECU_ADDRESS 0x0000 /* @ECU_Address@rtDW_ADAS.GTsf_Diodeblinkdetector_i.GTBlinkCount@ */ /end MEASUREMENT
/begin MEASUREMENT rtDW_ADAS.GTsf_Diodeblinkdetector_i.GTis_COUNTING "" UBYTE ADAS_CM_uint8 0 0 0 255 ECU_ADDRESS 0x0000 /* @ECU_Address@rtDW_ADAS.GTsf_Diodeblinkdetector_i.GTis_COUNTING@ */ /end MEASUREMENT
/begin MEASUREMENT rtDW_ADAS.GTsf_Diodeblinkdetector_i.GTis_WORK "" UBYTE ADAS_CM_uint8 0 0 0 255 ECU_ADDRESS 0x0000 /* @ECU_Address@rtDW_ADAS.GTsf_Diodeblinkdetector_i.GTis_WORK@ */ /end MEASUREMENT
/begin MEASUREMENT rtDW_ADAS.GTsf_Diodeblinkdetector_i.GTis_active_c471_ADAS "" UBYTE ADAS_CM_uint8 0 0 0 255 ECU_ADDRESS 0x0000 /* @ECU_Address@rtDW_ADAS.GTsf_Diodeblinkdetector_i.GTis_active_c471_ADAS@ */ /end MEASUREMENT
/begin MEASUREMENT rtDW_ADAS.GTsf_Diodeblinkdetector_i.GTis_c471_ADAS "" UBYTE ADAS_CM_uint8 0 0 0 255 ECU_ADDRESS 0x0000 /* @ECU_Address@rtDW_ADAS.GTsf_Diodeblinkdetector_i.GTis_c471_ADAS@ */ /end MEASUREMENT
/begin MEASUREMENT rtDW_ADAS.GTsf_Diodeblinkdetector_i.GTtemporalCounter_i1 "" ULONG ADAS_CM_uint32 0 0 0 4294967295 ECU_ADDRESS 0x0000 /* @ECU_Address@rtDW_ADAS.GTsf_Diodeblinkdetector_i.GTtemporalCounter_i1@ */ /end MEASUREMENT
/begin MEASUREMENT rtDW_ADAS.GTsf_Diodeblinkdetector_j.GTBlinkCount "" UBYTE ADAS_CM_uint8 0 0 0 255 ECU_ADDRESS 0x0000 /* @ECU_Address@rtDW_ADAS.GTsf_Diodeblinkdetector_j.GTBlinkCount@ */ /end MEASUREMENT
/begin MEASUREMENT rtDW_ADAS.GTsf_Diodeblinkdetector_j.GTis_COUNTING "" UBYTE ADAS_CM_uint8 0 0 0 255 ECU_ADDRESS 0x0000 /* @ECU_Address@rtDW_ADAS.GTsf_Diodeblinkdetector_j.GTis_COUNTING@ */ /end MEASUREMENT
/begin MEASUREMENT rtDW_ADAS.GTsf_Diodeblinkdetector_j.GTis_WORK "" UBYTE ADAS_CM_uint8 0 0 0 255 ECU_ADDRESS 0x0000 /* @ECU_Address@rtDW_ADAS.GTsf_Diodeblinkdetector_j.GTis_WORK@ */ /end MEASUREMENT
/begin MEASUREMENT rtDW_ADAS.GTsf_Diodeblinkdetector_j.GTis_active_c471_ADAS "" UBYTE ADAS_CM_uint8 0 0 0 255 ECU_ADDRESS 0x0000 /* @ECU_Address@rtDW_ADAS.GTsf_Diodeblinkdetector_j.GTis_active_c471_ADAS@ */ /end MEASUREMENT
/begin MEASUREMENT rtDW_ADAS.GTsf_Diodeblinkdetector_j.GTis_c471_ADAS "" UBYTE ADAS_CM_uint8 0 0 0 255 ECU_ADDRESS 0x0000 /* @ECU_Address@rtDW_ADAS.GTsf_Diodeblinkdetector_j.GTis_c471_ADAS@ */ /end MEASUREMENT
/begin MEASUREMENT rtDW_ADAS.GTsf_Diodeblinkdetector_j.GTtemporalCounter_i1 "" ULONG ADAS_CM_uint32 0 0 0 4294967295 ECU_ADDRESS 0x0000 /* @ECU_Address@rtDW_ADAS.GTsf_Diodeblinkdetector_j.GTtemporalCounter_i1@ */ /end MEASUREMENT
/begin MEASUREMENT rtDW_ADAS.GTsf_Diodeblinkdetector_jp.GTBlinkCount "" UBYTE ADAS_CM_uint8 0 0 0 255 ECU_ADDRESS 0x0000 /* @ECU_Address@rtDW_ADAS.GTsf_Diodeblinkdetector_jp.GTBlinkCount@ */ /end MEASUREMENT
/begin MEASUREMENT rtDW_ADAS.GTsf_Diodeblinkdetector_jp.GTis_COUNTING "" UBYTE ADAS_CM_uint8 0 0 0 255 ECU_ADDRESS 0x0000 /* @ECU_Address@rtDW_ADAS.GTsf_Diodeblinkdetector_jp.GTis_COUNTING@ */ /end MEASUREMENT
/begin MEASUREMENT rtDW_ADAS.GTsf_Diodeblinkdetector_jp.GTis_WORK "" UBYTE ADAS_CM_uint8 0 0 0 255 ECU_ADDRESS 0x0000 /* @ECU_Address@rtDW_ADAS.GTsf_Diodeblinkdetector_jp.GTis_WORK@ */ /end MEASUREMENT
/begin MEASUREMENT rtDW_ADAS.GTsf_Diodeblinkdetector_jp.GTis_active_c471_ADAS "" UBYTE ADAS_CM_uint8 0 0 0 255 ECU_ADDRESS 0x0000 /* @ECU_Address@rtDW_ADAS.GTsf_Diodeblinkdetector_jp.GTis_active_c471_ADAS@ */ /end MEASUREMENT
/begin MEASUREMENT rtDW_ADAS.GTsf_Diodeblinkdetector_jp.GTis_c471_ADAS "" UBYTE ADAS_CM_uint8 0 0 0 255 ECU_ADDRESS 0x0000 /* @ECU_Address@rtDW_ADAS.GTsf_Diodeblinkdetector_jp.GTis_c471_ADAS@ */ /end MEASUREMENT
/begin MEASUREMENT rtDW_ADAS.GTsf_Diodeblinkdetector_jp.GTtemporalCounter_i1 "" ULONG ADAS_CM_uint32 0 0 0 4294967295 ECU_ADDRESS 0x0000 /* @ECU_Address@rtDW_ADAS.GTsf_Diodeblinkdetector_jp.GTtemporalCounter_i1@ */ /end MEASUREMENT
/begin MEASUREMENT rtDW_ADAS.GTsf_Diodeblinkdetector_jw.GTBlinkCount "" UBYTE ADAS_CM_uint8 0 0 0 255 ECU_ADDRESS 0x0000 /* @ECU_Address@rtDW_ADAS.GTsf_Diodeblinkdetector_jw.GTBlinkCount@ */ /end MEASUREMENT
/begin MEASUREMENT rtDW_ADAS.GTsf_Diodeblinkdetector_jw.GTis_COUNTING "" UBYTE ADAS_CM_uint8 0 0 0 255 ECU_ADDRESS 0x0000 /* @ECU_Address@rtDW_ADAS.GTsf_Diodeblinkdetector_jw.GTis_COUNTING@ */ /end MEASUREMENT
/begin MEASUREMENT rtDW_ADAS.GTsf_Diodeblinkdetector_jw.GTis_WORK "" UBYTE ADAS_CM_uint8 0 0 0 255 ECU_ADDRESS 0x0000 /* @ECU_Address@rtDW_ADAS.GTsf_Diodeblinkdetector_jw.GTis_WORK@ */ /end MEASUREMENT
/begin MEASUREMENT rtDW_ADAS.GTsf_Diodeblinkdetector_jw.GTis_active_c471_ADAS "" UBYTE ADAS_CM_uint8 0 0 0 255 ECU_ADDRESS 0x0000 /* @ECU_Address@rtDW_ADAS.GTsf_Diodeblinkdetector_jw.GTis_active_c471_ADAS@ */ /end MEASUREMENT
/begin MEASUREMENT rtDW_ADAS.GTsf_Diodeblinkdetector_jw.GTis_c471_ADAS "" UBYTE ADAS_CM_uint8 0 0 0 255 ECU_ADDRESS 0x0000 /* @ECU_Address@rtDW_ADAS.GTsf_Diodeblinkdetector_jw.GTis_c471_ADAS@ */ /end MEASUREMENT
/begin MEASUREMENT rtDW_ADAS.GTsf_Diodeblinkdetector_jw.GTtemporalCounter_i1 "" ULONG ADAS_CM_uint32 0 0 0 4294967295 ECU_ADDRESS 0x0000 /* @ECU_Address@rtDW_ADAS.GTsf_Diodeblinkdetector_jw.GTtemporalCounter_i1@ */ /end MEASUREMENT
/begin MEASUREMENT rtDW_ADAS.GTsf_Diodeblinkdetector_k.GTBlinkCount "" UBYTE ADAS_CM_uint8 0 0 0 255 ECU_ADDRESS 0x0000 /* @ECU_Address@rtDW_ADAS.GTsf_Diodeblinkdetector_k.GTBlinkCount@ */ /end MEASUREMENT
/begin MEASUREMENT rtDW_ADAS.GTsf_Diodeblinkdetector_k.GTis_COUNTING "" UBYTE ADAS_CM_uint8 0 0 0 255 ECU_ADDRESS 0x0000 /* @ECU_Address@rtDW_ADAS.GTsf_Diodeblinkdetector_k.GTis_COUNTING@ */ /end MEASUREMENT
/begin MEASUREMENT rtDW_ADAS.GTsf_Diodeblinkdetector_k.GTis_WORK "" UBYTE ADAS_CM_uint8 0 0 0 255 ECU_ADDRESS 0x0000 /* @ECU_Address@rtDW_ADAS.GTsf_Diodeblinkdetector_k.GTis_WORK@ */ /end MEASUREMENT
/begin MEASUREMENT rtDW_ADAS.GTsf_Diodeblinkdetector_k.GTis_active_c471_ADAS "" UBYTE ADAS_CM_uint8 0 0 0 255 ECU_ADDRESS 0x0000 /* @ECU_Address@rtDW_ADAS.GTsf_Diodeblinkdetector_k.GTis_active_c471_ADAS@ */ /end MEASUREMENT
/begin MEASUREMENT rtDW_ADAS.GTsf_Diodeblinkdetector_k.GTis_c471_ADAS "" UBYTE ADAS_CM_uint8 0 0 0 255 ECU_ADDRESS 0x0000 /* @ECU_Address@rtDW_ADAS.GTsf_Diodeblinkdetector_k.GTis_c471_ADAS@ */ /end MEASUREMENT
/begin MEASUREMENT rtDW_ADAS.GTsf_Diodeblinkdetector_k.GTtemporalCounter_i1 "" ULONG ADAS_CM_uint32 0 0 0 4294967295 ECU_ADDRESS 0x0000 /* @ECU_Address@rtDW_ADAS.GTsf_Diodeblinkdetector_k.GTtemporalCounter_i1@ */ /end MEASUREMENT
/begin MEASUREMENT rtDW_ADAS.GTsf_Diodeblinkdetector_kp.GTBlinkCount "" UBYTE ADAS_CM_uint8 0 0 0 255 ECU_ADDRESS 0x0000 /* @ECU_Address@rtDW_ADAS.GTsf_Diodeblinkdetector_kp.GTBlinkCount@ */ /end MEASUREMENT
/begin MEASUREMENT rtDW_ADAS.GTsf_Diodeblinkdetector_kp.GTis_COUNTING "" UBYTE ADAS_CM_uint8 0 0 0 255 ECU_ADDRESS 0x0000 /* @ECU_Address@rtDW_ADAS.GTsf_Diodeblinkdetector_kp.GTis_COUNTING@ */ /end MEASUREMENT
/begin MEASUREMENT rtDW_ADAS.GTsf_Diodeblinkdetector_kp.GTis_WORK "" UBYTE ADAS_CM_uint8 0 0 0 255 ECU_ADDRESS 0x0000 /* @ECU_Address@rtDW_ADAS.GTsf_Diodeblinkdetector_kp.GTis_WORK@ */ /end MEASUREMENT
/begin MEASUREMENT rtDW_ADAS.GTsf_Diodeblinkdetector_kp.GTis_active_c471_ADAS "" UBYTE ADAS_CM_uint8 0 0 0 255 ECU_ADDRESS 0x0000 /* @ECU_Address@rtDW_ADAS.GTsf_Diodeblinkdetector_kp.GTis_active_c471_ADAS@ */ /end MEASUREMENT
/begin MEASUREMENT rtDW_ADAS.GTsf_Diodeblinkdetector_kp.GTis_c471_ADAS "" UBYTE ADAS_CM_uint8 0 0 0 255 ECU_ADDRESS 0x0000 /* @ECU_Address@rtDW_ADAS.GTsf_Diodeblinkdetector_kp.GTis_c471_ADAS@ */ /end MEASUREMENT
/begin MEASUREMENT rtDW_ADAS.GTsf_Diodeblinkdetector_kp.GTtemporalCounter_i1 "" ULONG ADAS_CM_uint32 0 0 0 4294967295 ECU_ADDRESS 0x0000 /* @ECU_Address@rtDW_ADAS.GTsf_Diodeblinkdetector_kp.GTtemporalCounter_i1@ */ /end MEASUREMENT
/begin MEASUREMENT rtDW_ADAS.GTsf_Diodeblinkdetector_l.GTBlinkCount "" UBYTE ADAS_CM_uint8 0 0 0 255 ECU_ADDRESS 0x0000 /* @ECU_Address@rtDW_ADAS.GTsf_Diodeblinkdetector_l.GTBlinkCount@ */ /end MEASUREMENT
/begin MEASUREMENT rtDW_ADAS.GTsf_Diodeblinkdetector_l.GTis_COUNTING "" UBYTE ADAS_CM_uint8 0 0 0 255 ECU_ADDRESS 0x0000 /* @ECU_Address@rtDW_ADAS.GTsf_Diodeblinkdetector_l.GTis_COUNTING@ */ /end MEASUREMENT
/begin MEASUREMENT rtDW_ADAS.GTsf_Diodeblinkdetector_l.GTis_WORK "" UBYTE ADAS_CM_uint8 0 0 0 255 ECU_ADDRESS 0x0000 /* @ECU_Address@rtDW_ADAS.GTsf_Diodeblinkdetector_l.GTis_WORK@ */ /end MEASUREMENT
/begin MEASUREMENT rtDW_ADAS.GTsf_Diodeblinkdetector_l.GTis_active_c471_ADAS "" UBYTE ADAS_CM_uint8 0 0 0 255 ECU_ADDRESS 0x0000 /* @ECU_Address@rtDW_ADAS.GTsf_Diodeblinkdetector_l.GTis_active_c471_ADAS@ */ /end MEASUREMENT
/begin MEASUREMENT rtDW_ADAS.GTsf_Diodeblinkdetector_l.GTis_c471_ADAS "" UBYTE ADAS_CM_uint8 0 0 0 255 ECU_ADDRESS 0x0000 /* @ECU_Address@rtDW_ADAS.GTsf_Diodeblinkdetector_l.GTis_c471_ADAS@ */ /end MEASUREMENT
/begin MEASUREMENT rtDW_ADAS.GTsf_Diodeblinkdetector_l.GTtemporalCounter_i1 "" ULONG ADAS_CM_uint32 0 0 0 4294967295 ECU_ADDRESS 0x0000 /* @ECU_Address@rtDW_ADAS.GTsf_Diodeblinkdetector_l.GTtemporalCounter_i1@ */ /end MEASUREMENT
/begin MEASUREMENT rtDW_ADAS.GTsf_Diodeblinkdetector_li.GTBlinkCount "" UBYTE ADAS_CM_uint8 0 0 0 255 ECU_ADDRESS 0x0000 /* @ECU_Address@rtDW_ADAS.GTsf_Diodeblinkdetector_li.GTBlinkCount@ */ /end MEASUREMENT
/begin MEASUREMENT rtDW_ADAS.GTsf_Diodeblinkdetector_li.GTis_COUNTING "" UBYTE ADAS_CM_uint8 0 0 0 255 ECU_ADDRESS 0x0000 /* @ECU_Address@rtDW_ADAS.GTsf_Diodeblinkdetector_li.GTis_COUNTING@ */ /end MEASUREMENT
/begin MEASUREMENT rtDW_ADAS.GTsf_Diodeblinkdetector_li.GTis_WORK "" UBYTE ADAS_CM_uint8 0 0 0 255 ECU_ADDRESS 0x0000 /* @ECU_Address@rtDW_ADAS.GTsf_Diodeblinkdetector_li.GTis_WORK@ */ /end MEASUREMENT
/begin MEASUREMENT rtDW_ADAS.GTsf_Diodeblinkdetector_li.GTis_active_c471_ADAS "" UBYTE ADAS_CM_uint8 0 0 0 255 ECU_ADDRESS 0x0000 /* @ECU_Address@rtDW_ADAS.GTsf_Diodeblinkdetector_li.GTis_active_c471_ADAS@ */ /end MEASUREMENT
/begin MEASUREMENT rtDW_ADAS.GTsf_Diodeblinkdetector_li.GTis_c471_ADAS "" UBYTE ADAS_CM_uint8 0 0 0 255 ECU_ADDRESS 0x0000 /* @ECU_Address@rtDW_ADAS.GTsf_Diodeblinkdetector_li.GTis_c471_ADAS@ */ /end MEASUREMENT
/begin MEASUREMENT rtDW_ADAS.GTsf_Diodeblinkdetector_li.GTtemporalCounter_i1 "" ULONG ADAS_CM_uint32 0 0 0 4294967295 ECU_ADDRESS 0x0000 /* @ECU_Address@rtDW_ADAS.GTsf_Diodeblinkdetector_li.GTtemporalCounter_i1@ */ /end MEASUREMENT
/begin MEASUREMENT rtDW_ADAS.GTsf_Diodeblinkdetector_m.GTBlinkCount "" UBYTE ADAS_CM_uint8 0 0 0 255 ECU_ADDRESS 0x0000 /* @ECU_Address@rtDW_ADAS.GTsf_Diodeblinkdetector_m.GTBlinkCount@ */ /end MEASUREMENT
/begin MEASUREMENT rtDW_ADAS.GTsf_Diodeblinkdetector_m.GTis_COUNTING "" UBYTE ADAS_CM_uint8 0 0 0 255 ECU_ADDRESS 0x0000 /* @ECU_Address@rtDW_ADAS.GTsf_Diodeblinkdetector_m.GTis_COUNTING@ */ /end MEASUREMENT
/begin MEASUREMENT rtDW_ADAS.GTsf_Diodeblinkdetector_m.GTis_WORK "" UBYTE ADAS_CM_uint8 0 0 0 255 ECU_ADDRESS 0x0000 /* @ECU_Address@rtDW_ADAS.GTsf_Diodeblinkdetector_m.GTis_WORK@ */ /end MEASUREMENT
/begin MEASUREMENT rtDW_ADAS.GTsf_Diodeblinkdetector_m.GTis_active_c471_ADAS "" UBYTE ADAS_CM_uint8 0 0 0 255 ECU_ADDRESS 0x0000 /* @ECU_Address@rtDW_ADAS.GTsf_Diodeblinkdetector_m.GTis_active_c471_ADAS@ */ /end MEASUREMENT
/begin MEASUREMENT rtDW_ADAS.GTsf_Diodeblinkdetector_m.GTis_c471_ADAS "" UBYTE ADAS_CM_uint8 0 0 0 255 ECU_ADDRESS 0x0000 /* @ECU_Address@rtDW_ADAS.GTsf_Diodeblinkdetector_m.GTis_c471_ADAS@ */ /end MEASUREMENT
/begin MEASUREMENT rtDW_ADAS.GTsf_Diodeblinkdetector_m.GTtemporalCounter_i1 "" ULONG ADAS_CM_uint32 0 0 0 4294967295 ECU_ADDRESS 0x0000 /* @ECU_Address@rtDW_ADAS.GTsf_Diodeblinkdetector_m.GTtemporalCounter_i1@ */ /end MEASUREMENT
/begin MEASUREMENT rtDW_ADAS.GTsf_Diodeblinkdetector_n.GTBlinkCount "" UBYTE ADAS_CM_uint8 0 0 0 255 ECU_ADDRESS 0x0000 /* @ECU_Address@rtDW_ADAS.GTsf_Diodeblinkdetector_n.GTBlinkCount@ */ /end MEASUREMENT
/begin MEASUREMENT rtDW_ADAS.GTsf_Diodeblinkdetector_n.GTis_COUNTING "" UBYTE ADAS_CM_uint8 0 0 0 255 ECU_ADDRESS 0x0000 /* @ECU_Address@rtDW_ADAS.GTsf_Diodeblinkdetector_n.GTis_COUNTING@ */ /end MEASUREMENT
/begin MEASUREMENT rtDW_ADAS.GTsf_Diodeblinkdetector_n.GTis_WORK "" UBYTE ADAS_CM_uint8 0 0 0 255 ECU_ADDRESS 0x0000 /* @ECU_Address@rtDW_ADAS.GTsf_Diodeblinkdetector_n.GTis_WORK@ */ /end MEASUREMENT
/begin MEASUREMENT rtDW_ADAS.GTsf_Diodeblinkdetector_n.GTis_active_c471_ADAS "" UBYTE ADAS_CM_uint8 0 0 0 255 ECU_ADDRESS 0x0000 /* @ECU_Address@rtDW_ADAS.GTsf_Diodeblinkdetector_n.GTis_active_c471_ADAS@ */ /end MEASUREMENT
/begin MEASUREMENT rtDW_ADAS.GTsf_Diodeblinkdetector_n.GTis_c471_ADAS "" UBYTE ADAS_CM_uint8 0 0 0 255 ECU_ADDRESS 0x0000 /* @ECU_Address@rtDW_ADAS.GTsf_Diodeblinkdetector_n.GTis_c471_ADAS@ */ /end MEASUREMENT
/begin MEASUREMENT rtDW_ADAS.GTsf_Diodeblinkdetector_n.GTtemporalCounter_i1 "" ULONG ADAS_CM_uint32 0 0 0 4294967295 ECU_ADDRESS 0x0000 /* @ECU_Address@rtDW_ADAS.GTsf_Diodeblinkdetector_n.GTtemporalCounter_i1@ */ /end MEASUREMENT
/begin MEASUREMENT rtDW_ADAS.GTsf_Diodeblinkdetector_na.GTBlinkCount "" UBYTE ADAS_CM_uint8 0 0 0 255 ECU_ADDRESS 0x0000 /* @ECU_Address@rtDW_ADAS.GTsf_Diodeblinkdetector_na.GTBlinkCount@ */ /end MEASUREMENT
/begin MEASUREMENT rtDW_ADAS.GTsf_Diodeblinkdetector_na.GTis_COUNTING "" UBYTE ADAS_CM_uint8 0 0 0 255 ECU_ADDRESS 0x0000 /* @ECU_Address@rtDW_ADAS.GTsf_Diodeblinkdetector_na.GTis_COUNTING@ */ /end MEASUREMENT
/begin MEASUREMENT rtDW_ADAS.GTsf_Diodeblinkdetector_na.GTis_WORK "" UBYTE ADAS_CM_uint8 0 0 0 255 ECU_ADDRESS 0x0000 /* @ECU_Address@rtDW_ADAS.GTsf_Diodeblinkdetector_na.GTis_WORK@ */ /end MEASUREMENT
/begin MEASUREMENT rtDW_ADAS.GTsf_Diodeblinkdetector_na.GTis_active_c471_ADAS "" UBYTE ADAS_CM_uint8 0 0 0 255 ECU_ADDRESS 0x0000 /* @ECU_Address@rtDW_ADAS.GTsf_Diodeblinkdetector_na.GTis_active_c471_ADAS@ */ /end MEASUREMENT
/begin MEASUREMENT rtDW_ADAS.GTsf_Diodeblinkdetector_na.GTis_c471_ADAS "" UBYTE ADAS_CM_uint8 0 0 0 255 ECU_ADDRESS 0x0000 /* @ECU_Address@rtDW_ADAS.GTsf_Diodeblinkdetector_na.GTis_c471_ADAS@ */ /end MEASUREMENT
/begin MEASUREMENT rtDW_ADAS.GTsf_Diodeblinkdetector_na.GTtemporalCounter_i1 "" ULONG ADAS_CM_uint32 0 0 0 4294967295 ECU_ADDRESS 0x0000 /* @ECU_Address@rtDW_ADAS.GTsf_Diodeblinkdetector_na.GTtemporalCounter_i1@ */ /end MEASUREMENT
/begin MEASUREMENT rtDW_ADAS.GTsf_Diodeblinkdetector_nb.GTBlinkCount "" UBYTE ADAS_CM_uint8 0 0 0 255 ECU_ADDRESS 0x0000 /* @ECU_Address@rtDW_ADAS.GTsf_Diodeblinkdetector_nb.GTBlinkCount@ */ /end MEASUREMENT
/begin MEASUREMENT rtDW_ADAS.GTsf_Diodeblinkdetector_nb.GTis_COUNTING "" UBYTE ADAS_CM_uint8 0 0 0 255 ECU_ADDRESS 0x0000 /* @ECU_Address@rtDW_ADAS.GTsf_Diodeblinkdetector_nb.GTis_COUNTING@ */ /end MEASUREMENT
/begin MEASUREMENT rtDW_ADAS.GTsf_Diodeblinkdetector_nb.GTis_WORK "" UBYTE ADAS_CM_uint8 0 0 0 255 ECU_ADDRESS 0x0000 /* @ECU_Address@rtDW_ADAS.GTsf_Diodeblinkdetector_nb.GTis_WORK@ */ /end MEASUREMENT
/begin MEASUREMENT rtDW_ADAS.GTsf_Diodeblinkdetector_nb.GTis_active_c471_ADAS "" UBYTE ADAS_CM_uint8 0 0 0 255 ECU_ADDRESS 0x0000 /* @ECU_Address@rtDW_ADAS.GTsf_Diodeblinkdetector_nb.GTis_active_c471_ADAS@ */ /end MEASUREMENT
/begin MEASUREMENT rtDW_ADAS.GTsf_Diodeblinkdetector_nb.GTis_c471_ADAS "" UBYTE ADAS_CM_uint8 0 0 0 255 ECU_ADDRESS 0x0000 /* @ECU_Address@rtDW_ADAS.GTsf_Diodeblinkdetector_nb.GTis_c471_ADAS@ */ /end MEASUREMENT
/begin MEASUREMENT rtDW_ADAS.GTsf_Diodeblinkdetector_nb.GTtemporalCounter_i1 "" ULONG ADAS_CM_uint32 0 0 0 4294967295 ECU_ADDRESS 0x0000 /* @ECU_Address@rtDW_ADAS.GTsf_Diodeblinkdetector_nb.GTtemporalCounter_i1@ */ /end MEASUREMENT
/begin MEASUREMENT rtDW_ADAS.GTsf_Diodeblinkdetector_ne.GTBlinkCount "" UBYTE ADAS_CM_uint8 0 0 0 255 ECU_ADDRESS 0x0000 /* @ECU_Address@rtDW_ADAS.GTsf_Diodeblinkdetector_ne.GTBlinkCount@ */ /end MEASUREMENT
/begin MEASUREMENT rtDW_ADAS.GTsf_Diodeblinkdetector_ne.GTis_COUNTING "" UBYTE ADAS_CM_uint8 0 0 0 255 ECU_ADDRESS 0x0000 /* @ECU_Address@rtDW_ADAS.GTsf_Diodeblinkdetector_ne.GTis_COUNTING@ */ /end MEASUREMENT
/begin MEASUREMENT rtDW_ADAS.GTsf_Diodeblinkdetector_ne.GTis_WORK "" UBYTE ADAS_CM_uint8 0 0 0 255 ECU_ADDRESS 0x0000 /* @ECU_Address@rtDW_ADAS.GTsf_Diodeblinkdetector_ne.GTis_WORK@ */ /end MEASUREMENT
/begin MEASUREMENT rtDW_ADAS.GTsf_Diodeblinkdetector_ne.GTis_active_c471_ADAS "" UBYTE ADAS_CM_uint8 0 0 0 255 ECU_ADDRESS 0x0000 /* @ECU_Address@rtDW_ADAS.GTsf_Diodeblinkdetector_ne.GTis_active_c471_ADAS@ */ /end MEASUREMENT
/begin MEASUREMENT rtDW_ADAS.GTsf_Diodeblinkdetector_ne.GTis_c471_ADAS "" UBYTE ADAS_CM_uint8 0 0 0 255 ECU_ADDRESS 0x0000 /* @ECU_Address@rtDW_ADAS.GTsf_Diodeblinkdetector_ne.GTis_c471_ADAS@ */ /end MEASUREMENT
/begin MEASUREMENT rtDW_ADAS.GTsf_Diodeblinkdetector_ne.GTtemporalCounter_i1 "" ULONG ADAS_CM_uint32 0 0 0 4294967295 ECU_ADDRESS 0x0000 /* @ECU_Address@rtDW_ADAS.GTsf_Diodeblinkdetector_ne.GTtemporalCounter_i1@ */ /end MEASUREMENT
/begin MEASUREMENT rtDW_ADAS.GTsf_Diodeblinkdetector_ng.GTBlinkCount "" UBYTE ADAS_CM_uint8 0 0 0 255 ECU_ADDRESS 0x0000 /* @ECU_Address@rtDW_ADAS.GTsf_Diodeblinkdetector_ng.GTBlinkCount@ */ /end MEASUREMENT
/begin MEASUREMENT rtDW_ADAS.GTsf_Diodeblinkdetector_ng.GTis_COUNTING "" UBYTE ADAS_CM_uint8 0 0 0 255 ECU_ADDRESS 0x0000 /* @ECU_Address@rtDW_ADAS.GTsf_Diodeblinkdetector_ng.GTis_COUNTING@ */ /end MEASUREMENT
/begin MEASUREMENT rtDW_ADAS.GTsf_Diodeblinkdetector_ng.GTis_WORK "" UBYTE ADAS_CM_uint8 0 0 0 255 ECU_ADDRESS 0x0000 /* @ECU_Address@rtDW_ADAS.GTsf_Diodeblinkdetector_ng.GTis_WORK@ */ /end MEASUREMENT
/begin MEASUREMENT rtDW_ADAS.GTsf_Diodeblinkdetector_ng.GTis_active_c471_ADAS "" UBYTE ADAS_CM_uint8 0 0 0 255 ECU_ADDRESS 0x0000 /* @ECU_Address@rtDW_ADAS.GTsf_Diodeblinkdetector_ng.GTis_active_c471_ADAS@ */ /end MEASUREMENT
/begin MEASUREMENT rtDW_ADAS.GTsf_Diodeblinkdetector_ng.GTis_c471_ADAS "" UBYTE ADAS_CM_uint8 0 0 0 255 ECU_ADDRESS 0x0000 /* @ECU_Address@rtDW_ADAS.GTsf_Diodeblinkdetector_ng.GTis_c471_ADAS@ */ /end MEASUREMENT
/begin MEASUREMENT rtDW_ADAS.GTsf_Diodeblinkdetector_ng.GTtemporalCounter_i1 "" ULONG ADAS_CM_uint32 0 0 0 4294967295 ECU_ADDRESS 0x0000 /* @ECU_Address@rtDW_ADAS.GTsf_Diodeblinkdetector_ng.GTtemporalCounter_i1@ */ /end MEASUREMENT
/begin MEASUREMENT rtDW_ADAS.GTsf_Diodeblinkdetector_o.GTBlinkCount "" UBYTE ADAS_CM_uint8 0 0 0 255 ECU_ADDRESS 0x0000 /* @ECU_Address@rtDW_ADAS.GTsf_Diodeblinkdetector_o.GTBlinkCount@ */ /end MEASUREMENT
/begin MEASUREMENT rtDW_ADAS.GTsf_Diodeblinkdetector_o.GTis_COUNTING "" UBYTE ADAS_CM_uint8 0 0 0 255 ECU_ADDRESS 0x0000 /* @ECU_Address@rtDW_ADAS.GTsf_Diodeblinkdetector_o.GTis_COUNTING@ */ /end MEASUREMENT
/begin MEASUREMENT rtDW_ADAS.GTsf_Diodeblinkdetector_o.GTis_WORK "" UBYTE ADAS_CM_uint8 0 0 0 255 ECU_ADDRESS 0x0000 /* @ECU_Address@rtDW_ADAS.GTsf_Diodeblinkdetector_o.GTis_WORK@ */ /end MEASUREMENT
/begin MEASUREMENT rtDW_ADAS.GTsf_Diodeblinkdetector_o.GTis_active_c471_ADAS "" UBYTE ADAS_CM_uint8 0 0 0 255 ECU_ADDRESS 0x0000 /* @ECU_Address@rtDW_ADAS.GTsf_Diodeblinkdetector_o.GTis_active_c471_ADAS@ */ /end MEASUREMENT
/begin MEASUREMENT rtDW_ADAS.GTsf_Diodeblinkdetector_o.GTis_c471_ADAS "" UBYTE ADAS_CM_uint8 0 0 0 255 ECU_ADDRESS 0x0000 /* @ECU_Address@rtDW_ADAS.GTsf_Diodeblinkdetector_o.GTis_c471_ADAS@ */ /end MEASUREMENT
/begin MEASUREMENT rtDW_ADAS.GTsf_Diodeblinkdetector_o.GTtemporalCounter_i1 "" ULONG ADAS_CM_uint32 0 0 0 4294967295 ECU_ADDRESS 0x0000 /* @ECU_Address@rtDW_ADAS.GTsf_Diodeblinkdetector_o.GTtemporalCounter_i1@ */ /end MEASUREMENT
/begin MEASUREMENT rtDW_ADAS.GTsf_Diodeblinkdetector_o4.GTBlinkCount "" UBYTE ADAS_CM_uint8 0 0 0 255 ECU_ADDRESS 0x0000 /* @ECU_Address@rtDW_ADAS.GTsf_Diodeblinkdetector_o4.GTBlinkCount@ */ /end MEASUREMENT
/begin MEASUREMENT rtDW_ADAS.GTsf_Diodeblinkdetector_o4.GTis_COUNTING "" UBYTE ADAS_CM_uint8 0 0 0 255 ECU_ADDRESS 0x0000 /* @ECU_Address@rtDW_ADAS.GTsf_Diodeblinkdetector_o4.GTis_COUNTING@ */ /end MEASUREMENT
/begin MEASUREMENT rtDW_ADAS.GTsf_Diodeblinkdetector_o4.GTis_WORK "" UBYTE ADAS_CM_uint8 0 0 0 255 ECU_ADDRESS 0x0000 /* @ECU_Address@rtDW_ADAS.GTsf_Diodeblinkdetector_o4.GTis_WORK@ */ /end MEASUREMENT
/begin MEASUREMENT rtDW_ADAS.GTsf_Diodeblinkdetector_o4.GTis_active_c471_ADAS "" UBYTE ADAS_CM_uint8 0 0 0 255 ECU_ADDRESS 0x0000 /* @ECU_Address@rtDW_ADAS.GTsf_Diodeblinkdetector_o4.GTis_active_c471_ADAS@ */ /end MEASUREMENT
/begin MEASUREMENT rtDW_ADAS.GTsf_Diodeblinkdetector_o4.GTis_c471_ADAS "" UBYTE ADAS_CM_uint8 0 0 0 255 ECU_ADDRESS 0x0000 /* @ECU_Address@rtDW_ADAS.GTsf_Diodeblinkdetector_o4.GTis_c471_ADAS@ */ /end MEASUREMENT
/begin MEASUREMENT rtDW_ADAS.GTsf_Diodeblinkdetector_o4.GTtemporalCounter_i1 "" ULONG ADAS_CM_uint32 0 0 0 4294967295 ECU_ADDRESS 0x0000 /* @ECU_Address@rtDW_ADAS.GTsf_Diodeblinkdetector_o4.GTtemporalCounter_i1@ */ /end MEASUREMENT
/begin MEASUREMENT rtDW_ADAS.GTsf_Diodeblinkdetector_om.GTBlinkCount "" UBYTE ADAS_CM_uint8 0 0 0 255 ECU_ADDRESS 0x0000 /* @ECU_Address@rtDW_ADAS.GTsf_Diodeblinkdetector_om.GTBlinkCount@ */ /end MEASUREMENT
/begin MEASUREMENT rtDW_ADAS.GTsf_Diodeblinkdetector_om.GTis_COUNTING "" UBYTE ADAS_CM_uint8 0 0 0 255 ECU_ADDRESS 0x0000 /* @ECU_Address@rtDW_ADAS.GTsf_Diodeblinkdetector_om.GTis_COUNTING@ */ /end MEASUREMENT
/begin MEASUREMENT rtDW_ADAS.GTsf_Diodeblinkdetector_om.GTis_WORK "" UBYTE ADAS_CM_uint8 0 0 0 255 ECU_ADDRESS 0x0000 /* @ECU_Address@rtDW_ADAS.GTsf_Diodeblinkdetector_om.GTis_WORK@ */ /end MEASUREMENT
/begin MEASUREMENT rtDW_ADAS.GTsf_Diodeblinkdetector_om.GTis_active_c471_ADAS "" UBYTE ADAS_CM_uint8 0 0 0 255 ECU_ADDRESS 0x0000 /* @ECU_Address@rtDW_ADAS.GTsf_Diodeblinkdetector_om.GTis_active_c471_ADAS@ */ /end MEASUREMENT
/begin MEASUREMENT rtDW_ADAS.GTsf_Diodeblinkdetector_om.GTis_c471_ADAS "" UBYTE ADAS_CM_uint8 0 0 0 255 ECU_ADDRESS 0x0000 /* @ECU_Address@rtDW_ADAS.GTsf_Diodeblinkdetector_om.GTis_c471_ADAS@ */ /end MEASUREMENT
/begin MEASUREMENT rtDW_ADAS.GTsf_Diodeblinkdetector_om.GTtemporalCounter_i1 "" ULONG ADAS_CM_uint32 0 0 0 4294967295 ECU_ADDRESS 0x0000 /* @ECU_Address@rtDW_ADAS.GTsf_Diodeblinkdetector_om.GTtemporalCounter_i1@ */ /end MEASUREMENT
/begin MEASUREMENT rtDW_ADAS.GTsf_Diodeblinkdetector_p.GTBlinkCount "" UBYTE ADAS_CM_uint8 0 0 0 255 ECU_ADDRESS 0x0000 /* @ECU_Address@rtDW_ADAS.GTsf_Diodeblinkdetector_p.GTBlinkCount@ */ /end MEASUREMENT
/begin MEASUREMENT rtDW_ADAS.GTsf_Diodeblinkdetector_p.GTis_COUNTING "" UBYTE ADAS_CM_uint8 0 0 0 255 ECU_ADDRESS 0x0000 /* @ECU_Address@rtDW_ADAS.GTsf_Diodeblinkdetector_p.GTis_COUNTING@ */ /end MEASUREMENT
/begin MEASUREMENT rtDW_ADAS.GTsf_Diodeblinkdetector_p.GTis_WORK "" UBYTE ADAS_CM_uint8 0 0 0 255 ECU_ADDRESS 0x0000 /* @ECU_Address@rtDW_ADAS.GTsf_Diodeblinkdetector_p.GTis_WORK@ */ /end MEASUREMENT
/begin MEASUREMENT rtDW_ADAS.GTsf_Diodeblinkdetector_p.GTis_active_c471_ADAS "" UBYTE ADAS_CM_uint8 0 0 0 255 ECU_ADDRESS 0x0000 /* @ECU_Address@rtDW_ADAS.GTsf_Diodeblinkdetector_p.GTis_active_c471_ADAS@ */ /end MEASUREMENT
/begin MEASUREMENT rtDW_ADAS.GTsf_Diodeblinkdetector_p.GTis_c471_ADAS "" UBYTE ADAS_CM_uint8 0 0 0 255 ECU_ADDRESS 0x0000 /* @ECU_Address@rtDW_ADAS.GTsf_Diodeblinkdetector_p.GTis_c471_ADAS@ */ /end MEASUREMENT
/begin MEASUREMENT rtDW_ADAS.GTsf_Diodeblinkdetector_p.GTtemporalCounter_i1 "" ULONG ADAS_CM_uint32 0 0 0 4294967295 ECU_ADDRESS 0x0000 /* @ECU_Address@rtDW_ADAS.GTsf_Diodeblinkdetector_p.GTtemporalCounter_i1@ */ /end MEASUREMENT
/begin MEASUREMENT rtDW_ADAS.GTsf_Diodeblinkdetector_pj.GTBlinkCount "" UBYTE ADAS_CM_uint8 0 0 0 255 ECU_ADDRESS 0x0000 /* @ECU_Address@rtDW_ADAS.GTsf_Diodeblinkdetector_pj.GTBlinkCount@ */ /end MEASUREMENT
/begin MEASUREMENT rtDW_ADAS.GTsf_Diodeblinkdetector_pj.GTis_COUNTING "" UBYTE ADAS_CM_uint8 0 0 0 255 ECU_ADDRESS 0x0000 /* @ECU_Address@rtDW_ADAS.GTsf_Diodeblinkdetector_pj.GTis_COUNTING@ */ /end MEASUREMENT
/begin MEASUREMENT rtDW_ADAS.GTsf_Diodeblinkdetector_pj.GTis_WORK "" UBYTE ADAS_CM_uint8 0 0 0 255 ECU_ADDRESS 0x0000 /* @ECU_Address@rtDW_ADAS.GTsf_Diodeblinkdetector_pj.GTis_WORK@ */ /end MEASUREMENT
/begin MEASUREMENT rtDW_ADAS.GTsf_Diodeblinkdetector_pj.GTis_active_c471_ADAS "" UBYTE ADAS_CM_uint8 0 0 0 255 ECU_ADDRESS 0x0000 /* @ECU_Address@rtDW_ADAS.GTsf_Diodeblinkdetector_pj.GTis_active_c471_ADAS@ */ /end MEASUREMENT
/begin MEASUREMENT rtDW_ADAS.GTsf_Diodeblinkdetector_pj.GTis_c471_ADAS "" UBYTE ADAS_CM_uint8 0 0 0 255 ECU_ADDRESS 0x0000 /* @ECU_Address@rtDW_ADAS.GTsf_Diodeblinkdetector_pj.GTis_c471_ADAS@ */ /end MEASUREMENT
/begin MEASUREMENT rtDW_ADAS.GTsf_Diodeblinkdetector_pj.GTtemporalCounter_i1 "" ULONG ADAS_CM_uint32 0 0 0 4294967295 ECU_ADDRESS 0x0000 /* @ECU_Address@rtDW_ADAS.GTsf_Diodeblinkdetector_pj.GTtemporalCounter_i1@ */ /end MEASUREMENT
/begin MEASUREMENT rtDW_ADAS.GTsf_Diodeblinkdetector_px.GTBlinkCount "" UBYTE ADAS_CM_uint8 0 0 0 255 ECU_ADDRESS 0x0000 /* @ECU_Address@rtDW_ADAS.GTsf_Diodeblinkdetector_px.GTBlinkCount@ */ /end MEASUREMENT
/begin MEASUREMENT rtDW_ADAS.GTsf_Diodeblinkdetector_px.GTis_COUNTING "" UBYTE ADAS_CM_uint8 0 0 0 255 ECU_ADDRESS 0x0000 /* @ECU_Address@rtDW_ADAS.GTsf_Diodeblinkdetector_px.GTis_COUNTING@ */ /end MEASUREMENT
/begin MEASUREMENT rtDW_ADAS.GTsf_Diodeblinkdetector_px.GTis_WORK "" UBYTE ADAS_CM_uint8 0 0 0 255 ECU_ADDRESS 0x0000 /* @ECU_Address@rtDW_ADAS.GTsf_Diodeblinkdetector_px.GTis_WORK@ */ /end MEASUREMENT
/begin MEASUREMENT rtDW_ADAS.GTsf_Diodeblinkdetector_px.GTis_active_c471_ADAS "" UBYTE ADAS_CM_uint8 0 0 0 255 ECU_ADDRESS 0x0000 /* @ECU_Address@rtDW_ADAS.GTsf_Diodeblinkdetector_px.GTis_active_c471_ADAS@ */ /end MEASUREMENT
/begin MEASUREMENT rtDW_ADAS.GTsf_Diodeblinkdetector_px.GTis_c471_ADAS "" UBYTE ADAS_CM_uint8 0 0 0 255 ECU_ADDRESS 0x0000 /* @ECU_Address@rtDW_ADAS.GTsf_Diodeblinkdetector_px.GTis_c471_ADAS@ */ /end MEASUREMENT
/begin MEASUREMENT rtDW_ADAS.GTsf_Diodeblinkdetector_px.GTtemporalCounter_i1 "" ULONG ADAS_CM_uint32 0 0 0 4294967295 ECU_ADDRESS 0x0000 /* @ECU_Address@rtDW_ADAS.GTsf_Diodeblinkdetector_px.GTtemporalCounter_i1@ */ /end MEASUREMENT
/begin MEASUREMENT rtDW_ADAS.GTsf_Diodefilter.GTis_active_c490_ADAS "" UBYTE ADAS_CM_uint8 0 0 0 255 ECU_ADDRESS 0x0000 /* @ECU_Address@rtDW_ADAS.GTsf_Diodefilter.GTis_active_c490_ADAS@ */ /end MEASUREMENT
/begin MEASUREMENT rtDW_ADAS.GTsf_Diodefilter.GTis_c490_ADAS "" UBYTE ADAS_CM_uint8 0 0 0 255 ECU_ADDRESS 0x0000 /* @ECU_Address@rtDW_ADAS.GTsf_Diodefilter.GTis_c490_ADAS@ */ /end MEASUREMENT
/begin MEASUREMENT rtDW_ADAS.GTsf_Diodefilter.GTtemporalCounter_i1 "" ULONG ADAS_CM_uint32 0 0 0 4294967295 ECU_ADDRESS 0x0000 /* @ECU_Address@rtDW_ADAS.GTsf_Diodefilter.GTtemporalCounter_i1@ */ /end MEASUREMENT
/begin MEASUREMENT rtDW_ADAS.GTsf_Diodefilter_a.GTis_active_c490_ADAS "" UBYTE ADAS_CM_uint8 0 0 0 255 ECU_ADDRESS 0x0000 /* @ECU_Address@rtDW_ADAS.GTsf_Diodefilter_a.GTis_active_c490_ADAS@ */ /end MEASUREMENT
/begin MEASUREMENT rtDW_ADAS.GTsf_Diodefilter_a.GTis_c490_ADAS "" UBYTE ADAS_CM_uint8 0 0 0 255 ECU_ADDRESS 0x0000 /* @ECU_Address@rtDW_ADAS.GTsf_Diodefilter_a.GTis_c490_ADAS@ */ /end MEASUREMENT
/begin MEASUREMENT rtDW_ADAS.GTsf_Diodefilter_a.GTtemporalCounter_i1 "" ULONG ADAS_CM_uint32 0 0 0 4294967295 ECU_ADDRESS 0x0000 /* @ECU_Address@rtDW_ADAS.GTsf_Diodefilter_a.GTtemporalCounter_i1@ */ /end MEASUREMENT
/begin MEASUREMENT rtDW_ADAS.GTsf_Diodefilter_ab.GTis_active_c490_ADAS "" UBYTE ADAS_CM_uint8 0 0 0 255 ECU_ADDRESS 0x0000 /* @ECU_Address@rtDW_ADAS.GTsf_Diodefilter_ab.GTis_active_c490_ADAS@ */ /end MEASUREMENT
/begin MEASUREMENT rtDW_ADAS.GTsf_Diodefilter_ab.GTis_c490_ADAS "" UBYTE ADAS_CM_uint8 0 0 0 255 ECU_ADDRESS 0x0000 /* @ECU_Address@rtDW_ADAS.GTsf_Diodefilter_ab.GTis_c490_ADAS@ */ /end MEASUREMENT
/begin MEASUREMENT rtDW_ADAS.GTsf_Diodefilter_ab.GTtemporalCounter_i1 "" ULONG ADAS_CM_uint32 0 0 0 4294967295 ECU_ADDRESS 0x0000 /* @ECU_Address@rtDW_ADAS.GTsf_Diodefilter_ab.GTtemporalCounter_i1@ */ /end MEASUREMENT
/begin MEASUREMENT rtDW_ADAS.GTsf_Diodefilter_af.GTis_active_c490_ADAS "" UBYTE ADAS_CM_uint8 0 0 0 255 ECU_ADDRESS 0x0000 /* @ECU_Address@rtDW_ADAS.GTsf_Diodefilter_af.GTis_active_c490_ADAS@ */ /end MEASUREMENT
/begin MEASUREMENT rtDW_ADAS.GTsf_Diodefilter_af.GTis_c490_ADAS "" UBYTE ADAS_CM_uint8 0 0 0 255 ECU_ADDRESS 0x0000 /* @ECU_Address@rtDW_ADAS.GTsf_Diodefilter_af.GTis_c490_ADAS@ */ /end MEASUREMENT
/begin MEASUREMENT rtDW_ADAS.GTsf_Diodefilter_af.GTtemporalCounter_i1 "" ULONG ADAS_CM_uint32 0 0 0 4294967295 ECU_ADDRESS 0x0000 /* @ECU_Address@rtDW_ADAS.GTsf_Diodefilter_af.GTtemporalCounter_i1@ */ /end MEASUREMENT
/begin MEASUREMENT rtDW_ADAS.GTsf_Diodefilter_aq.GTis_active_c490_ADAS "" UBYTE ADAS_CM_uint8 0 0 0 255 ECU_ADDRESS 0x0000 /* @ECU_Address@rtDW_ADAS.GTsf_Diodefilter_aq.GTis_active_c490_ADAS@ */ /end MEASUREMENT
/begin MEASUREMENT rtDW_ADAS.GTsf_Diodefilter_aq.GTis_c490_ADAS "" UBYTE ADAS_CM_uint8 0 0 0 255 ECU_ADDRESS 0x0000 /* @ECU_Address@rtDW_ADAS.GTsf_Diodefilter_aq.GTis_c490_ADAS@ */ /end MEASUREMENT
/begin MEASUREMENT rtDW_ADAS.GTsf_Diodefilter_aq.GTtemporalCounter_i1 "" ULONG ADAS_CM_uint32 0 0 0 4294967295 ECU_ADDRESS 0x0000 /* @ECU_Address@rtDW_ADAS.GTsf_Diodefilter_aq.GTtemporalCounter_i1@ */ /end MEASUREMENT
/begin MEASUREMENT rtDW_ADAS.GTsf_Diodefilter_b.GTis_active_c490_ADAS "" UBYTE ADAS_CM_uint8 0 0 0 255 ECU_ADDRESS 0x0000 /* @ECU_Address@rtDW_ADAS.GTsf_Diodefilter_b.GTis_active_c490_ADAS@ */ /end MEASUREMENT
/begin MEASUREMENT rtDW_ADAS.GTsf_Diodefilter_b.GTis_c490_ADAS "" UBYTE ADAS_CM_uint8 0 0 0 255 ECU_ADDRESS 0x0000 /* @ECU_Address@rtDW_ADAS.GTsf_Diodefilter_b.GTis_c490_ADAS@ */ /end MEASUREMENT
/begin MEASUREMENT rtDW_ADAS.GTsf_Diodefilter_b.GTtemporalCounter_i1 "" ULONG ADAS_CM_uint32 0 0 0 4294967295 ECU_ADDRESS 0x0000 /* @ECU_Address@rtDW_ADAS.GTsf_Diodefilter_b.GTtemporalCounter_i1@ */ /end MEASUREMENT
/begin MEASUREMENT rtDW_ADAS.GTsf_Diodefilter_bb.GTis_active_c490_ADAS "" UBYTE ADAS_CM_uint8 0 0 0 255 ECU_ADDRESS 0x0000 /* @ECU_Address@rtDW_ADAS.GTsf_Diodefilter_bb.GTis_active_c490_ADAS@ */ /end MEASUREMENT
/begin MEASUREMENT rtDW_ADAS.GTsf_Diodefilter_bb.GTis_c490_ADAS "" UBYTE ADAS_CM_uint8 0 0 0 255 ECU_ADDRESS 0x0000 /* @ECU_Address@rtDW_ADAS.GTsf_Diodefilter_bb.GTis_c490_ADAS@ */ /end MEASUREMENT
/begin MEASUREMENT rtDW_ADAS.GTsf_Diodefilter_bb.GTtemporalCounter_i1 "" ULONG ADAS_CM_uint32 0 0 0 4294967295 ECU_ADDRESS 0x0000 /* @ECU_Address@rtDW_ADAS.GTsf_Diodefilter_bb.GTtemporalCounter_i1@ */ /end MEASUREMENT
/begin MEASUREMENT rtDW_ADAS.GTsf_Diodefilter_c.GTis_active_c490_ADAS "" UBYTE ADAS_CM_uint8 0 0 0 255 ECU_ADDRESS 0x0000 /* @ECU_Address@rtDW_ADAS.GTsf_Diodefilter_c.GTis_active_c490_ADAS@ */ /end MEASUREMENT
/begin MEASUREMENT rtDW_ADAS.GTsf_Diodefilter_c.GTis_c490_ADAS "" UBYTE ADAS_CM_uint8 0 0 0 255 ECU_ADDRESS 0x0000 /* @ECU_Address@rtDW_ADAS.GTsf_Diodefilter_c.GTis_c490_ADAS@ */ /end MEASUREMENT
/begin MEASUREMENT rtDW_ADAS.GTsf_Diodefilter_c.GTtemporalCounter_i1 "" ULONG ADAS_CM_uint32 0 0 0 4294967295 ECU_ADDRESS 0x0000 /* @ECU_Address@rtDW_ADAS.GTsf_Diodefilter_c.GTtemporalCounter_i1@ */ /end MEASUREMENT
/begin MEASUREMENT rtDW_ADAS.GTsf_Diodefilter_co.GTis_active_c490_ADAS "" UBYTE ADAS_CM_uint8 0 0 0 255 ECU_ADDRESS 0x0000 /* @ECU_Address@rtDW_ADAS.GTsf_Diodefilter_co.GTis_active_c490_ADAS@ */ /end MEASUREMENT
/begin MEASUREMENT rtDW_ADAS.GTsf_Diodefilter_co.GTis_c490_ADAS "" UBYTE ADAS_CM_uint8 0 0 0 255 ECU_ADDRESS 0x0000 /* @ECU_Address@rtDW_ADAS.GTsf_Diodefilter_co.GTis_c490_ADAS@ */ /end MEASUREMENT
/begin MEASUREMENT rtDW_ADAS.GTsf_Diodefilter_co.GTtemporalCounter_i1 "" ULONG ADAS_CM_uint32 0 0 0 4294967295 ECU_ADDRESS 0x0000 /* @ECU_Address@rtDW_ADAS.GTsf_Diodefilter_co.GTtemporalCounter_i1@ */ /end MEASUREMENT
/begin MEASUREMENT rtDW_ADAS.GTsf_Diodefilter_d.GTis_active_c490_ADAS "" UBYTE ADAS_CM_uint8 0 0 0 255 ECU_ADDRESS 0x0000 /* @ECU_Address@rtDW_ADAS.GTsf_Diodefilter_d.GTis_active_c490_ADAS@ */ /end MEASUREMENT
/begin MEASUREMENT rtDW_ADAS.GTsf_Diodefilter_d.GTis_c490_ADAS "" UBYTE ADAS_CM_uint8 0 0 0 255 ECU_ADDRESS 0x0000 /* @ECU_Address@rtDW_ADAS.GTsf_Diodefilter_d.GTis_c490_ADAS@ */ /end MEASUREMENT
/begin MEASUREMENT rtDW_ADAS.GTsf_Diodefilter_d.GTtemporalCounter_i1 "" ULONG ADAS_CM_uint32 0 0 0 4294967295 ECU_ADDRESS 0x0000 /* @ECU_Address@rtDW_ADAS.GTsf_Diodefilter_d.GTtemporalCounter_i1@ */ /end MEASUREMENT
/begin MEASUREMENT rtDW_ADAS.GTsf_Diodefilter_e.GTis_active_c490_ADAS "" UBYTE ADAS_CM_uint8 0 0 0 255 ECU_ADDRESS 0x0000 /* @ECU_Address@rtDW_ADAS.GTsf_Diodefilter_e.GTis_active_c490_ADAS@ */ /end MEASUREMENT
/begin MEASUREMENT rtDW_ADAS.GTsf_Diodefilter_e.GTis_c490_ADAS "" UBYTE ADAS_CM_uint8 0 0 0 255 ECU_ADDRESS 0x0000 /* @ECU_Address@rtDW_ADAS.GTsf_Diodefilter_e.GTis_c490_ADAS@ */ /end MEASUREMENT
/begin MEASUREMENT rtDW_ADAS.GTsf_Diodefilter_e.GTtemporalCounter_i1 "" ULONG ADAS_CM_uint32 0 0 0 4294967295 ECU_ADDRESS 0x0000 /* @ECU_Address@rtDW_ADAS.GTsf_Diodefilter_e.GTtemporalCounter_i1@ */ /end MEASUREMENT
/begin MEASUREMENT rtDW_ADAS.GTsf_Diodefilter_e0.GTis_active_c490_ADAS "" UBYTE ADAS_CM_uint8 0 0 0 255 ECU_ADDRESS 0x0000 /* @ECU_Address@rtDW_ADAS.GTsf_Diodefilter_e0.GTis_active_c490_ADAS@ */ /end MEASUREMENT
/begin MEASUREMENT rtDW_ADAS.GTsf_Diodefilter_e0.GTis_c490_ADAS "" UBYTE ADAS_CM_uint8 0 0 0 255 ECU_ADDRESS 0x0000 /* @ECU_Address@rtDW_ADAS.GTsf_Diodefilter_e0.GTis_c490_ADAS@ */ /end MEASUREMENT
/begin MEASUREMENT rtDW_ADAS.GTsf_Diodefilter_e0.GTtemporalCounter_i1 "" ULONG ADAS_CM_uint32 0 0 0 4294967295 ECU_ADDRESS 0x0000 /* @ECU_Address@rtDW_ADAS.GTsf_Diodefilter_e0.GTtemporalCounter_i1@ */ /end MEASUREMENT
/begin MEASUREMENT rtDW_ADAS.GTsf_Diodefilter_ec.GTis_active_c490_ADAS "" UBYTE ADAS_CM_uint8 0 0 0 255 ECU_ADDRESS 0x0000 /* @ECU_Address@rtDW_ADAS.GTsf_Diodefilter_ec.GTis_active_c490_ADAS@ */ /end MEASUREMENT
/begin MEASUREMENT rtDW_ADAS.GTsf_Diodefilter_ec.GTis_c490_ADAS "" UBYTE ADAS_CM_uint8 0 0 0 255 ECU_ADDRESS 0x0000 /* @ECU_Address@rtDW_ADAS.GTsf_Diodefilter_ec.GTis_c490_ADAS@ */ /end MEASUREMENT
/begin MEASUREMENT rtDW_ADAS.GTsf_Diodefilter_ec.GTtemporalCounter_i1 "" ULONG ADAS_CM_uint32 0 0 0 4294967295 ECU_ADDRESS 0x0000 /* @ECU_Address@rtDW_ADAS.GTsf_Diodefilter_ec.GTtemporalCounter_i1@ */ /end MEASUREMENT
/begin MEASUREMENT rtDW_ADAS.GTsf_Diodefilter_g.GTis_active_c490_ADAS "" UBYTE ADAS_CM_uint8 0 0 0 255 ECU_ADDRESS 0x0000 /* @ECU_Address@rtDW_ADAS.GTsf_Diodefilter_g.GTis_active_c490_ADAS@ */ /end MEASUREMENT
/begin MEASUREMENT rtDW_ADAS.GTsf_Diodefilter_g.GTis_c490_ADAS "" UBYTE ADAS_CM_uint8 0 0 0 255 ECU_ADDRESS 0x0000 /* @ECU_Address@rtDW_ADAS.GTsf_Diodefilter_g.GTis_c490_ADAS@ */ /end MEASUREMENT
/begin MEASUREMENT rtDW_ADAS.GTsf_Diodefilter_g.GTtemporalCounter_i1 "" ULONG ADAS_CM_uint32 0 0 0 4294967295 ECU_ADDRESS 0x0000 /* @ECU_Address@rtDW_ADAS.GTsf_Diodefilter_g.GTtemporalCounter_i1@ */ /end MEASUREMENT
/begin MEASUREMENT rtDW_ADAS.GTsf_Diodefilter_g0.GTis_active_c490_ADAS "" UBYTE ADAS_CM_uint8 0 0 0 255 ECU_ADDRESS 0x0000 /* @ECU_Address@rtDW_ADAS.GTsf_Diodefilter_g0.GTis_active_c490_ADAS@ */ /end MEASUREMENT
/begin MEASUREMENT rtDW_ADAS.GTsf_Diodefilter_g0.GTis_c490_ADAS "" UBYTE ADAS_CM_uint8 0 0 0 255 ECU_ADDRESS 0x0000 /* @ECU_Address@rtDW_ADAS.GTsf_Diodefilter_g0.GTis_c490_ADAS@ */ /end MEASUREMENT
/begin MEASUREMENT rtDW_ADAS.GTsf_Diodefilter_g0.GTtemporalCounter_i1 "" ULONG ADAS_CM_uint32 0 0 0 4294967295 ECU_ADDRESS 0x0000 /* @ECU_Address@rtDW_ADAS.GTsf_Diodefilter_g0.GTtemporalCounter_i1@ */ /end MEASUREMENT
/begin MEASUREMENT rtDW_ADAS.GTsf_Diodefilter_gb.GTis_active_c490_ADAS "" UBYTE ADAS_CM_uint8 0 0 0 255 ECU_ADDRESS 0x0000 /* @ECU_Address@rtDW_ADAS.GTsf_Diodefilter_gb.GTis_active_c490_ADAS@ */ /end MEASUREMENT
/begin MEASUREMENT rtDW_ADAS.GTsf_Diodefilter_gb.GTis_c490_ADAS "" UBYTE ADAS_CM_uint8 0 0 0 255 ECU_ADDRESS 0x0000 /* @ECU_Address@rtDW_ADAS.GTsf_Diodefilter_gb.GTis_c490_ADAS@ */ /end MEASUREMENT
/begin MEASUREMENT rtDW_ADAS.GTsf_Diodefilter_gb.GTtemporalCounter_i1 "" ULONG ADAS_CM_uint32 0 0 0 4294967295 ECU_ADDRESS 0x0000 /* @ECU_Address@rtDW_ADAS.GTsf_Diodefilter_gb.GTtemporalCounter_i1@ */ /end MEASUREMENT
/begin MEASUREMENT rtDW_ADAS.GTsf_Diodefilter_gj.GTis_active_c490_ADAS "" UBYTE ADAS_CM_uint8 0 0 0 255 ECU_ADDRESS 0x0000 /* @ECU_Address@rtDW_ADAS.GTsf_Diodefilter_gj.GTis_active_c490_ADAS@ */ /end MEASUREMENT
/begin MEASUREMENT rtDW_ADAS.GTsf_Diodefilter_gj.GTis_c490_ADAS "" UBYTE ADAS_CM_uint8 0 0 0 255 ECU_ADDRESS 0x0000 /* @ECU_Address@rtDW_ADAS.GTsf_Diodefilter_gj.GTis_c490_ADAS@ */ /end MEASUREMENT
/begin MEASUREMENT rtDW_ADAS.GTsf_Diodefilter_gj.GTtemporalCounter_i1 "" ULONG ADAS_CM_uint32 0 0 0 4294967295 ECU_ADDRESS 0x0000 /* @ECU_Address@rtDW_ADAS.GTsf_Diodefilter_gj.GTtemporalCounter_i1@ */ /end MEASUREMENT
/begin MEASUREMENT rtDW_ADAS.GTsf_Diodefilter_gv.GTis_active_c490_ADAS "" UBYTE ADAS_CM_uint8 0 0 0 255 ECU_ADDRESS 0x0000 /* @ECU_Address@rtDW_ADAS.GTsf_Diodefilter_gv.GTis_active_c490_ADAS@ */ /end MEASUREMENT
/begin MEASUREMENT rtDW_ADAS.GTsf_Diodefilter_gv.GTis_c490_ADAS "" UBYTE ADAS_CM_uint8 0 0 0 255 ECU_ADDRESS 0x0000 /* @ECU_Address@rtDW_ADAS.GTsf_Diodefilter_gv.GTis_c490_ADAS@ */ /end MEASUREMENT
/begin MEASUREMENT rtDW_ADAS.GTsf_Diodefilter_gv.GTtemporalCounter_i1 "" ULONG ADAS_CM_uint32 0 0 0 4294967295 ECU_ADDRESS 0x0000 /* @ECU_Address@rtDW_ADAS.GTsf_Diodefilter_gv.GTtemporalCounter_i1@ */ /end MEASUREMENT
/begin MEASUREMENT rtDW_ADAS.GTsf_Diodefilter_h.GTis_active_c490_ADAS "" UBYTE ADAS_CM_uint8 0 0 0 255 ECU_ADDRESS 0x0000 /* @ECU_Address@rtDW_ADAS.GTsf_Diodefilter_h.GTis_active_c490_ADAS@ */ /end MEASUREMENT
/begin MEASUREMENT rtDW_ADAS.GTsf_Diodefilter_h.GTis_c490_ADAS "" UBYTE ADAS_CM_uint8 0 0 0 255 ECU_ADDRESS 0x0000 /* @ECU_Address@rtDW_ADAS.GTsf_Diodefilter_h.GTis_c490_ADAS@ */ /end MEASUREMENT
/begin MEASUREMENT rtDW_ADAS.GTsf_Diodefilter_h.GTtemporalCounter_i1 "" ULONG ADAS_CM_uint32 0 0 0 4294967295 ECU_ADDRESS 0x0000 /* @ECU_Address@rtDW_ADAS.GTsf_Diodefilter_h.GTtemporalCounter_i1@ */ /end MEASUREMENT
/begin MEASUREMENT rtDW_ADAS.GTsf_Diodefilter_ho.GTis_active_c490_ADAS "" UBYTE ADAS_CM_uint8 0 0 0 255 ECU_ADDRESS 0x0000 /* @ECU_Address@rtDW_ADAS.GTsf_Diodefilter_ho.GTis_active_c490_ADAS@ */ /end MEASUREMENT
/begin MEASUREMENT rtDW_ADAS.GTsf_Diodefilter_ho.GTis_c490_ADAS "" UBYTE ADAS_CM_uint8 0 0 0 255 ECU_ADDRESS 0x0000 /* @ECU_Address@rtDW_ADAS.GTsf_Diodefilter_ho.GTis_c490_ADAS@ */ /end MEASUREMENT
/begin MEASUREMENT rtDW_ADAS.GTsf_Diodefilter_ho.GTtemporalCounter_i1 "" ULONG ADAS_CM_uint32 0 0 0 4294967295 ECU_ADDRESS 0x0000 /* @ECU_Address@rtDW_ADAS.GTsf_Diodefilter_ho.GTtemporalCounter_i1@ */ /end MEASUREMENT
/begin MEASUREMENT rtDW_ADAS.GTsf_Diodefilter_i.GTis_active_c490_ADAS "" UBYTE ADAS_CM_uint8 0 0 0 255 ECU_ADDRESS 0x0000 /* @ECU_Address@rtDW_ADAS.GTsf_Diodefilter_i.GTis_active_c490_ADAS@ */ /end MEASUREMENT
/begin MEASUREMENT rtDW_ADAS.GTsf_Diodefilter_i.GTis_c490_ADAS "" UBYTE ADAS_CM_uint8 0 0 0 255 ECU_ADDRESS 0x0000 /* @ECU_Address@rtDW_ADAS.GTsf_Diodefilter_i.GTis_c490_ADAS@ */ /end MEASUREMENT
/begin MEASUREMENT rtDW_ADAS.GTsf_Diodefilter_i.GTtemporalCounter_i1 "" ULONG ADAS_CM_uint32 0 0 0 4294967295 ECU_ADDRESS 0x0000 /* @ECU_Address@rtDW_ADAS.GTsf_Diodefilter_i.GTtemporalCounter_i1@ */ /end MEASUREMENT
/begin MEASUREMENT rtDW_ADAS.GTsf_Diodefilter_it.GTis_active_c490_ADAS "" UBYTE ADAS_CM_uint8 0 0 0 255 ECU_ADDRESS 0x0000 /* @ECU_Address@rtDW_ADAS.GTsf_Diodefilter_it.GTis_active_c490_ADAS@ */ /end MEASUREMENT
/begin MEASUREMENT rtDW_ADAS.GTsf_Diodefilter_it.GTis_c490_ADAS "" UBYTE ADAS_CM_uint8 0 0 0 255 ECU_ADDRESS 0x0000 /* @ECU_Address@rtDW_ADAS.GTsf_Diodefilter_it.GTis_c490_ADAS@ */ /end MEASUREMENT
/begin MEASUREMENT rtDW_ADAS.GTsf_Diodefilter_it.GTtemporalCounter_i1 "" ULONG ADAS_CM_uint32 0 0 0 4294967295 ECU_ADDRESS 0x0000 /* @ECU_Address@rtDW_ADAS.GTsf_Diodefilter_it.GTtemporalCounter_i1@ */ /end MEASUREMENT
/begin MEASUREMENT rtDW_ADAS.GTsf_Diodefilter_j.GTis_active_c490_ADAS "" UBYTE ADAS_CM_uint8 0 0 0 255 ECU_ADDRESS 0x0000 /* @ECU_Address@rtDW_ADAS.GTsf_Diodefilter_j.GTis_active_c490_ADAS@ */ /end MEASUREMENT
/begin MEASUREMENT rtDW_ADAS.GTsf_Diodefilter_j.GTis_c490_ADAS "" UBYTE ADAS_CM_uint8 0 0 0 255 ECU_ADDRESS 0x0000 /* @ECU_Address@rtDW_ADAS.GTsf_Diodefilter_j.GTis_c490_ADAS@ */ /end MEASUREMENT
/begin MEASUREMENT rtDW_ADAS.GTsf_Diodefilter_j.GTtemporalCounter_i1 "" ULONG ADAS_CM_uint32 0 0 0 4294967295 ECU_ADDRESS 0x0000 /* @ECU_Address@rtDW_ADAS.GTsf_Diodefilter_j.GTtemporalCounter_i1@ */ /end MEASUREMENT
/begin MEASUREMENT rtDW_ADAS.GTsf_Diodefilter_k.GTis_active_c490_ADAS "" UBYTE ADAS_CM_uint8 0 0 0 255 ECU_ADDRESS 0x0000 /* @ECU_Address@rtDW_ADAS.GTsf_Diodefilter_k.GTis_active_c490_ADAS@ */ /end MEASUREMENT
/begin MEASUREMENT rtDW_ADAS.GTsf_Diodefilter_k.GTis_c490_ADAS "" UBYTE ADAS_CM_uint8 0 0 0 255 ECU_ADDRESS 0x0000 /* @ECU_Address@rtDW_ADAS.GTsf_Diodefilter_k.GTis_c490_ADAS@ */ /end MEASUREMENT
/begin MEASUREMENT rtDW_ADAS.GTsf_Diodefilter_k.GTtemporalCounter_i1 "" ULONG ADAS_CM_uint32 0 0 0 4294967295 ECU_ADDRESS 0x0000 /* @ECU_Address@rtDW_ADAS.GTsf_Diodefilter_k.GTtemporalCounter_i1@ */ /end MEASUREMENT
/begin MEASUREMENT rtDW_ADAS.GTsf_Diodefilter_l.GTis_active_c490_ADAS "" UBYTE ADAS_CM_uint8 0 0 0 255 ECU_ADDRESS 0x0000 /* @ECU_Address@rtDW_ADAS.GTsf_Diodefilter_l.GTis_active_c490_ADAS@ */ /end MEASUREMENT
/begin MEASUREMENT rtDW_ADAS.GTsf_Diodefilter_l.GTis_c490_ADAS "" UBYTE ADAS_CM_uint8 0 0 0 255 ECU_ADDRESS 0x0000 /* @ECU_Address@rtDW_ADAS.GTsf_Diodefilter_l.GTis_c490_ADAS@ */ /end MEASUREMENT
/begin MEASUREMENT rtDW_ADAS.GTsf_Diodefilter_l.GTtemporalCounter_i1 "" ULONG ADAS_CM_uint32 0 0 0 4294967295 ECU_ADDRESS 0x0000 /* @ECU_Address@rtDW_ADAS.GTsf_Diodefilter_l.GTtemporalCounter_i1@ */ /end MEASUREMENT
/begin MEASUREMENT rtDW_ADAS.GTsf_Diodefilter_l3.GTis_active_c490_ADAS "" UBYTE ADAS_CM_uint8 0 0 0 255 ECU_ADDRESS 0x0000 /* @ECU_Address@rtDW_ADAS.GTsf_Diodefilter_l3.GTis_active_c490_ADAS@ */ /end MEASUREMENT
/begin MEASUREMENT rtDW_ADAS.GTsf_Diodefilter_l3.GTis_c490_ADAS "" UBYTE ADAS_CM_uint8 0 0 0 255 ECU_ADDRESS 0x0000 /* @ECU_Address@rtDW_ADAS.GTsf_Diodefilter_l3.GTis_c490_ADAS@ */ /end MEASUREMENT
/begin MEASUREMENT rtDW_ADAS.GTsf_Diodefilter_l3.GTtemporalCounter_i1 "" ULONG ADAS_CM_uint32 0 0 0 4294967295 ECU_ADDRESS 0x0000 /* @ECU_Address@rtDW_ADAS.GTsf_Diodefilter_l3.GTtemporalCounter_i1@ */ /end MEASUREMENT
/begin MEASUREMENT rtDW_ADAS.GTsf_Diodefilter_lk.GTis_active_c490_ADAS "" UBYTE ADAS_CM_uint8 0 0 0 255 ECU_ADDRESS 0x0000 /* @ECU_Address@rtDW_ADAS.GTsf_Diodefilter_lk.GTis_active_c490_ADAS@ */ /end MEASUREMENT
/begin MEASUREMENT rtDW_ADAS.GTsf_Diodefilter_lk.GTis_c490_ADAS "" UBYTE ADAS_CM_uint8 0 0 0 255 ECU_ADDRESS 0x0000 /* @ECU_Address@rtDW_ADAS.GTsf_Diodefilter_lk.GTis_c490_ADAS@ */ /end MEASUREMENT
/begin MEASUREMENT rtDW_ADAS.GTsf_Diodefilter_lk.GTtemporalCounter_i1 "" ULONG ADAS_CM_uint32 0 0 0 4294967295 ECU_ADDRESS 0x0000 /* @ECU_Address@rtDW_ADAS.GTsf_Diodefilter_lk.GTtemporalCounter_i1@ */ /end MEASUREMENT
/begin MEASUREMENT rtDW_ADAS.GTsf_Diodefilter_n.GTis_active_c490_ADAS "" UBYTE ADAS_CM_uint8 0 0 0 255 ECU_ADDRESS 0x0000 /* @ECU_Address@rtDW_ADAS.GTsf_Diodefilter_n.GTis_active_c490_ADAS@ */ /end MEASUREMENT
/begin MEASUREMENT rtDW_ADAS.GTsf_Diodefilter_n.GTis_c490_ADAS "" UBYTE ADAS_CM_uint8 0 0 0 255 ECU_ADDRESS 0x0000 /* @ECU_Address@rtDW_ADAS.GTsf_Diodefilter_n.GTis_c490_ADAS@ */ /end MEASUREMENT
/begin MEASUREMENT rtDW_ADAS.GTsf_Diodefilter_n.GTtemporalCounter_i1 "" ULONG ADAS_CM_uint32 0 0 0 4294967295 ECU_ADDRESS 0x0000 /* @ECU_Address@rtDW_ADAS.GTsf_Diodefilter_n.GTtemporalCounter_i1@ */ /end MEASUREMENT
/begin MEASUREMENT rtDW_ADAS.GTsf_Diodefilter_n3.GTis_active_c490_ADAS "" UBYTE ADAS_CM_uint8 0 0 0 255 ECU_ADDRESS 0x0000 /* @ECU_Address@rtDW_ADAS.GTsf_Diodefilter_n3.GTis_active_c490_ADAS@ */ /end MEASUREMENT
/begin MEASUREMENT rtDW_ADAS.GTsf_Diodefilter_n3.GTis_c490_ADAS "" UBYTE ADAS_CM_uint8 0 0 0 255 ECU_ADDRESS 0x0000 /* @ECU_Address@rtDW_ADAS.GTsf_Diodefilter_n3.GTis_c490_ADAS@ */ /end MEASUREMENT
/begin MEASUREMENT rtDW_ADAS.GTsf_Diodefilter_n3.GTtemporalCounter_i1 "" ULONG ADAS_CM_uint32 0 0 0 4294967295 ECU_ADDRESS 0x0000 /* @ECU_Address@rtDW_ADAS.GTsf_Diodefilter_n3.GTtemporalCounter_i1@ */ /end MEASUREMENT
/begin MEASUREMENT rtDW_ADAS.GTsf_Diodefilter_ng.GTis_active_c490_ADAS "" UBYTE ADAS_CM_uint8 0 0 0 255 ECU_ADDRESS 0x0000 /* @ECU_Address@rtDW_ADAS.GTsf_Diodefilter_ng.GTis_active_c490_ADAS@ */ /end MEASUREMENT
/begin MEASUREMENT rtDW_ADAS.GTsf_Diodefilter_ng.GTis_c490_ADAS "" UBYTE ADAS_CM_uint8 0 0 0 255 ECU_ADDRESS 0x0000 /* @ECU_Address@rtDW_ADAS.GTsf_Diodefilter_ng.GTis_c490_ADAS@ */ /end MEASUREMENT
/begin MEASUREMENT rtDW_ADAS.GTsf_Diodefilter_ng.GTtemporalCounter_i1 "" ULONG ADAS_CM_uint32 0 0 0 4294967295 ECU_ADDRESS 0x0000 /* @ECU_Address@rtDW_ADAS.GTsf_Diodefilter_ng.GTtemporalCounter_i1@ */ /end MEASUREMENT
/begin MEASUREMENT rtDW_ADAS.GTsf_Diodefilter_nj.GTis_active_c490_ADAS "" UBYTE ADAS_CM_uint8 0 0 0 255 ECU_ADDRESS 0x0000 /* @ECU_Address@rtDW_ADAS.GTsf_Diodefilter_nj.GTis_active_c490_ADAS@ */ /end MEASUREMENT
/begin MEASUREMENT rtDW_ADAS.GTsf_Diodefilter_nj.GTis_c490_ADAS "" UBYTE ADAS_CM_uint8 0 0 0 255 ECU_ADDRESS 0x0000 /* @ECU_Address@rtDW_ADAS.GTsf_Diodefilter_nj.GTis_c490_ADAS@ */ /end MEASUREMENT
/begin MEASUREMENT rtDW_ADAS.GTsf_Diodefilter_nj.GTtemporalCounter_i1 "" ULONG ADAS_CM_uint32 0 0 0 4294967295 ECU_ADDRESS 0x0000 /* @ECU_Address@rtDW_ADAS.GTsf_Diodefilter_nj.GTtemporalCounter_i1@ */ /end MEASUREMENT
/begin MEASUREMENT rtDW_ADAS.GTsf_Diodefilter_nk.GTis_active_c490_ADAS "" UBYTE ADAS_CM_uint8 0 0 0 255 ECU_ADDRESS 0x0000 /* @ECU_Address@rtDW_ADAS.GTsf_Diodefilter_nk.GTis_active_c490_ADAS@ */ /end MEASUREMENT
/begin MEASUREMENT rtDW_ADAS.GTsf_Diodefilter_nk.GTis_c490_ADAS "" UBYTE ADAS_CM_uint8 0 0 0 255 ECU_ADDRESS 0x0000 /* @ECU_Address@rtDW_ADAS.GTsf_Diodefilter_nk.GTis_c490_ADAS@ */ /end MEASUREMENT
/begin MEASUREMENT rtDW_ADAS.GTsf_Diodefilter_nk.GTtemporalCounter_i1 "" ULONG ADAS_CM_uint32 0 0 0 4294967295 ECU_ADDRESS 0x0000 /* @ECU_Address@rtDW_ADAS.GTsf_Diodefilter_nk.GTtemporalCounter_i1@ */ /end MEASUREMENT
/begin MEASUREMENT rtDW_ADAS.GTsf_Diodefilter_o.GTis_active_c490_ADAS "" UBYTE ADAS_CM_uint8 0 0 0 255 ECU_ADDRESS 0x0000 /* @ECU_Address@rtDW_ADAS.GTsf_Diodefilter_o.GTis_active_c490_ADAS@ */ /end MEASUREMENT
/begin MEASUREMENT rtDW_ADAS.GTsf_Diodefilter_o.GTis_c490_ADAS "" UBYTE ADAS_CM_uint8 0 0 0 255 ECU_ADDRESS 0x0000 /* @ECU_Address@rtDW_ADAS.GTsf_Diodefilter_o.GTis_c490_ADAS@ */ /end MEASUREMENT
/begin MEASUREMENT rtDW_ADAS.GTsf_Diodefilter_o.GTtemporalCounter_i1 "" ULONG ADAS_CM_uint32 0 0 0 4294967295 ECU_ADDRESS 0x0000 /* @ECU_Address@rtDW_ADAS.GTsf_Diodefilter_o.GTtemporalCounter_i1@ */ /end MEASUREMENT
/begin MEASUREMENT rtDW_ADAS.GTsf_Diodefilter_od.GTis_active_c490_ADAS "" UBYTE ADAS_CM_uint8 0 0 0 255 ECU_ADDRESS 0x0000 /* @ECU_Address@rtDW_ADAS.GTsf_Diodefilter_od.GTis_active_c490_ADAS@ */ /end MEASUREMENT
/begin MEASUREMENT rtDW_ADAS.GTsf_Diodefilter_od.GTis_c490_ADAS "" UBYTE ADAS_CM_uint8 0 0 0 255 ECU_ADDRESS 0x0000 /* @ECU_Address@rtDW_ADAS.GTsf_Diodefilter_od.GTis_c490_ADAS@ */ /end MEASUREMENT
/begin MEASUREMENT rtDW_ADAS.GTsf_Diodefilter_od.GTtemporalCounter_i1 "" ULONG ADAS_CM_uint32 0 0 0 4294967295 ECU_ADDRESS 0x0000 /* @ECU_Address@rtDW_ADAS.GTsf_Diodefilter_od.GTtemporalCounter_i1@ */ /end MEASUREMENT
/begin MEASUREMENT rtDW_ADAS.GTsf_Diodefilter_op.GTis_active_c490_ADAS "" UBYTE ADAS_CM_uint8 0 0 0 255 ECU_ADDRESS 0x0000 /* @ECU_Address@rtDW_ADAS.GTsf_Diodefilter_op.GTis_active_c490_ADAS@ */ /end MEASUREMENT
/begin MEASUREMENT rtDW_ADAS.GTsf_Diodefilter_op.GTis_c490_ADAS "" UBYTE ADAS_CM_uint8 0 0 0 255 ECU_ADDRESS 0x0000 /* @ECU_Address@rtDW_ADAS.GTsf_Diodefilter_op.GTis_c490_ADAS@ */ /end MEASUREMENT
/begin MEASUREMENT rtDW_ADAS.GTsf_Diodefilter_op.GTtemporalCounter_i1 "" ULONG ADAS_CM_uint32 0 0 0 4294967295 ECU_ADDRESS 0x0000 /* @ECU_Address@rtDW_ADAS.GTsf_Diodefilter_op.GTtemporalCounter_i1@ */ /end MEASUREMENT
/begin MEASUREMENT rtDW_ADAS.GTsf_Diodefilter_p.GTis_active_c490_ADAS "" UBYTE ADAS_CM_uint8 0 0 0 255 ECU_ADDRESS 0x0000 /* @ECU_Address@rtDW_ADAS.GTsf_Diodefilter_p.GTis_active_c490_ADAS@ */ /end MEASUREMENT
/begin MEASUREMENT rtDW_ADAS.GTsf_Diodefilter_p.GTis_c490_ADAS "" UBYTE ADAS_CM_uint8 0 0 0 255 ECU_ADDRESS 0x0000 /* @ECU_Address@rtDW_ADAS.GTsf_Diodefilter_p.GTis_c490_ADAS@ */ /end MEASUREMENT
/begin MEASUREMENT rtDW_ADAS.GTsf_Diodefilter_p.GTtemporalCounter_i1 "" ULONG ADAS_CM_uint32 0 0 0 4294967295 ECU_ADDRESS 0x0000 /* @ECU_Address@rtDW_ADAS.GTsf_Diodefilter_p.GTtemporalCounter_i1@ */ /end MEASUREMENT
/begin MEASUREMENT rtDW_ADAS.GTsf_Distancefrozen1.GTcount "" UBYTE ADAS_CM_uint8 0 0 0 255 ECU_ADDRESS 0x0000 /* @ECU_Address@rtDW_ADAS.GTsf_Distancefrozen1.GTcount@ */ /end MEASUREMENT
/begin MEASUREMENT rtDW_ADAS.GTsf_Distancefrozen1.GTis_active_c45_ADAS "" UBYTE ADAS_CM_uint8 0 0 0 255 ECU_ADDRESS 0x0000 /* @ECU_Address@rtDW_ADAS.GTsf_Distancefrozen1.GTis_active_c45_ADAS@ */ /end MEASUREMENT
/begin MEASUREMENT rtDW_ADAS.GTsf_Distancefrozen1.GTis_c45_ADAS "" UBYTE ADAS_CM_uint8 0 0 0 255 ECU_ADDRESS 0x0000 /* @ECU_Address@rtDW_ADAS.GTsf_Distancefrozen1.GTis_c45_ADAS@ */ /end MEASUREMENT
/begin MEASUREMENT rtDW_ADAS.GTsf_Distancefrozen1.GTtemporalCounter_i1 "" UBYTE ADAS_CM_uint8 0 0 0 255 ECU_ADDRESS 0x0000 /* @ECU_Address@rtDW_ADAS.GTsf_Distancefrozen1.GTtemporalCounter_i1@ */ /end MEASUREMENT
/begin MEASUREMENT rtDW_ADAS.GTsf_Dow_warning_requester_SF_a.GTdurationCounter_1 "" SLONG ADAS_CM_int32 0 0 -2147483648 2147483647 ECU_ADDRESS 0x0000 /* @ECU_Address@rtDW_ADAS.GTsf_Dow_warning_requester_SF_a.GTdurationCounter_1@ */ /end MEASUREMENT
/begin MEASUREMENT rtDW_ADAS.GTsf_Dow_warning_requester_SF_a.GTdurationCounter_1_f "" SLONG ADAS_CM_int32 0 0 -2147483648 2147483647 ECU_ADDRESS 0x0000 /* @ECU_Address@rtDW_ADAS.GTsf_Dow_warning_requester_SF_a.GTdurationCounter_1_f@ */ /end MEASUREMENT
/begin MEASUREMENT rtDW_ADAS.GTsf_Dow_warning_requester_SF_a.GTis_Warning_state "" UBYTE ADAS_CM_uint8 0 0 0 255 ECU_ADDRESS 0x0000 /* @ECU_Address@rtDW_ADAS.GTsf_Dow_warning_requester_SF_a.GTis_Warning_state@ */ /end MEASUREMENT
/begin MEASUREMENT rtDW_ADAS.GTsf_Dow_warning_requester_SF_a.GTis_active_c625_ADAS "" UBYTE ADAS_CM_uint8 0 0 0 255 ECU_ADDRESS 0x0000 /* @ECU_Address@rtDW_ADAS.GTsf_Dow_warning_requester_SF_a.GTis_active_c625_ADAS@ */ /end MEASUREMENT
/begin MEASUREMENT rtDW_ADAS.GTsf_Dow_warning_requester_SF_a.GTis_c625_ADAS "" UBYTE ADAS_CM_uint8 0 0 0 255 ECU_ADDRESS 0x0000 /* @ECU_Address@rtDW_ADAS.GTsf_Dow_warning_requester_SF_a.GTis_c625_ADAS@ */ /end MEASUREMENT
/begin MEASUREMENT rtDW_ADAS.GTsf_Dow_warning_requester_SF_a.GTtemporalCounter_i1 "" ULONG ADAS_CM_uint32 0 0 0 4294967295 ECU_ADDRESS 0x0000 /* @ECU_Address@rtDW_ADAS.GTsf_Dow_warning_requester_SF_a.GTtemporalCounter_i1@ */ /end MEASUREMENT
/begin MEASUREMENT rtDW_ADAS.GTsf_Dow_warning_requester_SF_c.GTdurationCounter_1 "" SLONG ADAS_CM_int32 0 0 -2147483648 2147483647 ECU_ADDRESS 0x0000 /* @ECU_Address@rtDW_ADAS.GTsf_Dow_warning_requester_SF_c.GTdurationCounter_1@ */ /end MEASUREMENT
/begin MEASUREMENT rtDW_ADAS.GTsf_Dow_warning_requester_SF_c.GTdurationCounter_1_f "" SLONG ADAS_CM_int32 0 0 -2147483648 2147483647 ECU_ADDRESS 0x0000 /* @ECU_Address@rtDW_ADAS.GTsf_Dow_warning_requester_SF_c.GTdurationCounter_1_f@ */ /end MEASUREMENT
/begin MEASUREMENT rtDW_ADAS.GTsf_Dow_warning_requester_SF_c.GTis_Warning_state "" UBYTE ADAS_CM_uint8 0 0 0 255 ECU_ADDRESS 0x0000 /* @ECU_Address@rtDW_ADAS.GTsf_Dow_warning_requester_SF_c.GTis_Warning_state@ */ /end MEASUREMENT
/begin MEASUREMENT rtDW_ADAS.GTsf_Dow_warning_requester_SF_c.GTis_active_c625_ADAS "" UBYTE ADAS_CM_uint8 0 0 0 255 ECU_ADDRESS 0x0000 /* @ECU_Address@rtDW_ADAS.GTsf_Dow_warning_requester_SF_c.GTis_active_c625_ADAS@ */ /end MEASUREMENT
/begin MEASUREMENT rtDW_ADAS.GTsf_Dow_warning_requester_SF_c.GTis_c625_ADAS "" UBYTE ADAS_CM_uint8 0 0 0 255 ECU_ADDRESS 0x0000 /* @ECU_Address@rtDW_ADAS.GTsf_Dow_warning_requester_SF_c.GTis_c625_ADAS@ */ /end MEASUREMENT
/begin MEASUREMENT rtDW_ADAS.GTsf_Dow_warning_requester_SF_c.GTtemporalCounter_i1 "" ULONG ADAS_CM_uint32 0 0 0 4294967295 ECU_ADDRESS 0x0000 /* @ECU_Address@rtDW_ADAS.GTsf_Dow_warning_requester_SF_c.GTtemporalCounter_i1@ */ /end MEASUREMENT
/begin MEASUREMENT rtDW_ADAS.GTsf_FIRST_WARN_LINE.GTis_active_c273_ADAS "" UBYTE ADAS_CM_uint8 0 0 0 255 ECU_ADDRESS 0x0000 /* @ECU_Address@rtDW_ADAS.GTsf_FIRST_WARN_LINE.GTis_active_c273_ADAS@ */ /end MEASUREMENT
/begin MEASUREMENT rtDW_ADAS.GTsf_FIRST_WARN_LINE.GTis_c273_ADAS "" UBYTE ADAS_CM_uint8 0 0 0 255 ECU_ADDRESS 0x0000 /* @ECU_Address@rtDW_ADAS.GTsf_FIRST_WARN_LINE.GTis_c273_ADAS@ */ /end MEASUREMENT
/begin MEASUREMENT rtDW_ADAS.GTsf_FIRST_WARN_LINE_m.GTis_active_c273_ADAS "" UBYTE ADAS_CM_uint8 0 0 0 255 ECU_ADDRESS 0x0000 /* @ECU_Address@rtDW_ADAS.GTsf_FIRST_WARN_LINE_m.GTis_active_c273_ADAS@ */ /end MEASUREMENT
/begin MEASUREMENT rtDW_ADAS.GTsf_FIRST_WARN_LINE_m.GTis_c273_ADAS "" UBYTE ADAS_CM_uint8 0 0 0 255 ECU_ADDRESS 0x0000 /* @ECU_Address@rtDW_ADAS.GTsf_FIRST_WARN_LINE_m.GTis_c273_ADAS@ */ /end MEASUREMENT
/begin MEASUREMENT rtDW_ADAS.GTsf_HUD.GTcount "" UBYTE ADAS_CM_uint8 0 0 0 255 ECU_ADDRESS 0x0000 /* @ECU_Address@rtDW_ADAS.GTsf_HUD.GTcount@ */ /end MEASUREMENT
/begin MEASUREMENT rtDW_ADAS.GTsf_HUD.GTis_active_c45_ADAS "" UBYTE ADAS_CM_uint8 0 0 0 255 ECU_ADDRESS 0x0000 /* @ECU_Address@rtDW_ADAS.GTsf_HUD.GTis_active_c45_ADAS@ */ /end MEASUREMENT
/begin MEASUREMENT rtDW_ADAS.GTsf_HUD.GTis_c45_ADAS "" UBYTE ADAS_CM_uint8 0 0 0 255 ECU_ADDRESS 0x0000 /* @ECU_Address@rtDW_ADAS.GTsf_HUD.GTis_c45_ADAS@ */ /end MEASUREMENT
/begin MEASUREMENT rtDW_ADAS.GTsf_HUD.GTtemporalCounter_i1 "" UBYTE ADAS_CM_uint8 0 0 0 255 ECU_ADDRESS 0x0000 /* @ECU_Address@rtDW_ADAS.GTsf_HUD.GTtemporalCounter_i1@ */ /end MEASUREMENT
/begin MEASUREMENT rtDW_ADAS.GTsf_IN_LANE_POSITION.GTis_IN_LANE "" UBYTE ADAS_CM_uint8 0 0 0 255 ECU_ADDRESS 0x0000 /* @ECU_Address@rtDW_ADAS.GTsf_IN_LANE_POSITION.GTis_IN_LANE@ */ /end MEASUREMENT
/begin MEASUREMENT rtDW_ADAS.GTsf_IN_LANE_POSITION.GTis_active_c274_ADAS "" UBYTE ADAS_CM_uint8 0 0 0 255 ECU_ADDRESS 0x0000 /* @ECU_Address@rtDW_ADAS.GTsf_IN_LANE_POSITION.GTis_active_c274_ADAS@ */ /end MEASUREMENT
/begin MEASUREMENT rtDW_ADAS.GTsf_IN_LANE_POSITION.GTis_c274_ADAS "" UBYTE ADAS_CM_uint8 0 0 0 255 ECU_ADDRESS 0x0000 /* @ECU_Address@rtDW_ADAS.GTsf_IN_LANE_POSITION.GTis_c274_ADAS@ */ /end MEASUREMENT
/begin MEASUREMENT rtDW_ADAS.GTsf_IN_LANE_POSITION.GTtemporalCounter_i1 "" ULONG ADAS_CM_uint32 0 0 0 4294967295 ECU_ADDRESS 0x0000 /* @ECU_Address@rtDW_ADAS.GTsf_IN_LANE_POSITION.GTtemporalCounter_i1@ */ /end MEASUREMENT
/begin MEASUREMENT rtDW_ADAS.GTsf_IN_LANE_POSITION_m.GTis_IN_LANE "" UBYTE ADAS_CM_uint8 0 0 0 255 ECU_ADDRESS 0x0000 /* @ECU_Address@rtDW_ADAS.GTsf_IN_LANE_POSITION_m.GTis_IN_LANE@ */ /end MEASUREMENT
/begin MEASUREMENT rtDW_ADAS.GTsf_IN_LANE_POSITION_m.GTis_active_c274_ADAS "" UBYTE ADAS_CM_uint8 0 0 0 255 ECU_ADDRESS 0x0000 /* @ECU_Address@rtDW_ADAS.GTsf_IN_LANE_POSITION_m.GTis_active_c274_ADAS@ */ /end MEASUREMENT
/begin MEASUREMENT rtDW_ADAS.GTsf_IN_LANE_POSITION_m.GTis_c274_ADAS "" UBYTE ADAS_CM_uint8 0 0 0 255 ECU_ADDRESS 0x0000 /* @ECU_Address@rtDW_ADAS.GTsf_IN_LANE_POSITION_m.GTis_c274_ADAS@ */ /end MEASUREMENT
/begin MEASUREMENT rtDW_ADAS.GTsf_IN_LANE_POSITION_m.GTtemporalCounter_i1 "" ULONG ADAS_CM_uint32 0 0 0 4294967295 ECU_ADDRESS 0x0000 /* @ECU_Address@rtDW_ADAS.GTsf_IN_LANE_POSITION_m.GTtemporalCounter_i1@ */ /end MEASUREMENT
/begin MEASUREMENT rtDW_ADAS.GTsf_LCC_warning_requester_SF.GTdurationCounter_1 "" SLONG ADAS_CM_int32 0 0 -2147483648 2147483647 ECU_ADDRESS 0x0000 /* @ECU_Address@rtDW_ADAS.GTsf_LCC_warning_requester_SF.GTdurationCounter_1@ */ /end MEASUREMENT
/begin MEASUREMENT rtDW_ADAS.GTsf_LCC_warning_requester_SF.GTdurationCounter_1_e "" SLONG ADAS_CM_int32 0 0 -2147483648 2147483647 ECU_ADDRESS 0x0000 /* @ECU_Address@rtDW_ADAS.GTsf_LCC_warning_requester_SF.GTdurationCounter_1_e@ */ /end MEASUREMENT
/begin MEASUREMENT rtDW_ADAS.GTsf_LCC_warning_requester_SF.GTdurationCounter_2 "" SLONG ADAS_CM_int32 0 0 -2147483648 2147483647 ECU_ADDRESS 0x0000 /* @ECU_Address@rtDW_ADAS.GTsf_LCC_warning_requester_SF.GTdurationCounter_2@ */ /end MEASUREMENT
/begin MEASUREMENT rtDW_ADAS.GTsf_LCC_warning_requester_SF.GTis_Warning "" UBYTE ADAS_CM_uint8 0 0 0 255 ECU_ADDRESS 0x0000 /* @ECU_Address@rtDW_ADAS.GTsf_LCC_warning_requester_SF.GTis_Warning@ */ /end MEASUREMENT
/begin MEASUREMENT rtDW_ADAS.GTsf_LCC_warning_requester_SF.GTis_active_c224_ADAS "" UBYTE ADAS_CM_uint8 0 0 0 255 ECU_ADDRESS 0x0000 /* @ECU_Address@rtDW_ADAS.GTsf_LCC_warning_requester_SF.GTis_active_c224_ADAS@ */ /end MEASUREMENT
/begin MEASUREMENT rtDW_ADAS.GTsf_LCC_warning_requester_SF.GTis_c224_ADAS "" UBYTE ADAS_CM_uint8 0 0 0 255 ECU_ADDRESS 0x0000 /* @ECU_Address@rtDW_ADAS.GTsf_LCC_warning_requester_SF.GTis_c224_ADAS@ */ /end MEASUREMENT
/begin MEASUREMENT rtDW_ADAS.GTsf_LCC_warning_requester_SF.GTtemporalCounter_i1 "" ULONG ADAS_CM_uint32 0 0 0 4294967295 ECU_ADDRESS 0x0000 /* @ECU_Address@rtDW_ADAS.GTsf_LCC_warning_requester_SF.GTtemporalCounter_i1@ */ /end MEASUREMENT
/begin MEASUREMENT rtDW_ADAS.GTsf_LCC_warning_requester_SF_h.GTdurationCounter_1 "" SLONG ADAS_CM_int32 0 0 -2147483648 2147483647 ECU_ADDRESS 0x0000 /* @ECU_Address@rtDW_ADAS.GTsf_LCC_warning_requester_SF_h.GTdurationCounter_1@ */ /end MEASUREMENT
/begin MEASUREMENT rtDW_ADAS.GTsf_LCC_warning_requester_SF_h.GTdurationCounter_1_e "" SLONG ADAS_CM_int32 0 0 -2147483648 2147483647 ECU_ADDRESS 0x0000 /* @ECU_Address@rtDW_ADAS.GTsf_LCC_warning_requester_SF_h.GTdurationCounter_1_e@ */ /end MEASUREMENT
/begin MEASUREMENT rtDW_ADAS.GTsf_LCC_warning_requester_SF_h.GTdurationCounter_2 "" SLONG ADAS_CM_int32 0 0 -2147483648 2147483647 ECU_ADDRESS 0x0000 /* @ECU_Address@rtDW_ADAS.GTsf_LCC_warning_requester_SF_h.GTdurationCounter_2@ */ /end MEASUREMENT
/begin MEASUREMENT rtDW_ADAS.GTsf_LCC_warning_requester_SF_h.GTis_Warning "" UBYTE ADAS_CM_uint8 0 0 0 255 ECU_ADDRESS 0x0000 /* @ECU_Address@rtDW_ADAS.GTsf_LCC_warning_requester_SF_h.GTis_Warning@ */ /end MEASUREMENT
/begin MEASUREMENT rtDW_ADAS.GTsf_LCC_warning_requester_SF_h.GTis_active_c224_ADAS "" UBYTE ADAS_CM_uint8 0 0 0 255 ECU_ADDRESS 0x0000 /* @ECU_Address@rtDW_ADAS.GTsf_LCC_warning_requester_SF_h.GTis_active_c224_ADAS@ */ /end MEASUREMENT
/begin MEASUREMENT rtDW_ADAS.GTsf_LCC_warning_requester_SF_h.GTis_c224_ADAS "" UBYTE ADAS_CM_uint8 0 0 0 255 ECU_ADDRESS 0x0000 /* @ECU_Address@rtDW_ADAS.GTsf_LCC_warning_requester_SF_h.GTis_c224_ADAS@ */ /end MEASUREMENT
/begin MEASUREMENT rtDW_ADAS.GTsf_LCC_warning_requester_SF_h.GTtemporalCounter_i1 "" ULONG ADAS_CM_uint32 0 0 0 4294967295 ECU_ADDRESS 0x0000 /* @ECU_Address@rtDW_ADAS.GTsf_LCC_warning_requester_SF_h.GTtemporalCounter_i1@ */ /end MEASUREMENT
/begin MEASUREMENT rtDW_ADAS.GTsf_LccBt.GTcount "" UBYTE ADAS_CM_uint8 0 0 0 255 ECU_ADDRESS 0x0000 /* @ECU_Address@rtDW_ADAS.GTsf_LccBt.GTcount@ */ /end MEASUREMENT
/begin MEASUREMENT rtDW_ADAS.GTsf_LccBt.GTis_active_c19_ADAS "" UBYTE ADAS_CM_uint8 0 0 0 255 ECU_ADDRESS 0x0000 /* @ECU_Address@rtDW_ADAS.GTsf_LccBt.GTis_active_c19_ADAS@ */ /end MEASUREMENT
/begin MEASUREMENT rtDW_ADAS.GTsf_LccBt.GTis_c19_ADAS "" UBYTE ADAS_CM_uint8 0 0 0 255 ECU_ADDRESS 0x0000 /* @ECU_Address@rtDW_ADAS.GTsf_LccBt.GTis_c19_ADAS@ */ /end MEASUREMENT
/begin MEASUREMENT rtDW_ADAS.GTsf_LccBt.GTtemporalCounter_i1 "" UBYTE ADAS_CM_uint8 0 0 0 255 ECU_ADDRESS 0x0000 /* @ECU_Address@rtDW_ADAS.GTsf_LccBt.GTtemporalCounter_i1@ */ /end MEASUREMENT
/begin MEASUREMENT rtDW_ADAS.GTsf_LdwBt.GTcount "" UBYTE ADAS_CM_uint8 0 0 0 255 ECU_ADDRESS 0x0000 /* @ECU_Address@rtDW_ADAS.GTsf_LdwBt.GTcount@ */ /end MEASUREMENT
/begin MEASUREMENT rtDW_ADAS.GTsf_LdwBt.GTis_active_c19_ADAS "" UBYTE ADAS_CM_uint8 0 0 0 255 ECU_ADDRESS 0x0000 /* @ECU_Address@rtDW_ADAS.GTsf_LdwBt.GTis_active_c19_ADAS@ */ /end MEASUREMENT
/begin MEASUREMENT rtDW_ADAS.GTsf_LdwBt.GTis_c19_ADAS "" UBYTE ADAS_CM_uint8 0 0 0 255 ECU_ADDRESS 0x0000 /* @ECU_Address@rtDW_ADAS.GTsf_LdwBt.GTis_c19_ADAS@ */ /end MEASUREMENT
/begin MEASUREMENT rtDW_ADAS.GTsf_LdwBt.GTtemporalCounter_i1 "" UBYTE ADAS_CM_uint8 0 0 0 255 ECU_ADDRESS 0x0000 /* @ECU_Address@rtDW_ADAS.GTsf_LdwBt.GTtemporalCounter_i1@ */ /end MEASUREMENT
/begin MEASUREMENT rtDW_ADAS.GTsf_MATLABFunction.GTprevSmoothed "" FLOAT32_IEEE ADAS_CM_single 0 0 -3.4E+38 3.4E+38 ECU_ADDRESS 0x0000 /* @ECU_Address@rtDW_ADAS.GTsf_MATLABFunction.GTprevSmoothed@ */ /end MEASUREMENT
/begin MEASUREMENT rtDW_ADAS.GTsf_MATLABFunction.GTprevSmoothed_not_empty "" UBYTE ADAS_CM_logical 0 0 0 1 ECU_ADDRESS 0x0000 /* @ECU_Address@rtDW_ADAS.GTsf_MATLABFunction.GTprevSmoothed_not_empty@ */ /end MEASUREMENT
/begin MEASUREMENT rtDW_ADAS.GTsf_MATLABFunction1_gq.GTprevSmoothed "" FLOAT32_IEEE ADAS_CM_single 0 0 -3.4E+38 3.4E+38 ECU_ADDRESS 0x0000 /* @ECU_Address@rtDW_ADAS.GTsf_MATLABFunction1_gq.GTprevSmoothed@ */ /end MEASUREMENT
/begin MEASUREMENT rtDW_ADAS.GTsf_MATLABFunction1_gq.GTprevSmoothed_not_empty "" UBYTE ADAS_CM_logical 0 0 0 1 ECU_ADDRESS 0x0000 /* @ECU_Address@rtDW_ADAS.GTsf_MATLABFunction1_gq.GTprevSmoothed_not_empty@ */ /end MEASUREMENT
/begin MEASUREMENT rtDW_ADAS.GTsf_MATLABFunction2.GTprevSmoothed "" FLOAT32_IEEE ADAS_CM_single 0 0 -3.4E+38 3.4E+38 ECU_ADDRESS 0x0000 /* @ECU_Address@rtDW_ADAS.GTsf_MATLABFunction2.GTprevSmoothed@ */ /end MEASUREMENT
/begin MEASUREMENT rtDW_ADAS.GTsf_MATLABFunction2.GTprevSmoothed_not_empty "" UBYTE ADAS_CM_logical 0 0 0 1 ECU_ADDRESS 0x0000 /* @ECU_Address@rtDW_ADAS.GTsf_MATLABFunction2.GTprevSmoothed_not_empty@ */ /end MEASUREMENT
/begin MEASUREMENT rtDW_ADAS.GTsf_MATLABFunction3.GTprevSmoothed "" FLOAT32_IEEE ADAS_CM_single 0 0 -3.4E+38 3.4E+38 ECU_ADDRESS 0x0000 /* @ECU_Address@rtDW_ADAS.GTsf_MATLABFunction3.GTprevSmoothed@ */ /end MEASUREMENT
/begin MEASUREMENT rtDW_ADAS.GTsf_MATLABFunction3.GTprevSmoothed_not_empty "" UBYTE ADAS_CM_logical 0 0 0 1 ECU_ADDRESS 0x0000 /* @ECU_Address@rtDW_ADAS.GTsf_MATLABFunction3.GTprevSmoothed_not_empty@ */ /end MEASUREMENT
/begin MEASUREMENT rtDW_ADAS.GTsf_MATLABFunction3_b.GTprevSmoothed "" FLOAT32_IEEE ADAS_CM_single 0 0 -3.4E+38 3.4E+38 ECU_ADDRESS 0x0000 /* @ECU_Address@rtDW_ADAS.GTsf_MATLABFunction3_b.GTprevSmoothed@ */ /end MEASUREMENT
/begin MEASUREMENT rtDW_ADAS.GTsf_MATLABFunction3_b.GTprevSmoothed_not_empty "" UBYTE ADAS_CM_logical 0 0 0 1 ECU_ADDRESS 0x0000 /* @ECU_Address@rtDW_ADAS.GTsf_MATLABFunction3_b.GTprevSmoothed_not_empty@ */ /end MEASUREMENT
/begin MEASUREMENT rtDW_ADAS.GTsf_MATLABFunction4.GTprevSmoothed "" FLOAT32_IEEE ADAS_CM_single 0 0 -3.4E+38 3.4E+38 ECU_ADDRESS 0x0000 /* @ECU_Address@rtDW_ADAS.GTsf_MATLABFunction4.GTprevSmoothed@ */ /end MEASUREMENT
/begin MEASUREMENT rtDW_ADAS.GTsf_MATLABFunction4.GTprevSmoothed_not_empty "" UBYTE ADAS_CM_logical 0 0 0 1 ECU_ADDRESS 0x0000 /* @ECU_Address@rtDW_ADAS.GTsf_MATLABFunction4.GTprevSmoothed_not_empty@ */ /end MEASUREMENT
/begin MEASUREMENT rtDW_ADAS.GTsf_MATLABFunction5.GTprevSmoothed "" FLOAT32_IEEE ADAS_CM_single 0 0 -3.4E+38 3.4E+38 ECU_ADDRESS 0x0000 /* @ECU_Address@rtDW_ADAS.GTsf_MATLABFunction5.GTprevSmoothed@ */ /end MEASUREMENT
/begin MEASUREMENT rtDW_ADAS.GTsf_MATLABFunction5.GTprevSmoothed_not_empty "" UBYTE ADAS_CM_logical 0 0 0 1 ECU_ADDRESS 0x0000 /* @ECU_Address@rtDW_ADAS.GTsf_MATLABFunction5.GTprevSmoothed_not_empty@ */ /end MEASUREMENT
/begin MEASUREMENT rtDW_ADAS.GTsf_MIN_TTLC.GTis_BASE "" UBYTE ADAS_CM_uint8 0 0 0 255 ECU_ADDRESS 0x0000 /* @ECU_Address@rtDW_ADAS.GTsf_MIN_TTLC.GTis_BASE@ */ /end MEASUREMENT
/begin MEASUREMENT rtDW_ADAS.GTsf_MIN_TTLC.GTis_BEFORE_CROSS "" UBYTE ADAS_CM_uint8 0 0 0 255 ECU_ADDRESS 0x0000 /* @ECU_Address@rtDW_ADAS.GTsf_MIN_TTLC.GTis_BEFORE_CROSS@ */ /end MEASUREMENT
/begin MEASUREMENT rtDW_ADAS.GTsf_MIN_TTLC.GTis_active_c276_ADAS "" UBYTE ADAS_CM_uint8 0 0 0 255 ECU_ADDRESS 0x0000 /* @ECU_Address@rtDW_ADAS.GTsf_MIN_TTLC.GTis_active_c276_ADAS@ */ /end MEASUREMENT
/begin MEASUREMENT rtDW_ADAS.GTsf_MIN_TTLC.GTis_c276_ADAS "" UBYTE ADAS_CM_uint8 0 0 0 255 ECU_ADDRESS 0x0000 /* @ECU_Address@rtDW_ADAS.GTsf_MIN_TTLC.GTis_c276_ADAS@ */ /end MEASUREMENT
/begin MEASUREMENT rtDW_ADAS.GTsf_MIN_TTLC.GTtemporalCounter_i1 "" ULONG ADAS_CM_uint32 0 0 0 4294967295 ECU_ADDRESS 0x0000 /* @ECU_Address@rtDW_ADAS.GTsf_MIN_TTLC.GTtemporalCounter_i1@ */ /end MEASUREMENT
/begin MEASUREMENT rtDW_ADAS.GTsf_MIN_TTLC_c.GTis_BASE "" UBYTE ADAS_CM_uint8 0 0 0 255 ECU_ADDRESS 0x0000 /* @ECU_Address@rtDW_ADAS.GTsf_MIN_TTLC_c.GTis_BASE@ */ /end MEASUREMENT
/begin MEASUREMENT rtDW_ADAS.GTsf_MIN_TTLC_c.GTis_BEFORE_CROSS "" UBYTE ADAS_CM_uint8 0 0 0 255 ECU_ADDRESS 0x0000 /* @ECU_Address@rtDW_ADAS.GTsf_MIN_TTLC_c.GTis_BEFORE_CROSS@ */ /end MEASUREMENT
/begin MEASUREMENT rtDW_ADAS.GTsf_MIN_TTLC_c.GTis_active_c276_ADAS "" UBYTE ADAS_CM_uint8 0 0 0 255 ECU_ADDRESS 0x0000 /* @ECU_Address@rtDW_ADAS.GTsf_MIN_TTLC_c.GTis_active_c276_ADAS@ */ /end MEASUREMENT
/begin MEASUREMENT rtDW_ADAS.GTsf_MIN_TTLC_c.GTis_c276_ADAS "" UBYTE ADAS_CM_uint8 0 0 0 255 ECU_ADDRESS 0x0000 /* @ECU_Address@rtDW_ADAS.GTsf_MIN_TTLC_c.GTis_c276_ADAS@ */ /end MEASUREMENT
/begin MEASUREMENT rtDW_ADAS.GTsf_MIN_TTLC_c.GTtemporalCounter_i1 "" ULONG ADAS_CM_uint32 0 0 0 4294967295 ECU_ADDRESS 0x0000 /* @ECU_Address@rtDW_ADAS.GTsf_MIN_TTLC_c.GTtemporalCounter_i1@ */ /end MEASUREMENT
/begin MEASUREMENT rtDW_ADAS.GTsf_NotifErrHold.GTis_ERROR "" UBYTE ADAS_CM_uint8 0 0 0 255 ECU_ADDRESS 0x0000 /* @ECU_Address@rtDW_ADAS.GTsf_NotifErrHold.GTis_ERROR@ */ /end MEASUREMENT
/begin MEASUREMENT rtDW_ADAS.GTsf_NotifErrHold.GTis_active_c200_ADAS "" UBYTE ADAS_CM_uint8 0 0 0 255 ECU_ADDRESS 0x0000 /* @ECU_Address@rtDW_ADAS.GTsf_NotifErrHold.GTis_active_c200_ADAS@ */ /end MEASUREMENT
/begin MEASUREMENT rtDW_ADAS.GTsf_NotifErrHold.GTis_c200_ADAS "" UBYTE ADAS_CM_uint8 0 0 0 255 ECU_ADDRESS 0x0000 /* @ECU_Address@rtDW_ADAS.GTsf_NotifErrHold.GTis_c200_ADAS@ */ /end MEASUREMENT
/begin MEASUREMENT rtDW_ADAS.GTsf_NotifErrHold.GTtemporalCounter_i1 "" UBYTE ADAS_CM_uint8 0 0 0 255 ECU_ADDRESS 0x0000 /* @ECU_Address@rtDW_ADAS.GTsf_NotifErrHold.GTtemporalCounter_i1@ */ /end MEASUREMENT
/begin MEASUREMENT rtDW_ADAS.GTsf_NotifErrHold1.GTis_ERROR "" UBYTE ADAS_CM_uint8 0 0 0 255 ECU_ADDRESS 0x0000 /* @ECU_Address@rtDW_ADAS.GTsf_NotifErrHold1.GTis_ERROR@ */ /end MEASUREMENT
/begin MEASUREMENT rtDW_ADAS.GTsf_NotifErrHold1.GTis_active_c200_ADAS "" UBYTE ADAS_CM_uint8 0 0 0 255 ECU_ADDRESS 0x0000 /* @ECU_Address@rtDW_ADAS.GTsf_NotifErrHold1.GTis_active_c200_ADAS@ */ /end MEASUREMENT
/begin MEASUREMENT rtDW_ADAS.GTsf_NotifErrHold1.GTis_c200_ADAS "" UBYTE ADAS_CM_uint8 0 0 0 255 ECU_ADDRESS 0x0000 /* @ECU_Address@rtDW_ADAS.GTsf_NotifErrHold1.GTis_c200_ADAS@ */ /end MEASUREMENT
/begin MEASUREMENT rtDW_ADAS.GTsf_NotifErrHold1.GTtemporalCounter_i1 "" UBYTE ADAS_CM_uint8 0 0 0 255 ECU_ADDRESS 0x0000 /* @ECU_Address@rtDW_ADAS.GTsf_NotifErrHold1.GTtemporalCounter_i1@ */ /end MEASUREMENT
/begin MEASUREMENT rtDW_ADAS.GTsf_NotifErrHold11.GTis_ERROR "" UBYTE ADAS_CM_uint8 0 0 0 255 ECU_ADDRESS 0x0000 /* @ECU_Address@rtDW_ADAS.GTsf_NotifErrHold11.GTis_ERROR@ */ /end MEASUREMENT
/begin MEASUREMENT rtDW_ADAS.GTsf_NotifErrHold11.GTis_active_c200_ADAS "" UBYTE ADAS_CM_uint8 0 0 0 255 ECU_ADDRESS 0x0000 /* @ECU_Address@rtDW_ADAS.GTsf_NotifErrHold11.GTis_active_c200_ADAS@ */ /end MEASUREMENT
/begin MEASUREMENT rtDW_ADAS.GTsf_NotifErrHold11.GTis_c200_ADAS "" UBYTE ADAS_CM_uint8 0 0 0 255 ECU_ADDRESS 0x0000 /* @ECU_Address@rtDW_ADAS.GTsf_NotifErrHold11.GTis_c200_ADAS@ */ /end MEASUREMENT
/begin MEASUREMENT rtDW_ADAS.GTsf_NotifErrHold11.GTtemporalCounter_i1 "" UBYTE ADAS_CM_uint8 0 0 0 255 ECU_ADDRESS 0x0000 /* @ECU_Address@rtDW_ADAS.GTsf_NotifErrHold11.GTtemporalCounter_i1@ */ /end MEASUREMENT
/begin MEASUREMENT rtDW_ADAS.GTsf_NotifErrHold12.GTis_ERROR "" UBYTE ADAS_CM_uint8 0 0 0 255 ECU_ADDRESS 0x0000 /* @ECU_Address@rtDW_ADAS.GTsf_NotifErrHold12.GTis_ERROR@ */ /end MEASUREMENT
/begin MEASUREMENT rtDW_ADAS.GTsf_NotifErrHold12.GTis_active_c200_ADAS "" UBYTE ADAS_CM_uint8 0 0 0 255 ECU_ADDRESS 0x0000 /* @ECU_Address@rtDW_ADAS.GTsf_NotifErrHold12.GTis_active_c200_ADAS@ */ /end MEASUREMENT
/begin MEASUREMENT rtDW_ADAS.GTsf_NotifErrHold12.GTis_c200_ADAS "" UBYTE ADAS_CM_uint8 0 0 0 255 ECU_ADDRESS 0x0000 /* @ECU_Address@rtDW_ADAS.GTsf_NotifErrHold12.GTis_c200_ADAS@ */ /end MEASUREMENT
/begin MEASUREMENT rtDW_ADAS.GTsf_NotifErrHold12.GTtemporalCounter_i1 "" UBYTE ADAS_CM_uint8 0 0 0 255 ECU_ADDRESS 0x0000 /* @ECU_Address@rtDW_ADAS.GTsf_NotifErrHold12.GTtemporalCounter_i1@ */ /end MEASUREMENT
/begin MEASUREMENT rtDW_ADAS.GTsf_NotifErrHold13.GTis_ERROR "" UBYTE ADAS_CM_uint8 0 0 0 255 ECU_ADDRESS 0x0000 /* @ECU_Address@rtDW_ADAS.GTsf_NotifErrHold13.GTis_ERROR@ */ /end MEASUREMENT
/begin MEASUREMENT rtDW_ADAS.GTsf_NotifErrHold13.GTis_active_c200_ADAS "" UBYTE ADAS_CM_uint8 0 0 0 255 ECU_ADDRESS 0x0000 /* @ECU_Address@rtDW_ADAS.GTsf_NotifErrHold13.GTis_active_c200_ADAS@ */ /end MEASUREMENT
/begin MEASUREMENT rtDW_ADAS.GTsf_NotifErrHold13.GTis_c200_ADAS "" UBYTE ADAS_CM_uint8 0 0 0 255 ECU_ADDRESS 0x0000 /* @ECU_Address@rtDW_ADAS.GTsf_NotifErrHold13.GTis_c200_ADAS@ */ /end MEASUREMENT
/begin MEASUREMENT rtDW_ADAS.GTsf_NotifErrHold13.GTtemporalCounter_i1 "" UBYTE ADAS_CM_uint8 0 0 0 255 ECU_ADDRESS 0x0000 /* @ECU_Address@rtDW_ADAS.GTsf_NotifErrHold13.GTtemporalCounter_i1@ */ /end MEASUREMENT
/begin MEASUREMENT rtDW_ADAS.GTsf_NotifErrHold2.GTis_ERROR "" UBYTE ADAS_CM_uint8 0 0 0 255 ECU_ADDRESS 0x0000 /* @ECU_Address@rtDW_ADAS.GTsf_NotifErrHold2.GTis_ERROR@ */ /end MEASUREMENT
/begin MEASUREMENT rtDW_ADAS.GTsf_NotifErrHold2.GTis_active_c200_ADAS "" UBYTE ADAS_CM_uint8 0 0 0 255 ECU_ADDRESS 0x0000 /* @ECU_Address@rtDW_ADAS.GTsf_NotifErrHold2.GTis_active_c200_ADAS@ */ /end MEASUREMENT
/begin MEASUREMENT rtDW_ADAS.GTsf_NotifErrHold2.GTis_c200_ADAS "" UBYTE ADAS_CM_uint8 0 0 0 255 ECU_ADDRESS 0x0000 /* @ECU_Address@rtDW_ADAS.GTsf_NotifErrHold2.GTis_c200_ADAS@ */ /end MEASUREMENT
/begin MEASUREMENT rtDW_ADAS.GTsf_NotifErrHold2.GTtemporalCounter_i1 "" UBYTE ADAS_CM_uint8 0 0 0 255 ECU_ADDRESS 0x0000 /* @ECU_Address@rtDW_ADAS.GTsf_NotifErrHold2.GTtemporalCounter_i1@ */ /end MEASUREMENT
/begin MEASUREMENT rtDW_ADAS.GTsf_NotifErrHold3.GTis_ERROR "" UBYTE ADAS_CM_uint8 0 0 0 255 ECU_ADDRESS 0x0000 /* @ECU_Address@rtDW_ADAS.GTsf_NotifErrHold3.GTis_ERROR@ */ /end MEASUREMENT
/begin MEASUREMENT rtDW_ADAS.GTsf_NotifErrHold3.GTis_active_c200_ADAS "" UBYTE ADAS_CM_uint8 0 0 0 255 ECU_ADDRESS 0x0000 /* @ECU_Address@rtDW_ADAS.GTsf_NotifErrHold3.GTis_active_c200_ADAS@ */ /end MEASUREMENT
/begin MEASUREMENT rtDW_ADAS.GTsf_NotifErrHold3.GTis_c200_ADAS "" UBYTE ADAS_CM_uint8 0 0 0 255 ECU_ADDRESS 0x0000 /* @ECU_Address@rtDW_ADAS.GTsf_NotifErrHold3.GTis_c200_ADAS@ */ /end MEASUREMENT
/begin MEASUREMENT rtDW_ADAS.GTsf_NotifErrHold3.GTtemporalCounter_i1 "" UBYTE ADAS_CM_uint8 0 0 0 255 ECU_ADDRESS 0x0000 /* @ECU_Address@rtDW_ADAS.GTsf_NotifErrHold3.GTtemporalCounter_i1@ */ /end MEASUREMENT
/begin MEASUREMENT rtDW_ADAS.GTsf_NotifErrHold4.GTis_ERROR "" UBYTE ADAS_CM_uint8 0 0 0 255 ECU_ADDRESS 0x0000 /* @ECU_Address@rtDW_ADAS.GTsf_NotifErrHold4.GTis_ERROR@ */ /end MEASUREMENT
/begin MEASUREMENT rtDW_ADAS.GTsf_NotifErrHold4.GTis_active_c200_ADAS "" UBYTE ADAS_CM_uint8 0 0 0 255 ECU_ADDRESS 0x0000 /* @ECU_Address@rtDW_ADAS.GTsf_NotifErrHold4.GTis_active_c200_ADAS@ */ /end MEASUREMENT
/begin MEASUREMENT rtDW_ADAS.GTsf_NotifErrHold4.GTis_c200_ADAS "" UBYTE ADAS_CM_uint8 0 0 0 255 ECU_ADDRESS 0x0000 /* @ECU_Address@rtDW_ADAS.GTsf_NotifErrHold4.GTis_c200_ADAS@ */ /end MEASUREMENT
/begin MEASUREMENT rtDW_ADAS.GTsf_NotifErrHold4.GTtemporalCounter_i1 "" UBYTE ADAS_CM_uint8 0 0 0 255 ECU_ADDRESS 0x0000 /* @ECU_Address@rtDW_ADAS.GTsf_NotifErrHold4.GTtemporalCounter_i1@ */ /end MEASUREMENT
/begin MEASUREMENT rtDW_ADAS.GTsf_NotifErrHold5.GTis_ERROR "" UBYTE ADAS_CM_uint8 0 0 0 255 ECU_ADDRESS 0x0000 /* @ECU_Address@rtDW_ADAS.GTsf_NotifErrHold5.GTis_ERROR@ */ /end MEASUREMENT
/begin MEASUREMENT rtDW_ADAS.GTsf_NotifErrHold5.GTis_active_c200_ADAS "" UBYTE ADAS_CM_uint8 0 0 0 255 ECU_ADDRESS 0x0000 /* @ECU_Address@rtDW_ADAS.GTsf_NotifErrHold5.GTis_active_c200_ADAS@ */ /end MEASUREMENT
/begin MEASUREMENT rtDW_ADAS.GTsf_NotifErrHold5.GTis_c200_ADAS "" UBYTE ADAS_CM_uint8 0 0 0 255 ECU_ADDRESS 0x0000 /* @ECU_Address@rtDW_ADAS.GTsf_NotifErrHold5.GTis_c200_ADAS@ */ /end MEASUREMENT
/begin MEASUREMENT rtDW_ADAS.GTsf_NotifErrHold5.GTtemporalCounter_i1 "" UBYTE ADAS_CM_uint8 0 0 0 255 ECU_ADDRESS 0x0000 /* @ECU_Address@rtDW_ADAS.GTsf_NotifErrHold5.GTtemporalCounter_i1@ */ /end MEASUREMENT
/begin MEASUREMENT rtDW_ADAS.GTsf_NotifErrHold6.GTis_ERROR "" UBYTE ADAS_CM_uint8 0 0 0 255 ECU_ADDRESS 0x0000 /* @ECU_Address@rtDW_ADAS.GTsf_NotifErrHold6.GTis_ERROR@ */ /end MEASUREMENT
/begin MEASUREMENT rtDW_ADAS.GTsf_NotifErrHold6.GTis_active_c200_ADAS "" UBYTE ADAS_CM_uint8 0 0 0 255 ECU_ADDRESS 0x0000 /* @ECU_Address@rtDW_ADAS.GTsf_NotifErrHold6.GTis_active_c200_ADAS@ */ /end MEASUREMENT
/begin MEASUREMENT rtDW_ADAS.GTsf_NotifErrHold6.GTis_c200_ADAS "" UBYTE ADAS_CM_uint8 0 0 0 255 ECU_ADDRESS 0x0000 /* @ECU_Address@rtDW_ADAS.GTsf_NotifErrHold6.GTis_c200_ADAS@ */ /end MEASUREMENT
/begin MEASUREMENT rtDW_ADAS.GTsf_NotifErrHold6.GTtemporalCounter_i1 "" UBYTE ADAS_CM_uint8 0 0 0 255 ECU_ADDRESS 0x0000 /* @ECU_Address@rtDW_ADAS.GTsf_NotifErrHold6.GTtemporalCounter_i1@ */ /end MEASUREMENT
/begin MEASUREMENT rtDW_ADAS.GTsf_NotifErrHold7.GTis_ERROR "" UBYTE ADAS_CM_uint8 0 0 0 255 ECU_ADDRESS 0x0000 /* @ECU_Address@rtDW_ADAS.GTsf_NotifErrHold7.GTis_ERROR@ */ /end MEASUREMENT
/begin MEASUREMENT rtDW_ADAS.GTsf_NotifErrHold7.GTis_active_c200_ADAS "" UBYTE ADAS_CM_uint8 0 0 0 255 ECU_ADDRESS 0x0000 /* @ECU_Address@rtDW_ADAS.GTsf_NotifErrHold7.GTis_active_c200_ADAS@ */ /end MEASUREMENT
/begin MEASUREMENT rtDW_ADAS.GTsf_NotifErrHold7.GTis_c200_ADAS "" UBYTE ADAS_CM_uint8 0 0 0 255 ECU_ADDRESS 0x0000 /* @ECU_Address@rtDW_ADAS.GTsf_NotifErrHold7.GTis_c200_ADAS@ */ /end MEASUREMENT
/begin MEASUREMENT rtDW_ADAS.GTsf_NotifErrHold7.GTtemporalCounter_i1 "" UBYTE ADAS_CM_uint8 0 0 0 255 ECU_ADDRESS 0x0000 /* @ECU_Address@rtDW_ADAS.GTsf_NotifErrHold7.GTtemporalCounter_i1@ */ /end MEASUREMENT
/begin MEASUREMENT rtDW_ADAS.GTsf_NotifErrHold8.GTis_ERROR "" UBYTE ADAS_CM_uint8 0 0 0 255 ECU_ADDRESS 0x0000 /* @ECU_Address@rtDW_ADAS.GTsf_NotifErrHold8.GTis_ERROR@ */ /end MEASUREMENT
/begin MEASUREMENT rtDW_ADAS.GTsf_NotifErrHold8.GTis_active_c200_ADAS "" UBYTE ADAS_CM_uint8 0 0 0 255 ECU_ADDRESS 0x0000 /* @ECU_Address@rtDW_ADAS.GTsf_NotifErrHold8.GTis_active_c200_ADAS@ */ /end MEASUREMENT
/begin MEASUREMENT rtDW_ADAS.GTsf_NotifErrHold8.GTis_c200_ADAS "" UBYTE ADAS_CM_uint8 0 0 0 255 ECU_ADDRESS 0x0000 /* @ECU_Address@rtDW_ADAS.GTsf_NotifErrHold8.GTis_c200_ADAS@ */ /end MEASUREMENT
/begin MEASUREMENT rtDW_ADAS.GTsf_NotifErrHold8.GTtemporalCounter_i1 "" UBYTE ADAS_CM_uint8 0 0 0 255 ECU_ADDRESS 0x0000 /* @ECU_Address@rtDW_ADAS.GTsf_NotifErrHold8.GTtemporalCounter_i1@ */ /end MEASUREMENT
/begin MEASUREMENT rtDW_ADAS.GTsf_NotifErrHold9.GTis_ERROR "" UBYTE ADAS_CM_uint8 0 0 0 255 ECU_ADDRESS 0x0000 /* @ECU_Address@rtDW_ADAS.GTsf_NotifErrHold9.GTis_ERROR@ */ /end MEASUREMENT
/begin MEASUREMENT rtDW_ADAS.GTsf_NotifErrHold9.GTis_active_c200_ADAS "" UBYTE ADAS_CM_uint8 0 0 0 255 ECU_ADDRESS 0x0000 /* @ECU_Address@rtDW_ADAS.GTsf_NotifErrHold9.GTis_active_c200_ADAS@ */ /end MEASUREMENT
/begin MEASUREMENT rtDW_ADAS.GTsf_NotifErrHold9.GTis_c200_ADAS "" UBYTE ADAS_CM_uint8 0 0 0 255 ECU_ADDRESS 0x0000 /* @ECU_Address@rtDW_ADAS.GTsf_NotifErrHold9.GTis_c200_ADAS@ */ /end MEASUREMENT
/begin MEASUREMENT rtDW_ADAS.GTsf_NotifErrHold9.GTtemporalCounter_i1 "" UBYTE ADAS_CM_uint8 0 0 0 255 ECU_ADDRESS 0x0000 /* @ECU_Address@rtDW_ADAS.GTsf_NotifErrHold9.GTtemporalCounter_i1@ */ /end MEASUREMENT
/begin MEASUREMENT rtDW_ADAS.GTsf_Signdisplayduration.GTis_NO_SIGN "" UBYTE ADAS_CM_uint8 0 0 0 255 ECU_ADDRESS 0x0000 /* @ECU_Address@rtDW_ADAS.GTsf_Signdisplayduration.GTis_NO_SIGN@ */ /end MEASUREMENT
/begin MEASUREMENT rtDW_ADAS.GTsf_Signdisplayduration.GTis_active_c560_ADAS "" UBYTE ADAS_CM_uint8 0 0 0 255 ECU_ADDRESS 0x0000 /* @ECU_Address@rtDW_ADAS.GTsf_Signdisplayduration.GTis_active_c560_ADAS@ */ /end MEASUREMENT
/begin MEASUREMENT rtDW_ADAS.GTsf_Signdisplayduration.GTis_c560_ADAS "" UBYTE ADAS_CM_uint8 0 0 0 255 ECU_ADDRESS 0x0000 /* @ECU_Address@rtDW_ADAS.GTsf_Signdisplayduration.GTis_c560_ADAS@ */ /end MEASUREMENT
/begin MEASUREMENT rtDW_ADAS.GTsf_Signdisplayduration.GTtemporalCounter_i1 "" ULONG ADAS_CM_uint32 0 0 0 4294967295 ECU_ADDRESS 0x0000 /* @ECU_Address@rtDW_ADAS.GTsf_Signdisplayduration.GTtemporalCounter_i1@ */ /end MEASUREMENT
/begin MEASUREMENT rtDW_ADAS.GTsf_Signdisplayduration_h.GTis_NO_SIGN "" UBYTE ADAS_CM_uint8 0 0 0 255 ECU_ADDRESS 0x0000 /* @ECU_Address@rtDW_ADAS.GTsf_Signdisplayduration_h.GTis_NO_SIGN@ */ /end MEASUREMENT
/begin MEASUREMENT rtDW_ADAS.GTsf_Signdisplayduration_h.GTis_active_c560_ADAS "" UBYTE ADAS_CM_uint8 0 0 0 255 ECU_ADDRESS 0x0000 /* @ECU_Address@rtDW_ADAS.GTsf_Signdisplayduration_h.GTis_active_c560_ADAS@ */ /end MEASUREMENT
/begin MEASUREMENT rtDW_ADAS.GTsf_Signdisplayduration_h.GTis_c560_ADAS "" UBYTE ADAS_CM_uint8 0 0 0 255 ECU_ADDRESS 0x0000 /* @ECU_Address@rtDW_ADAS.GTsf_Signdisplayduration_h.GTis_c560_ADAS@ */ /end MEASUREMENT
/begin MEASUREMENT rtDW_ADAS.GTsf_Signdisplayduration_h.GTtemporalCounter_i1 "" ULONG ADAS_CM_uint32 0 0 0 4294967295 ECU_ADDRESS 0x0000 /* @ECU_Address@rtDW_ADAS.GTsf_Signdisplayduration_h.GTtemporalCounter_i1@ */ /end MEASUREMENT
/begin MEASUREMENT rtDW_ADAS.GTsf_TURN_SIGNAL_MANAGER.GTis_active_c279_ADAS "" UBYTE ADAS_CM_uint8 0 0 0 255 ECU_ADDRESS 0x0000 /* @ECU_Address@rtDW_ADAS.GTsf_TURN_SIGNAL_MANAGER.GTis_active_c279_ADAS@ */ /end MEASUREMENT
/begin MEASUREMENT rtDW_ADAS.GTsf_TURN_SIGNAL_MANAGER.GTis_c279_ADAS "" UBYTE ADAS_CM_uint8 0 0 0 255 ECU_ADDRESS 0x0000 /* @ECU_Address@rtDW_ADAS.GTsf_TURN_SIGNAL_MANAGER.GTis_c279_ADAS@ */ /end MEASUREMENT
/begin MEASUREMENT rtDW_ADAS.GTsf_TURN_SIGNAL_MANAGER.GTtemporalCounter_i1 "" ULONG ADAS_CM_uint32 0 0 0 4294967295 ECU_ADDRESS 0x0000 /* @ECU_Address@rtDW_ADAS.GTsf_TURN_SIGNAL_MANAGER.GTtemporalCounter_i1@ */ /end MEASUREMENT
/begin MEASUREMENT rtDW_ADAS.GTsf_TURN_SIGNAL_MANAGER_d.GTis_active_c279_ADAS "" UBYTE ADAS_CM_uint8 0 0 0 255 ECU_ADDRESS 0x0000 /* @ECU_Address@rtDW_ADAS.GTsf_TURN_SIGNAL_MANAGER_d.GTis_active_c279_ADAS@ */ /end MEASUREMENT
/begin MEASUREMENT rtDW_ADAS.GTsf_TURN_SIGNAL_MANAGER_d.GTis_c279_ADAS "" UBYTE ADAS_CM_uint8 0 0 0 255 ECU_ADDRESS 0x0000 /* @ECU_Address@rtDW_ADAS.GTsf_TURN_SIGNAL_MANAGER_d.GTis_c279_ADAS@ */ /end MEASUREMENT
/begin MEASUREMENT rtDW_ADAS.GTsf_TURN_SIGNAL_MANAGER_d.GTtemporalCounter_i1 "" ULONG ADAS_CM_uint32 0 0 0 4294967295 ECU_ADDRESS 0x0000 /* @ECU_Address@rtDW_ADAS.GTsf_TURN_SIGNAL_MANAGER_d.GTtemporalCounter_i1@ */ /end MEASUREMENT
/begin MEASUREMENT rtDW_ADAS.GTsf_TotalanalyticcounterLDP.GTis_active_c321_ADAS "" UBYTE ADAS_CM_uint8 0 0 0 255 ECU_ADDRESS 0x0000 /* @ECU_Address@rtDW_ADAS.GTsf_TotalanalyticcounterLDP.GTis_active_c321_ADAS@ */ /end MEASUREMENT
/begin MEASUREMENT rtDW_ADAS.GTsf_TotalanalyticcounterLDP.GTtemporalCounter_i1 "" UBYTE ADAS_CM_uint8 0 0 0 255 ECU_ADDRESS 0x0000 /* @ECU_Address@rtDW_ADAS.GTsf_TotalanalyticcounterLDP.GTtemporalCounter_i1@ */ /end MEASUREMENT
/begin MEASUREMENT rtDW_ADAS.GTsf_TotalanalyticcounterLDW.GTis_active_c321_ADAS "" UBYTE ADAS_CM_uint8 0 0 0 255 ECU_ADDRESS 0x0000 /* @ECU_Address@rtDW_ADAS.GTsf_TotalanalyticcounterLDW.GTis_active_c321_ADAS@ */ /end MEASUREMENT
/begin MEASUREMENT rtDW_ADAS.GTsf_TotalanalyticcounterLDW.GTtemporalCounter_i1 "" UBYTE ADAS_CM_uint8 0 0 0 255 ECU_ADDRESS 0x0000 /* @ECU_Address@rtDW_ADAS.GTsf_TotalanalyticcounterLDW.GTtemporalCounter_i1@ */ /end MEASUREMENT
/begin MEASUREMENT rtDW_ADAS.GTsf_Turnoffblinkside.GTOut1 "" UBYTE ADAS_CM_uint8 0 0 0 255 ECU_ADDRESS 0x0000 /* @ECU_Address@rtDW_ADAS.GTsf_Turnoffblinkside.GTOut1@ */ /end MEASUREMENT
/begin MEASUREMENT rtDW_ADAS.GTsf_Turnoffblinkside.GTOut10 "" UBYTE ADAS_CM_uint8 0 0 0 255 ECU_ADDRESS 0x0000 /* @ECU_Address@rtDW_ADAS.GTsf_Turnoffblinkside.GTOut10@ */ /end MEASUREMENT
/begin MEASUREMENT rtDW_ADAS.GTsf_Turnoffblinkside.GTOut11 "" UBYTE ADAS_CM_uint8 0 0 0 255 ECU_ADDRESS 0x0000 /* @ECU_Address@rtDW_ADAS.GTsf_Turnoffblinkside.GTOut11@ */ /end MEASUREMENT
/begin MEASUREMENT rtDW_ADAS.GTsf_Turnoffblinkside.GTOut12 "" UBYTE ADAS_CM_uint8 0 0 0 255 ECU_ADDRESS 0x0000 /* @ECU_Address@rtDW_ADAS.GTsf_Turnoffblinkside.GTOut12@ */ /end MEASUREMENT
/begin MEASUREMENT rtDW_ADAS.GTsf_Turnoffblinkside.GTOut13 "" UBYTE ADAS_CM_uint8 0 0 0 255 ECU_ADDRESS 0x0000 /* @ECU_Address@rtDW_ADAS.GTsf_Turnoffblinkside.GTOut13@ */ /end MEASUREMENT
/begin MEASUREMENT rtDW_ADAS.GTsf_Turnoffblinkside.GTOut14 "" UBYTE ADAS_CM_uint8 0 0 0 255 ECU_ADDRESS 0x0000 /* @ECU_Address@rtDW_ADAS.GTsf_Turnoffblinkside.GTOut14@ */ /end MEASUREMENT
/begin MEASUREMENT rtDW_ADAS.GTsf_Turnoffblinkside.GTOut15 "" UBYTE ADAS_CM_uint8 0 0 0 255 ECU_ADDRESS 0x0000 /* @ECU_Address@rtDW_ADAS.GTsf_Turnoffblinkside.GTOut15@ */ /end MEASUREMENT
/begin MEASUREMENT rtDW_ADAS.GTsf_Turnoffblinkside.GTOut16 "" UBYTE ADAS_CM_uint8 0 0 0 255 ECU_ADDRESS 0x0000 /* @ECU_Address@rtDW_ADAS.GTsf_Turnoffblinkside.GTOut16@ */ /end MEASUREMENT
/begin MEASUREMENT rtDW_ADAS.GTsf_Turnoffblinkside.GTOut17 "" UBYTE ADAS_CM_uint8 0 0 0 255 ECU_ADDRESS 0x0000 /* @ECU_Address@rtDW_ADAS.GTsf_Turnoffblinkside.GTOut17@ */ /end MEASUREMENT
/begin MEASUREMENT rtDW_ADAS.GTsf_Turnoffblinkside.GTOut18 "" UBYTE ADAS_CM_uint8 0 0 0 255 ECU_ADDRESS 0x0000 /* @ECU_Address@rtDW_ADAS.GTsf_Turnoffblinkside.GTOut18@ */ /end MEASUREMENT
/begin MEASUREMENT rtDW_ADAS.GTsf_Turnoffblinkside.GTOut2 "" UBYTE ADAS_CM_uint8 0 0 0 255 ECU_ADDRESS 0x0000 /* @ECU_Address@rtDW_ADAS.GTsf_Turnoffblinkside.GTOut2@ */ /end MEASUREMENT
/begin MEASUREMENT rtDW_ADAS.GTsf_Turnoffblinkside.GTOut3 "" UBYTE ADAS_CM_uint8 0 0 0 255 ECU_ADDRESS 0x0000 /* @ECU_Address@rtDW_ADAS.GTsf_Turnoffblinkside.GTOut3@ */ /end MEASUREMENT
/begin MEASUREMENT rtDW_ADAS.GTsf_Turnoffblinkside.GTOut4 "" UBYTE ADAS_CM_uint8 0 0 0 255 ECU_ADDRESS 0x0000 /* @ECU_Address@rtDW_ADAS.GTsf_Turnoffblinkside.GTOut4@ */ /end MEASUREMENT
/begin MEASUREMENT rtDW_ADAS.GTsf_Turnoffblinkside.GTOut5 "" UBYTE ADAS_CM_uint8 0 0 0 255 ECU_ADDRESS 0x0000 /* @ECU_Address@rtDW_ADAS.GTsf_Turnoffblinkside.GTOut5@ */ /end MEASUREMENT
/begin MEASUREMENT rtDW_ADAS.GTsf_Turnoffblinkside.GTOut6 "" UBYTE ADAS_CM_uint8 0 0 0 255 ECU_ADDRESS 0x0000 /* @ECU_Address@rtDW_ADAS.GTsf_Turnoffblinkside.GTOut6@ */ /end MEASUREMENT
/begin MEASUREMENT rtDW_ADAS.GTsf_Turnoffblinkside.GTOut7 "" UBYTE ADAS_CM_uint8 0 0 0 255 ECU_ADDRESS 0x0000 /* @ECU_Address@rtDW_ADAS.GTsf_Turnoffblinkside.GTOut7@ */ /end MEASUREMENT
/begin MEASUREMENT rtDW_ADAS.GTsf_Turnoffblinkside.GTOut8 "" UBYTE ADAS_CM_uint8 0 0 0 255 ECU_ADDRESS 0x0000 /* @ECU_Address@rtDW_ADAS.GTsf_Turnoffblinkside.GTOut8@ */ /end MEASUREMENT
/begin MEASUREMENT rtDW_ADAS.GTsf_Turnoffblinkside.GTOut9 "" UBYTE ADAS_CM_uint8 0 0 0 255 ECU_ADDRESS 0x0000 /* @ECU_Address@rtDW_ADAS.GTsf_Turnoffblinkside.GTOut9@ */ /end MEASUREMENT
/begin MEASUREMENT rtDW_ADAS.GTsf_Turnoffblinkside_c.GTOut1 "" UBYTE ADAS_CM_uint8 0 0 0 255 ECU_ADDRESS 0x0000 /* @ECU_Address@rtDW_ADAS.GTsf_Turnoffblinkside_c.GTOut1@ */ /end MEASUREMENT
/begin MEASUREMENT rtDW_ADAS.GTsf_Turnoffblinkside_c.GTOut10 "" UBYTE ADAS_CM_uint8 0 0 0 255 ECU_ADDRESS 0x0000 /* @ECU_Address@rtDW_ADAS.GTsf_Turnoffblinkside_c.GTOut10@ */ /end MEASUREMENT
/begin MEASUREMENT rtDW_ADAS.GTsf_Turnoffblinkside_c.GTOut11 "" UBYTE ADAS_CM_uint8 0 0 0 255 ECU_ADDRESS 0x0000 /* @ECU_Address@rtDW_ADAS.GTsf_Turnoffblinkside_c.GTOut11@ */ /end MEASUREMENT
/begin MEASUREMENT rtDW_ADAS.GTsf_Turnoffblinkside_c.GTOut12 "" UBYTE ADAS_CM_uint8 0 0 0 255 ECU_ADDRESS 0x0000 /* @ECU_Address@rtDW_ADAS.GTsf_Turnoffblinkside_c.GTOut12@ */ /end MEASUREMENT
/begin MEASUREMENT rtDW_ADAS.GTsf_Turnoffblinkside_c.GTOut13 "" UBYTE ADAS_CM_uint8 0 0 0 255 ECU_ADDRESS 0x0000 /* @ECU_Address@rtDW_ADAS.GTsf_Turnoffblinkside_c.GTOut13@ */ /end MEASUREMENT
/begin MEASUREMENT rtDW_ADAS.GTsf_Turnoffblinkside_c.GTOut14 "" UBYTE ADAS_CM_uint8 0 0 0 255 ECU_ADDRESS 0x0000 /* @ECU_Address@rtDW_ADAS.GTsf_Turnoffblinkside_c.GTOut14@ */ /end MEASUREMENT
/begin MEASUREMENT rtDW_ADAS.GTsf_Turnoffblinkside_c.GTOut15 "" UBYTE ADAS_CM_uint8 0 0 0 255 ECU_ADDRESS 0x0000 /* @ECU_Address@rtDW_ADAS.GTsf_Turnoffblinkside_c.GTOut15@ */ /end MEASUREMENT
/begin MEASUREMENT rtDW_ADAS.GTsf_Turnoffblinkside_c.GTOut16 "" UBYTE ADAS_CM_uint8 0 0 0 255 ECU_ADDRESS 0x0000 /* @ECU_Address@rtDW_ADAS.GTsf_Turnoffblinkside_c.GTOut16@ */ /end MEASUREMENT
/begin MEASUREMENT rtDW_ADAS.GTsf_Turnoffblinkside_c.GTOut17 "" UBYTE ADAS_CM_uint8 0 0 0 255 ECU_ADDRESS 0x0000 /* @ECU_Address@rtDW_ADAS.GTsf_Turnoffblinkside_c.GTOut17@ */ /end MEASUREMENT
/begin MEASUREMENT rtDW_ADAS.GTsf_Turnoffblinkside_c.GTOut18 "" UBYTE ADAS_CM_uint8 0 0 0 255 ECU_ADDRESS 0x0000 /* @ECU_Address@rtDW_ADAS.GTsf_Turnoffblinkside_c.GTOut18@ */ /end MEASUREMENT
/begin MEASUREMENT rtDW_ADAS.GTsf_Turnoffblinkside_c.GTOut2 "" UBYTE ADAS_CM_uint8 0 0 0 255 ECU_ADDRESS 0x0000 /* @ECU_Address@rtDW_ADAS.GTsf_Turnoffblinkside_c.GTOut2@ */ /end MEASUREMENT
/begin MEASUREMENT rtDW_ADAS.GTsf_Turnoffblinkside_c.GTOut3 "" UBYTE ADAS_CM_uint8 0 0 0 255 ECU_ADDRESS 0x0000 /* @ECU_Address@rtDW_ADAS.GTsf_Turnoffblinkside_c.GTOut3@ */ /end MEASUREMENT
/begin MEASUREMENT rtDW_ADAS.GTsf_Turnoffblinkside_c.GTOut4 "" UBYTE ADAS_CM_uint8 0 0 0 255 ECU_ADDRESS 0x0000 /* @ECU_Address@rtDW_ADAS.GTsf_Turnoffblinkside_c.GTOut4@ */ /end MEASUREMENT
/begin MEASUREMENT rtDW_ADAS.GTsf_Turnoffblinkside_c.GTOut5 "" UBYTE ADAS_CM_uint8 0 0 0 255 ECU_ADDRESS 0x0000 /* @ECU_Address@rtDW_ADAS.GTsf_Turnoffblinkside_c.GTOut5@ */ /end MEASUREMENT
/begin MEASUREMENT rtDW_ADAS.GTsf_Turnoffblinkside_c.GTOut6 "" UBYTE ADAS_CM_uint8 0 0 0 255 ECU_ADDRESS 0x0000 /* @ECU_Address@rtDW_ADAS.GTsf_Turnoffblinkside_c.GTOut6@ */ /end MEASUREMENT
/begin MEASUREMENT rtDW_ADAS.GTsf_Turnoffblinkside_c.GTOut7 "" UBYTE ADAS_CM_uint8 0 0 0 255 ECU_ADDRESS 0x0000 /* @ECU_Address@rtDW_ADAS.GTsf_Turnoffblinkside_c.GTOut7@ */ /end MEASUREMENT
/begin MEASUREMENT rtDW_ADAS.GTsf_Turnoffblinkside_c.GTOut8 "" UBYTE ADAS_CM_uint8 0 0 0 255 ECU_ADDRESS 0x0000 /* @ECU_Address@rtDW_ADAS.GTsf_Turnoffblinkside_c.GTOut8@ */ /end MEASUREMENT
/begin MEASUREMENT rtDW_ADAS.GTsf_Turnoffblinkside_c.GTOut9 "" UBYTE ADAS_CM_uint8 0 0 0 255 ECU_ADDRESS 0x0000 /* @ECU_Address@rtDW_ADAS.GTsf_Turnoffblinkside_c.GTOut9@ */ /end MEASUREMENT
/begin MEASUREMENT rtDW_ADAS.GTsf_WARNING_TIME_MANAGER.GTis_active_c284_ADAS "" UBYTE ADAS_CM_uint8 0 0 0 255 ECU_ADDRESS 0x0000 /* @ECU_Address@rtDW_ADAS.GTsf_WARNING_TIME_MANAGER.GTis_active_c284_ADAS@ */ /end MEASUREMENT
/begin MEASUREMENT rtDW_ADAS.GTsf_WARNING_TIME_MANAGER.GTis_c284_ADAS "" UBYTE ADAS_CM_uint8 0 0 0 255 ECU_ADDRESS 0x0000 /* @ECU_Address@rtDW_ADAS.GTsf_WARNING_TIME_MANAGER.GTis_c284_ADAS@ */ /end MEASUREMENT
/begin MEASUREMENT rtDW_ADAS.GTsf_WARNING_TIME_MANAGER.GTtemporalCounter_i1 "" ULONG ADAS_CM_uint32 0 0 0 4294967295 ECU_ADDRESS 0x0000 /* @ECU_Address@rtDW_ADAS.GTsf_WARNING_TIME_MANAGER.GTtemporalCounter_i1@ */ /end MEASUREMENT
/begin MEASUREMENT rtDW_ADAS.GTsf_WARNING_TIME_MANAGER_p.GTis_active_c284_ADAS "" UBYTE ADAS_CM_uint8 0 0 0 255 ECU_ADDRESS 0x0000 /* @ECU_Address@rtDW_ADAS.GTsf_WARNING_TIME_MANAGER_p.GTis_active_c284_ADAS@ */ /end MEASUREMENT
/begin MEASUREMENT rtDW_ADAS.GTsf_WARNING_TIME_MANAGER_p.GTis_c284_ADAS "" UBYTE ADAS_CM_uint8 0 0 0 255 ECU_ADDRESS 0x0000 /* @ECU_Address@rtDW_ADAS.GTsf_WARNING_TIME_MANAGER_p.GTis_c284_ADAS@ */ /end MEASUREMENT
/begin MEASUREMENT rtDW_ADAS.GTsf_WARNING_TIME_MANAGER_p.GTtemporalCounter_i1 "" ULONG ADAS_CM_uint32 0 0 0 4294967295 ECU_ADDRESS 0x0000 /* @ECU_Address@rtDW_ADAS.GTsf_WARNING_TIME_MANAGER_p.GTtemporalCounter_i1@ */ /end MEASUREMENT
/begin MEASUREMENT rtDW_ADAS.GTsf_WARN_BLOCKING.GTis_NO_BLOCKING "" UBYTE ADAS_CM_uint8 0 0 0 255 ECU_ADDRESS 0x0000 /* @ECU_Address@rtDW_ADAS.GTsf_WARN_BLOCKING.GTis_NO_BLOCKING@ */ /end MEASUREMENT
/begin MEASUREMENT rtDW_ADAS.GTsf_WARN_BLOCKING.GTis_active_c282_ADAS "" UBYTE ADAS_CM_uint8 0 0 0 255 ECU_ADDRESS 0x0000 /* @ECU_Address@rtDW_ADAS.GTsf_WARN_BLOCKING.GTis_active_c282_ADAS@ */ /end MEASUREMENT
/begin MEASUREMENT rtDW_ADAS.GTsf_WARN_BLOCKING.GTis_c282_ADAS "" UBYTE ADAS_CM_uint8 0 0 0 255 ECU_ADDRESS 0x0000 /* @ECU_Address@rtDW_ADAS.GTsf_WARN_BLOCKING.GTis_c282_ADAS@ */ /end MEASUREMENT
/begin MEASUREMENT rtDW_ADAS.GTsf_WARN_BLOCKING.GTtemporalCounter_i1 "" ULONG ADAS_CM_uint32 0 0 0 4294967295 ECU_ADDRESS 0x0000 /* @ECU_Address@rtDW_ADAS.GTsf_WARN_BLOCKING.GTtemporalCounter_i1@ */ /end MEASUREMENT
/begin MEASUREMENT rtDW_ADAS.GTsf_WARN_BLOCKING_f.GTis_NO_BLOCKING "" UBYTE ADAS_CM_uint8 0 0 0 255 ECU_ADDRESS 0x0000 /* @ECU_Address@rtDW_ADAS.GTsf_WARN_BLOCKING_f.GTis_NO_BLOCKING@ */ /end MEASUREMENT
/begin MEASUREMENT rtDW_ADAS.GTsf_WARN_BLOCKING_f.GTis_active_c282_ADAS "" UBYTE ADAS_CM_uint8 0 0 0 255 ECU_ADDRESS 0x0000 /* @ECU_Address@rtDW_ADAS.GTsf_WARN_BLOCKING_f.GTis_active_c282_ADAS@ */ /end MEASUREMENT
/begin MEASUREMENT rtDW_ADAS.GTsf_WARN_BLOCKING_f.GTis_c282_ADAS "" UBYTE ADAS_CM_uint8 0 0 0 255 ECU_ADDRESS 0x0000 /* @ECU_Address@rtDW_ADAS.GTsf_WARN_BLOCKING_f.GTis_c282_ADAS@ */ /end MEASUREMENT
/begin MEASUREMENT rtDW_ADAS.GTsf_WARN_BLOCKING_f.GTtemporalCounter_i1 "" ULONG ADAS_CM_uint32 0 0 0 4294967295 ECU_ADDRESS 0x0000 /* @ECU_Address@rtDW_ADAS.GTsf_WARN_BLOCKING_f.GTtemporalCounter_i1@ */ /end MEASUREMENT
/begin MEASUREMENT rtDW_ADAS.GTsf_WARN_DELAY_L.GTis_active_c318_ADAS "" UBYTE ADAS_CM_uint8 0 0 0 255 ECU_ADDRESS 0x0000 /* @ECU_Address@rtDW_ADAS.GTsf_WARN_DELAY_L.GTis_active_c318_ADAS@ */ /end MEASUREMENT
/begin MEASUREMENT rtDW_ADAS.GTsf_WARN_DELAY_L.GTis_c318_ADAS "" UBYTE ADAS_CM_uint8 0 0 0 255 ECU_ADDRESS 0x0000 /* @ECU_Address@rtDW_ADAS.GTsf_WARN_DELAY_L.GTis_c318_ADAS@ */ /end MEASUREMENT
/begin MEASUREMENT rtDW_ADAS.GTsf_WARN_DELAY_L.GTtemporalCounter_i1 "" ULONG ADAS_CM_uint32 0 0 0 4294967295 ECU_ADDRESS 0x0000 /* @ECU_Address@rtDW_ADAS.GTsf_WARN_DELAY_L.GTtemporalCounter_i1@ */ /end MEASUREMENT
/begin MEASUREMENT rtDW_ADAS.GTsf_WARN_DELAY_R.GTis_active_c318_ADAS "" UBYTE ADAS_CM_uint8 0 0 0 255 ECU_ADDRESS 0x0000 /* @ECU_Address@rtDW_ADAS.GTsf_WARN_DELAY_R.GTis_active_c318_ADAS@ */ /end MEASUREMENT
/begin MEASUREMENT rtDW_ADAS.GTsf_WARN_DELAY_R.GTis_c318_ADAS "" UBYTE ADAS_CM_uint8 0 0 0 255 ECU_ADDRESS 0x0000 /* @ECU_Address@rtDW_ADAS.GTsf_WARN_DELAY_R.GTis_c318_ADAS@ */ /end MEASUREMENT
/begin MEASUREMENT rtDW_ADAS.GTsf_WARN_DELAY_R.GTtemporalCounter_i1 "" ULONG ADAS_CM_uint32 0 0 0 4294967295 ECU_ADDRESS 0x0000 /* @ECU_Address@rtDW_ADAS.GTsf_WARN_DELAY_R.GTtemporalCounter_i1@ */ /end MEASUREMENT
/begin COMPU_METHOD ADAS_CM_int32 "" IDENTICAL "%10.0" "" /end COMPU_METHOD
/begin COMPU_METHOD ADAS_CM_logical "" IDENTICAL "%1.0" "" /end COMPU_METHOD
/begin COMPU_METHOD ADAS_CM_single "" IDENTICAL "%8.6" "" /end COMPU_METHOD
/begin COMPU_METHOD ADAS_CM_uint32 "" IDENTICAL "%10.0" "" /end COMPU_METHOD
/begin COMPU_METHOD ADAS_CM_uint8 "" IDENTICAL "%3.0" "" /end COMPU_METHOD
/begin RECORD_LAYOUT Scalar_ULONG FNC_VALUES 1 ULONG COLUMN_DIR DIRECT /end RECORD_LAYOUT
/begin RECORD_LAYOUT Scalar_UWORD FNC_VALUES 1 UWORD COLUMN_DIR DIRECT /end RECORD_LAYOUT
/end MODULE
/end PROJECT
