ASAP2_VERSION 1 71
/begin PROJECT ProjectName "Project Comment Goes Here"
/begin HEADER "Header Comments go here" /end HEADER
/begin MODULE ModuleName "Module Comment Goes Here"
/begin MOD_COMMON "Mod Common Comment Here" BYTE_ORDER MSB_LAST ALIGNMENT_BYTE 1 ALIGNMENT_WORD 2 ALIGNMENT_LONG 4 ALIGNMENT_FLOAT32_IEEE 4 ALIGNMENT_FLOAT64_IEEE 8 ALIGNMENT_INT64 8 /end MOD_COMMON
/begin MEASUREMENT rtDW_ADAS.GTAdd1_b "" FLOAT32_IEEE ADAS_CM_single 0 0 -3.4E+38 3.4E+38 ECU_ADDRESS 0x0000 /* @ECU_Address@rtDW_ADAS.GTAdd1_b@ */ /end MEASUREMENT
/begin MEASUREMENT rtDW_ADAS.GTAdd1_c "" FLOAT32_IEEE ADAS_CM_single 0 0 -3.4E+38 3.4E+38 MATRIX_DIM 1 1 ECU_ADDRESS 0x0000 /* @ECU_Address@rtDW_ADAS.GTAdd1_c@ */ /end MEASUREMENT
/begin MEASUREMENT rtDW_ADAS.GTAdd1_cm "" FLOAT32_IEEE ADAS_CM_single 0 0 -3.4E+38 3.4E+38 ECU_ADDRESS 0x0000 /* @ECU_Address@rtDW_ADAS.GTAdd1_cm@ */ /end MEASUREMENT
/begin MEASUREMENT rtDW_ADAS.GTAdd1_e3 "" FLOAT32_IEEE ADAS_CM_single 0 0 -3.4E+38 3.4E+38 MATRIX_DIM 1 1 ECU_ADDRESS 0x0000 /* @ECU_Address@rtDW_ADAS.GTAdd1_e3@ */ /end MEASUREMENT
/begin MEASUREMENT rtDW_ADAS.GTAdd1_ez "" FLOAT32_IEEE ADAS_CM_single 0 0 -3.4E+38 3.4E+38 ECU_ADDRESS 0x0000 /* @ECU_Address@rtDW_ADAS.GTAdd1_ez@ */ /end MEASUREMENT
/begin MEASUREMENT rtDW_ADAS.GTAdd1_j "" FLOAT32_IEEE ADAS_CM_single 0 0 -3.4E+38 3.4E+38 ECU_ADDRESS 0x0000 /* @ECU_Address@rtDW_ADAS.GTAdd1_j@ */ /end MEASUREMENT
/begin MEASUREMENT rtDW_ADAS.GTAdd1_jl "" FLOAT32_IEEE ADAS_CM_single 0 0 -3.4E+38 3.4E+38 ECU_ADDRESS 0x0000 /* @ECU_Address@rtDW_ADAS.GTAdd1_jl@ */ /end MEASUREMENT
/begin MEASUREMENT rtDW_ADAS.GTAdd1_m "" FLOAT32_IEEE ADAS_CM_single 0 0 -3.4E+38 3.4E+38 MATRIX_DIM 1 1 ECU_ADDRESS 0x0000 /* @ECU_Address@rtDW_ADAS.GTAdd1_m@ */ /end MEASUREMENT
/begin MEASUREMENT rtDW_ADAS.GTAdd2_d "" FLOAT32_IEEE ADAS_CM_single 0 0 -3.4E+38 3.4E+38 MATRIX_DIM 1 1 ECU_ADDRESS 0x0000 /* @ECU_Address@rtDW_ADAS.GTAdd2_d@ */ /end MEASUREMENT
/begin MEASUREMENT rtDW_ADAS.GTAdd2_e "" FLOAT32_IEEE ADAS_CM_single 0 0 -3.4E+38 3.4E+38 MATRIX_DIM 1 1 ECU_ADDRESS 0x0000 /* @ECU_Address@rtDW_ADAS.GTAdd2_e@ */ /end MEASUREMENT
/begin MEASUREMENT rtDW_ADAS.GTAdd2_i "" FLOAT32_IEEE ADAS_CM_single 0 0 -3.4E+38 3.4E+38 MATRIX_DIM 1 1 ECU_ADDRESS 0x0000 /* @ECU_Address@rtDW_ADAS.GTAdd2_i@ */ /end MEASUREMENT
/begin MEASUREMENT rtDW_ADAS.GTAdd_f "" FLOAT32_IEEE ADAS_CM_single 0 0 -3.4E+38 3.4E+38 ECU_ADDRESS 0x0000 /* @ECU_Address@rtDW_ADAS.GTAdd_f@ */ /end MEASUREMENT
/begin MEASUREMENT rtDW_ADAS.GTAdd_ku "" FLOAT32_IEEE ADAS_CM_single 0 0 -3.4E+38 3.4E+38 ECU_ADDRESS 0x0000 /* @ECU_Address@rtDW_ADAS.GTAdd_ku@ */ /end MEASUREMENT
/begin MEASUREMENT rtDW_ADAS.GTAngleObjArray "" FLOAT32_IEEE ADAS_CM_single 0 0 -3.4E+38 3.4E+38 LAYOUT COLUMN_DIR MATRIX_DIM 1 6 ECU_ADDRESS 0x0000 /* @ECU_Address@rtDW_ADAS.GTAngleObjArray@ */ /end MEASUREMENT
/begin MEASUREMENT rtDW_ADAS.GTAngleObjArray_b "" FLOAT32_IEEE ADAS_CM_single 0 0 -3.4E+38 3.4E+38 LAYOUT COLUMN_DIR MATRIX_DIM 1 6 ECU_ADDRESS 0x0000 /* @ECU_Address@rtDW_ADAS.GTAngleObjArray_b@ */ /end MEASUREMENT
/begin MEASUREMENT rtDW_ADAS.GTAngleObjArray_c "" FLOAT32_IEEE ADAS_CM_single 0 0 -3.4E+38 3.4E+38 LAYOUT COLUMN_DIR MATRIX_DIM 1 6 ECU_ADDRESS 0x0000 /* @ECU_Address@rtDW_ADAS.GTAngleObjArray_c@ */ /end MEASUREMENT
/begin MEASUREMENT rtDW_ADAS.GTAngleObjArray_d "" FLOAT32_IEEE ADAS_CM_single 0 0 -3.4E+38 3.4E+38 LAYOUT COLUMN_DIR MATRIX_DIM 1 6 ECU_ADDRESS 0x0000 /* @ECU_Address@rtDW_ADAS.GTAngleObjArray_d@ */ /end MEASUREMENT
/begin MEASUREMENT rtDW_ADAS.GTAngleObjArray_di "" FLOAT32_IEEE ADAS_CM_single 0 0 -3.4E+38 3.4E+38 LAYOUT COLUMN_DIR MATRIX_DIM 1 6 ECU_ADDRESS 0x0000 /* @ECU_Address@rtDW_ADAS.GTAngleObjArray_di@ */ /end MEASUREMENT
/begin MEASUREMENT rtDW_ADAS.GTAngleObjArray_g "" FLOAT32_IEEE ADAS_CM_single 0 0 -3.4E+38 3.4E+38 LAYOUT COLUMN_DIR MATRIX_DIM 1 6 ECU_ADDRESS 0x0000 /* @ECU_Address@rtDW_ADAS.GTAngleObjArray_g@ */ /end MEASUREMENT
/begin MEASUREMENT rtDW_ADAS.GTAngleObjArray_h "" FLOAT32_IEEE ADAS_CM_single 0 0 -3.4E+38 3.4E+38 LAYOUT COLUMN_DIR MATRIX_DIM 1 6 ECU_ADDRESS 0x0000 /* @ECU_Address@rtDW_ADAS.GTAngleObjArray_h@ */ /end MEASUREMENT
/begin MEASUREMENT rtDW_ADAS.GTAngleObjArray_h2 "" FLOAT32_IEEE ADAS_CM_single 0 0 -3.4E+38 3.4E+38 LAYOUT COLUMN_DIR MATRIX_DIM 1 6 ECU_ADDRESS 0x0000 /* @ECU_Address@rtDW_ADAS.GTAngleObjArray_h2@ */ /end MEASUREMENT
/begin MEASUREMENT rtDW_ADAS.GTAngleObjArray_ha "" FLOAT32_IEEE ADAS_CM_single 0 0 -3.4E+38 3.4E+38 LAYOUT COLUMN_DIR MATRIX_DIM 1 6 ECU_ADDRESS 0x0000 /* @ECU_Address@rtDW_ADAS.GTAngleObjArray_ha@ */ /end MEASUREMENT
/begin MEASUREMENT rtDW_ADAS.GTAngleObjArray_ho "" FLOAT32_IEEE ADAS_CM_single 0 0 -3.4E+38 3.4E+38 LAYOUT COLUMN_DIR MATRIX_DIM 1 6 ECU_ADDRESS 0x0000 /* @ECU_Address@rtDW_ADAS.GTAngleObjArray_ho@ */ /end MEASUREMENT
/begin MEASUREMENT rtDW_ADAS.GTAngleObjArray_hp "" FLOAT32_IEEE ADAS_CM_single 0 0 -3.4E+38 3.4E+38 LAYOUT COLUMN_DIR MATRIX_DIM 1 6 ECU_ADDRESS 0x0000 /* @ECU_Address@rtDW_ADAS.GTAngleObjArray_hp@ */ /end MEASUREMENT
/begin MEASUREMENT rtDW_ADAS.GTAngleObjArray_i "" FLOAT32_IEEE ADAS_CM_single 0 0 -3.4E+38 3.4E+38 LAYOUT COLUMN_DIR MATRIX_DIM 1 6 ECU_ADDRESS 0x0000 /* @ECU_Address@rtDW_ADAS.GTAngleObjArray_i@ */ /end MEASUREMENT
/begin MEASUREMENT rtDW_ADAS.GTAngleObjArray_ie "" FLOAT32_IEEE ADAS_CM_single 0 0 -3.4E+38 3.4E+38 LAYOUT COLUMN_DIR MATRIX_DIM 1 6 ECU_ADDRESS 0x0000 /* @ECU_Address@rtDW_ADAS.GTAngleObjArray_ie@ */ /end MEASUREMENT
/begin MEASUREMENT rtDW_ADAS.GTAngleObjArray_iw "" FLOAT32_IEEE ADAS_CM_single 0 0 -3.4E+38 3.4E+38 LAYOUT COLUMN_DIR MATRIX_DIM 1 6 ECU_ADDRESS 0x0000 /* @ECU_Address@rtDW_ADAS.GTAngleObjArray_iw@ */ /end MEASUREMENT
/begin MEASUREMENT rtDW_ADAS.GTAngleObjArray_j "" FLOAT32_IEEE ADAS_CM_single 0 0 -3.4E+38 3.4E+38 LAYOUT COLUMN_DIR MATRIX_DIM 1 6 ECU_ADDRESS 0x0000 /* @ECU_Address@rtDW_ADAS.GTAngleObjArray_j@ */ /end MEASUREMENT
/begin MEASUREMENT rtDW_ADAS.GTAngleObjArray_l "" FLOAT32_IEEE ADAS_CM_single 0 0 -3.4E+38 3.4E+38 LAYOUT COLUMN_DIR MATRIX_DIM 1 6 ECU_ADDRESS 0x0000 /* @ECU_Address@rtDW_ADAS.GTAngleObjArray_l@ */ /end MEASUREMENT
/begin MEASUREMENT rtDW_ADAS.GTAngleObjArray_lc "" FLOAT32_IEEE ADAS_CM_single 0 0 -3.4E+38 3.4E+38 LAYOUT COLUMN_DIR MATRIX_DIM 1 6 ECU_ADDRESS 0x0000 /* @ECU_Address@rtDW_ADAS.GTAngleObjArray_lc@ */ /end MEASUREMENT
/begin MEASUREMENT rtDW_ADAS.GTAngleObjArray_m "" FLOAT32_IEEE ADAS_CM_single 0 0 -3.4E+38 3.4E+38 LAYOUT COLUMN_DIR MATRIX_DIM 1 6 ECU_ADDRESS 0x0000 /* @ECU_Address@rtDW_ADAS.GTAngleObjArray_m@ */ /end MEASUREMENT
/begin MEASUREMENT rtDW_ADAS.GTAngleObjArray_o "" FLOAT32_IEEE ADAS_CM_single 0 0 -3.4E+38 3.4E+38 LAYOUT COLUMN_DIR MATRIX_DIM 1 6 ECU_ADDRESS 0x0000 /* @ECU_Address@rtDW_ADAS.GTAngleObjArray_o@ */ /end MEASUREMENT
/begin MEASUREMENT rtDW_ADAS.GTAngleObjArray_p "" FLOAT32_IEEE ADAS_CM_single 0 0 -3.4E+38 3.4E+38 LAYOUT COLUMN_DIR MATRIX_DIM 1 6 ECU_ADDRESS 0x0000 /* @ECU_Address@rtDW_ADAS.GTAngleObjArray_p@ */ /end MEASUREMENT
/begin MEASUREMENT rtDW_ADAS.GTAx_ref "" FLOAT32_IEEE ADAS_CM_single 0 0 -3.4E+38 3.4E+38 ECU_ADDRESS 0x0000 /* @ECU_Address@rtDW_ADAS.GTAx_ref@ */ /end MEASUREMENT
/begin MEASUREMENT rtDW_ADAS.GTByeSts_ag "" UBYTE ADAS_CM_uint8 0 0 0 255 ECU_ADDRESS 0x0000 /* @ECU_Address@rtDW_ADAS.GTByeSts_ag@ */ /end MEASUREMENT
/begin MEASUREMENT rtDW_ADAS.GTByeSts_go "" UBYTE ADAS_CM_uint8 0 0 0 255 ECU_ADDRESS 0x0000 /* @ECU_Address@rtDW_ADAS.GTByeSts_go@ */ /end MEASUREMENT
/begin MEASUREMENT rtDW_ADAS.GTCVW_req "" UBYTE ADAS_CM_uint8 0 0 0 255 MATRIX_DIM 1 1 ECU_ADDRESS 0x0000 /* @ECU_Address@rtDW_ADAS.GTCVW_req@ */ /end MEASUREMENT
/begin MEASUREMENT rtDW_ADAS.GTCVW_req_p "" UBYTE ADAS_CM_uint8 0 0 0 255 MATRIX_DIM 1 1 ECU_ADDRESS 0x0000 /* @ECU_Address@rtDW_ADAS.GTCVW_req_p@ */ /end MEASUREMENT
/begin MEASUREMENT rtDW_ADAS.GTCastToBoolean3 "" UBYTE ADAS_CM_uint8 0 0 0 255 ECU_ADDRESS 0x0000 /* @ECU_Address@rtDW_ADAS.GTCastToBoolean3@ */ /end MEASUREMENT
/begin MEASUREMENT rtDW_ADAS.GTCastToBoolean3_p "" UBYTE ADAS_CM_uint8 0 0 0 255 ECU_ADDRESS 0x0000 /* @ECU_Address@rtDW_ADAS.GTCastToBoolean3_p@ */ /end MEASUREMENT
/begin MEASUREMENT rtDW_ADAS.GTDelay1_DSTATE_ef "" UBYTE ADAS_CM_uint8 0 0 0 255 LAYOUT COLUMN_DIR MATRIX_DIM 2 ECU_ADDRESS 0x0000 /* @ECU_Address@rtDW_ADAS.GTDelay1_DSTATE_ef@ */ /end MEASUREMENT
/begin MEASUREMENT rtDW_ADAS.GTDelay1_DSTATE_o5 "" UBYTE ADAS_CM_uint8 0 0 0 255 LAYOUT COLUMN_DIR MATRIX_DIM 2 ECU_ADDRESS 0x0000 /* @ECU_Address@rtDW_ADAS.GTDelay1_DSTATE_o5@ */ /end MEASUREMENT
/begin MEASUREMENT rtDW_ADAS.GTDelay2_DSTATE_j "" FLOAT32_IEEE ADAS_CM_single 0 0 -3.4E+38 3.4E+38 ECU_ADDRESS 0x0000 /* @ECU_Address@rtDW_ADAS.GTDelay2_DSTATE_j@ */ /end MEASUREMENT
/begin MEASUREMENT rtDW_ADAS.GTDelay2_DSTATE_l4 "" UBYTE ADAS_CM_uint8 0 0 0 255 LAYOUT COLUMN_DIR MATRIX_DIM 3 ECU_ADDRESS 0x0000 /* @ECU_Address@rtDW_ADAS.GTDelay2_DSTATE_l4@ */ /end MEASUREMENT
/begin MEASUREMENT rtDW_ADAS.GTDelay2_DSTATE_m "" UBYTE ADAS_CM_uint8 0 0 0 255 LAYOUT COLUMN_DIR MATRIX_DIM 3 ECU_ADDRESS 0x0000 /* @ECU_Address@rtDW_ADAS.GTDelay2_DSTATE_m@ */ /end MEASUREMENT
/begin MEASUREMENT rtDW_ADAS.GTDelay3_DSTATE_a "" UBYTE ADAS_CM_logical 0 0 0 1 ECU_ADDRESS 0x0000 /* @ECU_Address@rtDW_ADAS.GTDelay3_DSTATE_a@ */ /end MEASUREMENT
/begin MEASUREMENT rtDW_ADAS.GTDelay3_DSTATE_g "" UBYTE ADAS_CM_uint8 0 0 0 255 LAYOUT COLUMN_DIR MATRIX_DIM 3 ECU_ADDRESS 0x0000 /* @ECU_Address@rtDW_ADAS.GTDelay3_DSTATE_g@ */ /end MEASUREMENT
/begin MEASUREMENT rtDW_ADAS.GTDelay3_DSTATE_g1 "" UBYTE ADAS_CM_uint8 0 0 0 255 LAYOUT COLUMN_DIR MATRIX_DIM 3 ECU_ADDRESS 0x0000 /* @ECU_Address@rtDW_ADAS.GTDelay3_DSTATE_g1@ */ /end MEASUREMENT
/begin MEASUREMENT rtDW_ADAS.GTDelay4_DSTATE "" FLOAT32_IEEE ADAS_CM_single 0 0 -3.4E+38 3.4E+38 ECU_ADDRESS 0x0000 /* @ECU_Address@rtDW_ADAS.GTDelay4_DSTATE@ */ /end MEASUREMENT
/begin MEASUREMENT rtDW_ADAS.GTDelay5_DSTATE_e "" UBYTE ADAS_CM_logical 0 0 0 1 ECU_ADDRESS 0x0000 /* @ECU_Address@rtDW_ADAS.GTDelay5_DSTATE_e@ */ /end MEASUREMENT
/begin MEASUREMENT rtDW_ADAS.GTDelay6_DSTATE_m "" FLOAT32_IEEE ADAS_CM_single 0 0 -3.4E+38 3.4E+38 ECU_ADDRESS 0x0000 /* @ECU_Address@rtDW_ADAS.GTDelay6_DSTATE_m@ */ /end MEASUREMENT
/begin MEASUREMENT rtDW_ADAS.GTDelay7_DSTATE "" FLOAT32_IEEE ADAS_CM_single 0 0 -3.4E+38 3.4E+38 ECU_ADDRESS 0x0000 /* @ECU_Address@rtDW_ADAS.GTDelay7_DSTATE@ */ /end MEASUREMENT
/begin MEASUREMENT rtDW_ADAS.GTDelayInput1_DSTATE_af "" UBYTE ADAS_CM_uint8 0 0 0 255 ECU_ADDRESS 0x0000 /* @ECU_Address@rtDW_ADAS.GTDelayInput1_DSTATE_af@ */ /end MEASUREMENT
/begin MEASUREMENT rtDW_ADAS.GTDelayInput1_DSTATE_ay "" UBYTE ADAS_CM_uint8 0 0 0 255 ECU_ADDRESS 0x0000 /* @ECU_Address@rtDW_ADAS.GTDelayInput1_DSTATE_ay@ */ /end MEASUREMENT
/begin MEASUREMENT rtDW_ADAS.GTDelayInput1_DSTATE_bn "" UBYTE ADAS_CM_uint8 0 0 0 255 ECU_ADDRESS 0x0000 /* @ECU_Address@rtDW_ADAS.GTDelayInput1_DSTATE_bn@ */ /end MEASUREMENT
/begin MEASUREMENT rtDW_ADAS.GTDelayInput1_DSTATE_c "" UBYTE ADAS_CM_uint8 0 0 0 255 ECU_ADDRESS 0x0000 /* @ECU_Address@rtDW_ADAS.GTDelayInput1_DSTATE_c@ */ /end MEASUREMENT
/begin MEASUREMENT rtDW_ADAS.GTDelayInput1_DSTATE_c1 "" UBYTE ADAS_CM_uint8 0 0 0 255 ECU_ADDRESS 0x0000 /* @ECU_Address@rtDW_ADAS.GTDelayInput1_DSTATE_c1@ */ /end MEASUREMENT
/begin MEASUREMENT rtDW_ADAS.GTDelayInput1_DSTATE_cgq "" UBYTE ADAS_CM_uint8 0 0 0 255 ECU_ADDRESS 0x0000 /* @ECU_Address@rtDW_ADAS.GTDelayInput1_DSTATE_cgq@ */ /end MEASUREMENT
/begin MEASUREMENT rtDW_ADAS.GTDelayInput1_DSTATE_cgu "" UBYTE ADAS_CM_uint8 0 0 0 255 ECU_ADDRESS 0x0000 /* @ECU_Address@rtDW_ADAS.GTDelayInput1_DSTATE_cgu@ */ /end MEASUREMENT
/begin MEASUREMENT rtDW_ADAS.GTDelayInput1_DSTATE_ci "" UBYTE ADAS_CM_uint8 0 0 0 255 ECU_ADDRESS 0x0000 /* @ECU_Address@rtDW_ADAS.GTDelayInput1_DSTATE_ci@ */ /end MEASUREMENT
/begin MEASUREMENT rtDW_ADAS.GTDelayInput1_DSTATE_cz "" UBYTE ADAS_CM_uint8 0 0 0 255 ECU_ADDRESS 0x0000 /* @ECU_Address@rtDW_ADAS.GTDelayInput1_DSTATE_cz@ */ /end MEASUREMENT
/begin MEASUREMENT rtDW_ADAS.GTDelayInput1_DSTATE_e1y "" UBYTE ADAS_CM_uint8 0 0 0 255 ECU_ADDRESS 0x0000 /* @ECU_Address@rtDW_ADAS.GTDelayInput1_DSTATE_e1y@ */ /end MEASUREMENT
/begin MEASUREMENT rtDW_ADAS.GTDelayInput1_DSTATE_ej "" UBYTE ADAS_CM_uint8 0 0 0 255 ECU_ADDRESS 0x0000 /* @ECU_Address@rtDW_ADAS.GTDelayInput1_DSTATE_ej@ */ /end MEASUREMENT
/begin MEASUREMENT rtDW_ADAS.GTDelayInput1_DSTATE_ep "" UBYTE ADAS_CM_uint8 0 0 0 255 ECU_ADDRESS 0x0000 /* @ECU_Address@rtDW_ADAS.GTDelayInput1_DSTATE_ep@ */ /end MEASUREMENT
/begin MEASUREMENT rtDW_ADAS.GTDelayInput1_DSTATE_ey "" UBYTE ADAS_CM_uint8 0 0 0 255 ECU_ADDRESS 0x0000 /* @ECU_Address@rtDW_ADAS.GTDelayInput1_DSTATE_ey@ */ /end MEASUREMENT
/begin MEASUREMENT rtDW_ADAS.GTDelayInput1_DSTATE_fe "" UBYTE ADAS_CM_uint8 0 0 0 255 ECU_ADDRESS 0x0000 /* @ECU_Address@rtDW_ADAS.GTDelayInput1_DSTATE_fe@ */ /end MEASUREMENT
/begin MEASUREMENT rtDW_ADAS.GTDelayInput1_DSTATE_fv "" UBYTE ADAS_CM_uint8 0 0 0 255 ECU_ADDRESS 0x0000 /* @ECU_Address@rtDW_ADAS.GTDelayInput1_DSTATE_fv@ */ /end MEASUREMENT
/begin MEASUREMENT rtDW_ADAS.GTDelayInput1_DSTATE_fvk "" UBYTE ADAS_CM_uint8 0 0 0 255 ECU_ADDRESS 0x0000 /* @ECU_Address@rtDW_ADAS.GTDelayInput1_DSTATE_fvk@ */ /end MEASUREMENT
/begin MEASUREMENT rtDW_ADAS.GTDelayInput1_DSTATE_g "" UBYTE ADAS_CM_uint8 0 0 0 255 ECU_ADDRESS 0x0000 /* @ECU_Address@rtDW_ADAS.GTDelayInput1_DSTATE_g@ */ /end MEASUREMENT
/begin MEASUREMENT rtDW_ADAS.GTDelayInput1_DSTATE_gg "" UBYTE ADAS_CM_uint8 0 0 0 255 ECU_ADDRESS 0x0000 /* @ECU_Address@rtDW_ADAS.GTDelayInput1_DSTATE_gg@ */ /end MEASUREMENT
/begin MEASUREMENT rtDW_ADAS.GTDelayInput1_DSTATE_gl "" UBYTE ADAS_CM_uint8 0 0 0 255 ECU_ADDRESS 0x0000 /* @ECU_Address@rtDW_ADAS.GTDelayInput1_DSTATE_gl@ */ /end MEASUREMENT
/begin MEASUREMENT rtDW_ADAS.GTDelayInput1_DSTATE_hc "" UBYTE ADAS_CM_uint8 0 0 0 255 ECU_ADDRESS 0x0000 /* @ECU_Address@rtDW_ADAS.GTDelayInput1_DSTATE_hc@ */ /end MEASUREMENT
/begin MEASUREMENT rtDW_ADAS.GTDelayInput1_DSTATE_hd "" UBYTE ADAS_CM_uint8 0 0 0 255 ECU_ADDRESS 0x0000 /* @ECU_Address@rtDW_ADAS.GTDelayInput1_DSTATE_hd@ */ /end MEASUREMENT
/begin MEASUREMENT rtDW_ADAS.GTDelayInput1_DSTATE_hy "" UBYTE ADAS_CM_uint8 0 0 0 255 ECU_ADDRESS 0x0000 /* @ECU_Address@rtDW_ADAS.GTDelayInput1_DSTATE_hy@ */ /end MEASUREMENT
/begin MEASUREMENT rtDW_ADAS.GTDelayInput1_DSTATE_ii "" UBYTE ADAS_CM_uint8 0 0 0 255 ECU_ADDRESS 0x0000 /* @ECU_Address@rtDW_ADAS.GTDelayInput1_DSTATE_ii@ */ /end MEASUREMENT
/begin MEASUREMENT rtDW_ADAS.GTDelayInput1_DSTATE_ij "" UBYTE ADAS_CM_uint8 0 0 0 255 ECU_ADDRESS 0x0000 /* @ECU_Address@rtDW_ADAS.GTDelayInput1_DSTATE_ij@ */ /end MEASUREMENT
/begin MEASUREMENT rtDW_ADAS.GTDelayInput1_DSTATE_il "" UBYTE ADAS_CM_uint8 0 0 0 255 ECU_ADDRESS 0x0000 /* @ECU_Address@rtDW_ADAS.GTDelayInput1_DSTATE_il@ */ /end MEASUREMENT
/begin MEASUREMENT rtDW_ADAS.GTDelayInput1_DSTATE_jr "" UBYTE ADAS_CM_uint8 0 0 0 255 ECU_ADDRESS 0x0000 /* @ECU_Address@rtDW_ADAS.GTDelayInput1_DSTATE_jr@ */ /end MEASUREMENT
/begin MEASUREMENT rtDW_ADAS.GTDelayInput1_DSTATE_k2 "" UBYTE ADAS_CM_uint8 0 0 0 255 ECU_ADDRESS 0x0000 /* @ECU_Address@rtDW_ADAS.GTDelayInput1_DSTATE_k2@ */ /end MEASUREMENT
/begin MEASUREMENT rtDW_ADAS.GTDelayInput1_DSTATE_kb "" UBYTE ADAS_CM_uint8 0 0 0 255 ECU_ADDRESS 0x0000 /* @ECU_Address@rtDW_ADAS.GTDelayInput1_DSTATE_kb@ */ /end MEASUREMENT
/begin MEASUREMENT rtDW_ADAS.GTDelayInput1_DSTATE_ku "" UBYTE ADAS_CM_uint8 0 0 0 255 ECU_ADDRESS 0x0000 /* @ECU_Address@rtDW_ADAS.GTDelayInput1_DSTATE_ku@ */ /end MEASUREMENT
/begin MEASUREMENT rtDW_ADAS.GTDelayInput1_DSTATE_kw "" UBYTE ADAS_CM_uint8 0 0 0 255 ECU_ADDRESS 0x0000 /* @ECU_Address@rtDW_ADAS.GTDelayInput1_DSTATE_kw@ */ /end MEASUREMENT
/begin MEASUREMENT rtDW_ADAS.GTDelayInput1_DSTATE_ky "" UBYTE ADAS_CM_uint8 0 0 0 255 ECU_ADDRESS 0x0000 /* @ECU_Address@rtDW_ADAS.GTDelayInput1_DSTATE_ky@ */ /end MEASUREMENT
/begin MEASUREMENT rtDW_ADAS.GTDelayInput1_DSTATE_l1 "" UBYTE ADAS_CM_uint8 0 0 0 255 ECU_ADDRESS 0x0000 /* @ECU_Address@rtDW_ADAS.GTDelayInput1_DSTATE_l1@ */ /end MEASUREMENT
/begin MEASUREMENT rtDW_ADAS.GTDelayInput1_DSTATE_lm "" UBYTE ADAS_CM_uint8 0 0 0 255 ECU_ADDRESS 0x0000 /* @ECU_Address@rtDW_ADAS.GTDelayInput1_DSTATE_lm@ */ /end MEASUREMENT
/begin MEASUREMENT rtDW_ADAS.GTDelayInput1_DSTATE_lp "" UBYTE ADAS_CM_uint8 0 0 0 255 ECU_ADDRESS 0x0000 /* @ECU_Address@rtDW_ADAS.GTDelayInput1_DSTATE_lp@ */ /end MEASUREMENT
/begin MEASUREMENT rtDW_ADAS.GTDelayInput1_DSTATE_lt "" UBYTE ADAS_CM_uint8 0 0 0 255 ECU_ADDRESS 0x0000 /* @ECU_Address@rtDW_ADAS.GTDelayInput1_DSTATE_lt@ */ /end MEASUREMENT
/begin MEASUREMENT rtDW_ADAS.GTDelayInput1_DSTATE_mc "" UBYTE ADAS_CM_uint8 0 0 0 255 ECU_ADDRESS 0x0000 /* @ECU_Address@rtDW_ADAS.GTDelayInput1_DSTATE_mc@ */ /end MEASUREMENT
/begin MEASUREMENT rtDW_ADAS.GTDelayInput1_DSTATE_me "" UBYTE ADAS_CM_uint8 0 0 0 255 ECU_ADDRESS 0x0000 /* @ECU_Address@rtDW_ADAS.GTDelayInput1_DSTATE_me@ */ /end MEASUREMENT
/begin MEASUREMENT rtDW_ADAS.GTDelayInput1_DSTATE_mj "" UBYTE ADAS_CM_logical 0 0 0 1 ECU_ADDRESS 0x0000 /* @ECU_Address@rtDW_ADAS.GTDelayInput1_DSTATE_mj@ */ /end MEASUREMENT
/begin MEASUREMENT rtDW_ADAS.GTDelayInput1_DSTATE_mm "" UBYTE ADAS_CM_uint8 0 0 0 255 ECU_ADDRESS 0x0000 /* @ECU_Address@rtDW_ADAS.GTDelayInput1_DSTATE_mm@ */ /end MEASUREMENT
/begin MEASUREMENT rtDW_ADAS.GTDelayInput1_DSTATE_mw "" UBYTE ADAS_CM_uint8 0 0 0 255 ECU_ADDRESS 0x0000 /* @ECU_Address@rtDW_ADAS.GTDelayInput1_DSTATE_mw@ */ /end MEASUREMENT
/begin MEASUREMENT rtDW_ADAS.GTDelayInput1_DSTATE_ox "" UBYTE ADAS_CM_uint8 0 0 0 255 ECU_ADDRESS 0x0000 /* @ECU_Address@rtDW_ADAS.GTDelayInput1_DSTATE_ox@ */ /end MEASUREMENT
/begin MEASUREMENT rtDW_ADAS.GTDelayInput1_DSTATE_oz "" UBYTE ADAS_CM_uint8 0 0 0 255 ECU_ADDRESS 0x0000 /* @ECU_Address@rtDW_ADAS.GTDelayInput1_DSTATE_oz@ */ /end MEASUREMENT
/begin MEASUREMENT rtDW_ADAS.GTDelayInput1_DSTATE_pg "" UBYTE ADAS_CM_uint8 0 0 0 255 ECU_ADDRESS 0x0000 /* @ECU_Address@rtDW_ADAS.GTDelayInput1_DSTATE_pg@ */ /end MEASUREMENT
/begin MEASUREMENT rtDW_ADAS.GTDelayInput2_DSTATE "" FLOAT32_IEEE ADAS_CM_single 0 0 -3.4E+38 3.4E+38 ECU_ADDRESS 0x0000 /* @ECU_Address@rtDW_ADAS.GTDelayInput2_DSTATE@ */ /end MEASUREMENT
/begin MEASUREMENT rtDW_ADAS.GTDelayInput2_DSTATE_i "" FLOAT32_IEEE ADAS_CM_single 0 0 -3.4E+38 3.4E+38 ECU_ADDRESS 0x0000 /* @ECU_Address@rtDW_ADAS.GTDelayInput2_DSTATE_i@ */ /end MEASUREMENT
/begin MEASUREMENT rtDW_ADAS.GTDelayInput2_DSTATE_l "" FLOAT32_IEEE ADAS_CM_single 0 0 -3.4E+38 3.4E+38 ECU_ADDRESS 0x0000 /* @ECU_Address@rtDW_ADAS.GTDelayInput2_DSTATE_l@ */ /end MEASUREMENT
/begin MEASUREMENT rtDW_ADAS.GTDelayInput2_DSTATE_p "" FLOAT32_IEEE ADAS_CM_single 0 0 -3.4E+38 3.4E+38 ECU_ADDRESS 0x0000 /* @ECU_Address@rtDW_ADAS.GTDelayInput2_DSTATE_p@ */ /end MEASUREMENT
/begin MEASUREMENT rtDW_ADAS.GTDelay_DSTATE_bd "" UBYTE ADAS_CM_uint8 0 0 0 255 LAYOUT COLUMN_DIR MATRIX_DIM 2 ECU_ADDRESS 0x0000 /* @ECU_Address@rtDW_ADAS.GTDelay_DSTATE_bd@ */ /end MEASUREMENT
/begin MEASUREMENT rtDW_ADAS.GTDelay_DSTATE_m "" UBYTE ADAS_CM_uint8 0 0 0 255 LAYOUT COLUMN_DIR MATRIX_DIM 2 ECU_ADDRESS 0x0000 /* @ECU_Address@rtDW_ADAS.GTDelay_DSTATE_m@ */ /end MEASUREMENT
/begin MEASUREMENT rtDW_ADAS.GTDetectObj9_10_j "" UBYTE ADAS_CM_uint8 0 0 0 255 ECU_ADDRESS 0x0000 /* @ECU_Address@rtDW_ADAS.GTDetectObj9_10_j@ */ /end MEASUREMENT
/begin MEASUREMENT rtDW_ADAS.GTDetectObj9_10_n "" UBYTE ADAS_CM_uint8 0 0 0 255 ECU_ADDRESS 0x0000 /* @ECU_Address@rtDW_ADAS.GTDetectObj9_10_n@ */ /end MEASUREMENT
/begin MEASUREMENT rtDW_ADAS.GTDifferenceInputs2 "" FLOAT32_IEEE ADAS_CM_single 0 0 -3.4E+38 3.4E+38 ECU_ADDRESS 0x0000 /* @ECU_Address@rtDW_ADAS.GTDifferenceInputs2@ */ /end MEASUREMENT
/begin MEASUREMENT rtDW_ADAS.GTDtLogLccLogicTrans "" UBYTE ADAS_CM_uint8 0 0 0 255 ECU_ADDRESS 0x0000 /* @ECU_Address@rtDW_ADAS.GTDtLogLccLogicTrans@ */ /end MEASUREMENT
/begin MEASUREMENT rtDW_ADAS.GTDtLogLccWarnReqTrans "" UBYTE ADAS_CM_uint8 0 0 0 255 ECU_ADDRESS 0x0000 /* @ECU_Address@rtDW_ADAS.GTDtLogLccWarnReqTrans@ */ /end MEASUREMENT
/begin MEASUREMENT rtDW_ADAS.GTDtLogLccWarnReqTransLeft "" UBYTE ADAS_CM_uint8 0 0 0 255 ECU_ADDRESS 0x0000 /* @ECU_Address@rtDW_ADAS.GTDtLogLccWarnReqTransLeft@ */ /end MEASUREMENT
/begin MEASUREMENT rtDW_ADAS.GTDtLogLccWarnReqTransRight "" UBYTE ADAS_CM_uint8 0 0 0 255 ECU_ADDRESS 0x0000 /* @ECU_Address@rtDW_ADAS.GTDtLogLccWarnReqTransRight@ */ /end MEASUREMENT
/begin MEASUREMENT rtDW_ADAS.GTDtLogLccWarnReqTrans_a "" UBYTE ADAS_CM_uint8 0 0 0 255 ECU_ADDRESS 0x0000 /* @ECU_Address@rtDW_ADAS.GTDtLogLccWarnReqTrans_a@ */ /end MEASUREMENT
/begin MEASUREMENT rtDW_ADAS.GTEnblAeb_FB "" UBYTE ADAS_CM_uint8 0 0 0 255 ECU_ADDRESS 0x0000 /* @ECU_Address@rtDW_ADAS.GTEnblAeb_FB@ */ /end MEASUREMENT
/begin MEASUREMENT rtDW_ADAS.GTGain1 "" FLOAT32_IEEE ADAS_CM_single 0 0 -3.4E+38 3.4E+38 ECU_ADDRESS 0x0000 /* @ECU_Address@rtDW_ADAS.GTGain1@ */ /end MEASUREMENT
/begin MEASUREMENT rtDW_ADAS.GTGain2_m "" FLOAT32_IEEE ADAS_CM_single 0 0 -3.4E+38 3.4E+38 ECU_ADDRESS 0x0000 /* @ECU_Address@rtDW_ADAS.GTGain2_m@ */ /end MEASUREMENT
/begin MEASUREMENT rtDW_ADAS.GTGain_c "" FLOAT32_IEEE ADAS_CM_single 0 0 -3.4E+38 3.4E+38 ECU_ADDRESS 0x0000 /* @ECU_Address@rtDW_ADAS.GTGain_c@ */ /end MEASUREMENT
/begin MEASUREMENT rtDW_ADAS.GTGain_k "" FLOAT32_IEEE ADAS_CM_single 0 0 -3.4E+38 3.4E+38 ECU_ADDRESS 0x0000 /* @ECU_Address@rtDW_ADAS.GTGain_k@ */ /end MEASUREMENT
/begin MEASUREMENT rtDW_ADAS.GTIntegrator_DSTATE "" FLOAT32_IEEE ADAS_CM_single 0 0 -3.4E+38 3.4E+38 ECU_ADDRESS 0x0000 /* @ECU_Address@rtDW_ADAS.GTIntegrator_DSTATE@ */ /end MEASUREMENT
/begin MEASUREMENT rtDW_ADAS.GTLccActvnMode "" UBYTE ADAS_CM_uint8 0 0 0 255 ECU_ADDRESS 0x0000 /* @ECU_Address@rtDW_ADAS.GTLccActvnMode@ */ /end MEASUREMENT
/begin MEASUREMENT rtDW_ADAS.GTLccLeftLedReq "" UBYTE ADAS_CM_uint8 0 0 0 255 ECU_ADDRESS 0x0000 /* @ECU_Address@rtDW_ADAS.GTLccLeftLedReq@ */ /end MEASUREMENT
/begin MEASUREMENT rtDW_ADAS.GTLccLeftWarnReq "" UBYTE ADAS_CM_uint8 0 0 0 255 ECU_ADDRESS 0x0000 /* @ECU_Address@rtDW_ADAS.GTLccLeftWarnReq@ */ /end MEASUREMENT
/begin MEASUREMENT rtDW_ADAS.GTLccRightLedReq "" UBYTE ADAS_CM_uint8 0 0 0 255 ECU_ADDRESS 0x0000 /* @ECU_Address@rtDW_ADAS.GTLccRightLedReq@ */ /end MEASUREMENT
/begin MEASUREMENT rtDW_ADAS.GTLccRightWarnReq "" UBYTE ADAS_CM_uint8 0 0 0 255 ECU_ADDRESS 0x0000 /* @ECU_Address@rtDW_ADAS.GTLccRightWarnReq@ */ /end MEASUREMENT
/begin MEASUREMENT rtDW_ADAS.GTLccSoundReq "" UBYTE ADAS_CM_uint8 0 0 0 255 ECU_ADDRESS 0x0000 /* @ECU_Address@rtDW_ADAS.GTLccSoundReq@ */ /end MEASUREMENT
/begin MEASUREMENT rtDW_ADAS.GTLccVibrWarnReq "" UBYTE ADAS_CM_uint8 0 0 0 255 ECU_ADDRESS 0x0000 /* @ECU_Address@rtDW_ADAS.GTLccVibrWarnReq@ */ /end MEASUREMENT
/begin MEASUREMENT rtDW_ADAS.GTLdwModeLogic "" UBYTE ADAS_CM_uint8 0 0 0 255 ECU_ADDRESS 0x0000 /* @ECU_Address@rtDW_ADAS.GTLdwModeLogic@ */ /end MEASUREMENT
/begin MEASUREMENT rtDW_ADAS.GTMemory10_PreviousInput "" UBYTE ADAS_CM_uint8 0 0 0 255 LAYOUT COLUMN_DIR MATRIX_DIM 18 ECU_ADDRESS 0x0000 /* @ECU_Address@rtDW_ADAS.GTMemory10_PreviousInput@ */ /end MEASUREMENT
/begin MEASUREMENT rtDW_ADAS.GTMemory11_PreviousInput "" UBYTE ADAS_CM_uint8 0 0 0 255 LAYOUT COLUMN_DIR MATRIX_DIM 18 ECU_ADDRESS 0x0000 /* @ECU_Address@rtDW_ADAS.GTMemory11_PreviousInput@ */ /end MEASUREMENT
/begin MEASUREMENT rtDW_ADAS.GTMemory1_PreviousInput_an "" FLOAT32_IEEE ADAS_CM_single 0 0 -3.4E+38 3.4E+38 LAYOUT COLUMN_DIR MATRIX_DIM 3 ECU_ADDRESS 0x0000 /* @ECU_Address@rtDW_ADAS.GTMemory1_PreviousInput_an@ */ /end MEASUREMENT
/begin MEASUREMENT rtDW_ADAS.GTMemory1_PreviousInput_ao "" FLOAT32_IEEE ADAS_CM_single 0 0 -3.4E+38 3.4E+38 LAYOUT COLUMN_DIR MATRIX_DIM 3 ECU_ADDRESS 0x0000 /* @ECU_Address@rtDW_ADAS.GTMemory1_PreviousInput_ao@ */ /end MEASUREMENT
/begin MEASUREMENT rtDW_ADAS.GTMemory1_PreviousInput_au "" FLOAT32_IEEE ADAS_CM_single 0 0 -3.4E+38 3.4E+38 ECU_ADDRESS 0x0000 /* @ECU_Address@rtDW_ADAS.GTMemory1_PreviousInput_au@ */ /end MEASUREMENT
/begin MEASUREMENT rtDW_ADAS.GTMemory1_PreviousInput_ax "" FLOAT32_IEEE ADAS_CM_single 0 0 -3.4E+38 3.4E+38 LAYOUT COLUMN_DIR MATRIX_DIM 3 ECU_ADDRESS 0x0000 /* @ECU_Address@rtDW_ADAS.GTMemory1_PreviousInput_ax@ */ /end MEASUREMENT
/begin MEASUREMENT rtDW_ADAS.GTMemory1_PreviousInput_b "" FLOAT32_IEEE ADAS_CM_single 0 0 -3.4E+38 3.4E+38 LAYOUT COLUMN_DIR MATRIX_DIM 3 ECU_ADDRESS 0x0000 /* @ECU_Address@rtDW_ADAS.GTMemory1_PreviousInput_b@ */ /end MEASUREMENT
/begin MEASUREMENT rtDW_ADAS.GTMemory1_PreviousInput_b0 "" UBYTE ADAS_CM_uint8 0 0 0 255 ECU_ADDRESS 0x0000 /* @ECU_Address@rtDW_ADAS.GTMemory1_PreviousInput_b0@ */ /end MEASUREMENT
/begin MEASUREMENT rtDW_ADAS.GTMemory1_PreviousInput_bn "" FLOAT32_IEEE ADAS_CM_single 0 0 -3.4E+38 3.4E+38 LAYOUT COLUMN_DIR MATRIX_DIM 3 ECU_ADDRESS 0x0000 /* @ECU_Address@rtDW_ADAS.GTMemory1_PreviousInput_bn@ */ /end MEASUREMENT
/begin MEASUREMENT rtDW_ADAS.GTMemory1_PreviousInput_cb "" FLOAT32_IEEE ADAS_CM_single 0 0 -3.4E+38 3.4E+38 LAYOUT COLUMN_DIR MATRIX_DIM 3 ECU_ADDRESS 0x0000 /* @ECU_Address@rtDW_ADAS.GTMemory1_PreviousInput_cb@ */ /end MEASUREMENT
/begin MEASUREMENT rtDW_ADAS.GTMemory1_PreviousInput_cu "" FLOAT32_IEEE ADAS_CM_single 0 0 -3.4E+38 3.4E+38 LAYOUT COLUMN_DIR MATRIX_DIM 3 ECU_ADDRESS 0x0000 /* @ECU_Address@rtDW_ADAS.GTMemory1_PreviousInput_cu@ */ /end MEASUREMENT
/begin MEASUREMENT rtDW_ADAS.GTMemory1_PreviousInput_cu1 "" FLOAT32_IEEE ADAS_CM_single 0 0 -3.4E+38 3.4E+38 LAYOUT COLUMN_DIR MATRIX_DIM 3 ECU_ADDRESS 0x0000 /* @ECU_Address@rtDW_ADAS.GTMemory1_PreviousInput_cu1@ */ /end MEASUREMENT
/begin MEASUREMENT rtDW_ADAS.GTMemory1_PreviousInput_d "" FLOAT32_IEEE ADAS_CM_single 0 0 -3.4E+38 3.4E+38 LAYOUT COLUMN_DIR MATRIX_DIM 3 ECU_ADDRESS 0x0000 /* @ECU_Address@rtDW_ADAS.GTMemory1_PreviousInput_d@ */ /end MEASUREMENT
/begin MEASUREMENT rtDW_ADAS.GTMemory1_PreviousInput_dt "" FLOAT32_IEEE ADAS_CM_single 0 0 -3.4E+38 3.4E+38 LAYOUT COLUMN_DIR MATRIX_DIM 3 ECU_ADDRESS 0x0000 /* @ECU_Address@rtDW_ADAS.GTMemory1_PreviousInput_dt@ */ /end MEASUREMENT
/begin MEASUREMENT rtDW_ADAS.GTMemory1_PreviousInput_dz "" FLOAT32_IEEE ADAS_CM_single 0 0 -3.4E+38 3.4E+38 LAYOUT COLUMN_DIR MATRIX_DIM 3 ECU_ADDRESS 0x0000 /* @ECU_Address@rtDW_ADAS.GTMemory1_PreviousInput_dz@ */ /end MEASUREMENT
/begin MEASUREMENT rtDW_ADAS.GTMemory1_PreviousInput_e "" FLOAT32_IEEE ADAS_CM_single 0 0 -3.4E+38 3.4E+38 LAYOUT COLUMN_DIR MATRIX_DIM 3 ECU_ADDRESS 0x0000 /* @ECU_Address@rtDW_ADAS.GTMemory1_PreviousInput_e@ */ /end MEASUREMENT
/begin MEASUREMENT rtDW_ADAS.GTMemory1_PreviousInput_f "" FLOAT32_IEEE ADAS_CM_single 0 0 -3.4E+38 3.4E+38 LAYOUT COLUMN_DIR MATRIX_DIM 3 ECU_ADDRESS 0x0000 /* @ECU_Address@rtDW_ADAS.GTMemory1_PreviousInput_f@ */ /end MEASUREMENT
/begin MEASUREMENT rtDW_ADAS.GTMemory1_PreviousInput_f0 "" FLOAT32_IEEE ADAS_CM_single 0 0 -3.4E+38 3.4E+38 LAYOUT COLUMN_DIR MATRIX_DIM 3 ECU_ADDRESS 0x0000 /* @ECU_Address@rtDW_ADAS.GTMemory1_PreviousInput_f0@ */ /end MEASUREMENT
/begin MEASUREMENT rtDW_ADAS.GTMemory1_PreviousInput_h "" UBYTE ADAS_CM_uint8 0 0 0 255 ECU_ADDRESS 0x0000 /* @ECU_Address@rtDW_ADAS.GTMemory1_PreviousInput_h@ */ /end MEASUREMENT
/begin MEASUREMENT rtDW_ADAS.GTMemory1_PreviousInput_i "" FLOAT32_IEEE ADAS_CM_single 0 0 -3.4E+38 3.4E+38 LAYOUT COLUMN_DIR MATRIX_DIM 3 ECU_ADDRESS 0x0000 /* @ECU_Address@rtDW_ADAS.GTMemory1_PreviousInput_i@ */ /end MEASUREMENT
/begin MEASUREMENT rtDW_ADAS.GTMemory1_PreviousInput_j "" UBYTE ADAS_CM_uint8 0 0 0 255 LAYOUT COLUMN_DIR MATRIX_DIM 18 ECU_ADDRESS 0x0000 /* @ECU_Address@rtDW_ADAS.GTMemory1_PreviousInput_j@ */ /end MEASUREMENT
/begin MEASUREMENT rtDW_ADAS.GTMemory1_PreviousInput_k "" FLOAT32_IEEE ADAS_CM_single 0 0 -3.4E+38 3.4E+38 LAYOUT COLUMN_DIR MATRIX_DIM 3 ECU_ADDRESS 0x0000 /* @ECU_Address@rtDW_ADAS.GTMemory1_PreviousInput_k@ */ /end MEASUREMENT
/begin MEASUREMENT rtDW_ADAS.GTMemory1_PreviousInput_k1 "" FLOAT32_IEEE ADAS_CM_single 0 0 -3.4E+38 3.4E+38 LAYOUT COLUMN_DIR MATRIX_DIM 3 ECU_ADDRESS 0x0000 /* @ECU_Address@rtDW_ADAS.GTMemory1_PreviousInput_k1@ */ /end MEASUREMENT
/begin MEASUREMENT rtDW_ADAS.GTMemory1_PreviousInput_ku "" FLOAT32_IEEE ADAS_CM_single 0 0 -3.4E+38 3.4E+38 LAYOUT COLUMN_DIR MATRIX_DIM 3 ECU_ADDRESS 0x0000 /* @ECU_Address@rtDW_ADAS.GTMemory1_PreviousInput_ku@ */ /end MEASUREMENT
/begin MEASUREMENT rtDW_ADAS.GTMemory1_PreviousInput_l "" UBYTE ADAS_CM_uint8 0 0 0 255 LAYOUT COLUMN_DIR MATRIX_DIM 18 ECU_ADDRESS 0x0000 /* @ECU_Address@rtDW_ADAS.GTMemory1_PreviousInput_l@ */ /end MEASUREMENT
/begin MEASUREMENT rtDW_ADAS.GTMemory2_PreviousInput "" FLOAT32_IEEE ADAS_CM_single 0 0 -3.4E+38 3.4E+38 ECU_ADDRESS 0x0000 /* @ECU_Address@rtDW_ADAS.GTMemory2_PreviousInput@ */ /end MEASUREMENT
/begin MEASUREMENT rtDW_ADAS.GTMemory2_PreviousInput_c0 "" UBYTE ADAS_CM_uint8 0 0 0 255 ECU_ADDRESS 0x0000 /* @ECU_Address@rtDW_ADAS.GTMemory2_PreviousInput_c0@ */ /end MEASUREMENT
/begin MEASUREMENT rtDW_ADAS.GTMemory2_PreviousInput_cn "" UBYTE ADAS_CM_uint8 0 0 0 255 ECU_ADDRESS 0x0000 /* @ECU_Address@rtDW_ADAS.GTMemory2_PreviousInput_cn@ */ /end MEASUREMENT
/begin MEASUREMENT rtDW_ADAS.GTMemory2_PreviousInput_cq "" UBYTE ADAS_CM_uint8 0 0 0 255 LAYOUT COLUMN_DIR MATRIX_DIM 18 ECU_ADDRESS 0x0000 /* @ECU_Address@rtDW_ADAS.GTMemory2_PreviousInput_cq@ */ /end MEASUREMENT
/begin MEASUREMENT rtDW_ADAS.GTMemory2_PreviousInput_en "" UBYTE ADAS_CM_uint8 0 0 0 255 LAYOUT COLUMN_DIR MATRIX_DIM 18 ECU_ADDRESS 0x0000 /* @ECU_Address@rtDW_ADAS.GTMemory2_PreviousInput_en@ */ /end MEASUREMENT
/begin MEASUREMENT rtDW_ADAS.GTMemory2_PreviousInput_mi "" UBYTE ADAS_CM_uint8 0 0 0 255 ECU_ADDRESS 0x0000 /* @ECU_Address@rtDW_ADAS.GTMemory2_PreviousInput_mi@ */ /end MEASUREMENT
/begin MEASUREMENT rtDW_ADAS.GTMemory2_PreviousInput_ni "" UBYTE ADAS_CM_uint8 0 0 0 255 ECU_ADDRESS 0x0000 /* @ECU_Address@rtDW_ADAS.GTMemory2_PreviousInput_ni@ */ /end MEASUREMENT
/begin MEASUREMENT rtDW_ADAS.GTMemory3_PreviousInput "" FLOAT32_IEEE ADAS_CM_single 0 0 -3.4E+38 3.4E+38 ECU_ADDRESS 0x0000 /* @ECU_Address@rtDW_ADAS.GTMemory3_PreviousInput@ */ /end MEASUREMENT
/begin MEASUREMENT rtDW_ADAS.GTMemory3_PreviousInput_a "" FLOAT32_IEEE ADAS_CM_single 0 0 -3.4E+38 3.4E+38 ECU_ADDRESS 0x0000 /* @ECU_Address@rtDW_ADAS.GTMemory3_PreviousInput_a@ */ /end MEASUREMENT
/begin MEASUREMENT rtDW_ADAS.GTMemory3_PreviousInput_av "" FLOAT32_IEEE ADAS_CM_single 0 0 -3.4E+38 3.4E+38 ECU_ADDRESS 0x0000 /* @ECU_Address@rtDW_ADAS.GTMemory3_PreviousInput_av@ */ /end MEASUREMENT
/begin MEASUREMENT rtDW_ADAS.GTMemory3_PreviousInput_b "" FLOAT32_IEEE ADAS_CM_single 0 0 -3.4E+38 3.4E+38 ECU_ADDRESS 0x0000 /* @ECU_Address@rtDW_ADAS.GTMemory3_PreviousInput_b@ */ /end MEASUREMENT
/begin MEASUREMENT rtDW_ADAS.GTMemory3_PreviousInput_d "" FLOAT32_IEEE ADAS_CM_single 0 0 -3.4E+38 3.4E+38 ECU_ADDRESS 0x0000 /* @ECU_Address@rtDW_ADAS.GTMemory3_PreviousInput_d@ */ /end MEASUREMENT
/begin MEASUREMENT rtDW_ADAS.GTMemory3_PreviousInput_dl "" FLOAT32_IEEE ADAS_CM_single 0 0 -3.4E+38 3.4E+38 ECU_ADDRESS 0x0000 /* @ECU_Address@rtDW_ADAS.GTMemory3_PreviousInput_dl@ */ /end MEASUREMENT
/begin MEASUREMENT rtDW_ADAS.GTMemory3_PreviousInput_f "" FLOAT32_IEEE ADAS_CM_single 0 0 -3.4E+38 3.4E+38 ECU_ADDRESS 0x0000 /* @ECU_Address@rtDW_ADAS.GTMemory3_PreviousInput_f@ */ /end MEASUREMENT
/begin MEASUREMENT rtDW_ADAS.GTMemory3_PreviousInput_g "" FLOAT32_IEEE ADAS_CM_single 0 0 -3.4E+38 3.4E+38 ECU_ADDRESS 0x0000 /* @ECU_Address@rtDW_ADAS.GTMemory3_PreviousInput_g@ */ /end MEASUREMENT
/begin MEASUREMENT rtDW_ADAS.GTMemory3_PreviousInput_gl "" UBYTE ADAS_CM_uint8 0 0 0 255 ECU_ADDRESS 0x0000 /* @ECU_Address@rtDW_ADAS.GTMemory3_PreviousInput_gl@ */ /end MEASUREMENT
/begin MEASUREMENT rtDW_ADAS.GTMemory3_PreviousInput_h "" FLOAT32_IEEE ADAS_CM_single 0 0 -3.4E+38 3.4E+38 ECU_ADDRESS 0x0000 /* @ECU_Address@rtDW_ADAS.GTMemory3_PreviousInput_h@ */ /end MEASUREMENT
/begin MEASUREMENT rtDW_ADAS.GTMemory3_PreviousInput_hx "" FLOAT32_IEEE ADAS_CM_single 0 0 -3.4E+38 3.4E+38 ECU_ADDRESS 0x0000 /* @ECU_Address@rtDW_ADAS.GTMemory3_PreviousInput_hx@ */ /end MEASUREMENT
/begin MEASUREMENT rtDW_ADAS.GTMemory3_PreviousInput_j "" FLOAT32_IEEE ADAS_CM_single 0 0 -3.4E+38 3.4E+38 ECU_ADDRESS 0x0000 /* @ECU_Address@rtDW_ADAS.GTMemory3_PreviousInput_j@ */ /end MEASUREMENT
/begin MEASUREMENT rtDW_ADAS.GTMemory3_PreviousInput_jz "" FLOAT32_IEEE ADAS_CM_single 0 0 -3.4E+38 3.4E+38 ECU_ADDRESS 0x0000 /* @ECU_Address@rtDW_ADAS.GTMemory3_PreviousInput_jz@ */ /end MEASUREMENT
/begin MEASUREMENT rtDW_ADAS.GTMemory3_PreviousInput_l "" FLOAT32_IEEE ADAS_CM_single 0 0 -3.4E+38 3.4E+38 ECU_ADDRESS 0x0000 /* @ECU_Address@rtDW_ADAS.GTMemory3_PreviousInput_l@ */ /end MEASUREMENT
/begin MEASUREMENT rtDW_ADAS.GTMemory3_PreviousInput_l1 "" FLOAT32_IEEE ADAS_CM_single 0 0 -3.4E+38 3.4E+38 ECU_ADDRESS 0x0000 /* @ECU_Address@rtDW_ADAS.GTMemory3_PreviousInput_l1@ */ /end MEASUREMENT
/begin MEASUREMENT rtDW_ADAS.GTMemory3_PreviousInput_m "" UBYTE ADAS_CM_uint8 0 0 0 255 LAYOUT COLUMN_DIR MATRIX_DIM 18 ECU_ADDRESS 0x0000 /* @ECU_Address@rtDW_ADAS.GTMemory3_PreviousInput_m@ */ /end MEASUREMENT
/begin MEASUREMENT rtDW_ADAS.GTMemory3_PreviousInput_n "" FLOAT32_IEEE ADAS_CM_single 0 0 -3.4E+38 3.4E+38 ECU_ADDRESS 0x0000 /* @ECU_Address@rtDW_ADAS.GTMemory3_PreviousInput_n@ */ /end MEASUREMENT
/begin MEASUREMENT rtDW_ADAS.GTMemory3_PreviousInput_nf "" FLOAT32_IEEE ADAS_CM_single 0 0 -3.4E+38 3.4E+38 ECU_ADDRESS 0x0000 /* @ECU_Address@rtDW_ADAS.GTMemory3_PreviousInput_nf@ */ /end MEASUREMENT
/begin MEASUREMENT rtDW_ADAS.GTMemory3_PreviousInput_o "" FLOAT32_IEEE ADAS_CM_single 0 0 -3.4E+38 3.4E+38 ECU_ADDRESS 0x0000 /* @ECU_Address@rtDW_ADAS.GTMemory3_PreviousInput_o@ */ /end MEASUREMENT
/begin MEASUREMENT rtDW_ADAS.GTMemory3_PreviousInput_o5 "" FLOAT32_IEEE ADAS_CM_single 0 0 -3.4E+38 3.4E+38 ECU_ADDRESS 0x0000 /* @ECU_Address@rtDW_ADAS.GTMemory3_PreviousInput_o5@ */ /end MEASUREMENT
/begin MEASUREMENT rtDW_ADAS.GTMemory3_PreviousInput_o5z "" UBYTE ADAS_CM_uint8 0 0 0 255 LAYOUT COLUMN_DIR MATRIX_DIM 18 ECU_ADDRESS 0x0000 /* @ECU_Address@rtDW_ADAS.GTMemory3_PreviousInput_o5z@ */ /end MEASUREMENT
/begin MEASUREMENT rtDW_ADAS.GTMemory3_PreviousInput_on "" FLOAT32_IEEE ADAS_CM_single 0 0 -3.4E+38 3.4E+38 ECU_ADDRESS 0x0000 /* @ECU_Address@rtDW_ADAS.GTMemory3_PreviousInput_on@ */ /end MEASUREMENT
/begin MEASUREMENT rtDW_ADAS.GTMemory4_PreviousInput "" FLOAT32_IEEE ADAS_CM_single 0 0 -3.4E+38 3.4E+38 ECU_ADDRESS 0x0000 /* @ECU_Address@rtDW_ADAS.GTMemory4_PreviousInput@ */ /end MEASUREMENT
/begin MEASUREMENT rtDW_ADAS.GTMemory4_PreviousInput_a "" FLOAT32_IEEE ADAS_CM_single 0 0 -3.4E+38 3.4E+38 ECU_ADDRESS 0x0000 /* @ECU_Address@rtDW_ADAS.GTMemory4_PreviousInput_a@ */ /end MEASUREMENT
/begin MEASUREMENT rtDW_ADAS.GTMemory4_PreviousInput_aa "" FLOAT32_IEEE ADAS_CM_single 0 0 -3.4E+38 3.4E+38 ECU_ADDRESS 0x0000 /* @ECU_Address@rtDW_ADAS.GTMemory4_PreviousInput_aa@ */ /end MEASUREMENT
/begin MEASUREMENT rtDW_ADAS.GTMemory4_PreviousInput_aas "" FLOAT32_IEEE ADAS_CM_single 0 0 -3.4E+38 3.4E+38 ECU_ADDRESS 0x0000 /* @ECU_Address@rtDW_ADAS.GTMemory4_PreviousInput_aas@ */ /end MEASUREMENT
/begin MEASUREMENT rtDW_ADAS.GTMemory4_PreviousInput_af "" FLOAT32_IEEE ADAS_CM_single 0 0 -3.4E+38 3.4E+38 ECU_ADDRESS 0x0000 /* @ECU_Address@rtDW_ADAS.GTMemory4_PreviousInput_af@ */ /end MEASUREMENT
/begin MEASUREMENT rtDW_ADAS.GTMemory4_PreviousInput_ag "" FLOAT32_IEEE ADAS_CM_single 0 0 -3.4E+38 3.4E+38 ECU_ADDRESS 0x0000 /* @ECU_Address@rtDW_ADAS.GTMemory4_PreviousInput_ag@ */ /end MEASUREMENT
/begin MEASUREMENT rtDW_ADAS.GTMemory4_PreviousInput_b "" FLOAT32_IEEE ADAS_CM_single 0 0 -3.4E+38 3.4E+38 ECU_ADDRESS 0x0000 /* @ECU_Address@rtDW_ADAS.GTMemory4_PreviousInput_b@ */ /end MEASUREMENT
/begin MEASUREMENT rtDW_ADAS.GTMemory4_PreviousInput_c "" FLOAT32_IEEE ADAS_CM_single 0 0 -3.4E+38 3.4E+38 ECU_ADDRESS 0x0000 /* @ECU_Address@rtDW_ADAS.GTMemory4_PreviousInput_c@ */ /end MEASUREMENT
/begin MEASUREMENT rtDW_ADAS.GTMemory4_PreviousInput_d "" FLOAT32_IEEE ADAS_CM_single 0 0 -3.4E+38 3.4E+38 ECU_ADDRESS 0x0000 /* @ECU_Address@rtDW_ADAS.GTMemory4_PreviousInput_d@ */ /end MEASUREMENT
/begin MEASUREMENT rtDW_ADAS.GTMemory4_PreviousInput_e "" FLOAT32_IEEE ADAS_CM_single 0 0 -3.4E+38 3.4E+38 ECU_ADDRESS 0x0000 /* @ECU_Address@rtDW_ADAS.GTMemory4_PreviousInput_e@ */ /end MEASUREMENT
/begin MEASUREMENT rtDW_ADAS.GTMemory4_PreviousInput_i "" FLOAT32_IEEE ADAS_CM_single 0 0 -3.4E+38 3.4E+38 ECU_ADDRESS 0x0000 /* @ECU_Address@rtDW_ADAS.GTMemory4_PreviousInput_i@ */ /end MEASUREMENT
/begin MEASUREMENT rtDW_ADAS.GTMemory4_PreviousInput_ic "" FLOAT32_IEEE ADAS_CM_single 0 0 -3.4E+38 3.4E+38 ECU_ADDRESS 0x0000 /* @ECU_Address@rtDW_ADAS.GTMemory4_PreviousInput_ic@ */ /end MEASUREMENT
/begin MEASUREMENT rtDW_ADAS.GTMemory4_PreviousInput_in "" FLOAT32_IEEE ADAS_CM_single 0 0 -3.4E+38 3.4E+38 ECU_ADDRESS 0x0000 /* @ECU_Address@rtDW_ADAS.GTMemory4_PreviousInput_in@ */ /end MEASUREMENT
/begin MEASUREMENT rtDW_ADAS.GTMemory4_PreviousInput_ix "" FLOAT32_IEEE ADAS_CM_single 0 0 -3.4E+38 3.4E+38 ECU_ADDRESS 0x0000 /* @ECU_Address@rtDW_ADAS.GTMemory4_PreviousInput_ix@ */ /end MEASUREMENT
/begin MEASUREMENT rtDW_ADAS.GTMemory4_PreviousInput_jh "" UBYTE ADAS_CM_uint8 0 0 0 255 LAYOUT COLUMN_DIR MATRIX_DIM 18 ECU_ADDRESS 0x0000 /* @ECU_Address@rtDW_ADAS.GTMemory4_PreviousInput_jh@ */ /end MEASUREMENT
/begin MEASUREMENT rtDW_ADAS.GTMemory4_PreviousInput_k "" FLOAT32_IEEE ADAS_CM_single 0 0 -3.4E+38 3.4E+38 ECU_ADDRESS 0x0000 /* @ECU_Address@rtDW_ADAS.GTMemory4_PreviousInput_k@ */ /end MEASUREMENT
/begin MEASUREMENT rtDW_ADAS.GTMemory4_PreviousInput_l "" FLOAT32_IEEE ADAS_CM_single 0 0 -3.4E+38 3.4E+38 ECU_ADDRESS 0x0000 /* @ECU_Address@rtDW_ADAS.GTMemory4_PreviousInput_l@ */ /end MEASUREMENT
/begin MEASUREMENT rtDW_ADAS.GTMemory4_PreviousInput_o "" FLOAT32_IEEE ADAS_CM_single 0 0 -3.4E+38 3.4E+38 ECU_ADDRESS 0x0000 /* @ECU_Address@rtDW_ADAS.GTMemory4_PreviousInput_o@ */ /end MEASUREMENT
/begin MEASUREMENT rtDW_ADAS.GTMemory4_PreviousInput_p "" FLOAT32_IEEE ADAS_CM_single 0 0 -3.4E+38 3.4E+38 ECU_ADDRESS 0x0000 /* @ECU_Address@rtDW_ADAS.GTMemory4_PreviousInput_p@ */ /end MEASUREMENT
/begin MEASUREMENT rtDW_ADAS.GTMemory5_PreviousInput "" FLOAT32_IEEE ADAS_CM_single 0 0 -3.4E+38 3.4E+38 ECU_ADDRESS 0x0000 /* @ECU_Address@rtDW_ADAS.GTMemory5_PreviousInput@ */ /end MEASUREMENT
/begin MEASUREMENT rtDW_ADAS.GTMemory5_PreviousInput_b "" UBYTE ADAS_CM_uint8 0 0 0 255 ECU_ADDRESS 0x0000 /* @ECU_Address@rtDW_ADAS.GTMemory5_PreviousInput_b@ */ /end MEASUREMENT
/begin MEASUREMENT rtDW_ADAS.GTMemory5_PreviousInput_c "" FLOAT32_IEEE ADAS_CM_single 0 0 -3.4E+38 3.4E+38 ECU_ADDRESS 0x0000 /* @ECU_Address@rtDW_ADAS.GTMemory5_PreviousInput_c@ */ /end MEASUREMENT
/begin MEASUREMENT rtDW_ADAS.GTMemory5_PreviousInput_c0 "" FLOAT32_IEEE ADAS_CM_single 0 0 -3.4E+38 3.4E+38 ECU_ADDRESS 0x0000 /* @ECU_Address@rtDW_ADAS.GTMemory5_PreviousInput_c0@ */ /end MEASUREMENT
/begin MEASUREMENT rtDW_ADAS.GTMemory5_PreviousInput_c1 "" FLOAT32_IEEE ADAS_CM_single 0 0 -3.4E+38 3.4E+38 ECU_ADDRESS 0x0000 /* @ECU_Address@rtDW_ADAS.GTMemory5_PreviousInput_c1@ */ /end MEASUREMENT
/begin MEASUREMENT rtDW_ADAS.GTMemory5_PreviousInput_cu "" FLOAT32_IEEE ADAS_CM_single 0 0 -3.4E+38 3.4E+38 ECU_ADDRESS 0x0000 /* @ECU_Address@rtDW_ADAS.GTMemory5_PreviousInput_cu@ */ /end MEASUREMENT
/begin MEASUREMENT rtDW_ADAS.GTMemory5_PreviousInput_cy "" FLOAT32_IEEE ADAS_CM_single 0 0 -3.4E+38 3.4E+38 ECU_ADDRESS 0x0000 /* @ECU_Address@rtDW_ADAS.GTMemory5_PreviousInput_cy@ */ /end MEASUREMENT
/begin MEASUREMENT rtDW_ADAS.GTMemory5_PreviousInput_d "" FLOAT32_IEEE ADAS_CM_single 0 0 -3.4E+38 3.4E+38 ECU_ADDRESS 0x0000 /* @ECU_Address@rtDW_ADAS.GTMemory5_PreviousInput_d@ */ /end MEASUREMENT
/begin MEASUREMENT rtDW_ADAS.GTMemory5_PreviousInput_e "" FLOAT32_IEEE ADAS_CM_single 0 0 -3.4E+38 3.4E+38 ECU_ADDRESS 0x0000 /* @ECU_Address@rtDW_ADAS.GTMemory5_PreviousInput_e@ */ /end MEASUREMENT
/begin MEASUREMENT rtDW_ADAS.GTMemory5_PreviousInput_f "" FLOAT32_IEEE ADAS_CM_single 0 0 -3.4E+38 3.4E+38 ECU_ADDRESS 0x0000 /* @ECU_Address@rtDW_ADAS.GTMemory5_PreviousInput_f@ */ /end MEASUREMENT
/begin MEASUREMENT rtDW_ADAS.GTMemory5_PreviousInput_g "" FLOAT32_IEEE ADAS_CM_single 0 0 -3.4E+38 3.4E+38 ECU_ADDRESS 0x0000 /* @ECU_Address@rtDW_ADAS.GTMemory5_PreviousInput_g@ */ /end MEASUREMENT
/begin MEASUREMENT rtDW_ADAS.GTMemory5_PreviousInput_k "" FLOAT32_IEEE ADAS_CM_single 0 0 -3.4E+38 3.4E+38 ECU_ADDRESS 0x0000 /* @ECU_Address@rtDW_ADAS.GTMemory5_PreviousInput_k@ */ /end MEASUREMENT
/begin MEASUREMENT rtDW_ADAS.GTMemory5_PreviousInput_km "" FLOAT32_IEEE ADAS_CM_single 0 0 -3.4E+38 3.4E+38 ECU_ADDRESS 0x0000 /* @ECU_Address@rtDW_ADAS.GTMemory5_PreviousInput_km@ */ /end MEASUREMENT
/begin MEASUREMENT rtDW_ADAS.GTMemory5_PreviousInput_n "" FLOAT32_IEEE ADAS_CM_single 0 0 -3.4E+38 3.4E+38 ECU_ADDRESS 0x0000 /* @ECU_Address@rtDW_ADAS.GTMemory5_PreviousInput_n@ */ /end MEASUREMENT
/begin MEASUREMENT rtDW_ADAS.GTMemory5_PreviousInput_n3 "" UBYTE ADAS_CM_uint8 0 0 0 255 LAYOUT COLUMN_DIR MATRIX_DIM 18 ECU_ADDRESS 0x0000 /* @ECU_Address@rtDW_ADAS.GTMemory5_PreviousInput_n3@ */ /end MEASUREMENT
/begin MEASUREMENT rtDW_ADAS.GTMemory5_PreviousInput_o "" FLOAT32_IEEE ADAS_CM_single 0 0 -3.4E+38 3.4E+38 ECU_ADDRESS 0x0000 /* @ECU_Address@rtDW_ADAS.GTMemory5_PreviousInput_o@ */ /end MEASUREMENT
/begin MEASUREMENT rtDW_ADAS.GTMemory5_PreviousInput_oh "" FLOAT32_IEEE ADAS_CM_single 0 0 -3.4E+38 3.4E+38 ECU_ADDRESS 0x0000 /* @ECU_Address@rtDW_ADAS.GTMemory5_PreviousInput_oh@ */ /end MEASUREMENT
/begin MEASUREMENT rtDW_ADAS.GTMemory5_PreviousInput_p "" FLOAT32_IEEE ADAS_CM_single 0 0 -3.4E+38 3.4E+38 ECU_ADDRESS 0x0000 /* @ECU_Address@rtDW_ADAS.GTMemory5_PreviousInput_p@ */ /end MEASUREMENT
/begin MEASUREMENT rtDW_ADAS.GTMemory5_PreviousInput_pa "" FLOAT32_IEEE ADAS_CM_single 0 0 -3.4E+38 3.4E+38 ECU_ADDRESS 0x0000 /* @ECU_Address@rtDW_ADAS.GTMemory5_PreviousInput_pa@ */ /end MEASUREMENT
/begin MEASUREMENT rtDW_ADAS.GTMemory5_PreviousInput_ps "" FLOAT32_IEEE ADAS_CM_single 0 0 -3.4E+38 3.4E+38 ECU_ADDRESS 0x0000 /* @ECU_Address@rtDW_ADAS.GTMemory5_PreviousInput_ps@ */ /end MEASUREMENT
/begin MEASUREMENT rtDW_ADAS.GTMemory6_PreviousInput "" FLOAT32_IEEE ADAS_CM_single 0 0 -3.4E+38 3.4E+38 LAYOUT COLUMN_DIR MATRIX_DIM 100 ECU_ADDRESS 0x0000 /* @ECU_Address@rtDW_ADAS.GTMemory6_PreviousInput@ */ /end MEASUREMENT
/begin MEASUREMENT rtDW_ADAS.GTMemory6_PreviousInput_b "" UBYTE ADAS_CM_uint8 0 0 0 255 ECU_ADDRESS 0x0000 /* @ECU_Address@rtDW_ADAS.GTMemory6_PreviousInput_b@ */ /end MEASUREMENT
/begin MEASUREMENT rtDW_ADAS.GTMemory6_PreviousInput_c "" UBYTE ADAS_CM_uint8 0 0 0 255 ECU_ADDRESS 0x0000 /* @ECU_Address@rtDW_ADAS.GTMemory6_PreviousInput_c@ */ /end MEASUREMENT
/begin MEASUREMENT rtDW_ADAS.GTMemory6_PreviousInput_f "" UBYTE ADAS_CM_uint8 0 0 0 255 ECU_ADDRESS 0x0000 /* @ECU_Address@rtDW_ADAS.GTMemory6_PreviousInput_f@ */ /end MEASUREMENT
/begin MEASUREMENT rtDW_ADAS.GTMemory6_PreviousInput_h "" UBYTE ADAS_CM_uint8 0 0 0 255 ECU_ADDRESS 0x0000 /* @ECU_Address@rtDW_ADAS.GTMemory6_PreviousInput_h@ */ /end MEASUREMENT
/begin MEASUREMENT rtDW_ADAS.GTMemory6_PreviousInput_hs "" UBYTE ADAS_CM_uint8 0 0 0 255 ECU_ADDRESS 0x0000 /* @ECU_Address@rtDW_ADAS.GTMemory6_PreviousInput_hs@ */ /end MEASUREMENT
/begin MEASUREMENT rtDW_ADAS.GTMemory6_PreviousInput_hy "" UBYTE ADAS_CM_uint8 0 0 0 255 ECU_ADDRESS 0x0000 /* @ECU_Address@rtDW_ADAS.GTMemory6_PreviousInput_hy@ */ /end MEASUREMENT
/begin MEASUREMENT rtDW_ADAS.GTMemory6_PreviousInput_hz "" UBYTE ADAS_CM_uint8 0 0 0 255 ECU_ADDRESS 0x0000 /* @ECU_Address@rtDW_ADAS.GTMemory6_PreviousInput_hz@ */ /end MEASUREMENT
/begin MEASUREMENT rtDW_ADAS.GTMemory6_PreviousInput_j "" UBYTE ADAS_CM_uint8 0 0 0 255 ECU_ADDRESS 0x0000 /* @ECU_Address@rtDW_ADAS.GTMemory6_PreviousInput_j@ */ /end MEASUREMENT
/begin MEASUREMENT rtDW_ADAS.GTMemory6_PreviousInput_jd "" UBYTE ADAS_CM_uint8 0 0 0 255 ECU_ADDRESS 0x0000 /* @ECU_Address@rtDW_ADAS.GTMemory6_PreviousInput_jd@ */ /end MEASUREMENT
/begin MEASUREMENT rtDW_ADAS.GTMemory6_PreviousInput_ju "" UBYTE ADAS_CM_uint8 0 0 0 255 ECU_ADDRESS 0x0000 /* @ECU_Address@rtDW_ADAS.GTMemory6_PreviousInput_ju@ */ /end MEASUREMENT
/begin MEASUREMENT rtDW_ADAS.GTMemory6_PreviousInput_jw "" UBYTE ADAS_CM_uint8 0 0 0 255 ECU_ADDRESS 0x0000 /* @ECU_Address@rtDW_ADAS.GTMemory6_PreviousInput_jw@ */ /end MEASUREMENT
/begin MEASUREMENT rtDW_ADAS.GTMemory6_PreviousInput_jz "" UBYTE ADAS_CM_uint8 0 0 0 255 ECU_ADDRESS 0x0000 /* @ECU_Address@rtDW_ADAS.GTMemory6_PreviousInput_jz@ */ /end MEASUREMENT
/begin MEASUREMENT rtDW_ADAS.GTMemory6_PreviousInput_l "" UBYTE ADAS_CM_uint8 0 0 0 255 LAYOUT COLUMN_DIR MATRIX_DIM 18 ECU_ADDRESS 0x0000 /* @ECU_Address@rtDW_ADAS.GTMemory6_PreviousInput_l@ */ /end MEASUREMENT
/begin MEASUREMENT rtDW_ADAS.GTMemory6_PreviousInput_n "" UBYTE ADAS_CM_uint8 0 0 0 255 ECU_ADDRESS 0x0000 /* @ECU_Address@rtDW_ADAS.GTMemory6_PreviousInput_n@ */ /end MEASUREMENT
/begin MEASUREMENT rtDW_ADAS.GTMemory6_PreviousInput_o "" UBYTE ADAS_CM_uint8 0 0 0 255 ECU_ADDRESS 0x0000 /* @ECU_Address@rtDW_ADAS.GTMemory6_PreviousInput_o@ */ /end MEASUREMENT
/begin MEASUREMENT rtDW_ADAS.GTMemory6_PreviousInput_oi "" UBYTE ADAS_CM_uint8 0 0 0 255 ECU_ADDRESS 0x0000 /* @ECU_Address@rtDW_ADAS.GTMemory6_PreviousInput_oi@ */ /end MEASUREMENT
/begin MEASUREMENT rtDW_ADAS.GTMemory6_PreviousInput_os "" UBYTE ADAS_CM_uint8 0 0 0 255 ECU_ADDRESS 0x0000 /* @ECU_Address@rtDW_ADAS.GTMemory6_PreviousInput_os@ */ /end MEASUREMENT
/begin MEASUREMENT rtDW_ADAS.GTMemory6_PreviousInput_osg "" UBYTE ADAS_CM_uint8 0 0 0 255 ECU_ADDRESS 0x0000 /* @ECU_Address@rtDW_ADAS.GTMemory6_PreviousInput_osg@ */ /end MEASUREMENT
/begin MEASUREMENT rtDW_ADAS.GTMemory6_PreviousInput_p "" UBYTE ADAS_CM_uint8 0 0 0 255 ECU_ADDRESS 0x0000 /* @ECU_Address@rtDW_ADAS.GTMemory6_PreviousInput_p@ */ /end MEASUREMENT
/begin MEASUREMENT rtDW_ADAS.GTMemory7_PreviousInput "" FLOAT32_IEEE ADAS_CM_single 0 0 -3.4E+38 3.4E+38 ECU_ADDRESS 0x0000 /* @ECU_Address@rtDW_ADAS.GTMemory7_PreviousInput@ */ /end MEASUREMENT
/begin MEASUREMENT rtDW_ADAS.GTMemory7_PreviousInput_a "" UBYTE ADAS_CM_uint8 0 0 0 255 ECU_ADDRESS 0x0000 /* @ECU_Address@rtDW_ADAS.GTMemory7_PreviousInput_a@ */ /end MEASUREMENT
/begin MEASUREMENT rtDW_ADAS.GTMemory7_PreviousInput_b "" UBYTE ADAS_CM_uint8 0 0 0 255 ECU_ADDRESS 0x0000 /* @ECU_Address@rtDW_ADAS.GTMemory7_PreviousInput_b@ */ /end MEASUREMENT
/begin MEASUREMENT rtDW_ADAS.GTMemory7_PreviousInput_ba "" UBYTE ADAS_CM_uint8 0 0 0 255 ECU_ADDRESS 0x0000 /* @ECU_Address@rtDW_ADAS.GTMemory7_PreviousInput_ba@ */ /end MEASUREMENT
/begin MEASUREMENT rtDW_ADAS.GTMemory7_PreviousInput_bm "" UBYTE ADAS_CM_uint8 0 0 0 255 ECU_ADDRESS 0x0000 /* @ECU_Address@rtDW_ADAS.GTMemory7_PreviousInput_bm@ */ /end MEASUREMENT
/begin MEASUREMENT rtDW_ADAS.GTMemory7_PreviousInput_by "" UBYTE ADAS_CM_uint8 0 0 0 255 ECU_ADDRESS 0x0000 /* @ECU_Address@rtDW_ADAS.GTMemory7_PreviousInput_by@ */ /end MEASUREMENT
/begin MEASUREMENT rtDW_ADAS.GTMemory7_PreviousInput_c "" UBYTE ADAS_CM_uint8 0 0 0 255 ECU_ADDRESS 0x0000 /* @ECU_Address@rtDW_ADAS.GTMemory7_PreviousInput_c@ */ /end MEASUREMENT
/begin MEASUREMENT rtDW_ADAS.GTMemory7_PreviousInput_e "" UBYTE ADAS_CM_uint8 0 0 0 255 LAYOUT COLUMN_DIR MATRIX_DIM 18 ECU_ADDRESS 0x0000 /* @ECU_Address@rtDW_ADAS.GTMemory7_PreviousInput_e@ */ /end MEASUREMENT
/begin MEASUREMENT rtDW_ADAS.GTMemory7_PreviousInput_ez "" UBYTE ADAS_CM_uint8 0 0 0 255 ECU_ADDRESS 0x0000 /* @ECU_Address@rtDW_ADAS.GTMemory7_PreviousInput_ez@ */ /end MEASUREMENT
/begin MEASUREMENT rtDW_ADAS.GTMemory7_PreviousInput_f "" UBYTE ADAS_CM_uint8 0 0 0 255 ECU_ADDRESS 0x0000 /* @ECU_Address@rtDW_ADAS.GTMemory7_PreviousInput_f@ */ /end MEASUREMENT
/begin MEASUREMENT rtDW_ADAS.GTMemory7_PreviousInput_i "" UBYTE ADAS_CM_uint8 0 0 0 255 ECU_ADDRESS 0x0000 /* @ECU_Address@rtDW_ADAS.GTMemory7_PreviousInput_i@ */ /end MEASUREMENT
/begin MEASUREMENT rtDW_ADAS.GTMemory7_PreviousInput_ii "" UBYTE ADAS_CM_uint8 0 0 0 255 ECU_ADDRESS 0x0000 /* @ECU_Address@rtDW_ADAS.GTMemory7_PreviousInput_ii@ */ /end MEASUREMENT
/begin MEASUREMENT rtDW_ADAS.GTMemory7_PreviousInput_j "" UBYTE ADAS_CM_uint8 0 0 0 255 ECU_ADDRESS 0x0000 /* @ECU_Address@rtDW_ADAS.GTMemory7_PreviousInput_j@ */ /end MEASUREMENT
/begin MEASUREMENT rtDW_ADAS.GTMemory7_PreviousInput_j1 "" UBYTE ADAS_CM_uint8 0 0 0 255 ECU_ADDRESS 0x0000 /* @ECU_Address@rtDW_ADAS.GTMemory7_PreviousInput_j1@ */ /end MEASUREMENT
/begin MEASUREMENT rtDW_ADAS.GTMemory7_PreviousInput_je "" UBYTE ADAS_CM_uint8 0 0 0 255 ECU_ADDRESS 0x0000 /* @ECU_Address@rtDW_ADAS.GTMemory7_PreviousInput_je@ */ /end MEASUREMENT
/begin MEASUREMENT rtDW_ADAS.GTMemory7_PreviousInput_k "" UBYTE ADAS_CM_uint8 0 0 0 255 ECU_ADDRESS 0x0000 /* @ECU_Address@rtDW_ADAS.GTMemory7_PreviousInput_k@ */ /end MEASUREMENT
/begin MEASUREMENT rtDW_ADAS.GTMemory7_PreviousInput_k3 "" UBYTE ADAS_CM_uint8 0 0 0 255 ECU_ADDRESS 0x0000 /* @ECU_Address@rtDW_ADAS.GTMemory7_PreviousInput_k3@ */ /end MEASUREMENT
/begin MEASUREMENT rtDW_ADAS.GTMemory7_PreviousInput_kt "" UBYTE ADAS_CM_uint8 0 0 0 255 ECU_ADDRESS 0x0000 /* @ECU_Address@rtDW_ADAS.GTMemory7_PreviousInput_kt@ */ /end MEASUREMENT
/begin MEASUREMENT rtDW_ADAS.GTMemory7_PreviousInput_l "" UBYTE ADAS_CM_uint8 0 0 0 255 ECU_ADDRESS 0x0000 /* @ECU_Address@rtDW_ADAS.GTMemory7_PreviousInput_l@ */ /end MEASUREMENT
/begin MEASUREMENT rtDW_ADAS.GTMemory7_PreviousInput_n "" UBYTE ADAS_CM_uint8 0 0 0 255 ECU_ADDRESS 0x0000 /* @ECU_Address@rtDW_ADAS.GTMemory7_PreviousInput_n@ */ /end MEASUREMENT
/begin MEASUREMENT rtDW_ADAS.GTMemory8_PreviousInput "" FLOAT32_IEEE ADAS_CM_single 0 0 -3.4E+38 3.4E+38 ECU_ADDRESS 0x0000 /* @ECU_Address@rtDW_ADAS.GTMemory8_PreviousInput@ */ /end MEASUREMENT
/begin MEASUREMENT rtDW_ADAS.GTMemory8_PreviousInput_g "" UBYTE ADAS_CM_uint8 0 0 0 255 LAYOUT COLUMN_DIR MATRIX_DIM 18 ECU_ADDRESS 0x0000 /* @ECU_Address@rtDW_ADAS.GTMemory8_PreviousInput_g@ */ /end MEASUREMENT
/begin MEASUREMENT rtDW_ADAS.GTMemory8_PreviousInput_o "" UBYTE ADAS_CM_uint8 0 0 0 255 LAYOUT COLUMN_DIR MATRIX_DIM 18 ECU_ADDRESS 0x0000 /* @ECU_Address@rtDW_ADAS.GTMemory8_PreviousInput_o@ */ /end MEASUREMENT
/begin MEASUREMENT rtDW_ADAS.GTMemory9_PreviousInput "" FLOAT32_IEEE ADAS_CM_single 0 0 -3.4E+38 3.4E+38 LAYOUT COLUMN_DIR MATRIX_DIM 100 ECU_ADDRESS 0x0000 /* @ECU_Address@rtDW_ADAS.GTMemory9_PreviousInput@ */ /end MEASUREMENT
/begin MEASUREMENT rtDW_ADAS.GTMemory9_PreviousInput_k "" UBYTE ADAS_CM_uint8 0 0 0 255 LAYOUT COLUMN_DIR MATRIX_DIM 18 ECU_ADDRESS 0x0000 /* @ECU_Address@rtDW_ADAS.GTMemory9_PreviousInput_k@ */ /end MEASUREMENT
/begin MEASUREMENT rtDW_ADAS.GTMemory_PreviousInput_a3 "" UBYTE ADAS_CM_uint8 0 0 0 255 ECU_ADDRESS 0x0000 /* @ECU_Address@rtDW_ADAS.GTMemory_PreviousInput_a3@ */ /end MEASUREMENT
/begin MEASUREMENT rtDW_ADAS.GTMemory_PreviousInput_b "" UBYTE ADAS_CM_uint8 0 0 0 255 ECU_ADDRESS 0x0000 /* @ECU_Address@rtDW_ADAS.GTMemory_PreviousInput_b@ */ /end MEASUREMENT
/begin MEASUREMENT rtDW_ADAS.GTMemory_PreviousInput_b5 "" UBYTE ADAS_CM_uint8 0 0 0 255 ECU_ADDRESS 0x0000 /* @ECU_Address@rtDW_ADAS.GTMemory_PreviousInput_b5@ */ /end MEASUREMENT
/begin MEASUREMENT rtDW_ADAS.GTMemory_PreviousInput_c4 "" UBYTE ADAS_CM_uint8 0 0 0 255 LAYOUT COLUMN_DIR MATRIX_DIM 18 ECU_ADDRESS 0x0000 /* @ECU_Address@rtDW_ADAS.GTMemory_PreviousInput_c4@ */ /end MEASUREMENT
/begin MEASUREMENT rtDW_ADAS.GTMemory_PreviousInput_co "" UBYTE ADAS_CM_uint8 0 0 0 255 ECU_ADDRESS 0x0000 /* @ECU_Address@rtDW_ADAS.GTMemory_PreviousInput_co@ */ /end MEASUREMENT
/begin MEASUREMENT rtDW_ADAS.GTMemory_PreviousInput_d "" UBYTE ADAS_CM_uint8 0 0 0 255 ECU_ADDRESS 0x0000 /* @ECU_Address@rtDW_ADAS.GTMemory_PreviousInput_d@ */ /end MEASUREMENT
/begin MEASUREMENT rtDW_ADAS.GTMemory_PreviousInput_dy "" UBYTE ADAS_CM_uint8 0 0 0 255 ECU_ADDRESS 0x0000 /* @ECU_Address@rtDW_ADAS.GTMemory_PreviousInput_dy@ */ /end MEASUREMENT
/begin MEASUREMENT rtDW_ADAS.GTMemory_PreviousInput_e "" UBYTE ADAS_CM_uint8 0 0 0 255 ECU_ADDRESS 0x0000 /* @ECU_Address@rtDW_ADAS.GTMemory_PreviousInput_e@ */ /end MEASUREMENT
/begin MEASUREMENT rtDW_ADAS.GTMemory_PreviousInput_eh "" UBYTE ADAS_CM_uint8 0 0 0 255 ECU_ADDRESS 0x0000 /* @ECU_Address@rtDW_ADAS.GTMemory_PreviousInput_eh@ */ /end MEASUREMENT
/begin MEASUREMENT rtDW_ADAS.GTMemory_PreviousInput_es "" UBYTE ADAS_CM_uint8 0 0 0 255 ECU_ADDRESS 0x0000 /* @ECU_Address@rtDW_ADAS.GTMemory_PreviousInput_es@ */ /end MEASUREMENT
/begin MEASUREMENT rtDW_ADAS.GTMemory_PreviousInput_fe "" UBYTE ADAS_CM_uint8 0 0 0 255 ECU_ADDRESS 0x0000 /* @ECU_Address@rtDW_ADAS.GTMemory_PreviousInput_fe@ */ /end MEASUREMENT
/begin MEASUREMENT rtDW_ADAS.GTMemory_PreviousInput_fj "" UBYTE ADAS_CM_uint8 0 0 0 255 ECU_ADDRESS 0x0000 /* @ECU_Address@rtDW_ADAS.GTMemory_PreviousInput_fj@ */ /end MEASUREMENT
/begin MEASUREMENT rtDW_ADAS.GTMemory_PreviousInput_g3 "" UBYTE ADAS_CM_uint8 0 0 0 255 ECU_ADDRESS 0x0000 /* @ECU_Address@rtDW_ADAS.GTMemory_PreviousInput_g3@ */ /end MEASUREMENT
/begin MEASUREMENT rtDW_ADAS.GTMemory_PreviousInput_hu "" UBYTE ADAS_CM_uint8 0 0 0 255 ECU_ADDRESS 0x0000 /* @ECU_Address@rtDW_ADAS.GTMemory_PreviousInput_hu@ */ /end MEASUREMENT
/begin MEASUREMENT rtDW_ADAS.GTMemory_PreviousInput_i "" UBYTE ADAS_CM_uint8 0 0 0 255 ECU_ADDRESS 0x0000 /* @ECU_Address@rtDW_ADAS.GTMemory_PreviousInput_i@ */ /end MEASUREMENT
/begin MEASUREMENT rtDW_ADAS.GTMemory_PreviousInput_k "" UBYTE ADAS_CM_uint8 0 0 0 255 ECU_ADDRESS 0x0000 /* @ECU_Address@rtDW_ADAS.GTMemory_PreviousInput_k@ */ /end MEASUREMENT
/begin MEASUREMENT rtDW_ADAS.GTMemory_PreviousInput_kj "" UBYTE ADAS_CM_uint8 0 0 0 255 ECU_ADDRESS 0x0000 /* @ECU_Address@rtDW_ADAS.GTMemory_PreviousInput_kj@ */ /end MEASUREMENT
/begin MEASUREMENT rtDW_ADAS.GTMemory_PreviousInput_mg "" UBYTE ADAS_CM_uint8 0 0 0 255 ECU_ADDRESS 0x0000 /* @ECU_Address@rtDW_ADAS.GTMemory_PreviousInput_mg@ */ /end MEASUREMENT
/begin MEASUREMENT rtDW_ADAS.GTMemory_PreviousInput_n0 "" UBYTE ADAS_CM_uint8 0 0 0 255 ECU_ADDRESS 0x0000 /* @ECU_Address@rtDW_ADAS.GTMemory_PreviousInput_n0@ */ /end MEASUREMENT
/begin MEASUREMENT rtDW_ADAS.GTMemory_PreviousInput_n0x "" UBYTE ADAS_CM_uint8 0 0 0 255 ECU_ADDRESS 0x0000 /* @ECU_Address@rtDW_ADAS.GTMemory_PreviousInput_n0x@ */ /end MEASUREMENT
/begin MEASUREMENT rtDW_ADAS.GTMemory_PreviousInput_od "" UBYTE ADAS_CM_uint8 0 0 0 255 ECU_ADDRESS 0x0000 /* @ECU_Address@rtDW_ADAS.GTMemory_PreviousInput_od@ */ /end MEASUREMENT
/begin MEASUREMENT rtDW_ADAS.GTMemory_PreviousInput_oo "" UBYTE ADAS_CM_uint8 0 0 0 255 ECU_ADDRESS 0x0000 /* @ECU_Address@rtDW_ADAS.GTMemory_PreviousInput_oo@ */ /end MEASUREMENT
/begin MEASUREMENT rtDW_ADAS.GTMemory_PreviousInput_op "" UBYTE ADAS_CM_uint8 0 0 0 255 ECU_ADDRESS 0x0000 /* @ECU_Address@rtDW_ADAS.GTMemory_PreviousInput_op@ */ /end MEASUREMENT
/begin MEASUREMENT rtDW_ADAS.GTMemory_PreviousInput_p "" UBYTE ADAS_CM_uint8 0 0 0 255 ECU_ADDRESS 0x0000 /* @ECU_Address@rtDW_ADAS.GTMemory_PreviousInput_p@ */ /end MEASUREMENT
/begin MEASUREMENT rtDW_ADAS.GTMinMax "" FLOAT32_IEEE ADAS_CM_single 0 0 -3.4E+38 3.4E+38 MATRIX_DIM 1 1 ECU_ADDRESS 0x0000 /* @ECU_Address@rtDW_ADAS.GTMinMax@ */ /end MEASUREMENT
/begin MEASUREMENT rtDW_ADAS.GTMinMax_j "" FLOAT32_IEEE ADAS_CM_single 0 0 -3.4E+38 3.4E+38 MATRIX_DIM 1 1 ECU_ADDRESS 0x0000 /* @ECU_Address@rtDW_ADAS.GTMinMax_j@ */ /end MEASUREMENT
/begin MEASUREMENT rtDW_ADAS.GTMinTLC "" FLOAT32_IEEE ADAS_CM_single 0 0 -3.4E+38 3.4E+38 ECU_ADDRESS 0x0000 /* @ECU_Address@rtDW_ADAS.GTMinTLC@ */ /end MEASUREMENT
/begin MEASUREMENT rtDW_ADAS.GTMinTLC_k "" FLOAT32_IEEE ADAS_CM_single 0 0 -3.4E+38 3.4E+38 ECU_ADDRESS 0x0000 /* @ECU_Address@rtDW_ADAS.GTMinTLC_k@ */ /end MEASUREMENT
/begin MEASUREMENT rtDW_ADAS.GTNumOfWarn "" FLOAT32_IEEE ADAS_CM_single 0 0 -3.4E+38 3.4E+38 ECU_ADDRESS 0x0000 /* @ECU_Address@rtDW_ADAS.GTNumOfWarn@ */ /end MEASUREMENT
/begin MEASUREMENT rtDW_ADAS.GTOutportBufferForWarnBlockSt_e "" UBYTE ADAS_CM_uint8 0 0 0 255 ECU_ADDRESS 0x0000 /* @ECU_Address@rtDW_ADAS.GTOutportBufferForWarnBlockSt_e@ */ /end MEASUREMENT
/begin MEASUREMENT rtDW_ADAS.GTOutportBufferForWarnBlockSts "" UBYTE ADAS_CM_uint8 0 0 0 255 ECU_ADDRESS 0x0000 /* @ECU_Address@rtDW_ADAS.GTOutportBufferForWarnBlockSts@ */ /end MEASUREMENT
/begin MEASUREMENT rtDW_ADAS.GTOutportBufferForWarnReq "" UBYTE ADAS_CM_uint8 0 0 0 255 ECU_ADDRESS 0x0000 /* @ECU_Address@rtDW_ADAS.GTOutportBufferForWarnReq@ */ /end MEASUREMENT
/begin MEASUREMENT rtDW_ADAS.GTOutportBufferForWarnReq_f "" UBYTE ADAS_CM_uint8 0 0 0 255 ECU_ADDRESS 0x0000 /* @ECU_Address@rtDW_ADAS.GTOutportBufferForWarnReq_f@ */ /end MEASUREMENT
/begin MEASUREMENT rtDW_ADAS.GTR "" FLOAT32_IEEE ADAS_CM_single 0 0 -3.4E+38 3.4E+38 ECU_ADDRESS 0x0000 /* @ECU_Address@rtDW_ADAS.GTR@ */ /end MEASUREMENT
/begin MEASUREMENT rtDW_ADAS.GTRateLimiter "" FLOAT32_IEEE ADAS_CM_single 0 0 -3.4E+38 3.4E+38 ECU_ADDRESS 0x0000 /* @ECU_Address@rtDW_ADAS.GTRateLimiter@ */ /end MEASUREMENT
/begin MEASUREMENT rtDW_ADAS.GTRateLimiter_i "" FLOAT32_IEEE ADAS_CM_single 0 0 -3.4E+38 3.4E+38 ECU_ADDRESS 0x0000 /* @ECU_Address@rtDW_ADAS.GTRateLimiter_i@ */ /end MEASUREMENT
/begin MEASUREMENT rtDW_ADAS.GTSwitch1_o "" FLOAT32_IEEE ADAS_CM_single 0 0 -3.4E+38 3.4E+38 ECU_ADDRESS 0x0000 /* @ECU_Address@rtDW_ADAS.GTSwitch1_o@ */ /end MEASUREMENT
/begin MEASUREMENT rtDW_ADAS.GTSwitch2 "" FLOAT32_IEEE ADAS_CM_single 0 0 -3.4E+38 3.4E+38 ECU_ADDRESS 0x0000 /* @ECU_Address@rtDW_ADAS.GTSwitch2@ */ /end MEASUREMENT
/begin MEASUREMENT rtDW_ADAS.GTSwitch_g "" UBYTE ADAS_CM_uint8 0 0 0 255 ECU_ADDRESS 0x0000 /* @ECU_Address@rtDW_ADAS.GTSwitch_g@ */ /end MEASUREMENT
/begin MEASUREMENT rtDW_ADAS.GTSwitch_m "" FLOAT32_IEEE ADAS_CM_single 0 0 -3.4E+38 3.4E+38 ECU_ADDRESS 0x0000 /* @ECU_Address@rtDW_ADAS.GTSwitch_m@ */ /end MEASUREMENT
/begin MEASUREMENT rtDW_ADAS.GTTiFS "" FLOAT32_IEEE ADAS_CM_single 0 0 -3.4E+38 3.4E+38 ECU_ADDRESS 0x0000 /* @ECU_Address@rtDW_ADAS.GTTiFS@ */ /end MEASUREMENT
/begin MEASUREMENT rtDW_ADAS.GTTiFSref "" FLOAT32_IEEE ADAS_CM_single 0 0 -3.4E+38 3.4E+38 ECU_ADDRESS 0x0000 /* @ECU_Address@rtDW_ADAS.GTTiFSref@ */ /end MEASUREMENT
/begin MEASUREMENT rtDW_ADAS.GTTimeTotal_a "" FLOAT32_IEEE ADAS_CM_single 0 0 -3.4E+38 3.4E+38 ECU_ADDRESS 0x0000 /* @ECU_Address@rtDW_ADAS.GTTimeTotal_a@ */ /end MEASUREMENT
/begin MEASUREMENT rtDW_ADAS.GTTimeTotal_p "" FLOAT32_IEEE ADAS_CM_single 0 0 -3.4E+38 3.4E+38 ECU_ADDRESS 0x0000 /* @ECU_Address@rtDW_ADAS.GTTimeTotal_p@ */ /end MEASUREMENT
/begin MEASUREMENT rtDW_ADAS.GTTmpBufferAtConstantOutport1 "" FLOAT32_IEEE ADAS_CM_single 0 0 -3.4E+38 3.4E+38 ECU_ADDRESS 0x0000 /* @ECU_Address@rtDW_ADAS.GTTmpBufferAtConstantOutport1@ */ /end MEASUREMENT
/begin MEASUREMENT rtDW_ADAS.GTTmpBufferAtConstantOutport1_h "" FLOAT32_IEEE ADAS_CM_single 0 0 -3.4E+38 3.4E+38 ECU_ADDRESS 0x0000 /* @ECU_Address@rtDW_ADAS.GTTmpBufferAtConstantOutport1_h@ */ /end MEASUREMENT
/begin MEASUREMENT rtDW_ADAS.GTTransLdwMode "" UBYTE ADAS_CM_uint8 0 0 0 255 ECU_ADDRESS 0x0000 /* @ECU_Address@rtDW_ADAS.GTTransLdwMode@ */ /end MEASUREMENT
/begin MEASUREMENT rtDW_ADAS.GTTransMliaMode "" UBYTE ADAS_CM_uint8 0 0 0 255 ECU_ADDRESS 0x0000 /* @ECU_Address@rtDW_ADAS.GTTransMliaMode@ */ /end MEASUREMENT
/begin MEASUREMENT rtDW_ADAS.GTTransTTLC_o "" UBYTE ADAS_CM_uint8 0 0 0 255 ECU_ADDRESS 0x0000 /* @ECU_Address@rtDW_ADAS.GTTransTTLC_o@ */ /end MEASUREMENT
/begin MEASUREMENT rtDW_ADAS.GTTransVehPosition_a "" UBYTE ADAS_CM_uint8 0 0 0 255 ECU_ADDRESS 0x0000 /* @ECU_Address@rtDW_ADAS.GTTransVehPosition_a@ */ /end MEASUREMENT
/begin MEASUREMENT rtDW_ADAS.GTTransVehPosition_i "" UBYTE ADAS_CM_uint8 0 0 0 255 ECU_ADDRESS 0x0000 /* @ECU_Address@rtDW_ADAS.GTTransVehPosition_i@ */ /end MEASUREMENT
/begin MEASUREMENT rtDW_ADAS.GTTransWarnBlocking_a "" UBYTE ADAS_CM_uint8 0 0 0 255 ECU_ADDRESS 0x0000 /* @ECU_Address@rtDW_ADAS.GTTransWarnBlocking_a@ */ /end MEASUREMENT
/begin MEASUREMENT rtDW_ADAS.GTUD_DSTATE_j "" FLOAT32_IEEE ADAS_CM_single 0 0 -3.4E+38 3.4E+38 ECU_ADDRESS 0x0000 /* @ECU_Address@rtDW_ADAS.GTUD_DSTATE_j@ */ /end MEASUREMENT
/begin MEASUREMENT rtDW_ADAS.GTUD_DSTATE_k "" FLOAT32_IEEE ADAS_CM_single 0 0 -3.4E+38 3.4E+38 ECU_ADDRESS 0x0000 /* @ECU_Address@rtDW_ADAS.GTUD_DSTATE_k@ */ /end MEASUREMENT
/begin MEASUREMENT rtDW_ADAS.GTVehPos "" UBYTE ADAS_CM_uint8 0 0 0 255 ECU_ADDRESS 0x0000 /* @ECU_Address@rtDW_ADAS.GTVehPos@ */ /end MEASUREMENT
/begin MEASUREMENT rtDW_ADAS.GTVehPos_m "" UBYTE ADAS_CM_uint8 0 0 0 255 ECU_ADDRESS 0x0000 /* @ECU_Address@rtDW_ADAS.GTVehPos_m@ */ /end MEASUREMENT
/begin MEASUREMENT rtDW_ADAS.GTWarnBlockSts "" UBYTE ADAS_CM_uint8 0 0 0 255 ECU_ADDRESS 0x0000 /* @ECU_Address@rtDW_ADAS.GTWarnBlockSts@ */ /end MEASUREMENT
/begin MEASUREMENT rtDW_ADAS.GTWarnBlockSts_p "" UBYTE ADAS_CM_uint8 0 0 0 255 ECU_ADDRESS 0x0000 /* @ECU_Address@rtDW_ADAS.GTWarnBlockSts_p@ */ /end MEASUREMENT
/begin MEASUREMENT rtDW_ADAS.GTWarnOut "" UBYTE ADAS_CM_uint8 0 0 0 255 ECU_ADDRESS 0x0000 /* @ECU_Address@rtDW_ADAS.GTWarnOut@ */ /end MEASUREMENT
/begin MEASUREMENT rtDW_ADAS.GTWarnOut_c "" UBYTE ADAS_CM_uint8 0 0 0 255 ECU_ADDRESS 0x0000 /* @ECU_Address@rtDW_ADAS.GTWarnOut_c@ */ /end MEASUREMENT
/begin MEASUREMENT rtDW_ADAS.GTWarnPredict_e "" UBYTE ADAS_CM_uint8 0 0 0 255 ECU_ADDRESS 0x0000 /* @ECU_Address@rtDW_ADAS.GTWarnPredict_e@ */ /end MEASUREMENT
/begin MEASUREMENT rtDW_ADAS.GTWarnPredict_o "" UBYTE ADAS_CM_uint8 0 0 0 255 ECU_ADDRESS 0x0000 /* @ECU_Address@rtDW_ADAS.GTWarnPredict_o@ */ /end MEASUREMENT
/begin MEASUREMENT rtDW_ADAS.GTWelcomeSts_f "" UBYTE ADAS_CM_uint8 0 0 0 255 ECU_ADDRESS 0x0000 /* @ECU_Address@rtDW_ADAS.GTWelcomeSts_f@ */ /end MEASUREMENT
/begin MEASUREMENT rtDW_ADAS.GTWelcomeSts_l "" UBYTE ADAS_CM_uint8 0 0 0 255 ECU_ADDRESS 0x0000 /* @ECU_Address@rtDW_ADAS.GTWelcomeSts_l@ */ /end MEASUREMENT
/begin MEASUREMENT rtDW_ADAS.GTYR_dt "" FLOAT32_IEEE ADAS_CM_single 0 0 -3.4E+38 3.4E+38 ECU_ADDRESS 0x0000 /* @ECU_Address@rtDW_ADAS.GTYR_dt@ */ /end MEASUREMENT
/begin MEASUREMENT rtDW_ADAS.GTYR_dt_c "" FLOAT32_IEEE ADAS_CM_single 0 0 -3.4E+38 3.4E+38 ECU_ADDRESS 0x0000 /* @ECU_Address@rtDW_ADAS.GTYR_dt_c@ */ /end MEASUREMENT
/begin MEASUREMENT rtDW_ADAS.GTcountAeb_FB "" FLOAT32_IEEE ADAS_CM_single 0 0 -3.4E+38 3.4E+38 ECU_ADDRESS 0x0000 /* @ECU_Address@rtDW_ADAS.GTcountAeb_FB@ */ /end MEASUREMENT
/begin MEASUREMENT rtDW_ADAS.GTisInsideAeb "" UBYTE ADAS_CM_uint8 0 0 0 255 ECU_ADDRESS 0x0000 /* @ECU_Address@rtDW_ADAS.GTisInsideAeb@ */ /end MEASUREMENT
/begin MEASUREMENT rtDW_ADAS.GTisInsideAeb_h "" UBYTE ADAS_CM_uint8 0 0 0 255 ECU_ADDRESS 0x0000 /* @ECU_Address@rtDW_ADAS.GTisInsideAeb_h@ */ /end MEASUREMENT
/begin MEASUREMENT rtDW_ADAS.GTisInsideFcw "" UBYTE ADAS_CM_uint8 0 0 0 255 ECU_ADDRESS 0x0000 /* @ECU_Address@rtDW_ADAS.GTisInsideFcw@ */ /end MEASUREMENT
/begin MEASUREMENT rtDW_ADAS.GTisInsideFcw_k "" UBYTE ADAS_CM_uint8 0 0 0 255 ECU_ADDRESS 0x0000 /* @ECU_Address@rtDW_ADAS.GTisInsideFcw_k@ */ /end MEASUREMENT
/begin MEASUREMENT rtDW_ADAS.GTisObjInCvwZone_uint8 "" UBYTE ADAS_CM_uint8 0 0 0 255 ECU_ADDRESS 0x0000 /* @ECU_Address@rtDW_ADAS.GTisObjInCvwZone_uint8@ */ /end MEASUREMENT
/begin MEASUREMENT rtDW_ADAS.GTisObjInCvwZone_uint8_o "" UBYTE ADAS_CM_uint8 0 0 0 255 ECU_ADDRESS 0x0000 /* @ECU_Address@rtDW_ADAS.GTisObjInCvwZone_uint8_o@ */ /end MEASUREMENT
/begin MEASUREMENT rtDW_ADAS.GTisObjInLeftCvwZone "" UBYTE ADAS_CM_uint8 0 0 0 255 ECU_ADDRESS 0x0000 /* @ECU_Address@rtDW_ADAS.GTisObjInLeftCvwZone@ */ /end MEASUREMENT
/begin MEASUREMENT rtDW_ADAS.GTisObjInRightCvwZone "" UBYTE ADAS_CM_uint8 0 0 0 255 ECU_ADDRESS 0x0000 /* @ECU_Address@rtDW_ADAS.GTisObjInRightCvwZone@ */ /end MEASUREMENT
/begin MEASUREMENT rtDW_ADAS.GTis_ACTIVE_b "" UBYTE ADAS_CM_uint8 0 0 0 255 ECU_ADDRESS 0x0000 /* @ECU_Address@rtDW_ADAS.GTis_ACTIVE_b@ */ /end MEASUREMENT
/begin MEASUREMENT rtDW_ADAS.GTis_ACTIVE_n "" UBYTE ADAS_CM_uint8 0 0 0 255 ECU_ADDRESS 0x0000 /* @ECU_Address@rtDW_ADAS.GTis_ACTIVE_n@ */ /end MEASUREMENT
/begin MEASUREMENT rtDW_ADAS.GTis_AEB "" UBYTE ADAS_CM_uint8 0 0 0 255 ECU_ADDRESS 0x0000 /* @ECU_Address@rtDW_ADAS.GTis_AEB@ */ /end MEASUREMENT
/begin MEASUREMENT rtDW_ADAS.GTis_FCW "" UBYTE ADAS_CM_uint8 0 0 0 255 ECU_ADDRESS 0x0000 /* @ECU_Address@rtDW_ADAS.GTis_FCW@ */ /end MEASUREMENT
/begin MEASUREMENT rtDW_ADAS.GTis_ON_l "" UBYTE ADAS_CM_uint8 0 0 0 255 ECU_ADDRESS 0x0000 /* @ECU_Address@rtDW_ADAS.GTis_ON_l@ */ /end MEASUREMENT
/begin MEASUREMENT rtDW_ADAS.GTis_ON_m "" UBYTE ADAS_CM_uint8 0 0 0 255 ECU_ADDRESS 0x0000 /* @ECU_Address@rtDW_ADAS.GTis_ON_m@ */ /end MEASUREMENT
/begin MEASUREMENT rtDW_ADAS.GTis_active_c226_ADAS "" UBYTE ADAS_CM_uint8 0 0 0 255 ECU_ADDRESS 0x0000 /* @ECU_Address@rtDW_ADAS.GTis_active_c226_ADAS@ */ /end MEASUREMENT
/begin MEASUREMENT rtDW_ADAS.GTis_active_c227_ADAS "" UBYTE ADAS_CM_uint8 0 0 0 255 ECU_ADDRESS 0x0000 /* @ECU_Address@rtDW_ADAS.GTis_active_c227_ADAS@ */ /end MEASUREMENT
/begin MEASUREMENT rtDW_ADAS.GTis_active_c228_ADAS "" UBYTE ADAS_CM_uint8 0 0 0 255 ECU_ADDRESS 0x0000 /* @ECU_Address@rtDW_ADAS.GTis_active_c228_ADAS@ */ /end MEASUREMENT
/begin MEASUREMENT rtDW_ADAS.GTis_active_c229_ADAS "" UBYTE ADAS_CM_uint8 0 0 0 255 ECU_ADDRESS 0x0000 /* @ECU_Address@rtDW_ADAS.GTis_active_c229_ADAS@ */ /end MEASUREMENT
/begin MEASUREMENT rtDW_ADAS.GTis_active_c230_ADAS "" UBYTE ADAS_CM_uint8 0 0 0 255 ECU_ADDRESS 0x0000 /* @ECU_Address@rtDW_ADAS.GTis_active_c230_ADAS@ */ /end MEASUREMENT
/begin MEASUREMENT rtDW_ADAS.GTis_active_c240_ADAS "" UBYTE ADAS_CM_uint8 0 0 0 255 ECU_ADDRESS 0x0000 /* @ECU_Address@rtDW_ADAS.GTis_active_c240_ADAS@ */ /end MEASUREMENT
/begin MEASUREMENT rtDW_ADAS.GTis_active_c30_ADAS "" UBYTE ADAS_CM_uint8 0 0 0 255 ECU_ADDRESS 0x0000 /* @ECU_Address@rtDW_ADAS.GTis_active_c30_ADAS@ */ /end MEASUREMENT
/begin MEASUREMENT rtDW_ADAS.GTis_active_c317_ADAS "" UBYTE ADAS_CM_uint8 0 0 0 255 ECU_ADDRESS 0x0000 /* @ECU_Address@rtDW_ADAS.GTis_active_c317_ADAS@ */ /end MEASUREMENT
/begin MEASUREMENT rtDW_ADAS.GTis_active_c320_ADAS "" UBYTE ADAS_CM_uint8 0 0 0 255 ECU_ADDRESS 0x0000 /* @ECU_Address@rtDW_ADAS.GTis_active_c320_ADAS@ */ /end MEASUREMENT
/begin MEASUREMENT rtDW_ADAS.GTis_c226_ADAS "" UBYTE ADAS_CM_uint8 0 0 0 255 ECU_ADDRESS 0x0000 /* @ECU_Address@rtDW_ADAS.GTis_c226_ADAS@ */ /end MEASUREMENT
/begin MEASUREMENT rtDW_ADAS.GTis_c227_ADAS "" UBYTE ADAS_CM_uint8 0 0 0 255 ECU_ADDRESS 0x0000 /* @ECU_Address@rtDW_ADAS.GTis_c227_ADAS@ */ /end MEASUREMENT
/begin MEASUREMENT rtDW_ADAS.GTis_c228_ADAS "" UBYTE ADAS_CM_uint8 0 0 0 255 ECU_ADDRESS 0x0000 /* @ECU_Address@rtDW_ADAS.GTis_c228_ADAS@ */ /end MEASUREMENT
/begin MEASUREMENT rtDW_ADAS.GTis_c229_ADAS "" UBYTE ADAS_CM_uint8 0 0 0 255 ECU_ADDRESS 0x0000 /* @ECU_Address@rtDW_ADAS.GTis_c229_ADAS@ */ /end MEASUREMENT
/begin MEASUREMENT rtDW_ADAS.GTis_c230_ADAS "" UBYTE ADAS_CM_uint8 0 0 0 255 ECU_ADDRESS 0x0000 /* @ECU_Address@rtDW_ADAS.GTis_c230_ADAS@ */ /end MEASUREMENT
/begin MEASUREMENT rtDW_ADAS.GTis_c30_ADAS "" UBYTE ADAS_CM_uint8 0 0 0 255 ECU_ADDRESS 0x0000 /* @ECU_Address@rtDW_ADAS.GTis_c30_ADAS@ */ /end MEASUREMENT
/begin MEASUREMENT rtDW_ADAS.GTis_c320_ADAS "" UBYTE ADAS_CM_uint8 0 0 0 255 ECU_ADDRESS 0x0000 /* @ECU_Address@rtDW_ADAS.GTis_c320_ADAS@ */ /end MEASUREMENT
/begin MEASUREMENT rtDW_ADAS.GTtemporalCounter_i1_f "" ULONG ADAS_CM_uint32 0 0 0 4294967295 ECU_ADDRESS 0x0000 /* @ECU_Address@rtDW_ADAS.GTtemporalCounter_i1_f@ */ /end MEASUREMENT
/begin MEASUREMENT rtDW_ADAS.GTtemporalCounter_i1_g "" ULONG ADAS_CM_uint32 0 0 0 4294967295 ECU_ADDRESS 0x0000 /* @ECU_Address@rtDW_ADAS.GTtemporalCounter_i1_g@ */ /end MEASUREMENT
/begin MEASUREMENT rtDW_ADAS.GTtemporalCounter_i1_hkp "" ULONG ADAS_CM_uint32 0 0 0 4294967295 ECU_ADDRESS 0x0000 /* @ECU_Address@rtDW_ADAS.GTtemporalCounter_i1_hkp@ */ /end MEASUREMENT
/begin MEASUREMENT rtDW_ADAS.GTtemporalCounter_i1_hz "" ULONG ADAS_CM_uint32 0 0 0 4294967295 ECU_ADDRESS 0x0000 /* @ECU_Address@rtDW_ADAS.GTtemporalCounter_i1_hz@ */ /end MEASUREMENT
/begin MEASUREMENT rtDW_ADAS.GTtemporalCounter_i1_n "" ULONG ADAS_CM_uint32 0 0 0 4294967295 ECU_ADDRESS 0x0000 /* @ECU_Address@rtDW_ADAS.GTtemporalCounter_i1_n@ */ /end MEASUREMENT
/begin MEASUREMENT rtDW_ADAS.GTtemporalCounter_i1_pe "" ULONG ADAS_CM_uint32 0 0 0 4294967295 ECU_ADDRESS 0x0000 /* @ECU_Address@rtDW_ADAS.GTtemporalCounter_i1_pe@ */ /end MEASUREMENT
/begin MEASUREMENT rtDW_ADAS.GTy "" FLOAT32_IEEE ADAS_CM_single_kmh 0 0 -3.4E+38 3.4E+38 ECU_ADDRESS 0x0000 /* @ECU_Address@rtDW_ADAS.GTy@ */ /end MEASUREMENT
/begin MEASUREMENT rtDW_ADAS.GTy_e "" FLOAT32_IEEE ADAS_CM_single_m 0 0 -3.4E+38 3.4E+38 ECU_ADDRESS 0x0000 /* @ECU_Address@rtDW_ADAS.GTy_e@ */ /end MEASUREMENT
/begin COMPU_METHOD ADAS_CM_logical "" IDENTICAL "%1.0" "" /end COMPU_METHOD
/begin COMPU_METHOD ADAS_CM_single "" IDENTICAL "%8.6" "" /end COMPU_METHOD
/begin COMPU_METHOD ADAS_CM_single_kmh "" IDENTICAL "%8.6" "kmh" /end COMPU_METHOD
/begin COMPU_METHOD ADAS_CM_single_m "" IDENTICAL "%8.6" "m" /end COMPU_METHOD
/begin COMPU_METHOD ADAS_CM_uint32 "" IDENTICAL "%10.0" "" /end COMPU_METHOD
/begin COMPU_METHOD ADAS_CM_uint8 "" IDENTICAL "%3.0" "" /end COMPU_METHOD
/begin GROUP ADAS_FuncLevel_FCW_AEB_Solver "ADAS/FuncLevel/FCW_AEB/Solver"
 /begin SUB_GROUP ADAS_FuncLevel_FCW_AEB_Solver_Calculation_Sx_for_FCW_and_AEB ADAS_FuncLevel_FCW_AEB_Solver_Distance_after_stop ADAS_FuncLevel_FCW_AEB_Solver_FunctionalSafetyProfile ADAS_FuncLevel_FCW_AEB_Solver_Subsystem ADAS_FuncLevel_FCW_AEB_Solver_Subsystem1 /end SUB_GROUP
 /begin REF_MEASUREMENT rtDW_ADAS.GTAx_ref rtDW_ADAS.GTEnblAeb_FB rtDW_ADAS.GTMemory_PreviousInput_b rtDW_ADAS.GTSwitch1_o rtDW_ADAS.GTSwitch_g rtDW_ADAS.GTTiFSref rtDW_ADAS.GTcountAeb_FB rtDW_ADAS.GTis_ACTIVE_b rtDW_ADAS.GTis_AEB rtDW_ADAS.GTis_FCW rtDW_ADAS.GTis_active_c240_ADAS /end REF_MEASUREMENT
/end GROUP
/begin GROUP ADAS_FuncLevel_FCW_AEB_Solver_Calculation_Sx_for_FCW_and_AEB "ADAS/FuncLevel/FCW_AEB/Solver/Calculation Sx for FCW and AEB"
 /begin SUB_GROUP ADAS_FuncLevel_FCW_AEB_Solver_Calculation_Sx_for_FCW_and_AEB_Changing_parameters_during_FS /end SUB_GROUP
/end GROUP
/begin GROUP ADAS_FuncLevel_FCW_AEB_Solver_Calculation_Sx_for_FCW_and_AEB_Changing_parameters_during_FS "ADAS/FuncLevel/FCW_AEB/Solver/Calculation Sx for FCW and AEB/Changing parameters during FS"
 /begin SUB_GROUP ADAS_FuncLevel_FCW_AEB_Solver_Calculation_Sx_for_FCW_and_AEB_Changing_parameters_during_FS_Changing_parameters_du_FS_w__o_the_achievement_of_a_ref_level ADAS_FuncLevel_FCW_AEB_Solver_Calculation_Sx_for_FCW_and_AEB_Changing_parameters_during_FS_Changing_parameters_du_FS_with_the_achievement_of_a_ref_level /end SUB_GROUP
 /begin REF_MEASUREMENT rtDW_ADAS.GTAdd_ku rtDW_ADAS.GTTiFS /end REF_MEASUREMENT
/end GROUP
/begin GROUP ADAS_FuncLevel_FCW_AEB_Solver_Calculation_Sx_for_FCW_and_AEB_Changing_parameters_during_FS_Changing_parameters_du_FS_w__o_the_achievement_of_a_ref_level "ADAS/FuncLevel/FCW_AEB/Solver/Calculation Sx for FCW and AEB/Changing parameters during FS/Changing parameters du FS w//o the achievement of a ref level"
 /begin SUB_GROUP ADAS_FuncLevel_FCW_AEB_Solver_Calculation_Sx_for_FCW_and_AEB_Changing_parameters_during_FS_Changing_parameters_du_FS_w__o_the_achievement_of_a_ref_level_Sx_before_transition_to_a_ref_deceleration ADAS_FuncLevel_FCW_AEB_Solver_Calculation_Sx_for_FCW_and_AEB_Changing_parameters_during_FS_Changing_parameters_du_FS_w__o_the_achievement_of_a_ref_level_Vx_before_transition_to_a_ref_deceleration /end SUB_GROUP
 /begin REF_MEASUREMENT rtDW_ADAS.GTAdd1_ez rtDW_ADAS.GTAdd_ku /end REF_MEASUREMENT
/end GROUP
/begin GROUP ADAS_FuncLevel_FCW_AEB_Solver_Calculation_Sx_for_FCW_and_AEB_Changing_parameters_during_FS_Changing_parameters_du_FS_w__o_the_achievement_of_a_ref_level_Sx_before_transition_to_a_ref_deceleration "ADAS/FuncLevel/FCW_AEB/Solver/Calculation Sx for FCW and AEB/Changing parameters during FS/Changing parameters du FS w//o the achievement of a ref level/Sx before transition to a ref deceleration" /begin REF_MEASUREMENT rtDW_ADAS.GTAdd1_jl rtDW_ADAS.GTAdd_ku /end REF_MEASUREMENT /end GROUP
/begin GROUP ADAS_FuncLevel_FCW_AEB_Solver_Calculation_Sx_for_FCW_and_AEB_Changing_parameters_during_FS_Changing_parameters_du_FS_w__o_the_achievement_of_a_ref_level_Vx_before_transition_to_a_ref_deceleration "ADAS/FuncLevel/FCW_AEB/Solver/Calculation Sx for FCW and AEB/Changing parameters during FS/Changing parameters du FS w//o the achievement of a ref level/Vx before transition to a ref deceleration" /begin REF_MEASUREMENT rtDW_ADAS.GTAdd1_b rtDW_ADAS.GTAdd_ku /end REF_MEASUREMENT /end GROUP
/begin GROUP ADAS_FuncLevel_FCW_AEB_Solver_Calculation_Sx_for_FCW_and_AEB_Changing_parameters_during_FS_Changing_parameters_du_FS_with_the_achievement_of_a_ref_level "ADAS/FuncLevel/FCW_AEB/Solver/Calculation Sx for FCW and AEB/Changing parameters during FS/Changing parameters du FS with the achievement of a ref level"
 /begin SUB_GROUP ADAS_FuncLevel_FCW_AEB_Solver_Calculation_Sx_for_FCW_and_AEB_Changing_parameters_during_FS_Changing_parameters_du_FS_with_the_achievement_of_a_ref_level_Changing_parameters_before_reaching_ref_deceleration_FS ADAS_FuncLevel_FCW_AEB_Solver_Calculation_Sx_for_FCW_and_AEB_Changing_parameters_during_FS_Changing_parameters_du_FS_with_the_achievement_of_a_ref_level_Changing_parameters_during_FS /end SUB_GROUP
 /begin REF_MEASUREMENT rtDW_ADAS.GTTiFS /end REF_MEASUREMENT
/end GROUP
/begin GROUP ADAS_FuncLevel_FCW_AEB_Solver_Calculation_Sx_for_FCW_and_AEB_Changing_parameters_during_FS_Changing_parameters_du_FS_with_the_achievement_of_a_ref_level_Changing_parameters_during_FS "ADAS/FuncLevel/FCW_AEB/Solver/Calculation Sx for FCW and AEB/Changing parameters during FS/Changing parameters du FS with the achievement of a ref level/Changing parameters during FS"
 /begin SUB_GROUP ADAS_FuncLevel_FCW_AEB_Solver_Calculation_Sx_for_FCW_and_AEB_Changing_parameters_during_FS_Changing_parameters_du_FS_with_the_achievement_of_a_ref_level_Changing_parameters_during_FS_Sx_before_transition_to_a_ref_deceleration ADAS_FuncLevel_FCW_AEB_Solver_Calculation_Sx_for_FCW_and_AEB_Changing_parameters_during_FS_Changing_parameters_du_FS_with_the_achievement_of_a_ref_level_Changing_parameters_during_FS_Vx_before_transition_to_a_ref_deceleration /end SUB_GROUP
/end GROUP
/begin GROUP ADAS_FuncLevel_FCW_AEB_Solver_Calculation_Sx_for_FCW_and_AEB_Changing_parameters_during_FS_Changing_parameters_du_FS_with_the_achievement_of_a_ref_level_Changing_parameters_during_FS_Sx_before_transition_to_a_ref_deceleration "ADAS/FuncLevel/FCW_AEB/Solver/Calculation Sx for FCW and AEB/Changing parameters during FS/Changing parameters du FS with the achievement of a ref level/Changing parameters during FS/Sx before transition to a ref deceleration" /begin REF_MEASUREMENT rtDW_ADAS.GTAdd1_cm /end REF_MEASUREMENT /end GROUP
/begin GROUP ADAS_FuncLevel_FCW_AEB_Solver_Calculation_Sx_for_FCW_and_AEB_Changing_parameters_during_FS_Changing_parameters_du_FS_with_the_achievement_of_a_ref_level_Changing_parameters_during_FS_Vx_before_transition_to_a_ref_deceleration "ADAS/FuncLevel/FCW_AEB/Solver/Calculation Sx for FCW and AEB/Changing parameters during FS/Changing parameters du FS with the achievement of a ref level/Changing parameters during FS/Vx before transition to a ref deceleration" /begin REF_MEASUREMENT rtDW_ADAS.GTAdd1_j /end REF_MEASUREMENT /end GROUP
/begin GROUP ADAS_FuncLevel_FCW_AEB_Solver_Distance_after_stop "ADAS/FuncLevel/FCW_AEB/Solver/Distance after stop" /begin REF_MEASUREMENT rtDW_ADAS.GTSwitch_m /end REF_MEASUREMENT /end GROUP
/begin GROUP ADAS_FuncLevel_FCW_AEB_Solver_Subsystem "ADAS/FuncLevel/FCW_AEB/Solver/Subsystem" /begin SUB_GROUP ADAS_FuncLevel_FCW_AEB_Solver_Subsystem_Subsystem /end SUB_GROUP
 /begin REF_MEASUREMENT rtDW_ADAS.GTAx_ref rtDW_ADAS.GTEnblAeb_FB rtDW_ADAS.GTSwitch2 rtDW_ADAS.GTSwitch_m /end REF_MEASUREMENT
/end GROUP
/begin GROUP ADAS_FuncLevel_FCW_AEB_Solver_Subsystem1 "ADAS/FuncLevel/FCW_AEB/Solver/Subsystem1"
 /begin SUB_GROUP ADAS_FuncLevel_FCW_AEB_Solver_Subsystem1_Compare_To_Constant ADAS_FuncLevel_FCW_AEB_Solver_Subsystem1_Compare_To_Constant1 ADAS_FuncLevel_FCW_AEB_Solver_Subsystem1_Subsystem ADAS_FuncLevel_FCW_AEB_Solver_Subsystem1_Subsystem1 ADAS_FuncLevel_FCW_AEB_Solver_Subsystem1_Subsystem2 ADAS_FuncLevel_FCW_AEB_Solver_Subsystem1_Target1Selection ADAS_FuncLevel_FCW_AEB_Solver_Subsystem1_Target1Selection1 ADAS_FuncLevel_FCW_AEB_Solver_Subsystem1_Target1Selection2 /end SUB_GROUP
 /begin REF_MEASUREMENT rtDW_ADAS.GTMinMax rtDW_ADAS.GTMinMax_j rtDW_ADAS.GTisInsideAeb rtDW_ADAS.GTisInsideAeb_h rtDW_ADAS.GTisInsideFcw rtDW_ADAS.GTisInsideFcw_k /end REF_MEASUREMENT
/end GROUP
/begin GROUP ADAS_FuncLevel_FCW_AEB_Solver_Subsystem1_Target1Selection "ADAS/FuncLevel/FCW_AEB/Solver/Subsystem1/Target1Selection"
 /begin SUB_GROUP ADAS_FuncLevel_FCW_AEB_Solver_Subsystem1_Target1Selection_Compare_To_Constant ADAS_FuncLevel_FCW_AEB_Solver_Subsystem1_Target1Selection_Compare_To_Constant1 ADAS_FuncLevel_FCW_AEB_Solver_Subsystem1_Target1Selection_Filter ADAS_FuncLevel_FCW_AEB_Solver_Subsystem1_Target1Selection_Subsystem ADAS_FuncLevel_FCW_AEB_Solver_Subsystem1_Target1Selection_Subsystem1 /end SUB_GROUP
 /begin REF_MEASUREMENT rtDW_ADAS.GTAdd1_m rtDW_ADAS.GTAdd2_e rtDW_ADAS.GTMemory2_PreviousInput_c0 rtDW_ADAS.GTMemory_PreviousInput_k rtDW_ADAS.GTSwitch_m /end REF_MEASUREMENT
/end GROUP
/begin GROUP ADAS_FuncLevel_FCW_AEB_Solver_Subsystem1_Target1Selection1 "ADAS/FuncLevel/FCW_AEB/Solver/Subsystem1/Target1Selection1"
 /begin SUB_GROUP ADAS_FuncLevel_FCW_AEB_Solver_Subsystem1_Target1Selection1_Compare_To_Constant ADAS_FuncLevel_FCW_AEB_Solver_Subsystem1_Target1Selection1_Compare_To_Constant1 ADAS_FuncLevel_FCW_AEB_Solver_Subsystem1_Target1Selection1_Filter ADAS_FuncLevel_FCW_AEB_Solver_Subsystem1_Target1Selection1_Subsystem ADAS_FuncLevel_FCW_AEB_Solver_Subsystem1_Target1Selection1_Subsystem1 /end SUB_GROUP
 /begin REF_MEASUREMENT rtDW_ADAS.GTAdd1_e3 rtDW_ADAS.GTAdd2_i rtDW_ADAS.GTMemory2_PreviousInput_cn rtDW_ADAS.GTMemory_PreviousInput_es rtDW_ADAS.GTMinMax_j rtDW_ADAS.GTisInsideAeb_h rtDW_ADAS.GTisInsideFcw_k /end REF_MEASUREMENT
/end GROUP
/begin GROUP ADAS_FuncLevel_FCW_AEB_Solver_Subsystem1_Target1Selection1_Filter "ADAS/FuncLevel/FCW_AEB/Solver/Subsystem1/Target1Selection1/Filter"
 /begin SUB_GROUP ADAS_FuncLevel_FCW_AEB_Solver_Subsystem1_Target1Selection1_Filter_Subsystem ADAS_FuncLevel_FCW_AEB_Solver_Subsystem1_Target1Selection1_Filter_Subsystem1 ADAS_FuncLevel_FCW_AEB_Solver_Subsystem1_Target1Selection1_Filter_Subsystem2 ADAS_FuncLevel_FCW_AEB_Solver_Subsystem1_Target1Selection1_Filter_Subsystem3 ADAS_FuncLevel_FCW_AEB_Solver_Subsystem1_Target1Selection1_Filter_Subsystem4 ADAS_FuncLevel_FCW_AEB_Solver_Subsystem1_Target1Selection1_Filter_Subsystem5 /end SUB_GROUP
/end GROUP
/begin GROUP ADAS_FuncLevel_FCW_AEB_Solver_Subsystem1_Target1Selection1_Filter_Subsystem "ADAS/FuncLevel/FCW_AEB/Solver/Subsystem1/Target1Selection1/Filter/Subsystem"
 /begin REF_MEASUREMENT rtDW_ADAS.GTMemory1_PreviousInput_dz rtDW_ADAS.GTMemory3_PreviousInput_f rtDW_ADAS.GTMemory4_PreviousInput_ic rtDW_ADAS.GTMemory5_PreviousInput_c1 rtDW_ADAS.GTMemory6_PreviousInput_ju rtDW_ADAS.GTMemory7_PreviousInput_a rtDW_ADAS.GTMemory_PreviousInput_fe /end REF_MEASUREMENT
/end GROUP
/begin GROUP ADAS_FuncLevel_FCW_AEB_Solver_Subsystem1_Target1Selection1_Filter_Subsystem1 "ADAS/FuncLevel/FCW_AEB/Solver/Subsystem1/Target1Selection1/Filter/Subsystem1"
 /begin REF_MEASUREMENT rtDW_ADAS.GTMemory1_PreviousInput_dt rtDW_ADAS.GTMemory3_PreviousInput_j rtDW_ADAS.GTMemory4_PreviousInput_l rtDW_ADAS.GTMemory5_PreviousInput_cu rtDW_ADAS.GTMemory6_PreviousInput_f rtDW_ADAS.GTMemory7_PreviousInput_ba rtDW_ADAS.GTMemory_PreviousInput_mg /end REF_MEASUREMENT
/end GROUP
/begin GROUP ADAS_FuncLevel_FCW_AEB_Solver_Subsystem1_Target1Selection1_Filter_Subsystem2 "ADAS/FuncLevel/FCW_AEB/Solver/Subsystem1/Target1Selection1/Filter/Subsystem2"
 /begin REF_MEASUREMENT rtDW_ADAS.GTMemory1_PreviousInput_cb rtDW_ADAS.GTMemory3_PreviousInput_o5 rtDW_ADAS.GTMemory4_PreviousInput_d rtDW_ADAS.GTMemory5_PreviousInput_oh rtDW_ADAS.GTMemory6_PreviousInput_n rtDW_ADAS.GTMemory7_PreviousInput_bm rtDW_ADAS.GTMemory_PreviousInput_oo /end REF_MEASUREMENT
/end GROUP
/begin GROUP ADAS_FuncLevel_FCW_AEB_Solver_Subsystem1_Target1Selection1_Filter_Subsystem3 "ADAS/FuncLevel/FCW_AEB/Solver/Subsystem1/Target1Selection1/Filter/Subsystem3"
 /begin REF_MEASUREMENT rtDW_ADAS.GTMemory1_PreviousInput_i rtDW_ADAS.GTMemory3_PreviousInput_jz rtDW_ADAS.GTMemory4_PreviousInput_ix rtDW_ADAS.GTMemory5_PreviousInput_km rtDW_ADAS.GTMemory6_PreviousInput_jw rtDW_ADAS.GTMemory7_PreviousInput_je rtDW_ADAS.GTMemory_PreviousInput_b5 /end REF_MEASUREMENT
/end GROUP
/begin GROUP ADAS_FuncLevel_FCW_AEB_Solver_Subsystem1_Target1Selection1_Filter_Subsystem4 "ADAS/FuncLevel/FCW_AEB/Solver/Subsystem1/Target1Selection1/Filter/Subsystem4"
 /begin REF_MEASUREMENT rtDW_ADAS.GTMemory1_PreviousInput_k1 rtDW_ADAS.GTMemory3_PreviousInput_on rtDW_ADAS.GTMemory4_PreviousInput_in rtDW_ADAS.GTMemory5_PreviousInput_f rtDW_ADAS.GTMemory6_PreviousInput_hs rtDW_ADAS.GTMemory7_PreviousInput_ii rtDW_ADAS.GTMemory_PreviousInput_a3 /end REF_MEASUREMENT
/end GROUP
/begin GROUP ADAS_FuncLevel_FCW_AEB_Solver_Subsystem1_Target1Selection1_Filter_Subsystem5 "ADAS/FuncLevel/FCW_AEB/Solver/Subsystem1/Target1Selection1/Filter/Subsystem5"
 /begin REF_MEASUREMENT rtDW_ADAS.GTMemory1_PreviousInput_ao rtDW_ADAS.GTMemory3_PreviousInput_nf rtDW_ADAS.GTMemory4_PreviousInput_p rtDW_ADAS.GTMemory5_PreviousInput_pa rtDW_ADAS.GTMemory6_PreviousInput_osg rtDW_ADAS.GTMemory7_PreviousInput_l rtDW_ADAS.GTMemory_PreviousInput_op /end REF_MEASUREMENT
/end GROUP
/begin GROUP ADAS_FuncLevel_FCW_AEB_Solver_Subsystem1_Target1Selection1_Subsystem1 "ADAS/FuncLevel/FCW_AEB/Solver/Subsystem1/Target1Selection1/Subsystem1" /begin REF_MEASUREMENT rtDW_ADAS.GTAdd1_e3 rtDW_ADAS.GTAdd2_i /end REF_MEASUREMENT /end GROUP
/begin GROUP ADAS_FuncLevel_FCW_AEB_Solver_Subsystem1_Target1Selection2 "ADAS/FuncLevel/FCW_AEB/Solver/Subsystem1/Target1Selection2"
 /begin SUB_GROUP ADAS_FuncLevel_FCW_AEB_Solver_Subsystem1_Target1Selection2_Compare_To_Constant ADAS_FuncLevel_FCW_AEB_Solver_Subsystem1_Target1Selection2_Compare_To_Constant1 ADAS_FuncLevel_FCW_AEB_Solver_Subsystem1_Target1Selection2_Filter ADAS_FuncLevel_FCW_AEB_Solver_Subsystem1_Target1Selection2_Subsystem ADAS_FuncLevel_FCW_AEB_Solver_Subsystem1_Target1Selection2_Subsystem1 /end SUB_GROUP
 /begin REF_MEASUREMENT rtDW_ADAS.GTAdd1_c rtDW_ADAS.GTAdd2_d rtDW_ADAS.GTMemory2_PreviousInput_ni rtDW_ADAS.GTMemory_PreviousInput_co rtDW_ADAS.GTMinMax rtDW_ADAS.GTSwitch_m rtDW_ADAS.GTisInsideAeb rtDW_ADAS.GTisInsideFcw /end REF_MEASUREMENT
/end GROUP
/begin GROUP ADAS_FuncLevel_FCW_AEB_Solver_Subsystem1_Target1Selection2_Filter "ADAS/FuncLevel/FCW_AEB/Solver/Subsystem1/Target1Selection2/Filter"
 /begin SUB_GROUP ADAS_FuncLevel_FCW_AEB_Solver_Subsystem1_Target1Selection2_Filter_Subsystem ADAS_FuncLevel_FCW_AEB_Solver_Subsystem1_Target1Selection2_Filter_Subsystem1 ADAS_FuncLevel_FCW_AEB_Solver_Subsystem1_Target1Selection2_Filter_Subsystem2 ADAS_FuncLevel_FCW_AEB_Solver_Subsystem1_Target1Selection2_Filter_Subsystem3 ADAS_FuncLevel_FCW_AEB_Solver_Subsystem1_Target1Selection2_Filter_Subsystem4 ADAS_FuncLevel_FCW_AEB_Solver_Subsystem1_Target1Selection2_Filter_Subsystem5 /end SUB_GROUP
/end GROUP
/begin GROUP ADAS_FuncLevel_FCW_AEB_Solver_Subsystem1_Target1Selection2_Filter_Subsystem "ADAS/FuncLevel/FCW_AEB/Solver/Subsystem1/Target1Selection2/Filter/Subsystem"
 /begin REF_MEASUREMENT rtDW_ADAS.GTMemory1_PreviousInput_cu1 rtDW_ADAS.GTMemory3_PreviousInput_h rtDW_ADAS.GTMemory4_PreviousInput_c rtDW_ADAS.GTMemory5_PreviousInput_cy rtDW_ADAS.GTMemory6_PreviousInput_hy rtDW_ADAS.GTMemory7_PreviousInput_i rtDW_ADAS.GTMemory_PreviousInput_kj /end REF_MEASUREMENT
/end GROUP
/begin GROUP ADAS_FuncLevel_FCW_AEB_Solver_Subsystem1_Target1Selection2_Filter_Subsystem1 "ADAS/FuncLevel/FCW_AEB/Solver/Subsystem1/Target1Selection2/Filter/Subsystem1"
 /begin REF_MEASUREMENT rtDW_ADAS.GTMemory1_PreviousInput_ax rtDW_ADAS.GTMemory3_PreviousInput_av rtDW_ADAS.GTMemory4_PreviousInput_aas rtDW_ADAS.GTMemory5_PreviousInput_e rtDW_ADAS.GTMemory6_PreviousInput_jz rtDW_ADAS.GTMemory7_PreviousInput_k3 rtDW_ADAS.GTMemory_PreviousInput_n0x /end REF_MEASUREMENT
/end GROUP
/begin GROUP ADAS_FuncLevel_FCW_AEB_Solver_Subsystem1_Target1Selection2_Filter_Subsystem2 "ADAS/FuncLevel/FCW_AEB/Solver/Subsystem1/Target1Selection2/Filter/Subsystem2"
 /begin REF_MEASUREMENT rtDW_ADAS.GTMemory1_PreviousInput_f rtDW_ADAS.GTMemory3_PreviousInput_o rtDW_ADAS.GTMemory4_PreviousInput_o rtDW_ADAS.GTMemory5_PreviousInput_c0 rtDW_ADAS.GTMemory6_PreviousInput_jd rtDW_ADAS.GTMemory7_PreviousInput_b rtDW_ADAS.GTMemory_PreviousInput_fj /end REF_MEASUREMENT
/end GROUP
/begin GROUP ADAS_FuncLevel_FCW_AEB_Solver_Subsystem1_Target1Selection2_Filter_Subsystem3 "ADAS/FuncLevel/FCW_AEB/Solver/Subsystem1/Target1Selection2/Filter/Subsystem3"
 /begin REF_MEASUREMENT rtDW_ADAS.GTMemory1_PreviousInput_f0 rtDW_ADAS.GTMemory3_PreviousInput_g rtDW_ADAS.GTMemory4_PreviousInput_e rtDW_ADAS.GTMemory5_PreviousInput_o rtDW_ADAS.GTMemory6_PreviousInput_b rtDW_ADAS.GTMemory7_PreviousInput_n rtDW_ADAS.GTMemory_PreviousInput_od /end REF_MEASUREMENT
/end GROUP
/begin GROUP ADAS_FuncLevel_FCW_AEB_Solver_Subsystem1_Target1Selection2_Filter_Subsystem4 "ADAS/FuncLevel/FCW_AEB/Solver/Subsystem1/Target1Selection2/Filter/Subsystem4"
 /begin REF_MEASUREMENT rtDW_ADAS.GTMemory1_PreviousInput_ku rtDW_ADAS.GTMemory3_PreviousInput_dl rtDW_ADAS.GTMemory4_PreviousInput_ag rtDW_ADAS.GTMemory5_PreviousInput_ps rtDW_ADAS.GTMemory6_PreviousInput_p rtDW_ADAS.GTMemory7_PreviousInput_by rtDW_ADAS.GTMemory_PreviousInput_d /end REF_MEASUREMENT
/end GROUP
/begin GROUP ADAS_FuncLevel_FCW_AEB_Solver_Subsystem1_Target1Selection2_Filter_Subsystem5 "ADAS/FuncLevel/FCW_AEB/Solver/Subsystem1/Target1Selection2/Filter/Subsystem5"
 /begin REF_MEASUREMENT rtDW_ADAS.GTMemory1_PreviousInput_e rtDW_ADAS.GTMemory3_PreviousInput_hx rtDW_ADAS.GTMemory4_PreviousInput_b rtDW_ADAS.GTMemory5_PreviousInput_n rtDW_ADAS.GTMemory6_PreviousInput_hz rtDW_ADAS.GTMemory7_PreviousInput_j1 rtDW_ADAS.GTMemory_PreviousInput_dy /end REF_MEASUREMENT
/end GROUP
/begin GROUP ADAS_FuncLevel_FCW_AEB_Solver_Subsystem1_Target1Selection2_Subsystem1 "ADAS/FuncLevel/FCW_AEB/Solver/Subsystem1/Target1Selection2/Subsystem1" /begin REF_MEASUREMENT rtDW_ADAS.GTAdd1_c rtDW_ADAS.GTAdd2_d /end REF_MEASUREMENT /end GROUP
/begin GROUP ADAS_FuncLevel_FCW_AEB_Solver_Subsystem1_Target1Selection_Filter "ADAS/FuncLevel/FCW_AEB/Solver/Subsystem1/Target1Selection/Filter"
 /begin SUB_GROUP ADAS_FuncLevel_FCW_AEB_Solver_Subsystem1_Target1Selection_Filter_Subsystem ADAS_FuncLevel_FCW_AEB_Solver_Subsystem1_Target1Selection_Filter_Subsystem1 ADAS_FuncLevel_FCW_AEB_Solver_Subsystem1_Target1Selection_Filter_Subsystem2 ADAS_FuncLevel_FCW_AEB_Solver_Subsystem1_Target1Selection_Filter_Subsystem3 ADAS_FuncLevel_FCW_AEB_Solver_Subsystem1_Target1Selection_Filter_Subsystem4 ADAS_FuncLevel_FCW_AEB_Solver_Subsystem1_Target1Selection_Filter_Subsystem5 /end SUB_GROUP
/end GROUP
/begin GROUP ADAS_FuncLevel_FCW_AEB_Solver_Subsystem1_Target1Selection_Filter_Subsystem "ADAS/FuncLevel/FCW_AEB/Solver/Subsystem1/Target1Selection/Filter/Subsystem"
 /begin REF_MEASUREMENT rtDW_ADAS.GTMemory1_PreviousInput_d rtDW_ADAS.GTMemory3_PreviousInput_l rtDW_ADAS.GTMemory4_PreviousInput rtDW_ADAS.GTMemory5_PreviousInput rtDW_ADAS.GTMemory6_PreviousInput_j rtDW_ADAS.GTMemory7_PreviousInput_j rtDW_ADAS.GTMemory_PreviousInput_e /end REF_MEASUREMENT
/end GROUP
/begin GROUP ADAS_FuncLevel_FCW_AEB_Solver_Subsystem1_Target1Selection_Filter_Subsystem1 "ADAS/FuncLevel/FCW_AEB/Solver/Subsystem1/Target1Selection/Filter/Subsystem1"
 /begin REF_MEASUREMENT rtDW_ADAS.GTMemory1_PreviousInput_an rtDW_ADAS.GTMemory3_PreviousInput_b rtDW_ADAS.GTMemory4_PreviousInput_a rtDW_ADAS.GTMemory5_PreviousInput_d rtDW_ADAS.GTMemory6_PreviousInput_h rtDW_ADAS.GTMemory7_PreviousInput_f rtDW_ADAS.GTMemory_PreviousInput_n0 /end REF_MEASUREMENT
/end GROUP
/begin GROUP ADAS_FuncLevel_FCW_AEB_Solver_Subsystem1_Target1Selection_Filter_Subsystem2 "ADAS/FuncLevel/FCW_AEB/Solver/Subsystem1/Target1Selection/Filter/Subsystem2"
 /begin REF_MEASUREMENT rtDW_ADAS.GTMemory1_PreviousInput_cu rtDW_ADAS.GTMemory3_PreviousInput_d rtDW_ADAS.GTMemory4_PreviousInput_k rtDW_ADAS.GTMemory5_PreviousInput_p rtDW_ADAS.GTMemory6_PreviousInput_c rtDW_ADAS.GTMemory7_PreviousInput_c rtDW_ADAS.GTMemory_PreviousInput_g3 /end REF_MEASUREMENT
/end GROUP
/begin GROUP ADAS_FuncLevel_FCW_AEB_Solver_Subsystem1_Target1Selection_Filter_Subsystem3 "ADAS/FuncLevel/FCW_AEB/Solver/Subsystem1/Target1Selection/Filter/Subsystem3"
 /begin REF_MEASUREMENT rtDW_ADAS.GTMemory1_PreviousInput_bn rtDW_ADAS.GTMemory3_PreviousInput_l1 rtDW_ADAS.GTMemory4_PreviousInput_i rtDW_ADAS.GTMemory5_PreviousInput_k rtDW_ADAS.GTMemory6_PreviousInput_os rtDW_ADAS.GTMemory7_PreviousInput_kt rtDW_ADAS.GTMemory_PreviousInput_p /end REF_MEASUREMENT
/end GROUP
/begin GROUP ADAS_FuncLevel_FCW_AEB_Solver_Subsystem1_Target1Selection_Filter_Subsystem4 "ADAS/FuncLevel/FCW_AEB/Solver/Subsystem1/Target1Selection/Filter/Subsystem4"
 /begin REF_MEASUREMENT rtDW_ADAS.GTMemory1_PreviousInput_b rtDW_ADAS.GTMemory3_PreviousInput_n rtDW_ADAS.GTMemory4_PreviousInput_aa rtDW_ADAS.GTMemory5_PreviousInput_c rtDW_ADAS.GTMemory6_PreviousInput_o rtDW_ADAS.GTMemory7_PreviousInput_ez rtDW_ADAS.GTMemory_PreviousInput_eh /end REF_MEASUREMENT
/end GROUP
/begin GROUP ADAS_FuncLevel_FCW_AEB_Solver_Subsystem1_Target1Selection_Filter_Subsystem5 "ADAS/FuncLevel/FCW_AEB/Solver/Subsystem1/Target1Selection/Filter/Subsystem5"
 /begin REF_MEASUREMENT rtDW_ADAS.GTMemory1_PreviousInput_k rtDW_ADAS.GTMemory3_PreviousInput_a rtDW_ADAS.GTMemory4_PreviousInput_af rtDW_ADAS.GTMemory5_PreviousInput_g rtDW_ADAS.GTMemory6_PreviousInput_oi rtDW_ADAS.GTMemory7_PreviousInput_k rtDW_ADAS.GTMemory_PreviousInput_i /end REF_MEASUREMENT
/end GROUP
/begin GROUP ADAS_FuncLevel_FCW_AEB_Solver_Subsystem1_Target1Selection_Subsystem1 "ADAS/FuncLevel/FCW_AEB/Solver/Subsystem1/Target1Selection/Subsystem1" /begin REF_MEASUREMENT rtDW_ADAS.GTAdd1_m rtDW_ADAS.GTAdd2_e /end REF_MEASUREMENT /end GROUP
/begin GROUP ADAS_FuncLevel_FCW_AEB_Solver_Subsystem_Subsystem "ADAS/FuncLevel/FCW_AEB/Solver/Subsystem/Subsystem"
 /begin SUB_GROUP ADAS_FuncLevel_FCW_AEB_Solver_Subsystem_Subsystem_Changing_parameters_before_reaching__ref_deceleration___2_Full1 ADAS_FuncLevel_FCW_AEB_Solver_Subsystem_Subsystem_Changing_parameters_during_Full1 ADAS_FuncLevel_FCW_AEB_Solver_Subsystem_Subsystem_PID_Controller2 ADAS_FuncLevel_FCW_AEB_Solver_Subsystem_Subsystem_Saturation_Dynamic /end SUB_GROUP
 /begin REF_MEASUREMENT rtDW_ADAS.GTMemory1_PreviousInput_au /end REF_MEASUREMENT
/end GROUP
/begin GROUP ADAS_FuncLevel_FCW_AEB_Solver_Subsystem_Subsystem_Changing_parameters_before_reaching__ref_deceleration___2_Full1 "ADAS/FuncLevel/FCW_AEB/Solver/Subsystem/Subsystem/Changing parameters before reaching (ref deceleration)//2 Full1"
 /begin SUB_GROUP ADAS_FuncLevel_FCW_AEB_Solver_Subsystem_Subsystem_Changing_parameters_before_reaching__ref_deceleration___2_Full1_Sx_before_transition_to_a_ref_deceleration ADAS_FuncLevel_FCW_AEB_Solver_Subsystem_Subsystem_Changing_parameters_before_reaching__ref_deceleration___2_Full1_Ti_before_transition_to_a_ref_deceleration /end SUB_GROUP
/end GROUP
/begin GROUP ADAS_FuncLevel_FCW_AEB_Solver_Subsystem_Subsystem_Changing_parameters_before_reaching__ref_deceleration___2_Full1_Ti_before_transition_to_a_ref_deceleration "ADAS/FuncLevel/FCW_AEB/Solver/Subsystem/Subsystem/Changing parameters before reaching (ref deceleration)//2 Full1/Ti before transition to a ref deceleration" /begin REF_MEASUREMENT rtConstB_ADAS.GTGain1 /end REF_MEASUREMENT /end GROUP
/begin GROUP ADAS_FuncLevel_FCW_AEB_Solver_Subsystem_Subsystem_PID_Controller2 "ADAS/FuncLevel/FCW_AEB/Solver/Subsystem/Subsystem/PID Controller2"
 /begin SUB_GROUP ADAS_FuncLevel_FCW_AEB_Solver_Subsystem_Subsystem_PID_Controller2_Anti_windup ADAS_FuncLevel_FCW_AEB_Solver_Subsystem_Subsystem_PID_Controller2_D_Gain ADAS_FuncLevel_FCW_AEB_Solver_Subsystem_Subsystem_PID_Controller2_Filter ADAS_FuncLevel_FCW_AEB_Solver_Subsystem_Subsystem_PID_Controller2_Filter_ICs ADAS_FuncLevel_FCW_AEB_Solver_Subsystem_Subsystem_PID_Controller2_I_Gain ADAS_FuncLevel_FCW_AEB_Solver_Subsystem_Subsystem_PID_Controller2_Ideal_P_Gain ADAS_FuncLevel_FCW_AEB_Solver_Subsystem_Subsystem_PID_Controller2_Ideal_P_Gain_Fdbk ADAS_FuncLevel_FCW_AEB_Solver_Subsystem_Subsystem_PID_Controller2_Integrator /end SUB_GROUP
/end GROUP
/begin GROUP ADAS_FuncLevel_FCW_AEB_Solver_Subsystem_Subsystem_PID_Controller2_Integrator "ADAS/FuncLevel/FCW_AEB/Solver/Subsystem/Subsystem/PID Controller2/Integrator"
 /begin SUB_GROUP ADAS_FuncLevel_FCW_AEB_Solver_Subsystem_Subsystem_PID_Controller2_Integrator_Discrete /end SUB_GROUP
/end GROUP
/begin GROUP ADAS_FuncLevel_FCW_AEB_Solver_Subsystem_Subsystem_PID_Controller2_Integrator_Discrete "ADAS/FuncLevel/FCW_AEB/Solver/Subsystem/Subsystem/PID Controller2/Integrator/Discrete" /begin REF_MEASUREMENT rtDW_ADAS.GTIntegrator_DSTATE /end REF_MEASUREMENT /end GROUP
/begin GROUP ADAS_FuncLevel_FCW_AEB_Solver_Subsystem_Subsystem_Saturation_Dynamic "ADAS/FuncLevel/FCW_AEB/Solver/Subsystem/Subsystem/Saturation
Dynamic" /begin REF_MEASUREMENT rtDW_ADAS.GTSwitch2 /end REF_MEASUREMENT /end GROUP
/begin GROUP ADAS_FuncLevel_LCC_ALCC "ADAS/FuncLevel/LCC_ALCC"
 /begin SUB_GROUP ADAS_FuncLevel_LCC_ALCC_Mode_selector ADAS_FuncLevel_LCC_ALCC_Solver /end SUB_GROUP
/end GROUP
/begin GROUP ADAS_FuncLevel_LCC_ALCC_Mode_selector "ADAS/FuncLevel/LCC_ALCC/Mode selector"
 /begin SUB_GROUP ADAS_FuncLevel_LCC_ALCC_Mode_selector_Compare_To_Constant ADAS_FuncLevel_LCC_ALCC_Mode_selector_Compare_To_Constant1 ADAS_FuncLevel_LCC_ALCC_Mode_selector_Compare_To_Constant2 ADAS_FuncLevel_LCC_ALCC_Mode_selector_Compare_To_Constant4 ADAS_FuncLevel_LCC_ALCC_Mode_selector_Drive ADAS_FuncLevel_LCC_ALCC_Mode_selector_Neutral /end SUB_GROUP
 /begin REF_MEASUREMENT rtDW_ADAS.GTDtLogLccLogicTrans rtDW_ADAS.GTLccActvnMode rtDW_ADAS.GTis_ON_l rtDW_ADAS.GTis_active_c30_ADAS rtDW_ADAS.GTis_c30_ADAS /end REF_MEASUREMENT
/end GROUP
/begin GROUP ADAS_FuncLevel_LCC_ALCC_Mode_selector_Compare_To_Constant "ADAS/FuncLevel/LCC_ALCC/Mode selector/Compare
To Constant" /begin REF_MEASUREMENT rtDW_ADAS.GTLccActvnMode /end REF_MEASUREMENT /end GROUP
/begin GROUP ADAS_FuncLevel_LCC_ALCC_Solver "ADAS/FuncLevel/LCC_ALCC/Solver"
 /begin SUB_GROUP ADAS_FuncLevel_LCC_ALCC_Solver_BSW_and_CVW ADAS_FuncLevel_LCC_ALCC_Solver_CarParameters ADAS_FuncLevel_LCC_ALCC_Solver_LCC_warning_requester_left ADAS_FuncLevel_LCC_ALCC_Solver_LCC_warning_requester_right /end SUB_GROUP
 /begin REF_MEASUREMENT rtDW_ADAS.GTCVW_req rtDW_ADAS.GTCVW_req_p rtDW_ADAS.GTCastToBoolean3 rtDW_ADAS.GTCastToBoolean3_p rtDW_ADAS.GTDtLogLccWarnReqTrans rtDW_ADAS.GTDtLogLccWarnReqTransLeft rtDW_ADAS.GTDtLogLccWarnReqTransRight rtDW_ADAS.GTDtLogLccWarnReqTrans_a rtDW_ADAS.GTLccLeftLedReq rtDW_ADAS.GTLccLeftWarnReq rtDW_ADAS.GTLccRightLedReq rtDW_ADAS.GTLccRightWarnReq rtDW_ADAS.GTLccSoundReq rtDW_ADAS.GTLccVibrWarnReq rtDW_ADAS.GTisObjInCvwZone_uint8 rtDW_ADAS.GTisObjInCvwZone_uint8_o rtDW_ADAS.GTisObjInLeftCvwZone rtDW_ADAS.GTisObjInRightCvwZone rtDW_ADAS.GTis_active_c226_ADAS rtDW_ADAS.GTis_active_c227_ADAS rtDW_ADAS.GTis_active_c228_ADAS rtDW_ADAS.GTis_active_c229_ADAS rtDW_ADAS.GTis_active_c230_ADAS rtDW_ADAS.GTis_c226_ADAS rtDW_ADAS.GTis_c227_ADAS rtDW_ADAS.GTis_c228_ADAS rtDW_ADAS.GTis_c229_ADAS rtDW_ADAS.GTis_c230_ADAS rtDW_ADAS.GTtemporalCounter_i1_f rtDW_ADAS.GTtemporalCounter_i1_g rtDW_ADAS.GTtemporalCounter_i1_hkp rtDW_ADAS.GTtemporalCounter_i1_hz rtDW_ADAS.GTtemporalCounter_i1_n /end REF_MEASUREMENT
/end GROUP
/begin GROUP ADAS_FuncLevel_LCC_ALCC_Solver_BSW_and_CVW "ADAS/FuncLevel/LCC_ALCC/Solver/BSW_and_CVW"
 /begin SUB_GROUP ADAS_FuncLevel_LCC_ALCC_Solver_BSW_and_CVW_LCC_BSW_OneSide_Left ADAS_FuncLevel_LCC_ALCC_Solver_BSW_and_CVW_LCC_BSW_OneSide_Right ADAS_FuncLevel_LCC_ALCC_Solver_BSW_and_CVW_LCC_CVW_OneSide_Left ADAS_FuncLevel_LCC_ALCC_Solver_BSW_and_CVW_LCC_CVW_OneSide_Right ADAS_FuncLevel_LCC_ALCC_Solver_BSW_and_CVW_LccModeChanger /end SUB_GROUP
/end GROUP
/begin GROUP ADAS_FuncLevel_LCC_ALCC_Solver_BSW_and_CVW_LCC_BSW_OneSide_Left "ADAS/FuncLevel/LCC_ALCC/Solver/BSW_and_CVW/LCC_BSW_OneSide_Left"
 /begin SUB_GROUP ADAS_FuncLevel_LCC_ALCC_Solver_BSW_and_CVW_LCC_BSW_OneSide_Left_BSW_OneSide_Solver /end SUB_GROUP
/end GROUP
/begin GROUP ADAS_FuncLevel_LCC_ALCC_Solver_BSW_and_CVW_LCC_BSW_OneSide_Left_BSW_OneSide_Solver "ADAS/FuncLevel/LCC_ALCC/Solver/BSW_and_CVW/LCC_BSW_OneSide_Left/BSW_OneSide_Solver" /begin REF_MEASUREMENT rtDW_ADAS.GTCastToBoolean3_p /end REF_MEASUREMENT /end GROUP
/begin GROUP ADAS_FuncLevel_LCC_ALCC_Solver_BSW_and_CVW_LCC_BSW_OneSide_Right "ADAS/FuncLevel/LCC_ALCC/Solver/BSW_and_CVW/LCC_BSW_OneSide_Right"
 /begin SUB_GROUP ADAS_FuncLevel_LCC_ALCC_Solver_BSW_and_CVW_LCC_BSW_OneSide_Right_BSW_OneSide_Solver /end SUB_GROUP
/end GROUP
/begin GROUP ADAS_FuncLevel_LCC_ALCC_Solver_BSW_and_CVW_LCC_BSW_OneSide_Right_BSW_OneSide_Solver "ADAS/FuncLevel/LCC_ALCC/Solver/BSW_and_CVW/LCC_BSW_OneSide_Right/BSW_OneSide_Solver" /begin REF_MEASUREMENT rtDW_ADAS.GTCastToBoolean3 /end REF_MEASUREMENT /end GROUP
/begin GROUP ADAS_FuncLevel_LCC_ALCC_Solver_BSW_and_CVW_LCC_CVW_OneSide_Left "ADAS/FuncLevel/LCC_ALCC/Solver/BSW_and_CVW/LCC_CVW_OneSide_Left"
 /begin SUB_GROUP ADAS_FuncLevel_LCC_ALCC_Solver_BSW_and_CVW_LCC_CVW_OneSide_Left_CVW_OneSide_solver /end SUB_GROUP
/end GROUP
/begin GROUP ADAS_FuncLevel_LCC_ALCC_Solver_BSW_and_CVW_LCC_CVW_OneSide_Left_CVW_OneSide_solver "ADAS/FuncLevel/LCC_ALCC/Solver/BSW_and_CVW/LCC_CVW_OneSide_Left/CVW_OneSide_solver" /begin REF_MEASUREMENT rtDW_ADAS.GTCVW_req_p rtDW_ADAS.GTisObjInCvwZone_uint8_o /end REF_MEASUREMENT /end GROUP
/begin GROUP ADAS_FuncLevel_LCC_ALCC_Solver_BSW_and_CVW_LCC_CVW_OneSide_Right "ADAS/FuncLevel/LCC_ALCC/Solver/BSW_and_CVW/LCC_CVW_OneSide_Right"
 /begin SUB_GROUP ADAS_FuncLevel_LCC_ALCC_Solver_BSW_and_CVW_LCC_CVW_OneSide_Right_CVW_OneSide_solver /end SUB_GROUP
/end GROUP
/begin GROUP ADAS_FuncLevel_LCC_ALCC_Solver_BSW_and_CVW_LCC_CVW_OneSide_Right_CVW_OneSide_solver "ADAS/FuncLevel/LCC_ALCC/Solver/BSW_and_CVW/LCC_CVW_OneSide_Right/CVW_OneSide_solver" /begin REF_MEASUREMENT rtDW_ADAS.GTCVW_req rtDW_ADAS.GTisObjInCvwZone_uint8 /end REF_MEASUREMENT /end GROUP
/begin GROUP ADAS_FuncLevel_LCC_ALCC_Solver_LCC_warning_requester_left "ADAS/FuncLevel/LCC_ALCC/Solver/LCC_warning_requester_left" /begin REF_MEASUREMENT rtDW_ADAS.GTDtLogLccWarnReqTrans_a /end REF_MEASUREMENT /end GROUP
/begin GROUP ADAS_FuncLevel_LCC_ALCC_Solver_LCC_warning_requester_right "ADAS/FuncLevel/LCC_ALCC/Solver/LCC_warning_requester_right" /begin REF_MEASUREMENT rtDW_ADAS.GTDtLogLccWarnReqTrans /end REF_MEASUREMENT /end GROUP
/begin GROUP ADAS_FuncLevel_LDW_LDP "ADAS/FuncLevel/LDW_LDP"
 /begin SUB_GROUP ADAS_FuncLevel_LDW_LDP_Compare_To_Constant1 ADAS_FuncLevel_LDW_LDP_LDW_calculation_29_05_2025 ADAS_FuncLevel_LDW_LDP_LDW_mode_27_09_2024 /end SUB_GROUP
/end GROUP
/begin GROUP ADAS_FuncLevel_LDW_LDP_Compare_To_Constant1 "ADAS/FuncLevel/LDW_LDP/Compare
To Constant1" /begin REF_MEASUREMENT rtDW_ADAS.GTLdwModeLogic /end REF_MEASUREMENT /end GROUP
/begin GROUP ADAS_FuncLevel_LDW_LDP_LDW_calculation_29_05_2025 "ADAS/FuncLevel/LDW_LDP/LDW calculation
29_05_2025"
 /begin SUB_GROUP ADAS_FuncLevel_LDW_LDP_LDW_calculation_29_05_2025_Compare_To_Constant ADAS_FuncLevel_LDW_LDP_LDW_calculation_29_05_2025_Compare_To_Constant1 ADAS_FuncLevel_LDW_LDP_LDW_calculation_29_05_2025_Compare_To_Constant10 ADAS_FuncLevel_LDW_LDP_LDW_calculation_29_05_2025_Compare_To_Constant11 ADAS_FuncLevel_LDW_LDP_LDW_calculation_29_05_2025_Compare_To_Constant12 ADAS_FuncLevel_LDW_LDP_LDW_calculation_29_05_2025_Compare_To_Constant13 ADAS_FuncLevel_LDW_LDP_LDW_calculation_29_05_2025_Compare_To_Constant2 ADAS_FuncLevel_LDW_LDP_LDW_calculation_29_05_2025_Compare_To_Constant4 ADAS_FuncLevel_LDW_LDP_LDW_calculation_29_05_2025_Compare_To_Constant6 ADAS_FuncLevel_LDW_LDP_LDW_calculation_29_05_2025_Compare_To_Constant7 ADAS_FuncLevel_LDW_LDP_LDW_calculation_29_05_2025_Compare_To_Constant8 ADAS_FuncLevel_LDW_LDP_LDW_calculation_29_05_2025_Compare_To_Constant9 ADAS_FuncLevel_LDW_LDP_LDW_calculation_29_05_2025_Detect_Increase ADAS_FuncLevel_LDW_LDP_LDW_calculation_29_05_2025_Detect_Increase2 ADAS_FuncLevel_LDW_LDP_LDW_calculation_29_05_2025_LEFT_SIDE_SOLVER ADAS_FuncLevel_LDW_LDP_LDW_calculation_29_05_2025_RIGHT_SIDE_SOLVER ADAS_FuncLevel_LDW_LDP_LDW_calculation_29_05_2025_WARN_COUNTER_LDW /end SUB_GROUP
 /begin REF_MEASUREMENT rtDW_ADAS.GTDelay2_DSTATE_j rtDW_ADAS.GTDelay3_DSTATE_a rtDW_ADAS.GTDelay4_DSTATE rtDW_ADAS.GTDelay5_DSTATE_e rtDW_ADAS.GTDelay6_DSTATE_m rtDW_ADAS.GTDelay7_DSTATE rtDW_ADAS.GTMemory1_PreviousInput_b0 rtDW_ADAS.GTMemory2_PreviousInput rtDW_ADAS.GTMemory3_PreviousInput rtDW_ADAS.GTMemory6_PreviousInput rtDW_ADAS.GTMemory7_PreviousInput rtDW_ADAS.GTMemory8_PreviousInput rtDW_ADAS.GTMemory9_PreviousInput rtDW_ADAS.GTMemory_PreviousInput_hu rtDW_ADAS.GTOutportBufferForWarnBlockSt_e rtDW_ADAS.GTOutportBufferForWarnBlockSts rtDW_ADAS.GTVehPos rtDW_ADAS.GTVehPos_m rtDW_ADAS.GTWarnOut rtDW_ADAS.GTWarnOut_c rtDW_ADAS.GTy rtDW_ADAS.GTy_e /end REF_MEASUREMENT
/end GROUP
/begin GROUP ADAS_FuncLevel_LDW_LDP_LDW_calculation_29_05_2025_Compare_To_Constant "ADAS/FuncLevel/LDW_LDP/LDW calculation
29_05_2025/Compare
To Constant" /begin REF_MEASUREMENT rtDW_ADAS.GTLdwModeLogic /end REF_MEASUREMENT /end GROUP
/begin GROUP ADAS_FuncLevel_LDW_LDP_LDW_calculation_29_05_2025_Compare_To_Constant1 "ADAS/FuncLevel/LDW_LDP/LDW calculation
29_05_2025/Compare
To Constant1" /begin REF_MEASUREMENT rtDW_ADAS.GTLdwModeLogic /end REF_MEASUREMENT /end GROUP
/begin GROUP ADAS_FuncLevel_LDW_LDP_LDW_calculation_29_05_2025_Compare_To_Constant2 "ADAS/FuncLevel/LDW_LDP/LDW calculation
29_05_2025/Compare
To Constant2" /begin REF_MEASUREMENT rtDW_ADAS.GTLdwModeLogic /end REF_MEASUREMENT /end GROUP
/begin GROUP ADAS_FuncLevel_LDW_LDP_LDW_calculation_29_05_2025_Compare_To_Constant6 "ADAS/FuncLevel/LDW_LDP/LDW calculation
29_05_2025/Compare
To Constant6" /begin REF_MEASUREMENT rtDW_ADAS.GTLdwModeLogic /end REF_MEASUREMENT /end GROUP
/begin GROUP ADAS_FuncLevel_LDW_LDP_LDW_calculation_29_05_2025_Detect_Increase "ADAS/FuncLevel/LDW_LDP/LDW calculation
29_05_2025/Detect
Increase" /begin REF_MEASUREMENT rtDW_ADAS.GTDelayInput1_DSTATE_cgu /end REF_MEASUREMENT /end GROUP
/begin GROUP ADAS_FuncLevel_LDW_LDP_LDW_calculation_29_05_2025_Detect_Increase2 "ADAS/FuncLevel/LDW_LDP/LDW calculation
29_05_2025/Detect
Increase2" /begin REF_MEASUREMENT rtDW_ADAS.GTDelayInput1_DSTATE_ky /end REF_MEASUREMENT /end GROUP
/begin GROUP ADAS_FuncLevel_LDW_LDP_LDW_calculation_29_05_2025_LEFT_SIDE_SOLVER "ADAS/FuncLevel/LDW_LDP/LDW calculation
29_05_2025/LEFT SIDE SOLVER"
 /begin SUB_GROUP ADAS_FuncLevel_LDW_LDP_LDW_calculation_29_05_2025_LEFT_SIDE_SOLVER_LDW_side_solver /end SUB_GROUP
 /begin REF_MEASUREMENT rtDW_ADAS.GTOutportBufferForWarnReq_f /end REF_MEASUREMENT
/end GROUP
/begin GROUP ADAS_FuncLevel_LDW_LDP_LDW_calculation_29_05_2025_LEFT_SIDE_SOLVER_LDW_side_solver "ADAS/FuncLevel/LDW_LDP/LDW calculation
29_05_2025/LEFT SIDE SOLVER/LDW side solver"
 /begin SUB_GROUP ADAS_FuncLevel_LDW_LDP_LDW_calculation_29_05_2025_LEFT_SIDE_SOLVER_LDW_side_solver_AVOIDANCE ADAS_FuncLevel_LDW_LDP_LDW_calculation_29_05_2025_LEFT_SIDE_SOLVER_LDW_side_solver_CORRECTION ADAS_FuncLevel_LDW_LDP_LDW_calculation_29_05_2025_LEFT_SIDE_SOLVER_LDW_side_solver_Compare_To_Constant5 ADAS_FuncLevel_LDW_LDP_LDW_calculation_29_05_2025_LEFT_SIDE_SOLVER_LDW_side_solver_PREDICTION ADAS_FuncLevel_LDW_LDP_LDW_calculation_29_05_2025_LEFT_SIDE_SOLVER_LDW_side_solver_TTLC ADAS_FuncLevel_LDW_LDP_LDW_calculation_29_05_2025_LEFT_SIDE_SOLVER_LDW_side_solver_V_departure /end SUB_GROUP
 /begin REF_MEASUREMENT rtDW_ADAS.GTMinTLC_k rtDW_ADAS.GTRateLimiter_i rtDW_ADAS.GTTransTTLC_o rtDW_ADAS.GTTransVehPosition_a rtDW_ADAS.GTTransWarnBlocking_a rtDW_ADAS.GTWarnBlockSts_p rtDW_ADAS.GTWarnPredict_o rtDW_ADAS.GTYR_dt_c /end REF_MEASUREMENT
/end GROUP
/begin GROUP ADAS_FuncLevel_LDW_LDP_LDW_calculation_29_05_2025_LEFT_SIDE_SOLVER_LDW_side_solver_AVOIDANCE "ADAS/FuncLevel/LDW_LDP/LDW calculation
29_05_2025/LEFT SIDE SOLVER/LDW side solver/AVOIDANCE" /begin REF_MEASUREMENT rtDW_ADAS.GTYR_dt_c /end REF_MEASUREMENT /end GROUP
/begin GROUP ADAS_FuncLevel_LDW_LDP_LDW_calculation_29_05_2025_LEFT_SIDE_SOLVER_LDW_side_solver_CORRECTION "ADAS/FuncLevel/LDW_LDP/LDW calculation
29_05_2025/LEFT SIDE SOLVER/LDW side solver/CORRECTION" /begin REF_MEASUREMENT rtDW_ADAS.GTR rtDW_ADAS.GTRateLimiter_i /end REF_MEASUREMENT /end GROUP
/begin GROUP ADAS_FuncLevel_LDW_LDP_LDW_calculation_29_05_2025_LEFT_SIDE_SOLVER_LDW_side_solver_PREDICTION "ADAS/FuncLevel/LDW_LDP/LDW calculation
29_05_2025/LEFT SIDE SOLVER/LDW side solver/PREDICTION" /begin REF_MEASUREMENT rtDW_ADAS.GTMinTLC_k rtDW_ADAS.GTWarnPredict_o /end REF_MEASUREMENT /end GROUP
/begin GROUP ADAS_FuncLevel_LDW_LDP_LDW_calculation_29_05_2025_LEFT_SIDE_SOLVER_LDW_side_solver_V_departure "ADAS/FuncLevel/LDW_LDP/LDW calculation
29_05_2025/LEFT SIDE SOLVER/LDW side solver/V_departure"
 /begin SUB_GROUP ADAS_FuncLevel_LDW_LDP_LDW_calculation_29_05_2025_LEFT_SIDE_SOLVER_LDW_side_solver_V_departure_Discrete_Derivative /end SUB_GROUP
/end GROUP
/begin GROUP ADAS_FuncLevel_LDW_LDP_LDW_calculation_29_05_2025_LEFT_SIDE_SOLVER_LDW_side_solver_V_departure_Discrete_Derivative "ADAS/FuncLevel/LDW_LDP/LDW calculation
29_05_2025/LEFT SIDE SOLVER/LDW side solver/V_departure/Discrete Derivative" /begin REF_MEASUREMENT rtDW_ADAS.GTUD_DSTATE_k /end REF_MEASUREMENT /end GROUP
/begin GROUP ADAS_FuncLevel_LDW_LDP_LDW_calculation_29_05_2025_RIGHT_SIDE_SOLVER "ADAS/FuncLevel/LDW_LDP/LDW calculation
29_05_2025/RIGHT SIDE SOLVER"
 /begin SUB_GROUP ADAS_FuncLevel_LDW_LDP_LDW_calculation_29_05_2025_RIGHT_SIDE_SOLVER_LDW_side_solver /end SUB_GROUP
 /begin REF_MEASUREMENT rtDW_ADAS.GTOutportBufferForWarnReq /end REF_MEASUREMENT
/end GROUP
/begin GROUP ADAS_FuncLevel_LDW_LDP_LDW_calculation_29_05_2025_RIGHT_SIDE_SOLVER_LDW_side_solver "ADAS/FuncLevel/LDW_LDP/LDW calculation
29_05_2025/RIGHT SIDE SOLVER/LDW side solver"
 /begin SUB_GROUP ADAS_FuncLevel_LDW_LDP_LDW_calculation_29_05_2025_RIGHT_SIDE_SOLVER_LDW_side_solver_AVOIDANCE ADAS_FuncLevel_LDW_LDP_LDW_calculation_29_05_2025_RIGHT_SIDE_SOLVER_LDW_side_solver_CORRECTION ADAS_FuncLevel_LDW_LDP_LDW_calculation_29_05_2025_RIGHT_SIDE_SOLVER_LDW_side_solver_Compare_To_Constant5 ADAS_FuncLevel_LDW_LDP_LDW_calculation_29_05_2025_RIGHT_SIDE_SOLVER_LDW_side_solver_PREDICTION ADAS_FuncLevel_LDW_LDP_LDW_calculation_29_05_2025_RIGHT_SIDE_SOLVER_LDW_side_solver_TTLC ADAS_FuncLevel_LDW_LDP_LDW_calculation_29_05_2025_RIGHT_SIDE_SOLVER_LDW_side_solver_V_departure /end SUB_GROUP
 /begin REF_MEASUREMENT rtDW_ADAS.GTMinTLC rtDW_ADAS.GTRateLimiter rtDW_ADAS.GTTransVehPosition_i rtDW_ADAS.GTWarnBlockSts rtDW_ADAS.GTWarnPredict_e rtDW_ADAS.GTYR_dt /end REF_MEASUREMENT
/end GROUP
/begin GROUP ADAS_FuncLevel_LDW_LDP_LDW_calculation_29_05_2025_RIGHT_SIDE_SOLVER_LDW_side_solver_AVOIDANCE "ADAS/FuncLevel/LDW_LDP/LDW calculation
29_05_2025/RIGHT SIDE SOLVER/LDW side solver/AVOIDANCE" /begin REF_MEASUREMENT rtDW_ADAS.GTYR_dt /end REF_MEASUREMENT /end GROUP
/begin GROUP ADAS_FuncLevel_LDW_LDP_LDW_calculation_29_05_2025_RIGHT_SIDE_SOLVER_LDW_side_solver_CORRECTION "ADAS/FuncLevel/LDW_LDP/LDW calculation
29_05_2025/RIGHT SIDE SOLVER/LDW side solver/CORRECTION" /begin REF_MEASUREMENT rtDW_ADAS.GTRateLimiter /end REF_MEASUREMENT /end GROUP
/begin GROUP ADAS_FuncLevel_LDW_LDP_LDW_calculation_29_05_2025_RIGHT_SIDE_SOLVER_LDW_side_solver_PREDICTION "ADAS/FuncLevel/LDW_LDP/LDW calculation
29_05_2025/RIGHT SIDE SOLVER/LDW side solver/PREDICTION" /begin REF_MEASUREMENT rtDW_ADAS.GTMinTLC rtDW_ADAS.GTWarnPredict_e /end REF_MEASUREMENT /end GROUP
/begin GROUP ADAS_FuncLevel_LDW_LDP_LDW_calculation_29_05_2025_RIGHT_SIDE_SOLVER_LDW_side_solver_V_departure "ADAS/FuncLevel/LDW_LDP/LDW calculation
29_05_2025/RIGHT SIDE SOLVER/LDW side solver/V_departure"
 /begin SUB_GROUP ADAS_FuncLevel_LDW_LDP_LDW_calculation_29_05_2025_RIGHT_SIDE_SOLVER_LDW_side_solver_V_departure_Discrete_Derivative /end SUB_GROUP
/end GROUP
/begin GROUP ADAS_FuncLevel_LDW_LDP_LDW_calculation_29_05_2025_RIGHT_SIDE_SOLVER_LDW_side_solver_V_departure_Discrete_Derivative "ADAS/FuncLevel/LDW_LDP/LDW calculation
29_05_2025/RIGHT SIDE SOLVER/LDW side solver/V_departure/Discrete Derivative" /begin REF_MEASUREMENT rtDW_ADAS.GTUD_DSTATE_j /end REF_MEASUREMENT /end GROUP
/begin GROUP ADAS_FuncLevel_LDW_LDP_LDW_calculation_29_05_2025_WARN_COUNTER_LDW "ADAS/FuncLevel/LDW_LDP/LDW calculation
29_05_2025/WARN COUNTER LDW"
 /begin SUB_GROUP ADAS_FuncLevel_LDW_LDP_LDW_calculation_29_05_2025_WARN_COUNTER_LDW_Detect_Rise_Positive /end SUB_GROUP
 /begin REF_MEASUREMENT rtDW_ADAS.GTNumOfWarn rtDW_ADAS.GTis_active_c317_ADAS /end REF_MEASUREMENT
/end GROUP
/begin GROUP ADAS_FuncLevel_LDW_LDP_LDW_calculation_29_05_2025_WARN_COUNTER_LDW_Detect_Rise_Positive "ADAS/FuncLevel/LDW_LDP/LDW calculation
29_05_2025/WARN COUNTER LDW/Detect Rise
Positive" /begin REF_MEASUREMENT rtDW_ADAS.GTDelayInput1_DSTATE_mj /end REF_MEASUREMENT /end GROUP
/begin GROUP ADAS_FuncLevel_LDW_LDP_LDW_mode_27_09_2024 "ADAS/FuncLevel/LDW_LDP/LDW mode
27_09_2024"
 /begin SUB_GROUP ADAS_FuncLevel_LDW_LDP_LDW_mode_27_09_2024_Compare_To_Constant ADAS_FuncLevel_LDW_LDP_LDW_mode_27_09_2024_Compare_To_Constant1 ADAS_FuncLevel_LDW_LDP_LDW_mode_27_09_2024_Compare_To_Constant3 ADAS_FuncLevel_LDW_LDP_LDW_mode_27_09_2024_Compare_To_Constant4 ADAS_FuncLevel_LDW_LDP_LDW_mode_27_09_2024_Compare_To_Constant5 ADAS_FuncLevel_LDW_LDP_LDW_mode_27_09_2024_Compare_To_Constant6 ADAS_FuncLevel_LDW_LDP_LDW_mode_27_09_2024_Compare_To_Constant7 ADAS_FuncLevel_LDW_LDP_LDW_mode_27_09_2024_Compare_To_Constant8 /end SUB_GROUP
 /begin REF_MEASUREMENT rtDW_ADAS.GTLdwModeLogic rtDW_ADAS.GTTimeTotal_a rtDW_ADAS.GTTimeTotal_p rtDW_ADAS.GTTransLdwMode rtDW_ADAS.GTis_ACTIVE_n rtDW_ADAS.GTis_ON_m rtDW_ADAS.GTis_active_c320_ADAS rtDW_ADAS.GTis_c320_ADAS rtDW_ADAS.GTtemporalCounter_i1_pe /end REF_MEASUREMENT
/end GROUP
/begin GROUP ADAS_FuncLevel_LDW_LDP_LDW_mode_27_09_2024_Compare_To_Constant "ADAS/FuncLevel/LDW_LDP/LDW mode
27_09_2024/Compare
To Constant" /begin REF_MEASUREMENT rtDW_ADAS.GTLdwModeLogic /end REF_MEASUREMENT /end GROUP
/begin GROUP ADAS_FuncLevel_LDW_LDP_LDW_mode_27_09_2024_Compare_To_Constant8 "ADAS/FuncLevel/LDW_LDP/LDW mode
27_09_2024/Compare
To Constant8" /begin REF_MEASUREMENT rtDW_ADAS.GTLdwModeLogic /end REF_MEASUREMENT /end GROUP
/begin GROUP ADAS_FuncLevel_LKA "ADAS/FuncLevel/LKA" /begin SUB_GROUP ADAS_FuncLevel_LKA_Compare_To_Constant /end SUB_GROUP /end GROUP
/begin GROUP ADAS_FuncLevel_LKA_Compare_To_Constant "ADAS/FuncLevel/LKA/Compare
To Constant" /begin REF_MEASUREMENT rtConstB_ADAS.GTCompare /end REF_MEASUREMENT /end GROUP
/begin GROUP ADAS_FuncLevel_MLIA "ADAS/FuncLevel/MLIA"
 /begin SUB_GROUP ADAS_FuncLevel_MLIA_Compare_To_Constant ADAS_FuncLevel_MLIA_Compare_To_Constant1 ADAS_FuncLevel_MLIA_MLIA ADAS_FuncLevel_MLIA_PROJECTION /end SUB_GROUP
/end GROUP
/begin GROUP ADAS_FuncLevel_MLIA_MLIA "ADAS/FuncLevel/MLIA/MLIA"
 /begin SUB_GROUP ADAS_FuncLevel_MLIA_MLIA_Compare_To_Constant4 ADAS_FuncLevel_MLIA_MLIA_MLIA_calculation ADAS_FuncLevel_MLIA_MLIA_MLIA_mode /end SUB_GROUP
/end GROUP
/begin GROUP ADAS_FuncLevel_MLIA_MLIA_MLIA_calculation "ADAS/FuncLevel/MLIA/MLIA/MLIA calculation"
 /begin SUB_GROUP ADAS_FuncLevel_MLIA_MLIA_MLIA_calculation_Angles_for_welcome_and__farewell_animation__objects_9_10_ ADAS_FuncLevel_MLIA_MLIA_MLIA_calculation_Compare_To_Constant ADAS_FuncLevel_MLIA_MLIA_MLIA_calculation_Compare_To_Constant1 ADAS_FuncLevel_MLIA_MLIA_MLIA_calculation_Compare_To_Constant2 ADAS_FuncLevel_MLIA_MLIA_MLIA_calculation_Object_position_in_each_HL_coordinate_system ADAS_FuncLevel_MLIA_MLIA_MLIA_calculation_Target_LEDs /end SUB_GROUP
/end GROUP
/begin GROUP ADAS_FuncLevel_MLIA_MLIA_MLIA_calculation_Angles_for_welcome_and__farewell_animation__objects_9_10_ "ADAS/FuncLevel/MLIA/MLIA/MLIA calculation/Angles for welcome and 
farewell animation (objects 9-10)"
 /begin SUB_GROUP ADAS_FuncLevel_MLIA_MLIA_MLIA_calculation_Angles_for_welcome_and__farewell_animation__objects_9_10__Bye_type ADAS_FuncLevel_MLIA_MLIA_MLIA_calculation_Angles_for_welcome_and__farewell_animation__objects_9_10__Compare_To_Constant ADAS_FuncLevel_MLIA_MLIA_MLIA_calculation_Angles_for_welcome_and__farewell_animation__objects_9_10__Compare_To_Constant1 ADAS_FuncLevel_MLIA_MLIA_MLIA_calculation_Angles_for_welcome_and__farewell_animation__objects_9_10__Compare_To_Constant2 ADAS_FuncLevel_MLIA_MLIA_MLIA_calculation_Angles_for_welcome_and__farewell_animation__objects_9_10__Compare_To_Constant3 ADAS_FuncLevel_MLIA_MLIA_MLIA_calculation_Angles_for_welcome_and__farewell_animation__objects_9_10__Compare_To_Constant4 ADAS_FuncLevel_MLIA_MLIA_MLIA_calculation_Angles_for_welcome_and__farewell_animation__objects_9_10__Compare_To_Constant5 ADAS_FuncLevel_MLIA_MLIA_MLIA_calculation_Angles_for_welcome_and__farewell_animation__objects_9_10__Compare_To_Constant6 ADAS_FuncLevel_MLIA_MLIA_MLIA_calculation_Angles_for_welcome_and__farewell_animation__objects_9_10__Compare_To_Constant7 ADAS_FuncLevel_MLIA_MLIA_MLIA_calculation_Angles_for_welcome_and__farewell_animation__objects_9_10__Compare_To_Constant8 ADAS_FuncLevel_MLIA_MLIA_MLIA_calculation_Angles_for_welcome_and__farewell_animation__objects_9_10__Compare_To_Constant9 ADAS_FuncLevel_MLIA_MLIA_MLIA_calculation_Angles_for_welcome_and__farewell_animation__objects_9_10__Welcome_type /end SUB_GROUP
 /begin REF_MEASUREMENT rtDW_ADAS.GTByeSts_ag rtDW_ADAS.GTMemory1_PreviousInput_h rtDW_ADAS.GTMemory2_PreviousInput_mi rtDW_ADAS.GTMemory3_PreviousInput_gl rtDW_ADAS.GTMemory5_PreviousInput_b rtDW_ADAS.GTWelcomeSts_f /end REF_MEASUREMENT
/end GROUP
/begin GROUP ADAS_FuncLevel_MLIA_MLIA_MLIA_calculation_Angles_for_welcome_and__farewell_animation__objects_9_10__Bye_type "ADAS/FuncLevel/MLIA/MLIA/MLIA calculation/Angles for welcome and 
farewell animation (objects 9-10)/Bye type"
 /begin SUB_GROUP ADAS_FuncLevel_MLIA_MLIA_MLIA_calculation_Angles_for_welcome_and__farewell_animation__objects_9_10__Bye_type_Bye_type_from_center_to_edge ADAS_FuncLevel_MLIA_MLIA_MLIA_calculation_Angles_for_welcome_and__farewell_animation__objects_9_10__Bye_type_Bye_type_from_edge_to_center /end SUB_GROUP
/end GROUP
/begin GROUP ADAS_FuncLevel_MLIA_MLIA_MLIA_calculation_Angles_for_welcome_and__farewell_animation__objects_9_10__Bye_type_Bye_type_from_center_to_edge "ADAS/FuncLevel/MLIA/MLIA/MLIA calculation/Angles for welcome and 
farewell animation (objects 9-10)/Bye type/Bye type
from center to edge"
 /begin SUB_GROUP ADAS_FuncLevel_MLIA_MLIA_MLIA_calculation_Angles_for_welcome_and__farewell_animation__objects_9_10__Bye_type_Bye_type_from_center_to_edge_Rate_Limiter_Dynamic /end SUB_GROUP
/end GROUP
/begin GROUP ADAS_FuncLevel_MLIA_MLIA_MLIA_calculation_Angles_for_welcome_and__farewell_animation__objects_9_10__Bye_type_Bye_type_from_center_to_edge_Rate_Limiter_Dynamic "ADAS/FuncLevel/MLIA/MLIA/MLIA calculation/Angles for welcome and 
farewell animation (objects 9-10)/Bye type/Bye type
from center to edge/Rate Limiter
Dynamic" /begin REF_MEASUREMENT rtDW_ADAS.GTDelayInput2_DSTATE_i /end REF_MEASUREMENT /end GROUP
/begin GROUP ADAS_FuncLevel_MLIA_MLIA_MLIA_calculation_Angles_for_welcome_and__farewell_animation__objects_9_10__Bye_type_Bye_type_from_edge_to_center "ADAS/FuncLevel/MLIA/MLIA/MLIA calculation/Angles for welcome and 
farewell animation (objects 9-10)/Bye type/Bye type
from edge to center"
 /begin SUB_GROUP ADAS_FuncLevel_MLIA_MLIA_MLIA_calculation_Angles_for_welcome_and__farewell_animation__objects_9_10__Bye_type_Bye_type_from_edge_to_center_Rate_Limiter_Dynamic /end SUB_GROUP
 /begin REF_MEASUREMENT rtDW_ADAS.GTAdd_f rtDW_ADAS.GTByeSts_go rtDW_ADAS.GTDetectObj9_10_j rtDW_ADAS.GTGain2_m rtDW_ADAS.GTGain_k rtDW_ADAS.GTTmpBufferAtConstantOutport1_h /end REF_MEASUREMENT
/end GROUP
/begin GROUP ADAS_FuncLevel_MLIA_MLIA_MLIA_calculation_Angles_for_welcome_and__farewell_animation__objects_9_10__Bye_type_Bye_type_from_edge_to_center_Rate_Limiter_Dynamic "ADAS/FuncLevel/MLIA/MLIA/MLIA calculation/Angles for welcome and 
farewell animation (objects 9-10)/Bye type/Bye type
from edge to center/Rate Limiter
Dynamic"
 /begin REF_MEASUREMENT rtDW_ADAS.GTDelayInput2_DSTATE_l rtDW_ADAS.GTTmpBufferAtConstantOutport1_h /end REF_MEASUREMENT
/end GROUP
/begin GROUP ADAS_FuncLevel_MLIA_MLIA_MLIA_calculation_Angles_for_welcome_and__farewell_animation__objects_9_10__Compare_To_Constant "ADAS/FuncLevel/MLIA/MLIA/MLIA calculation/Angles for welcome and 
farewell animation (objects 9-10)/Compare
To Constant" /begin REF_MEASUREMENT rtDW_ADAS.GTTransMliaMode /end REF_MEASUREMENT /end GROUP
/begin GROUP ADAS_FuncLevel_MLIA_MLIA_MLIA_calculation_Angles_for_welcome_and__farewell_animation__objects_9_10__Compare_To_Constant1 "ADAS/FuncLevel/MLIA/MLIA/MLIA calculation/Angles for welcome and 
farewell animation (objects 9-10)/Compare
To Constant1" /begin REF_MEASUREMENT rtDW_ADAS.GTTransMliaMode /end REF_MEASUREMENT /end GROUP
/begin GROUP ADAS_FuncLevel_MLIA_MLIA_MLIA_calculation_Angles_for_welcome_and__farewell_animation__objects_9_10__Compare_To_Constant2 "ADAS/FuncLevel/MLIA/MLIA/MLIA calculation/Angles for welcome and 
farewell animation (objects 9-10)/Compare
To Constant2" /begin REF_MEASUREMENT rtDW_ADAS.GTByeSts_ag /end REF_MEASUREMENT /end GROUP
/begin GROUP ADAS_FuncLevel_MLIA_MLIA_MLIA_calculation_Angles_for_welcome_and__farewell_animation__objects_9_10__Compare_To_Constant4 "ADAS/FuncLevel/MLIA/MLIA/MLIA calculation/Angles for welcome and 
farewell animation (objects 9-10)/Compare
To Constant4" /begin REF_MEASUREMENT rtDW_ADAS.GTTransMliaMode /end REF_MEASUREMENT /end GROUP
/begin GROUP ADAS_FuncLevel_MLIA_MLIA_MLIA_calculation_Angles_for_welcome_and__farewell_animation__objects_9_10__Welcome_type "ADAS/FuncLevel/MLIA/MLIA/MLIA calculation/Angles for welcome and 
farewell animation (objects 9-10)/Welcome type"
 /begin SUB_GROUP ADAS_FuncLevel_MLIA_MLIA_MLIA_calculation_Angles_for_welcome_and__farewell_animation__objects_9_10__Welcome_type_Compare_To_Constant ADAS_FuncLevel_MLIA_MLIA_MLIA_calculation_Angles_for_welcome_and__farewell_animation__objects_9_10__Welcome_type_Compare_To_Constant1 ADAS_FuncLevel_MLIA_MLIA_MLIA_calculation_Angles_for_welcome_and__farewell_animation__objects_9_10__Welcome_type_Welcome_type_from_center_to_edge ADAS_FuncLevel_MLIA_MLIA_MLIA_calculation_Angles_for_welcome_and__farewell_animation__objects_9_10__Welcome_type_Welcome_type_from_edge_to_center /end SUB_GROUP
/end GROUP
/begin GROUP ADAS_FuncLevel_MLIA_MLIA_MLIA_calculation_Angles_for_welcome_and__farewell_animation__objects_9_10__Welcome_type_Welcome_type_from_center_to_edge "ADAS/FuncLevel/MLIA/MLIA/MLIA calculation/Angles for welcome and 
farewell animation (objects 9-10)/Welcome type/Welcome type
from center to edge"
 /begin SUB_GROUP ADAS_FuncLevel_MLIA_MLIA_MLIA_calculation_Angles_for_welcome_and__farewell_animation__objects_9_10__Welcome_type_Welcome_type_from_center_to_edge_Rate_Limiter_Dynamic /end SUB_GROUP
 /begin REF_MEASUREMENT rtDW_ADAS.GTDetectObj9_10_n rtDW_ADAS.GTDifferenceInputs2 rtDW_ADAS.GTGain1 rtDW_ADAS.GTGain_c rtDW_ADAS.GTTmpBufferAtConstantOutport1 rtDW_ADAS.GTWelcomeSts_l /end REF_MEASUREMENT
/end GROUP
/begin GROUP ADAS_FuncLevel_MLIA_MLIA_MLIA_calculation_Angles_for_welcome_and__farewell_animation__objects_9_10__Welcome_type_Welcome_type_from_center_to_edge_Rate_Limiter_Dynamic "ADAS/FuncLevel/MLIA/MLIA/MLIA calculation/Angles for welcome and 
farewell animation (objects 9-10)/Welcome type/Welcome type
from center to edge/Rate Limiter
Dynamic"
 /begin REF_MEASUREMENT rtDW_ADAS.GTDelayInput2_DSTATE_p rtDW_ADAS.GTDifferenceInputs2 rtDW_ADAS.GTTmpBufferAtConstantOutport1 /end REF_MEASUREMENT
/end GROUP
/begin GROUP ADAS_FuncLevel_MLIA_MLIA_MLIA_calculation_Angles_for_welcome_and__farewell_animation__objects_9_10__Welcome_type_Welcome_type_from_edge_to_center "ADAS/FuncLevel/MLIA/MLIA/MLIA calculation/Angles for welcome and 
farewell animation (objects 9-10)/Welcome type/Welcome type
from edge to center"
 /begin SUB_GROUP ADAS_FuncLevel_MLIA_MLIA_MLIA_calculation_Angles_for_welcome_and__farewell_animation__objects_9_10__Welcome_type_Welcome_type_from_edge_to_center_Rate_Limiter_Dynamic /end SUB_GROUP
/end GROUP
/begin GROUP ADAS_FuncLevel_MLIA_MLIA_MLIA_calculation_Angles_for_welcome_and__farewell_animation__objects_9_10__Welcome_type_Welcome_type_from_edge_to_center_Rate_Limiter_Dynamic "ADAS/FuncLevel/MLIA/MLIA/MLIA calculation/Angles for welcome and 
farewell animation (objects 9-10)/Welcome type/Welcome type
from edge to center/Rate Limiter
Dynamic" /begin REF_MEASUREMENT rtDW_ADAS.GTDelayInput2_DSTATE /end REF_MEASUREMENT /end GROUP
/begin GROUP ADAS_FuncLevel_MLIA_MLIA_MLIA_calculation_Object_position_in_each_HL_coordinate_system "ADAS/FuncLevel/MLIA/MLIA/MLIA calculation/Object position in each
HL coordinate system"
 /begin SUB_GROUP ADAS_FuncLevel_MLIA_MLIA_MLIA_calculation_Object_position_in_each_HL_coordinate_system_Angle_obj1 ADAS_FuncLevel_MLIA_MLIA_MLIA_calculation_Object_position_in_each_HL_coordinate_system_Angle_obj10 ADAS_FuncLevel_MLIA_MLIA_MLIA_calculation_Object_position_in_each_HL_coordinate_system_Angle_obj11 ADAS_FuncLevel_MLIA_MLIA_MLIA_calculation_Object_position_in_each_HL_coordinate_system_Angle_obj12 ADAS_FuncLevel_MLIA_MLIA_MLIA_calculation_Object_position_in_each_HL_coordinate_system_Angle_obj13 ADAS_FuncLevel_MLIA_MLIA_MLIA_calculation_Object_position_in_each_HL_coordinate_system_Angle_obj14 ADAS_FuncLevel_MLIA_MLIA_MLIA_calculation_Object_position_in_each_HL_coordinate_system_Angle_obj15 ADAS_FuncLevel_MLIA_MLIA_MLIA_calculation_Object_position_in_each_HL_coordinate_system_Angle_obj16 ADAS_FuncLevel_MLIA_MLIA_MLIA_calculation_Object_position_in_each_HL_coordinate_system_Angle_obj17 ADAS_FuncLevel_MLIA_MLIA_MLIA_calculation_Object_position_in_each_HL_coordinate_system_Angle_obj18 ADAS_FuncLevel_MLIA_MLIA_MLIA_calculation_Object_position_in_each_HL_coordinate_system_Angle_obj19 ADAS_FuncLevel_MLIA_MLIA_MLIA_calculation_Object_position_in_each_HL_coordinate_system_Angle_obj2 ADAS_FuncLevel_MLIA_MLIA_MLIA_calculation_Object_position_in_each_HL_coordinate_system_Angle_obj20 ADAS_FuncLevel_MLIA_MLIA_MLIA_calculation_Object_position_in_each_HL_coordinate_system_Angle_obj3 ADAS_FuncLevel_MLIA_MLIA_MLIA_calculation_Object_position_in_each_HL_coordinate_system_Angle_obj4 ADAS_FuncLevel_MLIA_MLIA_MLIA_calculation_Object_position_in_each_HL_coordinate_system_Angle_obj5 ADAS_FuncLevel_MLIA_MLIA_MLIA_calculation_Object_position_in_each_HL_coordinate_system_Angle_obj6 ADAS_FuncLevel_MLIA_MLIA_MLIA_calculation_Object_position_in_each_HL_coordinate_system_Angle_obj7 ADAS_FuncLevel_MLIA_MLIA_MLIA_calculation_Object_position_in_each_HL_coordinate_system_Angle_obj8 ADAS_FuncLevel_MLIA_MLIA_MLIA_calculation_Object_position_in_each_HL_coordinate_system_Angle_obj9 /end SUB_GROUP
 /begin REF_MEASUREMENT rtDW_ADAS.GTAngleObjArray rtDW_ADAS.GTAngleObjArray_b rtDW_ADAS.GTAngleObjArray_c rtDW_ADAS.GTAngleObjArray_d rtDW_ADAS.GTAngleObjArray_di rtDW_ADAS.GTAngleObjArray_g rtDW_ADAS.GTAngleObjArray_h rtDW_ADAS.GTAngleObjArray_h2 rtDW_ADAS.GTAngleObjArray_ha rtDW_ADAS.GTAngleObjArray_ho rtDW_ADAS.GTAngleObjArray_hp rtDW_ADAS.GTAngleObjArray_i rtDW_ADAS.GTAngleObjArray_ie rtDW_ADAS.GTAngleObjArray_iw rtDW_ADAS.GTAngleObjArray_j rtDW_ADAS.GTAngleObjArray_l rtDW_ADAS.GTAngleObjArray_lc rtDW_ADAS.GTAngleObjArray_m rtDW_ADAS.GTAngleObjArray_o rtDW_ADAS.GTAngleObjArray_p /end REF_MEASUREMENT
/end GROUP
/begin GROUP ADAS_FuncLevel_MLIA_MLIA_MLIA_calculation_Object_position_in_each_HL_coordinate_system_Angle_obj1 "ADAS/FuncLevel/MLIA/MLIA/MLIA calculation/Object position in each
HL coordinate system/Angle obj1" /begin REF_MEASUREMENT rtDW_ADAS.GTAngleObjArray_lc /end REF_MEASUREMENT /end GROUP
/begin GROUP ADAS_FuncLevel_MLIA_MLIA_MLIA_calculation_Object_position_in_each_HL_coordinate_system_Angle_obj10 "ADAS/FuncLevel/MLIA/MLIA/MLIA calculation/Object position in each
HL coordinate system/Angle obj10" /begin REF_MEASUREMENT rtDW_ADAS.GTAngleObjArray_c /end REF_MEASUREMENT /end GROUP
/begin GROUP ADAS_FuncLevel_MLIA_MLIA_MLIA_calculation_Object_position_in_each_HL_coordinate_system_Angle_obj11 "ADAS/FuncLevel/MLIA/MLIA/MLIA calculation/Object position in each
HL coordinate system/Angle obj11" /begin REF_MEASUREMENT rtDW_ADAS.GTAngleObjArray_di /end REF_MEASUREMENT /end GROUP
/begin GROUP ADAS_FuncLevel_MLIA_MLIA_MLIA_calculation_Object_position_in_each_HL_coordinate_system_Angle_obj12 "ADAS/FuncLevel/MLIA/MLIA/MLIA calculation/Object position in each
HL coordinate system/Angle obj12" /begin REF_MEASUREMENT rtDW_ADAS.GTAngleObjArray_j /end REF_MEASUREMENT /end GROUP
/begin GROUP ADAS_FuncLevel_MLIA_MLIA_MLIA_calculation_Object_position_in_each_HL_coordinate_system_Angle_obj13 "ADAS/FuncLevel/MLIA/MLIA/MLIA calculation/Object position in each
HL coordinate system/Angle obj13" /begin REF_MEASUREMENT rtDW_ADAS.GTAngleObjArray_g /end REF_MEASUREMENT /end GROUP
/begin GROUP ADAS_FuncLevel_MLIA_MLIA_MLIA_calculation_Object_position_in_each_HL_coordinate_system_Angle_obj14 "ADAS/FuncLevel/MLIA/MLIA/MLIA calculation/Object position in each
HL coordinate system/Angle obj14" /begin REF_MEASUREMENT rtDW_ADAS.GTAngleObjArray_o /end REF_MEASUREMENT /end GROUP
/begin GROUP ADAS_FuncLevel_MLIA_MLIA_MLIA_calculation_Object_position_in_each_HL_coordinate_system_Angle_obj15 "ADAS/FuncLevel/MLIA/MLIA/MLIA calculation/Object position in each
HL coordinate system/Angle obj15" /begin REF_MEASUREMENT rtDW_ADAS.GTAngleObjArray_iw /end REF_MEASUREMENT /end GROUP
/begin GROUP ADAS_FuncLevel_MLIA_MLIA_MLIA_calculation_Object_position_in_each_HL_coordinate_system_Angle_obj16 "ADAS/FuncLevel/MLIA/MLIA/MLIA calculation/Object position in each
HL coordinate system/Angle obj16" /begin REF_MEASUREMENT rtDW_ADAS.GTAngleObjArray_l /end REF_MEASUREMENT /end GROUP
/begin GROUP ADAS_FuncLevel_MLIA_MLIA_MLIA_calculation_Object_position_in_each_HL_coordinate_system_Angle_obj17 "ADAS/FuncLevel/MLIA/MLIA/MLIA calculation/Object position in each
HL coordinate system/Angle obj17" /begin REF_MEASUREMENT rtDW_ADAS.GTAngleObjArray_ha /end REF_MEASUREMENT /end GROUP
/begin GROUP ADAS_FuncLevel_MLIA_MLIA_MLIA_calculation_Object_position_in_each_HL_coordinate_system_Angle_obj18 "ADAS/FuncLevel/MLIA/MLIA/MLIA calculation/Object position in each
HL coordinate system/Angle obj18" /begin REF_MEASUREMENT rtDW_ADAS.GTAngleObjArray_ho /end REF_MEASUREMENT /end GROUP
/begin GROUP ADAS_FuncLevel_MLIA_MLIA_MLIA_calculation_Object_position_in_each_HL_coordinate_system_Angle_obj19 "ADAS/FuncLevel/MLIA/MLIA/MLIA calculation/Object position in each
HL coordinate system/Angle obj19" /begin REF_MEASUREMENT rtDW_ADAS.GTAngleObjArray_hp /end REF_MEASUREMENT /end GROUP
/begin GROUP ADAS_FuncLevel_MLIA_MLIA_MLIA_calculation_Object_position_in_each_HL_coordinate_system_Angle_obj2 "ADAS/FuncLevel/MLIA/MLIA/MLIA calculation/Object position in each
HL coordinate system/Angle obj2" /begin REF_MEASUREMENT rtDW_ADAS.GTAngleObjArray_ie /end REF_MEASUREMENT /end GROUP
/begin GROUP ADAS_FuncLevel_MLIA_MLIA_MLIA_calculation_Object_position_in_each_HL_coordinate_system_Angle_obj20 "ADAS/FuncLevel/MLIA/MLIA/MLIA calculation/Object position in each
HL coordinate system/Angle obj20" /begin REF_MEASUREMENT rtDW_ADAS.GTAngleObjArray_d /end REF_MEASUREMENT /end GROUP
/begin GROUP ADAS_FuncLevel_MLIA_MLIA_MLIA_calculation_Object_position_in_each_HL_coordinate_system_Angle_obj3 "ADAS/FuncLevel/MLIA/MLIA/MLIA calculation/Object position in each
HL coordinate system/Angle obj3" /begin REF_MEASUREMENT rtDW_ADAS.GTAngleObjArray_b /end REF_MEASUREMENT /end GROUP
/begin GROUP ADAS_FuncLevel_MLIA_MLIA_MLIA_calculation_Object_position_in_each_HL_coordinate_system_Angle_obj4 "ADAS/FuncLevel/MLIA/MLIA/MLIA calculation/Object position in each
HL coordinate system/Angle obj4" /begin REF_MEASUREMENT rtDW_ADAS.GTAngleObjArray_i /end REF_MEASUREMENT /end GROUP
/begin GROUP ADAS_FuncLevel_MLIA_MLIA_MLIA_calculation_Object_position_in_each_HL_coordinate_system_Angle_obj5 "ADAS/FuncLevel/MLIA/MLIA/MLIA calculation/Object position in each
HL coordinate system/Angle obj5" /begin REF_MEASUREMENT rtDW_ADAS.GTAngleObjArray_p /end REF_MEASUREMENT /end GROUP
/begin GROUP ADAS_FuncLevel_MLIA_MLIA_MLIA_calculation_Object_position_in_each_HL_coordinate_system_Angle_obj6 "ADAS/FuncLevel/MLIA/MLIA/MLIA calculation/Object position in each
HL coordinate system/Angle obj6" /begin REF_MEASUREMENT rtDW_ADAS.GTAngleObjArray_m /end REF_MEASUREMENT /end GROUP
/begin GROUP ADAS_FuncLevel_MLIA_MLIA_MLIA_calculation_Object_position_in_each_HL_coordinate_system_Angle_obj7 "ADAS/FuncLevel/MLIA/MLIA/MLIA calculation/Object position in each
HL coordinate system/Angle obj7" /begin REF_MEASUREMENT rtDW_ADAS.GTAngleObjArray_h2 /end REF_MEASUREMENT /end GROUP
/begin GROUP ADAS_FuncLevel_MLIA_MLIA_MLIA_calculation_Object_position_in_each_HL_coordinate_system_Angle_obj8 "ADAS/FuncLevel/MLIA/MLIA/MLIA calculation/Object position in each
HL coordinate system/Angle obj8" /begin REF_MEASUREMENT rtDW_ADAS.GTAngleObjArray_h /end REF_MEASUREMENT /end GROUP
/begin GROUP ADAS_FuncLevel_MLIA_MLIA_MLIA_calculation_Object_position_in_each_HL_coordinate_system_Angle_obj9 "ADAS/FuncLevel/MLIA/MLIA/MLIA calculation/Object position in each
HL coordinate system/Angle obj9" /begin REF_MEASUREMENT rtDW_ADAS.GTAngleObjArray /end REF_MEASUREMENT /end GROUP
/begin GROUP ADAS_FuncLevel_MLIA_MLIA_MLIA_calculation_Target_LEDs "ADAS/FuncLevel/MLIA/MLIA/MLIA calculation/Target LEDs"
 /begin SUB_GROUP ADAS_FuncLevel_MLIA_MLIA_MLIA_calculation_Target_LEDs_ADB_target_LEDs ADAS_FuncLevel_MLIA_MLIA_MLIA_calculation_Target_LEDs_Compare_To_Constant ADAS_FuncLevel_MLIA_MLIA_MLIA_calculation_Target_LEDs_Compare_To_Constant1 ADAS_FuncLevel_MLIA_MLIA_MLIA_calculation_Target_LEDs_LED_Angle_Zones ADAS_FuncLevel_MLIA_MLIA_MLIA_calculation_Target_LEDs_microLED_target_LEDs ADAS_FuncLevel_MLIA_MLIA_MLIA_calculation_Target_LEDs_microLED_target_LEDs_Filter /end SUB_GROUP
/end GROUP
/begin GROUP ADAS_FuncLevel_MLIA_MLIA_MLIA_calculation_Target_LEDs_ADB_target_LEDs "ADAS/FuncLevel/MLIA/MLIA/MLIA calculation/Target LEDs/ADB target LEDs"
 /begin SUB_GROUP ADAS_FuncLevel_MLIA_MLIA_MLIA_calculation_Target_LEDs_ADB_target_LEDs_Compare_To_Constant ADAS_FuncLevel_MLIA_MLIA_MLIA_calculation_Target_LEDs_ADB_target_LEDs_Compare_To_Constant1 ADAS_FuncLevel_MLIA_MLIA_MLIA_calculation_Target_LEDs_ADB_target_LEDs_HLL_ADB_target_LEDs ADAS_FuncLevel_MLIA_MLIA_MLIA_calculation_Target_LEDs_ADB_target_LEDs_HLR_ADB_target_LEDs /end SUB_GROUP
/end GROUP
/begin GROUP ADAS_FuncLevel_MLIA_MLIA_MLIA_calculation_Target_LEDs_ADB_target_LEDs_HLL_ADB_target_LEDs "ADAS/FuncLevel/MLIA/MLIA/MLIA calculation/Target LEDs/ADB target LEDs/HLL ADB target LEDs"
 /begin SUB_GROUP ADAS_FuncLevel_MLIA_MLIA_MLIA_calculation_Target_LEDs_ADB_target_LEDs_HLL_ADB_target_LEDs_AllDiodes_Filter /end SUB_GROUP
 /begin REF_MEASUREMENT rtDW_ADAS.GTDelay1_DSTATE_o5 rtDW_ADAS.GTDelay_DSTATE_m rtDW_ADAS.GTMemory10_PreviousInput rtDW_ADAS.GTMemory11_PreviousInput rtDW_ADAS.GTMemory1_PreviousInput_j rtDW_ADAS.GTMemory2_PreviousInput_cq rtDW_ADAS.GTMemory3_PreviousInput_m rtDW_ADAS.GTMemory8_PreviousInput_g rtDW_ADAS.GTMemory9_PreviousInput_k rtDW_ADAS.GTMemory_PreviousInput_c4 /end REF_MEASUREMENT
/end GROUP
/begin GROUP ADAS_FuncLevel_MLIA_MLIA_MLIA_calculation_Target_LEDs_ADB_target_LEDs_HLL_ADB_target_LEDs_AllDiodes_Filter "ADAS/FuncLevel/MLIA/MLIA/MLIA calculation/Target LEDs/ADB target LEDs/HLL ADB target LEDs/AllDiodes_Filter"
 /begin SUB_GROUP ADAS_FuncLevel_MLIA_MLIA_MLIA_calculation_Target_LEDs_ADB_target_LEDs_HLL_ADB_target_LEDs_AllDiodes_Filter_BlinkDetector_1 ADAS_FuncLevel_MLIA_MLIA_MLIA_calculation_Target_LEDs_ADB_target_LEDs_HLL_ADB_target_LEDs_AllDiodes_Filter_BlinkDetector_10 ADAS_FuncLevel_MLIA_MLIA_MLIA_calculation_Target_LEDs_ADB_target_LEDs_HLL_ADB_target_LEDs_AllDiodes_Filter_BlinkDetector_11 ADAS_FuncLevel_MLIA_MLIA_MLIA_calculation_Target_LEDs_ADB_target_LEDs_HLL_ADB_target_LEDs_AllDiodes_Filter_BlinkDetector_12 ADAS_FuncLevel_MLIA_MLIA_MLIA_calculation_Target_LEDs_ADB_target_LEDs_HLL_ADB_target_LEDs_AllDiodes_Filter_BlinkDetector_13 ADAS_FuncLevel_MLIA_MLIA_MLIA_calculation_Target_LEDs_ADB_target_LEDs_HLL_ADB_target_LEDs_AllDiodes_Filter_BlinkDetector_14 ADAS_FuncLevel_MLIA_MLIA_MLIA_calculation_Target_LEDs_ADB_target_LEDs_HLL_ADB_target_LEDs_AllDiodes_Filter_BlinkDetector_15 ADAS_FuncLevel_MLIA_MLIA_MLIA_calculation_Target_LEDs_ADB_target_LEDs_HLL_ADB_target_LEDs_AllDiodes_Filter_BlinkDetector_16 ADAS_FuncLevel_MLIA_MLIA_MLIA_calculation_Target_LEDs_ADB_target_LEDs_HLL_ADB_target_LEDs_AllDiodes_Filter_BlinkDetector_17 ADAS_FuncLevel_MLIA_MLIA_MLIA_calculation_Target_LEDs_ADB_target_LEDs_HLL_ADB_target_LEDs_AllDiodes_Filter_BlinkDetector_18 ADAS_FuncLevel_MLIA_MLIA_MLIA_calculation_Target_LEDs_ADB_target_LEDs_HLL_ADB_target_LEDs_AllDiodes_Filter_BlinkDetector_2 ADAS_FuncLevel_MLIA_MLIA_MLIA_calculation_Target_LEDs_ADB_target_LEDs_HLL_ADB_target_LEDs_AllDiodes_Filter_BlinkDetector_3 ADAS_FuncLevel_MLIA_MLIA_MLIA_calculation_Target_LEDs_ADB_target_LEDs_HLL_ADB_target_LEDs_AllDiodes_Filter_BlinkDetector_4 ADAS_FuncLevel_MLIA_MLIA_MLIA_calculation_Target_LEDs_ADB_target_LEDs_HLL_ADB_target_LEDs_AllDiodes_Filter_BlinkDetector_5 ADAS_FuncLevel_MLIA_MLIA_MLIA_calculation_Target_LEDs_ADB_target_LEDs_HLL_ADB_target_LEDs_AllDiodes_Filter_BlinkDetector_6 ADAS_FuncLevel_MLIA_MLIA_MLIA_calculation_Target_LEDs_ADB_target_LEDs_HLL_ADB_target_LEDs_AllDiodes_Filter_BlinkDetector_7 ADAS_FuncLevel_MLIA_MLIA_MLIA_calculation_Target_LEDs_ADB_target_LEDs_HLL_ADB_target_LEDs_AllDiodes_Filter_BlinkDetector_8 ADAS_FuncLevel_MLIA_MLIA_MLIA_calculation_Target_LEDs_ADB_target_LEDs_HLL_ADB_target_LEDs_AllDiodes_Filter_BlinkDetector_9 /end SUB_GROUP
 /begin REF_MEASUREMENT rtDW_ADAS.GTDelay2_DSTATE_l4 rtDW_ADAS.GTDelay3_DSTATE_g1 /end REF_MEASUREMENT
/end GROUP
/begin GROUP ADAS_FuncLevel_MLIA_MLIA_MLIA_calculation_Target_LEDs_ADB_target_LEDs_HLL_ADB_target_LEDs_AllDiodes_Filter_BlinkDetector_1 "ADAS/FuncLevel/MLIA/MLIA/MLIA calculation/Target LEDs/ADB target LEDs/HLL ADB target LEDs/AllDiodes_Filter/BlinkDetector_1"
 /begin SUB_GROUP ADAS_FuncLevel_MLIA_MLIA_MLIA_calculation_Target_LEDs_ADB_target_LEDs_HLL_ADB_target_LEDs_AllDiodes_Filter_BlinkDetector_1_Detect_Decrease ADAS_FuncLevel_MLIA_MLIA_MLIA_calculation_Target_LEDs_ADB_target_LEDs_HLL_ADB_target_LEDs_AllDiodes_Filter_BlinkDetector_1_Detect_Increase /end SUB_GROUP
/end GROUP
/begin GROUP ADAS_FuncLevel_MLIA_MLIA_MLIA_calculation_Target_LEDs_ADB_target_LEDs_HLL_ADB_target_LEDs_AllDiodes_Filter_BlinkDetector_10 "ADAS/FuncLevel/MLIA/MLIA/MLIA calculation/Target LEDs/ADB target LEDs/HLL ADB target LEDs/AllDiodes_Filter/BlinkDetector_10"
 /begin SUB_GROUP ADAS_FuncLevel_MLIA_MLIA_MLIA_calculation_Target_LEDs_ADB_target_LEDs_HLL_ADB_target_LEDs_AllDiodes_Filter_BlinkDetector_10_Detect_Decrease ADAS_FuncLevel_MLIA_MLIA_MLIA_calculation_Target_LEDs_ADB_target_LEDs_HLL_ADB_target_LEDs_AllDiodes_Filter_BlinkDetector_10_Detect_Increase /end SUB_GROUP
/end GROUP
/begin GROUP ADAS_FuncLevel_MLIA_MLIA_MLIA_calculation_Target_LEDs_ADB_target_LEDs_HLL_ADB_target_LEDs_AllDiodes_Filter_BlinkDetector_10_Detect_Decrease "ADAS/FuncLevel/MLIA/MLIA/MLIA calculation/Target LEDs/ADB target LEDs/HLL ADB target LEDs/AllDiodes_Filter/BlinkDetector_10/Detect
Decrease" /begin REF_MEASUREMENT rtDW_ADAS.GTDelayInput1_DSTATE_fv /end REF_MEASUREMENT /end GROUP
/begin GROUP ADAS_FuncLevel_MLIA_MLIA_MLIA_calculation_Target_LEDs_ADB_target_LEDs_HLL_ADB_target_LEDs_AllDiodes_Filter_BlinkDetector_10_Detect_Increase "ADAS/FuncLevel/MLIA/MLIA/MLIA calculation/Target LEDs/ADB target LEDs/HLL ADB target LEDs/AllDiodes_Filter/BlinkDetector_10/Detect
Increase" /begin REF_MEASUREMENT rtDW_ADAS.GTDelayInput1_DSTATE_gl /end REF_MEASUREMENT /end GROUP
/begin GROUP ADAS_FuncLevel_MLIA_MLIA_MLIA_calculation_Target_LEDs_ADB_target_LEDs_HLL_ADB_target_LEDs_AllDiodes_Filter_BlinkDetector_11 "ADAS/FuncLevel/MLIA/MLIA/MLIA calculation/Target LEDs/ADB target LEDs/HLL ADB target LEDs/AllDiodes_Filter/BlinkDetector_11"
 /begin SUB_GROUP ADAS_FuncLevel_MLIA_MLIA_MLIA_calculation_Target_LEDs_ADB_target_LEDs_HLL_ADB_target_LEDs_AllDiodes_Filter_BlinkDetector_11_Detect_Decrease ADAS_FuncLevel_MLIA_MLIA_MLIA_calculation_Target_LEDs_ADB_target_LEDs_HLL_ADB_target_LEDs_AllDiodes_Filter_BlinkDetector_11_Detect_Increase /end SUB_GROUP
/end GROUP
/begin GROUP ADAS_FuncLevel_MLIA_MLIA_MLIA_calculation_Target_LEDs_ADB_target_LEDs_HLL_ADB_target_LEDs_AllDiodes_Filter_BlinkDetector_11_Detect_Decrease "ADAS/FuncLevel/MLIA/MLIA/MLIA calculation/Target LEDs/ADB target LEDs/HLL ADB target LEDs/AllDiodes_Filter/BlinkDetector_11/Detect
Decrease" /begin REF_MEASUREMENT rtDW_ADAS.GTDelayInput1_DSTATE_e1y /end REF_MEASUREMENT /end GROUP
/begin GROUP ADAS_FuncLevel_MLIA_MLIA_MLIA_calculation_Target_LEDs_ADB_target_LEDs_HLL_ADB_target_LEDs_AllDiodes_Filter_BlinkDetector_11_Detect_Increase "ADAS/FuncLevel/MLIA/MLIA/MLIA calculation/Target LEDs/ADB target LEDs/HLL ADB target LEDs/AllDiodes_Filter/BlinkDetector_11/Detect
Increase" /begin REF_MEASUREMENT rtDW_ADAS.GTDelayInput1_DSTATE_c1 /end REF_MEASUREMENT /end GROUP
/begin GROUP ADAS_FuncLevel_MLIA_MLIA_MLIA_calculation_Target_LEDs_ADB_target_LEDs_HLL_ADB_target_LEDs_AllDiodes_Filter_BlinkDetector_12 "ADAS/FuncLevel/MLIA/MLIA/MLIA calculation/Target LEDs/ADB target LEDs/HLL ADB target LEDs/AllDiodes_Filter/BlinkDetector_12"
 /begin SUB_GROUP ADAS_FuncLevel_MLIA_MLIA_MLIA_calculation_Target_LEDs_ADB_target_LEDs_HLL_ADB_target_LEDs_AllDiodes_Filter_BlinkDetector_12_Detect_Decrease ADAS_FuncLevel_MLIA_MLIA_MLIA_calculation_Target_LEDs_ADB_target_LEDs_HLL_ADB_target_LEDs_AllDiodes_Filter_BlinkDetector_12_Detect_Increase /end SUB_GROUP
/end GROUP
/begin GROUP ADAS_FuncLevel_MLIA_MLIA_MLIA_calculation_Target_LEDs_ADB_target_LEDs_HLL_ADB_target_LEDs_AllDiodes_Filter_BlinkDetector_12_Detect_Decrease "ADAS/FuncLevel/MLIA/MLIA/MLIA calculation/Target LEDs/ADB target LEDs/HLL ADB target LEDs/AllDiodes_Filter/BlinkDetector_12/Detect
Decrease" /begin REF_MEASUREMENT rtDW_ADAS.GTDelayInput1_DSTATE_il /end REF_MEASUREMENT /end GROUP
/begin GROUP ADAS_FuncLevel_MLIA_MLIA_MLIA_calculation_Target_LEDs_ADB_target_LEDs_HLL_ADB_target_LEDs_AllDiodes_Filter_BlinkDetector_12_Detect_Increase "ADAS/FuncLevel/MLIA/MLIA/MLIA calculation/Target LEDs/ADB target LEDs/HLL ADB target LEDs/AllDiodes_Filter/BlinkDetector_12/Detect
Increase" /begin REF_MEASUREMENT rtDW_ADAS.GTDelayInput1_DSTATE_cz /end REF_MEASUREMENT /end GROUP
/begin GROUP ADAS_FuncLevel_MLIA_MLIA_MLIA_calculation_Target_LEDs_ADB_target_LEDs_HLL_ADB_target_LEDs_AllDiodes_Filter_BlinkDetector_13 "ADAS/FuncLevel/MLIA/MLIA/MLIA calculation/Target LEDs/ADB target LEDs/HLL ADB target LEDs/AllDiodes_Filter/BlinkDetector_13"
 /begin SUB_GROUP ADAS_FuncLevel_MLIA_MLIA_MLIA_calculation_Target_LEDs_ADB_target_LEDs_HLL_ADB_target_LEDs_AllDiodes_Filter_BlinkDetector_13_Detect_Decrease ADAS_FuncLevel_MLIA_MLIA_MLIA_calculation_Target_LEDs_ADB_target_LEDs_HLL_ADB_target_LEDs_AllDiodes_Filter_BlinkDetector_13_Detect_Increase /end SUB_GROUP
/end GROUP
/begin GROUP ADAS_FuncLevel_MLIA_MLIA_MLIA_calculation_Target_LEDs_ADB_target_LEDs_HLL_ADB_target_LEDs_AllDiodes_Filter_BlinkDetector_13_Detect_Decrease "ADAS/FuncLevel/MLIA/MLIA/MLIA calculation/Target LEDs/ADB target LEDs/HLL ADB target LEDs/AllDiodes_Filter/BlinkDetector_13/Detect
Decrease" /begin REF_MEASUREMENT rtDW_ADAS.GTDelayInput1_DSTATE_l1 /end REF_MEASUREMENT /end GROUP
/begin GROUP ADAS_FuncLevel_MLIA_MLIA_MLIA_calculation_Target_LEDs_ADB_target_LEDs_HLL_ADB_target_LEDs_AllDiodes_Filter_BlinkDetector_13_Detect_Increase "ADAS/FuncLevel/MLIA/MLIA/MLIA calculation/Target LEDs/ADB target LEDs/HLL ADB target LEDs/AllDiodes_Filter/BlinkDetector_13/Detect
Increase" /begin REF_MEASUREMENT rtDW_ADAS.GTDelayInput1_DSTATE_pg /end REF_MEASUREMENT /end GROUP
/begin GROUP ADAS_FuncLevel_MLIA_MLIA_MLIA_calculation_Target_LEDs_ADB_target_LEDs_HLL_ADB_target_LEDs_AllDiodes_Filter_BlinkDetector_14 "ADAS/FuncLevel/MLIA/MLIA/MLIA calculation/Target LEDs/ADB target LEDs/HLL ADB target LEDs/AllDiodes_Filter/BlinkDetector_14"
 /begin SUB_GROUP ADAS_FuncLevel_MLIA_MLIA_MLIA_calculation_Target_LEDs_ADB_target_LEDs_HLL_ADB_target_LEDs_AllDiodes_Filter_BlinkDetector_14_Detect_Decrease ADAS_FuncLevel_MLIA_MLIA_MLIA_calculation_Target_LEDs_ADB_target_LEDs_HLL_ADB_target_LEDs_AllDiodes_Filter_BlinkDetector_14_Detect_Increase /end SUB_GROUP
/end GROUP
/begin GROUP ADAS_FuncLevel_MLIA_MLIA_MLIA_calculation_Target_LEDs_ADB_target_LEDs_HLL_ADB_target_LEDs_AllDiodes_Filter_BlinkDetector_14_Detect_Decrease "ADAS/FuncLevel/MLIA/MLIA/MLIA calculation/Target LEDs/ADB target LEDs/HLL ADB target LEDs/AllDiodes_Filter/BlinkDetector_14/Detect
Decrease" /begin REF_MEASUREMENT rtDW_ADAS.GTDelayInput1_DSTATE_kb /end REF_MEASUREMENT /end GROUP
/begin GROUP ADAS_FuncLevel_MLIA_MLIA_MLIA_calculation_Target_LEDs_ADB_target_LEDs_HLL_ADB_target_LEDs_AllDiodes_Filter_BlinkDetector_14_Detect_Increase "ADAS/FuncLevel/MLIA/MLIA/MLIA calculation/Target LEDs/ADB target LEDs/HLL ADB target LEDs/AllDiodes_Filter/BlinkDetector_14/Detect
Increase" /begin REF_MEASUREMENT rtDW_ADAS.GTDelayInput1_DSTATE_hc /end REF_MEASUREMENT /end GROUP
/begin GROUP ADAS_FuncLevel_MLIA_MLIA_MLIA_calculation_Target_LEDs_ADB_target_LEDs_HLL_ADB_target_LEDs_AllDiodes_Filter_BlinkDetector_15 "ADAS/FuncLevel/MLIA/MLIA/MLIA calculation/Target LEDs/ADB target LEDs/HLL ADB target LEDs/AllDiodes_Filter/BlinkDetector_15"
 /begin SUB_GROUP ADAS_FuncLevel_MLIA_MLIA_MLIA_calculation_Target_LEDs_ADB_target_LEDs_HLL_ADB_target_LEDs_AllDiodes_Filter_BlinkDetector_15_Detect_Decrease ADAS_FuncLevel_MLIA_MLIA_MLIA_calculation_Target_LEDs_ADB_target_LEDs_HLL_ADB_target_LEDs_AllDiodes_Filter_BlinkDetector_15_Detect_Increase /end SUB_GROUP
/end GROUP
/begin GROUP ADAS_FuncLevel_MLIA_MLIA_MLIA_calculation_Target_LEDs_ADB_target_LEDs_HLL_ADB_target_LEDs_AllDiodes_Filter_BlinkDetector_15_Detect_Decrease "ADAS/FuncLevel/MLIA/MLIA/MLIA calculation/Target LEDs/ADB target LEDs/HLL ADB target LEDs/AllDiodes_Filter/BlinkDetector_15/Detect
Decrease" /begin REF_MEASUREMENT rtDW_ADAS.GTDelayInput1_DSTATE_lp /end REF_MEASUREMENT /end GROUP
/begin GROUP ADAS_FuncLevel_MLIA_MLIA_MLIA_calculation_Target_LEDs_ADB_target_LEDs_HLL_ADB_target_LEDs_AllDiodes_Filter_BlinkDetector_15_Detect_Increase "ADAS/FuncLevel/MLIA/MLIA/MLIA calculation/Target LEDs/ADB target LEDs/HLL ADB target LEDs/AllDiodes_Filter/BlinkDetector_15/Detect
Increase" /begin REF_MEASUREMENT rtDW_ADAS.GTDelayInput1_DSTATE_hy /end REF_MEASUREMENT /end GROUP
/begin GROUP ADAS_FuncLevel_MLIA_MLIA_MLIA_calculation_Target_LEDs_ADB_target_LEDs_HLL_ADB_target_LEDs_AllDiodes_Filter_BlinkDetector_16 "ADAS/FuncLevel/MLIA/MLIA/MLIA calculation/Target LEDs/ADB target LEDs/HLL ADB target LEDs/AllDiodes_Filter/BlinkDetector_16"
 /begin SUB_GROUP ADAS_FuncLevel_MLIA_MLIA_MLIA_calculation_Target_LEDs_ADB_target_LEDs_HLL_ADB_target_LEDs_AllDiodes_Filter_BlinkDetector_16_Detect_Decrease ADAS_FuncLevel_MLIA_MLIA_MLIA_calculation_Target_LEDs_ADB_target_LEDs_HLL_ADB_target_LEDs_AllDiodes_Filter_BlinkDetector_16_Detect_Increase /end SUB_GROUP
/end GROUP
/begin GROUP ADAS_FuncLevel_MLIA_MLIA_MLIA_calculation_Target_LEDs_ADB_target_LEDs_HLL_ADB_target_LEDs_AllDiodes_Filter_BlinkDetector_16_Detect_Decrease "ADAS/FuncLevel/MLIA/MLIA/MLIA calculation/Target LEDs/ADB target LEDs/HLL ADB target LEDs/AllDiodes_Filter/BlinkDetector_16/Detect
Decrease" /begin REF_MEASUREMENT rtDW_ADAS.GTDelayInput1_DSTATE_k2 /end REF_MEASUREMENT /end GROUP
/begin GROUP ADAS_FuncLevel_MLIA_MLIA_MLIA_calculation_Target_LEDs_ADB_target_LEDs_HLL_ADB_target_LEDs_AllDiodes_Filter_BlinkDetector_16_Detect_Increase "ADAS/FuncLevel/MLIA/MLIA/MLIA calculation/Target LEDs/ADB target LEDs/HLL ADB target LEDs/AllDiodes_Filter/BlinkDetector_16/Detect
Increase" /begin REF_MEASUREMENT rtDW_ADAS.GTDelayInput1_DSTATE_mc /end REF_MEASUREMENT /end GROUP
/begin GROUP ADAS_FuncLevel_MLIA_MLIA_MLIA_calculation_Target_LEDs_ADB_target_LEDs_HLL_ADB_target_LEDs_AllDiodes_Filter_BlinkDetector_17 "ADAS/FuncLevel/MLIA/MLIA/MLIA calculation/Target LEDs/ADB target LEDs/HLL ADB target LEDs/AllDiodes_Filter/BlinkDetector_17"
 /begin SUB_GROUP ADAS_FuncLevel_MLIA_MLIA_MLIA_calculation_Target_LEDs_ADB_target_LEDs_HLL_ADB_target_LEDs_AllDiodes_Filter_BlinkDetector_17_Detect_Decrease ADAS_FuncLevel_MLIA_MLIA_MLIA_calculation_Target_LEDs_ADB_target_LEDs_HLL_ADB_target_LEDs_AllDiodes_Filter_BlinkDetector_17_Detect_Increase /end SUB_GROUP
/end GROUP
/begin GROUP ADAS_FuncLevel_MLIA_MLIA_MLIA_calculation_Target_LEDs_ADB_target_LEDs_HLL_ADB_target_LEDs_AllDiodes_Filter_BlinkDetector_17_Detect_Decrease "ADAS/FuncLevel/MLIA/MLIA/MLIA calculation/Target LEDs/ADB target LEDs/HLL ADB target LEDs/AllDiodes_Filter/BlinkDetector_17/Detect
Decrease" /begin REF_MEASUREMENT rtDW_ADAS.GTDelayInput1_DSTATE_bn /end REF_MEASUREMENT /end GROUP
/begin GROUP ADAS_FuncLevel_MLIA_MLIA_MLIA_calculation_Target_LEDs_ADB_target_LEDs_HLL_ADB_target_LEDs_AllDiodes_Filter_BlinkDetector_17_Detect_Increase "ADAS/FuncLevel/MLIA/MLIA/MLIA calculation/Target LEDs/ADB target LEDs/HLL ADB target LEDs/AllDiodes_Filter/BlinkDetector_17/Detect
Increase" /begin REF_MEASUREMENT rtDW_ADAS.GTDelayInput1_DSTATE_ej /end REF_MEASUREMENT /end GROUP
/begin GROUP ADAS_FuncLevel_MLIA_MLIA_MLIA_calculation_Target_LEDs_ADB_target_LEDs_HLL_ADB_target_LEDs_AllDiodes_Filter_BlinkDetector_18 "ADAS/FuncLevel/MLIA/MLIA/MLIA calculation/Target LEDs/ADB target LEDs/HLL ADB target LEDs/AllDiodes_Filter/BlinkDetector_18"
 /begin SUB_GROUP ADAS_FuncLevel_MLIA_MLIA_MLIA_calculation_Target_LEDs_ADB_target_LEDs_HLL_ADB_target_LEDs_AllDiodes_Filter_BlinkDetector_18_Detect_Decrease ADAS_FuncLevel_MLIA_MLIA_MLIA_calculation_Target_LEDs_ADB_target_LEDs_HLL_ADB_target_LEDs_AllDiodes_Filter_BlinkDetector_18_Detect_Increase /end SUB_GROUP
/end GROUP
/begin GROUP ADAS_FuncLevel_MLIA_MLIA_MLIA_calculation_Target_LEDs_ADB_target_LEDs_HLL_ADB_target_LEDs_AllDiodes_Filter_BlinkDetector_18_Detect_Decrease "ADAS/FuncLevel/MLIA/MLIA/MLIA calculation/Target LEDs/ADB target LEDs/HLL ADB target LEDs/AllDiodes_Filter/BlinkDetector_18/Detect
Decrease" /begin REF_MEASUREMENT rtDW_ADAS.GTDelayInput1_DSTATE_mw /end REF_MEASUREMENT /end GROUP
/begin GROUP ADAS_FuncLevel_MLIA_MLIA_MLIA_calculation_Target_LEDs_ADB_target_LEDs_HLL_ADB_target_LEDs_AllDiodes_Filter_BlinkDetector_18_Detect_Increase "ADAS/FuncLevel/MLIA/MLIA/MLIA calculation/Target LEDs/ADB target LEDs/HLL ADB target LEDs/AllDiodes_Filter/BlinkDetector_18/Detect
Increase" /begin REF_MEASUREMENT rtDW_ADAS.GTDelayInput1_DSTATE_af /end REF_MEASUREMENT /end GROUP
/begin GROUP ADAS_FuncLevel_MLIA_MLIA_MLIA_calculation_Target_LEDs_ADB_target_LEDs_HLL_ADB_target_LEDs_AllDiodes_Filter_BlinkDetector_1_Detect_Decrease "ADAS/FuncLevel/MLIA/MLIA/MLIA calculation/Target LEDs/ADB target LEDs/HLL ADB target LEDs/AllDiodes_Filter/BlinkDetector_1/Detect
Decrease" /begin REF_MEASUREMENT rtDW_ADAS.GTDelayInput1_DSTATE_ey /end REF_MEASUREMENT /end GROUP
/begin GROUP ADAS_FuncLevel_MLIA_MLIA_MLIA_calculation_Target_LEDs_ADB_target_LEDs_HLL_ADB_target_LEDs_AllDiodes_Filter_BlinkDetector_1_Detect_Increase "ADAS/FuncLevel/MLIA/MLIA/MLIA calculation/Target LEDs/ADB target LEDs/HLL ADB target LEDs/AllDiodes_Filter/BlinkDetector_1/Detect
Increase" /begin REF_MEASUREMENT rtDW_ADAS.GTDelayInput1_DSTATE_ku /end REF_MEASUREMENT /end GROUP
/begin GROUP ADAS_FuncLevel_MLIA_MLIA_MLIA_calculation_Target_LEDs_ADB_target_LEDs_HLL_ADB_target_LEDs_AllDiodes_Filter_BlinkDetector_2 "ADAS/FuncLevel/MLIA/MLIA/MLIA calculation/Target LEDs/ADB target LEDs/HLL ADB target LEDs/AllDiodes_Filter/BlinkDetector_2"
 /begin SUB_GROUP ADAS_FuncLevel_MLIA_MLIA_MLIA_calculation_Target_LEDs_ADB_target_LEDs_HLL_ADB_target_LEDs_AllDiodes_Filter_BlinkDetector_2_Detect_Decrease ADAS_FuncLevel_MLIA_MLIA_MLIA_calculation_Target_LEDs_ADB_target_LEDs_HLL_ADB_target_LEDs_AllDiodes_Filter_BlinkDetector_2_Detect_Increase /end SUB_GROUP
/end GROUP
/begin GROUP ADAS_FuncLevel_MLIA_MLIA_MLIA_calculation_Target_LEDs_ADB_target_LEDs_HLL_ADB_target_LEDs_AllDiodes_Filter_BlinkDetector_2_Detect_Decrease "ADAS/FuncLevel/MLIA/MLIA/MLIA calculation/Target LEDs/ADB target LEDs/HLL ADB target LEDs/AllDiodes_Filter/BlinkDetector_2/Detect
Decrease" /begin REF_MEASUREMENT rtDW_ADAS.GTDelayInput1_DSTATE_fe /end REF_MEASUREMENT /end GROUP
/begin GROUP ADAS_FuncLevel_MLIA_MLIA_MLIA_calculation_Target_LEDs_ADB_target_LEDs_HLL_ADB_target_LEDs_AllDiodes_Filter_BlinkDetector_2_Detect_Increase "ADAS/FuncLevel/MLIA/MLIA/MLIA calculation/Target LEDs/ADB target LEDs/HLL ADB target LEDs/AllDiodes_Filter/BlinkDetector_2/Detect
Increase" /begin REF_MEASUREMENT rtDW_ADAS.GTDelayInput1_DSTATE_ii /end REF_MEASUREMENT /end GROUP
/begin GROUP ADAS_FuncLevel_MLIA_MLIA_MLIA_calculation_Target_LEDs_ADB_target_LEDs_HLL_ADB_target_LEDs_AllDiodes_Filter_BlinkDetector_3 "ADAS/FuncLevel/MLIA/MLIA/MLIA calculation/Target LEDs/ADB target LEDs/HLL ADB target LEDs/AllDiodes_Filter/BlinkDetector_3"
 /begin SUB_GROUP ADAS_FuncLevel_MLIA_MLIA_MLIA_calculation_Target_LEDs_ADB_target_LEDs_HLL_ADB_target_LEDs_AllDiodes_Filter_BlinkDetector_3_Detect_Decrease ADAS_FuncLevel_MLIA_MLIA_MLIA_calculation_Target_LEDs_ADB_target_LEDs_HLL_ADB_target_LEDs_AllDiodes_Filter_BlinkDetector_3_Detect_Increase /end SUB_GROUP
/end GROUP
/begin GROUP ADAS_FuncLevel_MLIA_MLIA_MLIA_calculation_Target_LEDs_ADB_target_LEDs_HLL_ADB_target_LEDs_AllDiodes_Filter_BlinkDetector_3_Detect_Decrease "ADAS/FuncLevel/MLIA/MLIA/MLIA calculation/Target LEDs/ADB target LEDs/HLL ADB target LEDs/AllDiodes_Filter/BlinkDetector_3/Detect
Decrease" /begin REF_MEASUREMENT rtDW_ADAS.GTDelayInput1_DSTATE_ox /end REF_MEASUREMENT /end GROUP
/begin GROUP ADAS_FuncLevel_MLIA_MLIA_MLIA_calculation_Target_LEDs_ADB_target_LEDs_HLL_ADB_target_LEDs_AllDiodes_Filter_BlinkDetector_3_Detect_Increase "ADAS/FuncLevel/MLIA/MLIA/MLIA calculation/Target LEDs/ADB target LEDs/HLL ADB target LEDs/AllDiodes_Filter/BlinkDetector_3/Detect
Increase" /begin REF_MEASUREMENT rtDW_ADAS.GTDelayInput1_DSTATE_mm /end REF_MEASUREMENT /end GROUP
/begin GROUP ADAS_FuncLevel_MLIA_MLIA_MLIA_calculation_Target_LEDs_ADB_target_LEDs_HLL_ADB_target_LEDs_AllDiodes_Filter_BlinkDetector_4 "ADAS/FuncLevel/MLIA/MLIA/MLIA calculation/Target LEDs/ADB target LEDs/HLL ADB target LEDs/AllDiodes_Filter/BlinkDetector_4"
 /begin SUB_GROUP ADAS_FuncLevel_MLIA_MLIA_MLIA_calculation_Target_LEDs_ADB_target_LEDs_HLL_ADB_target_LEDs_AllDiodes_Filter_BlinkDetector_4_Detect_Decrease ADAS_FuncLevel_MLIA_MLIA_MLIA_calculation_Target_LEDs_ADB_target_LEDs_HLL_ADB_target_LEDs_AllDiodes_Filter_BlinkDetector_4_Detect_Increase /end SUB_GROUP
/end GROUP
/begin GROUP ADAS_FuncLevel_MLIA_MLIA_MLIA_calculation_Target_LEDs_ADB_target_LEDs_HLL_ADB_target_LEDs_AllDiodes_Filter_BlinkDetector_4_Detect_Decrease "ADAS/FuncLevel/MLIA/MLIA/MLIA calculation/Target LEDs/ADB target LEDs/HLL ADB target LEDs/AllDiodes_Filter/BlinkDetector_4/Detect
Decrease" /begin REF_MEASUREMENT rtDW_ADAS.GTDelayInput1_DSTATE_cgq /end REF_MEASUREMENT /end GROUP
/begin GROUP ADAS_FuncLevel_MLIA_MLIA_MLIA_calculation_Target_LEDs_ADB_target_LEDs_HLL_ADB_target_LEDs_AllDiodes_Filter_BlinkDetector_4_Detect_Increase "ADAS/FuncLevel/MLIA/MLIA/MLIA calculation/Target LEDs/ADB target LEDs/HLL ADB target LEDs/AllDiodes_Filter/BlinkDetector_4/Detect
Increase" /begin REF_MEASUREMENT rtDW_ADAS.GTDelayInput1_DSTATE_me /end REF_MEASUREMENT /end GROUP
/begin GROUP ADAS_FuncLevel_MLIA_MLIA_MLIA_calculation_Target_LEDs_ADB_target_LEDs_HLL_ADB_target_LEDs_AllDiodes_Filter_BlinkDetector_5 "ADAS/FuncLevel/MLIA/MLIA/MLIA calculation/Target LEDs/ADB target LEDs/HLL ADB target LEDs/AllDiodes_Filter/BlinkDetector_5"
 /begin SUB_GROUP ADAS_FuncLevel_MLIA_MLIA_MLIA_calculation_Target_LEDs_ADB_target_LEDs_HLL_ADB_target_LEDs_AllDiodes_Filter_BlinkDetector_5_Detect_Decrease ADAS_FuncLevel_MLIA_MLIA_MLIA_calculation_Target_LEDs_ADB_target_LEDs_HLL_ADB_target_LEDs_AllDiodes_Filter_BlinkDetector_5_Detect_Increase /end SUB_GROUP
/end GROUP
/begin GROUP ADAS_FuncLevel_MLIA_MLIA_MLIA_calculation_Target_LEDs_ADB_target_LEDs_HLL_ADB_target_LEDs_AllDiodes_Filter_BlinkDetector_5_Detect_Decrease "ADAS/FuncLevel/MLIA/MLIA/MLIA calculation/Target LEDs/ADB target LEDs/HLL ADB target LEDs/AllDiodes_Filter/BlinkDetector_5/Detect
Decrease" /begin REF_MEASUREMENT rtDW_ADAS.GTDelayInput1_DSTATE_ci /end REF_MEASUREMENT /end GROUP
/begin GROUP ADAS_FuncLevel_MLIA_MLIA_MLIA_calculation_Target_LEDs_ADB_target_LEDs_HLL_ADB_target_LEDs_AllDiodes_Filter_BlinkDetector_5_Detect_Increase "ADAS/FuncLevel/MLIA/MLIA/MLIA calculation/Target LEDs/ADB target LEDs/HLL ADB target LEDs/AllDiodes_Filter/BlinkDetector_5/Detect
Increase" /begin REF_MEASUREMENT rtDW_ADAS.GTDelayInput1_DSTATE_jr /end REF_MEASUREMENT /end GROUP
/begin GROUP ADAS_FuncLevel_MLIA_MLIA_MLIA_calculation_Target_LEDs_ADB_target_LEDs_HLL_ADB_target_LEDs_AllDiodes_Filter_BlinkDetector_6 "ADAS/FuncLevel/MLIA/MLIA/MLIA calculation/Target LEDs/ADB target LEDs/HLL ADB target LEDs/AllDiodes_Filter/BlinkDetector_6"
 /begin SUB_GROUP ADAS_FuncLevel_MLIA_MLIA_MLIA_calculation_Target_LEDs_ADB_target_LEDs_HLL_ADB_target_LEDs_AllDiodes_Filter_BlinkDetector_6_Detect_Decrease ADAS_FuncLevel_MLIA_MLIA_MLIA_calculation_Target_LEDs_ADB_target_LEDs_HLL_ADB_target_LEDs_AllDiodes_Filter_BlinkDetector_6_Detect_Increase /end SUB_GROUP
/end GROUP
/begin GROUP ADAS_FuncLevel_MLIA_MLIA_MLIA_calculation_Target_LEDs_ADB_target_LEDs_HLL_ADB_target_LEDs_AllDiodes_Filter_BlinkDetector_6_Detect_Decrease "ADAS/FuncLevel/MLIA/MLIA/MLIA calculation/Target LEDs/ADB target LEDs/HLL ADB target LEDs/AllDiodes_Filter/BlinkDetector_6/Detect
Decrease" /begin REF_MEASUREMENT rtDW_ADAS.GTDelayInput1_DSTATE_fvk /end REF_MEASUREMENT /end GROUP
/begin GROUP ADAS_FuncLevel_MLIA_MLIA_MLIA_calculation_Target_LEDs_ADB_target_LEDs_HLL_ADB_target_LEDs_AllDiodes_Filter_BlinkDetector_6_Detect_Increase "ADAS/FuncLevel/MLIA/MLIA/MLIA calculation/Target LEDs/ADB target LEDs/HLL ADB target LEDs/AllDiodes_Filter/BlinkDetector_6/Detect
Increase" /begin REF_MEASUREMENT rtDW_ADAS.GTDelayInput1_DSTATE_lt /end REF_MEASUREMENT /end GROUP
/begin GROUP ADAS_FuncLevel_MLIA_MLIA_MLIA_calculation_Target_LEDs_ADB_target_LEDs_HLL_ADB_target_LEDs_AllDiodes_Filter_BlinkDetector_7 "ADAS/FuncLevel/MLIA/MLIA/MLIA calculation/Target LEDs/ADB target LEDs/HLL ADB target LEDs/AllDiodes_Filter/BlinkDetector_7"
 /begin SUB_GROUP ADAS_FuncLevel_MLIA_MLIA_MLIA_calculation_Target_LEDs_ADB_target_LEDs_HLL_ADB_target_LEDs_AllDiodes_Filter_BlinkDetector_7_Detect_Decrease ADAS_FuncLevel_MLIA_MLIA_MLIA_calculation_Target_LEDs_ADB_target_LEDs_HLL_ADB_target_LEDs_AllDiodes_Filter_BlinkDetector_7_Detect_Increase /end SUB_GROUP
/end GROUP
/begin GROUP ADAS_FuncLevel_MLIA_MLIA_MLIA_calculation_Target_LEDs_ADB_target_LEDs_HLL_ADB_target_LEDs_AllDiodes_Filter_BlinkDetector_7_Detect_Decrease "ADAS/FuncLevel/MLIA/MLIA/MLIA calculation/Target LEDs/ADB target LEDs/HLL ADB target LEDs/AllDiodes_Filter/BlinkDetector_7/Detect
Decrease" /begin REF_MEASUREMENT rtDW_ADAS.GTDelayInput1_DSTATE_kw /end REF_MEASUREMENT /end GROUP
/begin GROUP ADAS_FuncLevel_MLIA_MLIA_MLIA_calculation_Target_LEDs_ADB_target_LEDs_HLL_ADB_target_LEDs_AllDiodes_Filter_BlinkDetector_7_Detect_Increase "ADAS/FuncLevel/MLIA/MLIA/MLIA calculation/Target LEDs/ADB target LEDs/HLL ADB target LEDs/AllDiodes_Filter/BlinkDetector_7/Detect
Increase" /begin REF_MEASUREMENT rtDW_ADAS.GTDelayInput1_DSTATE_lm /end REF_MEASUREMENT /end GROUP
/begin GROUP ADAS_FuncLevel_MLIA_MLIA_MLIA_calculation_Target_LEDs_ADB_target_LEDs_HLL_ADB_target_LEDs_AllDiodes_Filter_BlinkDetector_8 "ADAS/FuncLevel/MLIA/MLIA/MLIA calculation/Target LEDs/ADB target LEDs/HLL ADB target LEDs/AllDiodes_Filter/BlinkDetector_8"
 /begin SUB_GROUP ADAS_FuncLevel_MLIA_MLIA_MLIA_calculation_Target_LEDs_ADB_target_LEDs_HLL_ADB_target_LEDs_AllDiodes_Filter_BlinkDetector_8_Detect_Decrease ADAS_FuncLevel_MLIA_MLIA_MLIA_calculation_Target_LEDs_ADB_target_LEDs_HLL_ADB_target_LEDs_AllDiodes_Filter_BlinkDetector_8_Detect_Increase /end SUB_GROUP
/end GROUP
/begin GROUP ADAS_FuncLevel_MLIA_MLIA_MLIA_calculation_Target_LEDs_ADB_target_LEDs_HLL_ADB_target_LEDs_AllDiodes_Filter_BlinkDetector_8_Detect_Decrease "ADAS/FuncLevel/MLIA/MLIA/MLIA calculation/Target LEDs/ADB target LEDs/HLL ADB target LEDs/AllDiodes_Filter/BlinkDetector_8/Detect
Decrease" /begin REF_MEASUREMENT rtDW_ADAS.GTDelayInput1_DSTATE_ij /end REF_MEASUREMENT /end GROUP
/begin GROUP ADAS_FuncLevel_MLIA_MLIA_MLIA_calculation_Target_LEDs_ADB_target_LEDs_HLL_ADB_target_LEDs_AllDiodes_Filter_BlinkDetector_8_Detect_Increase "ADAS/FuncLevel/MLIA/MLIA/MLIA calculation/Target LEDs/ADB target LEDs/HLL ADB target LEDs/AllDiodes_Filter/BlinkDetector_8/Detect
Increase" /begin REF_MEASUREMENT rtDW_ADAS.GTDelayInput1_DSTATE_ay /end REF_MEASUREMENT /end GROUP
/begin GROUP ADAS_FuncLevel_MLIA_MLIA_MLIA_calculation_Target_LEDs_ADB_target_LEDs_HLL_ADB_target_LEDs_AllDiodes_Filter_BlinkDetector_9 "ADAS/FuncLevel/MLIA/MLIA/MLIA calculation/Target LEDs/ADB target LEDs/HLL ADB target LEDs/AllDiodes_Filter/BlinkDetector_9"
 /begin SUB_GROUP ADAS_FuncLevel_MLIA_MLIA_MLIA_calculation_Target_LEDs_ADB_target_LEDs_HLL_ADB_target_LEDs_AllDiodes_Filter_BlinkDetector_9_Detect_Decrease ADAS_FuncLevel_MLIA_MLIA_MLIA_calculation_Target_LEDs_ADB_target_LEDs_HLL_ADB_target_LEDs_AllDiodes_Filter_BlinkDetector_9_Detect_Increase /end SUB_GROUP
/end GROUP
/begin GROUP ADAS_FuncLevel_MLIA_MLIA_MLIA_calculation_Target_LEDs_ADB_target_LEDs_HLL_ADB_target_LEDs_AllDiodes_Filter_BlinkDetector_9_Detect_Decrease "ADAS/FuncLevel/MLIA/MLIA/MLIA calculation/Target LEDs/ADB target LEDs/HLL ADB target LEDs/AllDiodes_Filter/BlinkDetector_9/Detect
Decrease" /begin REF_MEASUREMENT rtDW_ADAS.GTDelayInput1_DSTATE_ep /end REF_MEASUREMENT /end GROUP
/begin GROUP ADAS_FuncLevel_MLIA_MLIA_MLIA_calculation_Target_LEDs_ADB_target_LEDs_HLL_ADB_target_LEDs_AllDiodes_Filter_BlinkDetector_9_Detect_Increase "ADAS/FuncLevel/MLIA/MLIA/MLIA calculation/Target LEDs/ADB target LEDs/HLL ADB target LEDs/AllDiodes_Filter/BlinkDetector_9/Detect
Increase" /begin REF_MEASUREMENT rtDW_ADAS.GTDelayInput1_DSTATE_oz /end REF_MEASUREMENT /end GROUP
/begin GROUP ADAS_FuncLevel_MLIA_MLIA_MLIA_calculation_Target_LEDs_ADB_target_LEDs_HLR_ADB_target_LEDs "ADAS/FuncLevel/MLIA/MLIA/MLIA calculation/Target LEDs/ADB target LEDs/HLR ADB target LEDs"
 /begin SUB_GROUP ADAS_FuncLevel_MLIA_MLIA_MLIA_calculation_Target_LEDs_ADB_target_LEDs_HLR_ADB_target_LEDs_AllDiodes_Filter /end SUB_GROUP
 /begin REF_MEASUREMENT rtDW_ADAS.GTDelay1_DSTATE_ef rtDW_ADAS.GTDelay_DSTATE_bd rtDW_ADAS.GTMemory1_PreviousInput_l rtDW_ADAS.GTMemory2_PreviousInput_en rtDW_ADAS.GTMemory3_PreviousInput_o5z rtDW_ADAS.GTMemory4_PreviousInput_jh rtDW_ADAS.GTMemory5_PreviousInput_n3 rtDW_ADAS.GTMemory6_PreviousInput_l rtDW_ADAS.GTMemory7_PreviousInput_e rtDW_ADAS.GTMemory8_PreviousInput_o /end REF_MEASUREMENT
/end GROUP
/begin GROUP ADAS_FuncLevel_MLIA_MLIA_MLIA_calculation_Target_LEDs_ADB_target_LEDs_HLR_ADB_target_LEDs_AllDiodes_Filter "ADAS/FuncLevel/MLIA/MLIA/MLIA calculation/Target LEDs/ADB target LEDs/HLR ADB target LEDs/AllDiodes_Filter"
 /begin SUB_GROUP ADAS_FuncLevel_MLIA_MLIA_MLIA_calculation_Target_LEDs_ADB_target_LEDs_HLR_ADB_target_LEDs_AllDiodes_Filter_BlinkDetector_1 ADAS_FuncLevel_MLIA_MLIA_MLIA_calculation_Target_LEDs_ADB_target_LEDs_HLR_ADB_target_LEDs_AllDiodes_Filter_BlinkDetector_10 ADAS_FuncLevel_MLIA_MLIA_MLIA_calculation_Target_LEDs_ADB_target_LEDs_HLR_ADB_target_LEDs_AllDiodes_Filter_BlinkDetector_11 ADAS_FuncLevel_MLIA_MLIA_MLIA_calculation_Target_LEDs_ADB_target_LEDs_HLR_ADB_target_LEDs_AllDiodes_Filter_BlinkDetector_12 ADAS_FuncLevel_MLIA_MLIA_MLIA_calculation_Target_LEDs_ADB_target_LEDs_HLR_ADB_target_LEDs_AllDiodes_Filter_BlinkDetector_13 ADAS_FuncLevel_MLIA_MLIA_MLIA_calculation_Target_LEDs_ADB_target_LEDs_HLR_ADB_target_LEDs_AllDiodes_Filter_BlinkDetector_14 ADAS_FuncLevel_MLIA_MLIA_MLIA_calculation_Target_LEDs_ADB_target_LEDs_HLR_ADB_target_LEDs_AllDiodes_Filter_BlinkDetector_15 ADAS_FuncLevel_MLIA_MLIA_MLIA_calculation_Target_LEDs_ADB_target_LEDs_HLR_ADB_target_LEDs_AllDiodes_Filter_BlinkDetector_16 ADAS_FuncLevel_MLIA_MLIA_MLIA_calculation_Target_LEDs_ADB_target_LEDs_HLR_ADB_target_LEDs_AllDiodes_Filter_BlinkDetector_17 ADAS_FuncLevel_MLIA_MLIA_MLIA_calculation_Target_LEDs_ADB_target_LEDs_HLR_ADB_target_LEDs_AllDiodes_Filter_BlinkDetector_18 ADAS_FuncLevel_MLIA_MLIA_MLIA_calculation_Target_LEDs_ADB_target_LEDs_HLR_ADB_target_LEDs_AllDiodes_Filter_BlinkDetector_2 ADAS_FuncLevel_MLIA_MLIA_MLIA_calculation_Target_LEDs_ADB_target_LEDs_HLR_ADB_target_LEDs_AllDiodes_Filter_BlinkDetector_3 ADAS_FuncLevel_MLIA_MLIA_MLIA_calculation_Target_LEDs_ADB_target_LEDs_HLR_ADB_target_LEDs_AllDiodes_Filter_BlinkDetector_4 ADAS_FuncLevel_MLIA_MLIA_MLIA_calculation_Target_LEDs_ADB_target_LEDs_HLR_ADB_target_LEDs_AllDiodes_Filter_BlinkDetector_5 ADAS_FuncLevel_MLIA_MLIA_MLIA_calculation_Target_LEDs_ADB_target_LEDs_HLR_ADB_target_LEDs_AllDiodes_Filter_BlinkDetector_6 ADAS_FuncLevel_MLIA_MLIA_MLIA_calculation_Target_LEDs_ADB_target_LEDs_HLR_ADB_target_LEDs_AllDiodes_Filter_BlinkDetector_7 ADAS_FuncLevel_MLIA_MLIA_MLIA_calculation_Target_LEDs_ADB_target_LEDs_HLR_ADB_target_LEDs_AllDiodes_Filter_BlinkDetector_8 ADAS_FuncLevel_MLIA_MLIA_MLIA_calculation_Target_LEDs_ADB_target_LEDs_HLR_ADB_target_LEDs_AllDiodes_Filter_BlinkDetector_9 /end SUB_GROUP
 /begin REF_MEASUREMENT rtDW_ADAS.GTDelay2_DSTATE_m rtDW_ADAS.GTDelay3_DSTATE_g /end REF_MEASUREMENT
/end GROUP
/begin GROUP ADAS_FuncLevel_MLIA_MLIA_MLIA_calculation_Target_LEDs_ADB_target_LEDs_HLR_ADB_target_LEDs_AllDiodes_Filter_BlinkDetector_1 "ADAS/FuncLevel/MLIA/MLIA/MLIA calculation/Target LEDs/ADB target LEDs/HLR ADB target LEDs/AllDiodes_Filter/BlinkDetector_1"
 /begin SUB_GROUP ADAS_FuncLevel_MLIA_MLIA_MLIA_calculation_Target_LEDs_ADB_target_LEDs_HLR_ADB_target_LEDs_AllDiodes_Filter_BlinkDetector_1_Detect_Decrease ADAS_FuncLevel_MLIA_MLIA_MLIA_calculation_Target_LEDs_ADB_target_LEDs_HLR_ADB_target_LEDs_AllDiodes_Filter_BlinkDetector_1_Detect_Increase /end SUB_GROUP
/end GROUP
/begin GROUP ADAS_FuncLevel_MLIA_MLIA_MLIA_calculation_Target_LEDs_ADB_target_LEDs_HLR_ADB_target_LEDs_AllDiodes_Filter_BlinkDetector_10 "ADAS/FuncLevel/MLIA/MLIA/MLIA calculation/Target LEDs/ADB target LEDs/HLR ADB target LEDs/AllDiodes_Filter/BlinkDetector_10"
 /begin SUB_GROUP ADAS_FuncLevel_MLIA_MLIA_MLIA_calculation_Target_LEDs_ADB_target_LEDs_HLR_ADB_target_LEDs_AllDiodes_Filter_BlinkDetector_10_Detect_Decrease ADAS_FuncLevel_MLIA_MLIA_MLIA_calculation_Target_LEDs_ADB_target_LEDs_HLR_ADB_target_LEDs_AllDiodes_Filter_BlinkDetector_10_Detect_Increase /end SUB_GROUP
/end GROUP
/begin GROUP ADAS_FuncLevel_MLIA_MLIA_MLIA_calculation_Target_LEDs_ADB_target_LEDs_HLR_ADB_target_LEDs_AllDiodes_Filter_BlinkDetector_10_Detect_Decrease "ADAS/FuncLevel/MLIA/MLIA/MLIA calculation/Target LEDs/ADB target LEDs/HLR ADB target LEDs/AllDiodes_Filter/BlinkDetector_10/Detect
Decrease" /begin REF_MEASUREMENT rtDW_ADAS.GTDelayInput1_DSTATE_c /end REF_MEASUREMENT /end GROUP
/begin GROUP ADAS_FuncLevel_MLIA_MLIA_MLIA_calculation_Target_LEDs_ADB_target_LEDs_HLR_ADB_target_LEDs_AllDiodes_Filter_BlinkDetector_10_Detect_Increase "ADAS/FuncLevel/MLIA/MLIA/MLIA calculation/Target LEDs/ADB target LEDs/HLR ADB target LEDs/AllDiodes_Filter/BlinkDetector_10/Detect
Increase" /begin REF_MEASUREMENT rtDW_ADAS.GTDelayInput1_DSTATE_g /end REF_MEASUREMENT /end GROUP
/begin GROUP ADAS_FuncLevel_MLIA_MLIA_MLIA_calculation_Target_LEDs_ADB_target_LEDs_HLR_ADB_target_LEDs_AllDiodes_Filter_BlinkDetector_11 "ADAS/FuncLevel/MLIA/MLIA/MLIA calculation/Target LEDs/ADB target LEDs/HLR ADB target LEDs/AllDiodes_Filter/BlinkDetector_11"
 /begin SUB_GROUP ADAS_FuncLevel_MLIA_MLIA_MLIA_calculation_Target_LEDs_ADB_target_LEDs_HLR_ADB_target_LEDs_AllDiodes_Filter_BlinkDetector_11_Detect_Decrease ADAS_FuncLevel_MLIA_MLIA_MLIA_calculation_Target_LEDs_ADB_target_LEDs_HLR_ADB_target_LEDs_AllDiodes_Filter_BlinkDetector_11_Detect_Increase /end SUB_GROUP
/end GROUP
/begin GROUP ADAS_FuncLevel_MLIA_MLIA_MLIA_calculation_Target_LEDs_ADB_target_LEDs_HLR_ADB_target_LEDs_AllDiodes_Filter_BlinkDetector_11_Detect_Decrease "ADAS/FuncLevel/MLIA/MLIA/MLIA calculation/Target LEDs/ADB target LEDs/HLR ADB target LEDs/AllDiodes_Filter/BlinkDetector_11/Detect
Decrease" /begin REF_MEASUREMENT rtDW_ADAS.GTDelayInput1_DSTATE_hd /end REF_MEASUREMENT /end GROUP
/begin GROUP ADAS_FuncLevel_MLIA_MLIA_MLIA_calculation_Target_LEDs_ADB_target_LEDs_HLR_ADB_target_LEDs_AllDiodes_Filter_BlinkDetector_11_Detect_Increase "ADAS/FuncLevel/MLIA/MLIA/MLIA calculation/Target LEDs/ADB target LEDs/HLR ADB target LEDs/AllDiodes_Filter/BlinkDetector_11/Detect
Increase" /begin REF_MEASUREMENT rtDW_ADAS.GTDelayInput1_DSTATE_gg /end REF_MEASUREMENT /end GROUP
/begin GROUP ADAS_FuncLevel_MLIA_MLIA_MLIA_mode "ADAS/FuncLevel/MLIA/MLIA/MLIA mode" /begin REF_MEASUREMENT rtDW_ADAS.GTTransMliaMode /end REF_MEASUREMENT /end GROUP
/begin GROUP ADAS_Output_new_FCW__AEB "ADAS/Output_new/FCW//AEB"
 /begin REF_MEASUREMENT rtDW_ADAS.GTSwitch1_o rtDW_ADAS.GTSwitch_g rtDW_ADAS.GTy rtDW_ADAS.GTy_e /end REF_MEASUREMENT
/end GROUP
/begin GROUP ADAS_Output_new_LCC__ALCC__DOW "ADAS/Output_new/LCC//ALCC//DOW"
 /begin REF_MEASUREMENT rtDW_ADAS.GTDtLogLccLogicTrans rtDW_ADAS.GTDtLogLccWarnReqTransLeft rtDW_ADAS.GTDtLogLccWarnReqTransRight rtDW_ADAS.GTLccActvnMode rtDW_ADAS.GTLccLeftLedReq rtDW_ADAS.GTLccLeftWarnReq rtDW_ADAS.GTLccRightLedReq rtDW_ADAS.GTLccRightWarnReq rtDW_ADAS.GTLccSoundReq rtDW_ADAS.GTisObjInLeftCvwZone rtDW_ADAS.GTisObjInRightCvwZone /end REF_MEASUREMENT
/end GROUP
/begin GROUP ADAS_Output_new_LDW__LDP "ADAS/Output_new/LDW//LDP" /begin REF_MEASUREMENT rtDW_ADAS.GTTransLdwMode /end REF_MEASUREMENT /end GROUP
/begin GROUP ADAS_Output_new_MLIA__Left "ADAS/Output_new/MLIA//Left" /begin REF_MEASUREMENT rtDW_ADAS.GTTransMliaMode /end REF_MEASUREMENT /end GROUP
/begin GROUP ADAS_Output_new_Vibration_Manager "ADAS/Output_new/Vibration
Manager" /begin REF_MEASUREMENT rtDW_ADAS.GTLccVibrWarnReq /end REF_MEASUREMENT /end GROUP
/end MODULE
/end PROJECT
