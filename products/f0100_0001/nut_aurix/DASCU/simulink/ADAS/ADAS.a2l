ASAP2_VERSION 1 71
/begin PROJECT ProjectName "Project Comment Goes Here"
/begin HEADER "Header Comments go here" /end HEADER
/begin MODULE ModuleName "Module Comment Goes Here"
/begin MOD_COMMON "Mod Common Comment Here" BYTE_ORDER MSB_LAST ALIGNMENT_BYTE 1 ALIGNMENT_WORD 2 ALIGNMENT_LONG 4 ALIGNMENT_FLOAT32_IEEE 4 ALIGNMENT_FLOAT64_IEEE 8 ALIGNMENT_INT64 8 /end MOD_COMMON
/begin CHARACTERISTIC ADB_Filter_avail "ADB-diode filter availability" VALUE 0x0000 /* @ECU_Address@ADB_Filter_avail@ */ Scalar_FLOAT32_IEEE 0 ADAS_CM_single 0.000000 1.000000 /end CHARACTERISTIC
/begin CHARACTERISTIC ADB_avail "Functioning ADB-module in MLIA: 0-off, 1-active" VALUE 0x0000 /* @ECU_Address@ADB_avail@ */ Scalar_FLOAT32_IEEE 0 ADAS_CM_single 0.000000 1.000000 /end CHARACTERISTIC
/begin CHARACTERISTIC AccelPosMax "Maximum acceleration pedal position at which warning is available, %" VALUE 0x0000 /* @ECU_Address@AccelPosMax@ */ Scalar_FLOAT32_IEEE 0 ADAS_CM_single 1.000000 120.000000 /end CHARACTERISTIC
/begin CHARACTERISTIC AebOnOff "Enable AEB" VALUE 0x0000 /* @ECU_Address@AebOnOff@ */ Scalar_UBYTE 0 ADAS_CM_uint8 0.000000 1.000000 /end CHARACTERISTIC
/begin CHARACTERISTIC AnimBorder "Outside border of animation object zone, deg" VALUE 0x0000 /* @ECU_Address@AnimBorder@ */ Scalar_FLOAT32_IEEE 0 ADAS_CM_single 25.000000 50.000000 /end CHARACTERISTIC
/begin CHARACTERISTIC AvoidanceAvail "Availability of AVOID block: 0-off, 1-avail" VALUE 0x0000 /* @ECU_Address@AvoidanceAvail@ */ Scalar_UBYTE 0 ADAS_CM_uint8 0.000000 1.000000 /end CHARACTERISTIC
/begin CHARACTERISTIC B_OutsideFront "Distance between outer sides of the front axle tires, m" VALUE 0x0000 /* @ECU_Address@B_OutsideFront@ */ Scalar_FLOAT32_IEEE 0 ADAS_CM_single 1.000000 3.000000 /end CHARACTERISTIC
/begin CHARACTERISTIC BlinkDetectDuration "Duration of BlinkDetect State (Standby) after blinks, sec" VALUE 0x0000 /* @ECU_Address@BlinkDetectDuration@ */ Scalar_FLOAT32_IEEE 0 ADAS_CM_single 0.000000 20.000000 /end CHARACTERISTIC
/begin CHARACTERISTIC BlinkDetector_avail "Blink detector availability" VALUE 0x0000 /* @ECU_Address@BlinkDetector_avail@ */ Scalar_FLOAT32_IEEE 0 ADAS_CM_single 0.000000 1.000000 /end CHARACTERISTIC
/begin CHARACTERISTIC BlinkPerdTurnSig "The period of blinking of the turn signal" VALUE 0x0000 /* @ECU_Address@BlinkPerdTurnSig@ */ Scalar_FLOAT32_IEEE 0 ADAS_CM_single_s 0.000000 3.000000 /end CHARACTERISTIC
/begin CHARACTERISTIC BlinkPeriod "The period of blinking of the led on the side rearview mirror" VALUE 0x0000 /* @ECU_Address@BlinkPeriod@ */ Scalar_FLOAT32_IEEE 0 ADAS_CM_single_s 0.000000 3.000000 /end CHARACTERISTIC
/begin CHARACTERISTIC BlinkPeriodCheckMode "CheckMode = 0 - LEDs work normal, = 1 - LEDs always blink" VALUE 0x0000 /* @ECU_Address@BlinkPeriodCheckMode@ */ Scalar_UBYTE 0 ADAS_CM_uint8 0.000000 1.000000 /end CHARACTERISTIC
/begin CHARACTERISTIC BrakePressMax "Maximum brake pressure in the master cylinder at which warning is available, bar" VALUE 0x0000 /* @ECU_Address@BrakePressMax@ */ Scalar_FLOAT32_IEEE 0 ADAS_CM_single 1.000000 200.000000 /end CHARACTERISTIC
/begin CHARACTERISTIC BswBackLineHystWidth "Ширина гистерезиса по выходу из зоны BSW через заднюю линию" VALUE 0x0000 /* @ECU_Address@BswBackLineHystWidth@ */ Scalar_FLOAT32_IEEE 0 ADAS_CM_single_m 0.000000 1.000000 /end CHARACTERISTIC
/begin CHARACTERISTIC BswCloseLineHystWidth "Ширина гистерезиса по выходу из зоны BSW через близкую боковую линию" VALUE 0x0000 /* @ECU_Address@BswCloseLineHystWidth@ */ Scalar_FLOAT32_IEEE 0 ADAS_CM_single_m 0.000000 1.000000 /end CHARACTERISTIC
/begin CHARACTERISTIC BswEnableServiceParam "1 - BSW enable, 0 - BSW disable" VALUE 0x0000 /* @ECU_Address@BswEnableServiceParam@ */ Scalar_UBYTE 0 ADAS_CM_uint8 0.000000 1.000000 /end CHARACTERISTIC
/begin CHARACTERISTIC BswFarLineHystWidth "Ширина гистерезиса по выходу из зоны BSW через дальнюю боковую линию" VALUE 0x0000 /* @ECU_Address@BswFarLineHystWidth@ */ Scalar_FLOAT32_IEEE 0 ADAS_CM_single_m 0.000000 1.000000 /end CHARACTERISTIC
/begin CHARACTERISTIC BswMaxDeltaSpeed "If main car speed exceeds Vx of the target object by a set value or more, then BSW is not triggered." VALUE 0x0000 /* @ECU_Address@BswMaxDeltaSpeed@ */ Scalar_FLOAT32_IEEE 0 ADAS_CM_single_m_per_s -10.000000 10.000000 /end CHARACTERISTIC
/begin CHARACTERISTIC BswSideEdgeToCloseLine "The distance from overall side edge of the car without mirrors to close line of BSW zone" VALUE 0x0000 /* @ECU_Address@BswSideEdgeToCloseLine@ */ Scalar_FLOAT32_IEEE 0 ADAS_CM_single_m -10.000000 10.000000 /end CHARACTERISTIC
/begin CHARACTERISTIC BswZoneLenClose "The length of the BSW zone BEHIND the vehicle in CLOSE mode" VALUE 0x0000 /* @ECU_Address@BswZoneLenClose@ */ Scalar_FLOAT32_IEEE 0 ADAS_CM_single_m -100.000000 100.000000 /end CHARACTERISTIC
/begin CHARACTERISTIC BswZoneLenFar "The length of the BSW zone BEHIND the vehicle in FAR mode" VALUE 0x0000 /* @ECU_Address@BswZoneLenFar@ */ Scalar_FLOAT32_IEEE 0 ADAS_CM_single_m -100.000000 100.000000 /end CHARACTERISTIC
/begin CHARACTERISTIC BswZoneLenMedium "The length of the BSW zone BEHIND the vehicle in MEDIUM mode" VALUE 0x0000 /* @ECU_Address@BswZoneLenMedium@ */ Scalar_FLOAT32_IEEE 0 ADAS_CM_single_m -100.000000 100.000000 /end CHARACTERISTIC
/begin CHARACTERISTIC BswZoneWidth "The width of the BSW zone" VALUE 0x0000 /* @ECU_Address@BswZoneWidth@ */ Scalar_FLOAT32_IEEE 0 ADAS_CM_single_m -100.000000 100.000000 /end CHARACTERISTIC
/begin CHARACTERISTIC ByeTi "Turning off HB animation time, s" VALUE 0x0000 /* @ECU_Address@ByeTi@ */ Scalar_FLOAT32_IEEE 0 ADAS_CM_single 0.000000 10.000000 /end CHARACTERISTIC
/begin CHARACTERISTIC CarWidthWithoutMirrors "Overall width of the car without side mirrors" VALUE 0x0000 /* @ECU_Address@CarWidthWithoutMirrors@ */ Scalar_FLOAT32_IEEE 0 ADAS_CM_single_m 0.000000 100.000000 /end CHARACTERISTIC
/begin CHARACTERISTIC CcDistA "[0,1,2,3]" CURVE 0x0000 /* @ECU_Address@CcDistA@ */ FixLookup_FLOAT32_IEEE 0 ADAS_CM_single -3.4E+38 3.4E+38
 /begin AXIS_DESCR FIX_AXIS NO_INPUT_QUANTITY ADAS_CM_single 4 0.000000 3.000000 FIX_AXIS_PAR_DIST 0 1 4 /end AXIS_DESCR
/end CHARACTERISTIC
/begin CHARACTERISTIC CcDistAngle "Angle =[-10,-8,-6,-4,-2,0,2,4,6,7]" CURVE 0x0000 /* @ECU_Address@CcDistAngle@ */ FixLookup_FLOAT32_IEEE 0 ADAS_CM_single -3.4E+38 3.4E+38
 /begin AXIS_DESCR FIX_AXIS NO_INPUT_QUANTITY ADAS_CM_single 10 -10.000000 7.000000 /begin FIX_AXIS_PAR_LIST -10 -8 -6 -4 -2 0 2 4 6 7 /end FIX_AXIS_PAR_LIST /end AXIS_DESCR
/end CHARACTERISTIC
/begin CHARACTERISTIC CcDistB "[0,1,2,3]" CURVE 0x0000 /* @ECU_Address@CcDistB@ */ FixLookup_FLOAT32_IEEE 0 ADAS_CM_single -3.4E+38 3.4E+38
 /begin AXIS_DESCR FIX_AXIS NO_INPUT_QUANTITY ADAS_CM_single 4 0.000000 3.000000 FIX_AXIS_PAR_DIST 0 1 4 /end AXIS_DESCR
/end CHARACTERISTIC
/begin CHARACTERISTIC CcDistC "[0,1,2,3]" CURVE 0x0000 /* @ECU_Address@CcDistC@ */ FixLookup_FLOAT32_IEEE 0 ADAS_CM_single -3.4E+38 3.4E+38
 /begin AXIS_DESCR FIX_AXIS NO_INPUT_QUANTITY ADAS_CM_single 4 0.000000 3.000000 FIX_AXIS_PAR_DIST 0 1 4 /end AXIS_DESCR
/end CHARACTERISTIC
/begin CHARACTERISTIC CcDrTakeMinTime "sec" VALUE 0x0000 /* @ECU_Address@CcDrTakeMinTime@ */ Scalar_FLOAT32_IEEE 0 ADAS_CM_single -3.4E+38 3.4E+38 /end CHARACTERISTIC
/begin CHARACTERISTIC CcDrTakeTimeDelay1 "sec" VALUE 0x0000 /* @ECU_Address@CcDrTakeTimeDelay1@ */ Scalar_FLOAT32_IEEE 0 ADAS_CM_single -3.4E+38 3.4E+38 /end CHARACTERISTIC
/begin CHARACTERISTIC CcDrTakeTimeDelay2 "sec" VALUE 0x0000 /* @ECU_Address@CcDrTakeTimeDelay2@ */ Scalar_FLOAT32_IEEE 0 ADAS_CM_single -3.4E+38 3.4E+38 /end CHARACTERISTIC
/begin CHARACTERISTIC CcLimGain "Error speed = [-10,0,10,20,30,40,50]" CURVE 0x0000 /* @ECU_Address@CcLimGain@ */ FixLookup_FLOAT32_IEEE 0 ADAS_CM_single -3.4E+38 3.4E+38
 /begin AXIS_DESCR FIX_AXIS NO_INPUT_QUANTITY ADAS_CM_single 7 -10.000000 50.000000 FIX_AXIS_PAR_DIST -10 10 7 /end AXIS_DESCR
/end CHARACTERISTIC
/begin CHARACTERISTIC CcLimSaturLow "Lower limit of acceleration for LIM, m/s2" VALUE 0x0000 /* @ECU_Address@CcLimSaturLow@ */ Scalar_FLOAT32_IEEE 0 ADAS_CM_single -3.4E+38 3.4E+38 /end CHARACTERISTIC
/begin CHARACTERISTIC CcLimSaturUp "Upper limit of acceleration for LIM, m/s2" VALUE 0x0000 /* @ECU_Address@CcLimSaturUp@ */ Scalar_FLOAT32_IEEE 0 ADAS_CM_single -3.4E+38 3.4E+38 /end CHARACTERISTIC
/begin CHARACTERISTIC CcMaxDist "MaxDist in IC" VALUE 0x0000 /* @ECU_Address@CcMaxDist@ */ Scalar_UBYTE 0 ADAS_CM_uint8 0 255 /end CHARACTERISTIC
/begin CHARACTERISTIC CcMaxSpeed "kmh" VALUE 0x0000 /* @ECU_Address@CcMaxSpeed@ */ Scalar_FLOAT32_IEEE 0 ADAS_CM_single -3.4E+38 3.4E+38 /end CHARACTERISTIC
/begin CHARACTERISTIC CcMinDist "MinDist in IC" VALUE 0x0000 /* @ECU_Address@CcMinDist@ */ Scalar_UBYTE 0 ADAS_CM_uint8 0 255 /end CHARACTERISTIC
/begin CHARACTERISTIC CcMinSpeed "kmh" VALUE 0x0000 /* @ECU_Address@CcMinSpeed@ */ Scalar_FLOAT32_IEEE 0 ADAS_CM_single -3.4E+38 3.4E+38 /end CHARACTERISTIC
/begin CHARACTERISTIC CcMotHysterLow "Lower limit of driver torque and ADAS torque difference, N*m" VALUE 0x0000 /* @ECU_Address@CcMotHysterLow@ */ Scalar_FLOAT32_IEEE 0 ADAS_CM_single -3.4E+38 3.4E+38 /end CHARACTERISTIC
/begin CHARACTERISTIC CcMotHysterUp "Upper limit of driver torque and ADAS torque difference, N*m" VALUE 0x0000 /* @ECU_Address@CcMotHysterUp@ */ Scalar_FLOAT32_IEEE 0 ADAS_CM_single -3.4E+38 3.4E+38 /end CHARACTERISTIC
/begin CHARACTERISTIC CcSetSpeedOffset "Set Speed offset" VALUE 0x0000 /* @ECU_Address@CcSetSpeedOffset@ */ Scalar_FLOAT32_IEEE 0 ADAS_CM_single -3.4E+38 3.4E+38 /end CHARACTERISTIC
/begin CHARACTERISTIC CcSpeedAccelGain "Error Speed = [-4,-3,-2,-1,0,1,2,3,4,5,6,7,10,13,15,16,17,18,20,22,25]" CURVE 0x0000 /* @ECU_Address@CcSpeedAccelGain@ */ FixLookup_FLOAT32_IEEE 0 ADAS_CM_single -3.4E+38 3.4E+38
 /begin AXIS_DESCR FIX_AXIS NO_INPUT_QUANTITY ADAS_CM_single 21 -4.000000 25.000000 /begin FIX_AXIS_PAR_LIST -4 -3 -2 -1 0 1 2 3 4 5 6 7 10 13 15 16 17 18 20 22 25 /end FIX_AXIS_PAR_LIST /end AXIS_DESCR
/end CHARACTERISTIC
/begin CHARACTERISTIC CcSpeedAccelRateUp "Rate Limiter Accel Up" VALUE 0x0000 /* @ECU_Address@CcSpeedAccelRateUp@ */ Scalar_FLOAT32_IEEE 0 ADAS_CM_single -3.4E+38 3.4E+38 /end CHARACTERISTIC
/begin CHARACTERISTIC CcSpeedDecelRateUp "Rate Limiter Decel Up" VALUE 0x0000 /* @ECU_Address@CcSpeedDecelRateUp@ */ Scalar_FLOAT32_IEEE 0 ADAS_CM_single -3.4E+38 3.4E+38 /end CHARACTERISTIC
/begin CHARACTERISTIC CcSpeedDecelRateUpOver "Rate Limiter Decel Up Override->Active" VALUE 0x0000 /* @ECU_Address@CcSpeedDecelRateUpOver@ */ Scalar_FLOAT32_IEEE 0 ADAS_CM_single -3.4E+38 3.4E+38 /end CHARACTERISTIC
/begin CHARACTERISTIC CcSpeedDecelVar "Error Speed = [-36,-35,-25,-24,-15,-12,-9,-6,-5,-4,-3,-2,-1,-0.2,2,3,4,5,6,7,8,9]" CURVE 0x0000 /* @ECU_Address@CcSpeedDecelVar@ */ FixLookup_FLOAT32_IEEE 0 ADAS_CM_single -3.4E+38 3.4E+38
 /begin AXIS_DESCR FIX_AXIS NO_INPUT_QUANTITY ADAS_CM_single 22 -36.000000 9.000000
  /begin FIX_AXIS_PAR_LIST -36 -35 -25 -24 -15 -12 -9 -6 -5 -4 -3 -2 -1 -0.2 2 3 4 5 6 7 8 9 /end FIX_AXIS_PAR_LIST
 /end AXIS_DESCR
/end CHARACTERISTIC
/begin CHARACTERISTIC CcSpeedDecreaseAccelGain "LaterAccel = [0,1,1.2,1.4,1.6,1.8,2,2.2,2.5,3]" CURVE 0x0000 /* @ECU_Address@CcSpeedDecreaseAccelGain@ */ FixLookup_FLOAT32_IEEE 0 ADAS_CM_single -3.4E+38 3.4E+38
 /begin AXIS_DESCR FIX_AXIS NO_INPUT_QUANTITY ADAS_CM_single 10 0.000000 3.000000 /begin FIX_AXIS_PAR_LIST 0 1 1.2 1.4 1.6 1.8 2 2.2 2.5 3 /end FIX_AXIS_PAR_LIST /end AXIS_DESCR
/end CHARACTERISTIC
/begin CHARACTERISTIC CcSpeedIncreaseDecelAdd "Gain = [2,2.5,3,3.5]" CURVE 0x0000 /* @ECU_Address@CcSpeedIncreaseDecelAdd@ */ FixLookup_FLOAT32_IEEE 0 ADAS_CM_single -3.4E+38 3.4E+38
 /begin AXIS_DESCR FIX_AXIS NO_INPUT_QUANTITY ADAS_CM_single 4 2.000000 3.500000 FIX_AXIS_PAR_DIST 2 0.5 4 /end AXIS_DESCR
/end CHARACTERISTIC
/begin CHARACTERISTIC CcStepDist "StepDist in IC" VALUE 0x0000 /* @ECU_Address@CcStepDist@ */ Scalar_UBYTE 0 ADAS_CM_uint8 0 255 /end CHARACTERISTIC
/begin CHARACTERISTIC CcStepSpeed "StepSpeed in IC" VALUE 0x0000 /* @ECU_Address@CcStepSpeed@ */ Scalar_FLOAT32_IEEE 0 ADAS_CM_single -3.4E+38 3.4E+38 /end CHARACTERISTIC
/begin CHARACTERISTIC CcTimeCycleSpeed "sec" VALUE 0x0000 /* @ECU_Address@CcTimeCycleSpeed@ */ Scalar_FLOAT32_IEEE 0 ADAS_CM_single -3.4E+38 3.4E+38 /end CHARACTERISTIC
/begin CHARACTERISTIC CcTimeCycleSpeedStart "sec" VALUE 0x0000 /* @ECU_Address@CcTimeCycleSpeedStart@ */ Scalar_FLOAT32_IEEE 0 ADAS_CM_single -3.4E+38 3.4E+38 /end CHARACTERISTIC
/begin CHARACTERISTIC CcTimeDelayAbs "Time delay when ABS/ESP=1,sec" VALUE 0x0000 /* @ECU_Address@CcTimeDelayAbs@ */ Scalar_FLOAT32_IEEE 0 ADAS_CM_single -3.4E+38 3.4E+38 /end CHARACTERISTIC
/begin CHARACTERISTIC CcVlcAngleCor "Angle = [-10,-8,0,2,6,8,10]" CURVE 0x0000 /* @ECU_Address@CcVlcAngleCor@ */ FixLookup_FLOAT32_IEEE 0 ADAS_CM_single -3.4E+38 3.4E+38
 /begin AXIS_DESCR FIX_AXIS NO_INPUT_QUANTITY ADAS_CM_single 7 -10.000000 10.000000 /begin FIX_AXIS_PAR_LIST -10 -8 0 2 6 8 10 /end FIX_AXIS_PAR_LIST /end AXIS_DESCR
/end CHARACTERISTIC
/begin CHARACTERISTIC CcVlcAngleSpeedCor "Speed kmh = [0,2,2.5,3,8,10,12,14]" CURVE 0x0000 /* @ECU_Address@CcVlcAngleSpeedCor@ */ FixLookup_FLOAT32_IEEE 0 ADAS_CM_single -3.4E+38 3.4E+38
 /begin AXIS_DESCR FIX_AXIS NO_INPUT_QUANTITY ADAS_CM_single 8 0.000000 14.000000 /begin FIX_AXIS_PAR_LIST 0 2 2.5 3 8 10 12 14 /end FIX_AXIS_PAR_LIST /end AXIS_DESCR
/end CHARACTERISTIC
/begin CHARACTERISTIC CcVlcSpeedCor "Speed kmh = [0,5,7,10,15,20,25,30,35]" CURVE 0x0000 /* @ECU_Address@CcVlcSpeedCor@ */ FixLookup_FLOAT32_IEEE 0 ADAS_CM_single -3.4E+38 3.4E+38
 /begin AXIS_DESCR FIX_AXIS NO_INPUT_QUANTITY ADAS_CM_single 9 0.000000 35.000000 /begin FIX_AXIS_PAR_LIST 0 5 7 10 15 20 25 30 35 /end FIX_AXIS_PAR_LIST /end AXIS_DESCR
/end CHARACTERISTIC
/begin CHARACTERISTIC CcWarnDecelLvl1 "Deceleration lead car, at which the warning is activated" VALUE 0x0000 /* @ECU_Address@CcWarnDecelLvl1@ */ Scalar_FLOAT32_IEEE 0 ADAS_CM_single -3.4E+38 3.4E+38 /end CHARACTERISTIC
/begin CHARACTERISTIC CcWarnDecelLvl2 "Deceleration lead car, at which the warning is activated" VALUE 0x0000 /* @ECU_Address@CcWarnDecelLvl2@ */ Scalar_FLOAT32_IEEE 0 ADAS_CM_single -3.4E+38 3.4E+38 /end CHARACTERISTIC
/begin CHARACTERISTIC CcWarnDecelPrognose "The deceleration that Aurus can implement when Prediction time." VALUE 0x0000 /* @ECU_Address@CcWarnDecelPrognose@ */ Scalar_FLOAT32_IEEE 0 ADAS_CM_single -3.4E+38 3.4E+38 /end CHARACTERISTIC
/begin CHARACTERISTIC CcWarnDistOffset "V_emp = [0,20,40,60,80,100,120,140]" CURVE 0x0000 /* @ECU_Address@CcWarnDistOffset@ */ FixLookup_FLOAT32_IEEE 0 ADAS_CM_single -3.4E+38 3.4E+38
 /begin AXIS_DESCR FIX_AXIS NO_INPUT_QUANTITY ADAS_CM_single 8 0.000000 140.000000 FIX_AXIS_PAR_DIST 0 20 8 /end AXIS_DESCR
/end CHARACTERISTIC
/begin CHARACTERISTIC CcWarnTimePrognose "Prediction time,sec" VALUE 0x0000 /* @ECU_Address@CcWarnTimePrognose@ */ Scalar_FLOAT32_IEEE 0 ADAS_CM_single -3.4E+38 3.4E+38 /end CHARACTERISTIC
/begin CHARACTERISTIC ChangePredTimeRCTC "Change dimamic Time or Fix predict time" VALUE 0x0000 /* @ECU_Address@ChangePredTimeRCTC@ */ Scalar_UBYTE 0 ADAS_CM_uint8 0.000000 1.000000 /end CHARACTERISTIC
/begin CHARACTERISTIC CoefDinamGab "Coefficient Dinamic gab" VALUE 0x0000 /* @ECU_Address@CoefDinamGab@ */ Scalar_FLOAT32_IEEE 0 ADAS_CM_single 0.000000 10.000000 /end CHARACTERISTIC
/begin CHARACTERISTIC CorrectionAvail "Availability of CORRECTION_WARN_LINE block: 0-off, 1-avail" VALUE 0x0000 /* @ECU_Address@CorrectionAvail@ */ Scalar_UBYTE 0 ADAS_CM_uint8 0.000000 1.000000 /end CHARACTERISTIC
/begin CHARACTERISTIC CvwAlarmTimeClose "The time of the CVW alarm before the collision in CLOSE mode" VALUE 0x0000 /* @ECU_Address@CvwAlarmTimeClose@ */ Scalar_FLOAT32_IEEE 0 ADAS_CM_single_s 0.000000 10.000000 /end CHARACTERISTIC
/begin CHARACTERISTIC CvwAlarmTimeFar "The time of the CVW alarm before the collision in FAR mode" VALUE 0x0000 /* @ECU_Address@CvwAlarmTimeFar@ */ Scalar_FLOAT32_IEEE 0 ADAS_CM_single_s 0.000000 10.000000 /end CHARACTERISTIC
/begin CHARACTERISTIC CvwAlarmTimeMedium "The time of the CVW alarm before the collision in MEDIUM mode" VALUE 0x0000 /* @ECU_Address@CvwAlarmTimeMedium@ */ Scalar_FLOAT32_IEEE 0 ADAS_CM_single_s 0.000000 10.000000 /end CHARACTERISTIC
/begin CHARACTERISTIC CvwEnableServiceParam "1 - CVW enable, 0 - CVW disable" VALUE 0x0000 /* @ECU_Address@CvwEnableServiceParam@ */ Scalar_UBYTE 0 ADAS_CM_uint8 0.000000 1.000000 /end CHARACTERISTIC
/begin CHARACTERISTIC CvwFreezeDistAfterCurv "The distance during which the CVW does not send a warning when switching from curved to straight motion" VALUE 0x0000 /* @ECU_Address@CvwFreezeDistAfterCurv@ */ Scalar_FLOAT32_IEEE 0 ADAS_CM_single_m 0.000000 200.000000 /end CHARACTERISTIC
/begin CHARACTERISTIC CvwFreezeTimeAfterCurv "The time during which the CVW does not send a warning when switching from curved to straight motion" VALUE 0x0000 /* @ECU_Address@CvwFreezeTimeAfterCurv@ */ Scalar_FLOAT32_IEEE 0 ADAS_CM_single_s 0.000000 20.000000 /end CHARACTERISTIC
/begin CHARACTERISTIC CvwMinRCurvForStraightAlg "The minimum radius of curvature at which the CVW algorithm for straight-line movement is used" VALUE 0x0000 /* @ECU_Address@CvwMinRCurvForStraightAlg@ */ Scalar_FLOAT32_IEEE 0 ADAS_CM_single_m 0.000000 500000.000000 /end CHARACTERISTIC
/begin CHARACTERISTIC CvwSideEdgeToCloseLine "The distance from overall side edge of the car without mirrors to close line of CVW zone" VALUE 0x0000 /* @ECU_Address@CvwSideEdgeToCloseLine@ */ Scalar_FLOAT32_IEEE 0 ADAS_CM_single_m -5.000000 5.000000 /end CHARACTERISTIC
/begin CHARACTERISTIC CvwZoneWidth "The width of the CVW zone" VALUE 0x0000 /* @ECU_Address@CvwZoneWidth@ */ Scalar_FLOAT32_IEEE 0 ADAS_CM_single_m 0.000000 10.000000 /end CHARACTERISTIC
/begin CHARACTERISTIC DealyDangerTime "Delay after ABS/VDC/AEB/FCW (increase active danger time), s" VALUE 0x0000 /* @ECU_Address@DealyDangerTime@ */ Scalar_FLOAT32_IEEE 0 ADAS_CM_single 0.100000 4.000000 /end CHARACTERISTIC
/begin CHARACTERISTIC DelayAvoidTime "Delay after avoid conditions stop (increase active avoid time), s" VALUE 0x0000 /* @ECU_Address@DelayAvoidTime@ */ Scalar_FLOAT32_IEEE 0 ADAS_CM_single 0.100000 4.000000 /end CHARACTERISTIC
/begin CHARACTERISTIC DelayBlockTime "Delay after blocking conditions stop (increase active blocking time), s" VALUE 0x0000 /* @ECU_Address@DelayBlockTime@ */ Scalar_FLOAT32_IEEE 0 ADAS_CM_single 0.100000 4.000000 /end CHARACTERISTIC
/begin CHARACTERISTIC DelayCorrTime "Delay after correction conditions stop (increase active correction time), s" VALUE 0x0000 /* @ECU_Address@DelayCorrTime@ */ Scalar_FLOAT32_IEEE 0 ADAS_CM_single 0.100000 4.000000 /end CHARACTERISTIC
/begin CHARACTERISTIC DelayWarnTime "Minimum delay between warnings, s" VALUE 0x0000 /* @ECU_Address@DelayWarnTime@ */ Scalar_FLOAT32_IEEE 0 ADAS_CM_single 0.100000 10.000000 /end CHARACTERISTIC
/begin CHARACTERISTIC DeltaPos "Hysteresis for IN_LANE_POSITION, m. (! DeltaPos > WarnLine_X !)" VALUE 0x0000 /* @ECU_Address@DeltaPos@ */ Scalar_FLOAT32_IEEE 0 ADAS_CM_single 0.000000 0.500000 /end CHARACTERISTIC
/begin CHARACTERISTIC DistFromRearAxleToCornrOfHood "Calculation manual" VALUE 0x0000 /* @ECU_Address@DistFromRearAxleToCornrOfHood@ */ Scalar_FLOAT32_IEEE 0 ADAS_CM_single_m 0.000000 10.000000 /end CHARACTERISTIC
/begin CHARACTERISTIC DistHysteresis "Calculation manual" VALUE 0x0000 /* @ECU_Address@DistHysteresis@ */ Scalar_FLOAT32_IEEE 0 ADAS_CM_single_m 0.000000 50.000000 /end CHARACTERISTIC
/begin CHARACTERISTIC DistReserv "Calculation manual" VALUE 0x0000 /* @ECU_Address@DistReserv@ */ Scalar_FLOAT32_IEEE 0 ADAS_CM_single_m 0.000000 10.000000 /end CHARACTERISTIC
/begin CHARACTERISTIC DistResvCoef "Calculation manual" VALUE 0x0000 /* @ECU_Address@DistResvCoef@ */ Scalar_FLOAT32_IEEE 0 ADAS_CM_single_m 0.000000 2.000000 /end CHARACTERISTIC
/begin CHARACTERISTIC DowAlarmTime "The time of the DOW alarm before the collision" VALUE 0x0000 /* @ECU_Address@DowAlarmTime@ */ Scalar_FLOAT32_IEEE 0 ADAS_CM_single_s 0.000000 20.000000 /end CHARACTERISTIC
/begin CHARACTERISTIC DowBlockWarnTime "The time during which sending DOW warning signal is blocked after falling edge of DOW warning signal" VALUE 0x0000 /* @ECU_Address@DowBlockWarnTime@ */ Scalar_FLOAT32_IEEE 0 ADAS_CM_single_s 0.000000 10.000000 /end CHARACTERISTIC
/begin CHARACTERISTIC DowDelayTimeOnFallEdge "Time delay on falling edge of warning from DOW. At this time, the notification continues to be requested, but DOW do not have warning." VALUE 0x0000 /* @ECU_Address@DowDelayTimeOnFallEdge@ */ Scalar_FLOAT32_IEEE 0 ADAS_CM_single_s 0.000000 2.000000 /end CHARACTERISTIC
/begin CHARACTERISTIC DowDelayTimeOnRisingEdge "Time delay on rising edge of warning from DOW. At this time, the notification does not request, but DOW do have warning." VALUE 0x0000 /* @ECU_Address@DowDelayTimeOnRisingEdge@ */ Scalar_FLOAT32_IEEE 0 ADAS_CM_single_s 0.000000 2.000000 /end CHARACTERISTIC
/begin CHARACTERISTIC DowMaxSpd "The maximum vehicle speed at which DOW active" VALUE 0x0000 /* @ECU_Address@DowMaxSpd@ */ Scalar_FLOAT32_IEEE 0 ADAS_CM_single_km_per_h 0.000000 255.000000 /end CHARACTERISTIC
/begin CHARACTERISTIC DowMinWarnTime "Minimum DOW warning signal time" VALUE 0x0000 /* @ECU_Address@DowMinWarnTime@ */ Scalar_FLOAT32_IEEE 0 ADAS_CM_single_s 0.000000 10.000000 /end CHARACTERISTIC
/begin CHARACTERISTIC DowSideEdgeToCloseLine "The distance from overall side edge of the car without mirrors to close line of DOW zone. If the value increases, the line goes farther from X axis." VALUE 0x0000 /* @ECU_Address@DowSideEdgeToCloseLine@ */ Scalar_FLOAT32_IEEE 0 ADAS_CM_single_m -5.000000 5.000000 /end CHARACTERISTIC
/begin CHARACTERISTIC DowTrailingEdgeToFrontLineDist "The distance from trailing edge of the car to DOW front line. If the value increases, the line goes back." VALUE 0x0000 /* @ECU_Address@DowTrailingEdgeToFrontLineDist@ */ Scalar_FLOAT32_IEEE 0 ADAS_CM_single_m -5.000000 10.000000 /end CHARACTERISTIC
/begin CHARACTERISTIC DowZoneWidth "The width of the DOW zone" VALUE 0x0000 /* @ECU_Address@DowZoneWidth@ */ Scalar_FLOAT32_IEEE 0 ADAS_CM_single_m 0.000000 10.000000 /end CHARACTERISTIC
/begin CHARACTERISTIC FcwFOFiltrDataAccumWindow "Response corridor width" VALUE 0x0000 /* @ECU_Address@FcwFOFiltrDataAccumWindow@ */ Scalar_UBYTE 0 ADAS_CM_uint8 0.000000 100.000000 /end CHARACTERISTIC
/begin CHARACTERISTIC FcwFOFiltrDataSpdAccumWindow "Response corridor width" VALUE 0x0000 /* @ECU_Address@FcwFOFiltrDataSpdAccumWindow@ */ Scalar_UBYTE 0 ADAS_CM_uint8 0.000000 100.000000 /end CHARACTERISTIC
/begin CHARACTERISTIC FcwFrontObj1or3 "Response corridor width" VALUE 0x0000 /* @ECU_Address@FcwFrontObj1or3@ */ Scalar_UBYTE 0 ADAS_CM_uint8 1.000000 2.000000 /end CHARACTERISTIC
/begin CHARACTERISTIC FcwFrontObjFiltrEnbl "Response corridor width" VALUE 0x0000 /* @ECU_Address@FcwFrontObjFiltrEnbl@ */ Scalar_UBYTE 0 ADAS_CM_uint8 0.000000 1.000000 /end CHARACTERISTIC
/begin CHARACTERISTIC FcwFrontObjFiltrSize "Response corridor width" VALUE 0x0000 /* @ECU_Address@FcwFrontObjFiltrSize@ */ Scalar_UBYTE 0 ADAS_CM_uint8 0.000000 100.000000 /end CHARACTERISTIC
/begin CHARACTERISTIC FcwFrontObjSpdFiltrSize "Response corridor width" VALUE 0x0000 /* @ECU_Address@FcwFrontObjSpdFiltrSize@ */ Scalar_UBYTE 0 ADAS_CM_uint8 0.000000 100.000000 /end CHARACTERISTIC
/begin CHARACTERISTIC Filter_delay_OFF "Diode filter time (time before diode turns off), sec" VALUE 0x0000 /* @ECU_Address@Filter_delay_OFF@ */ Scalar_FLOAT32_IEEE 0 ADAS_CM_single 0.000000 20.000000 /end CHARACTERISTIC
/begin CHARACTERISTIC Filter_delay_ON "Diode filter time (time before diode turns on), sec" VALUE 0x0000 /* @ECU_Address@Filter_delay_ON@ */ Scalar_FLOAT32_IEEE 0 ADAS_CM_single 0.000000 20.000000 /end CHARACTERISTIC
/begin CHARACTERISTIC FrontRadarAvail "FRCU installed" VALUE 0x0000 /* @ECU_Address@FrontRadarAvail@ */ Scalar_UBYTE 0 ADAS_CM_uint8 0.000000 1.000000 /end CHARACTERISTIC
/begin CHARACTERISTIC HLL_avail "Functioning HLL in MLIA: 0-off, 1-active" VALUE 0x0000 /* @ECU_Address@HLL_avail@ */ Scalar_FLOAT32_IEEE 0 ADAS_CM_single 0.000000 1.000000 /end CHARACTERISTIC
/begin CHARACTERISTIC HLR_avail "Functioning HLR in MLIA: 0-off, 1-active" VALUE 0x0000 /* @ECU_Address@HLR_avail@ */ Scalar_FLOAT32_IEEE 0 ADAS_CM_single 0.000000 1.000000 /end CHARACTERISTIC
/begin CHARACTERISTIC HcsCycleTime "Time to refresh the request" VALUE 0x0000 /* @ECU_Address@HcsCycleTime@ */ Scalar_FLOAT32_IEEE 0 ADAS_CM_single -3.4E+38 3.4E+38 /end CHARACTERISTIC
/begin CHARACTERISTIC HcsLowDelta "Delta of temperature for low heat" VALUE 0x0000 /* @ECU_Address@HcsLowDelta@ */ Scalar_FLOAT32_IEEE 0 ADAS_CM_single -3.4E+38 3.4E+38 /end CHARACTERISTIC
/begin CHARACTERISTIC HcsMedDelta "Delta of temperature for medium heat" VALUE 0x0000 /* @ECU_Address@HcsMedDelta@ */ Scalar_FLOAT32_IEEE 0 ADAS_CM_single -3.4E+38 3.4E+38 /end CHARACTERISTIC
/begin CHARACTERISTIC HysterCoef "Zone expansion coefficient of each diode for turn-on hysteresis for HLx_ADB_TargetLed_Obj" VALUE 0x0000 /* @ECU_Address@HysterCoef@ */ Scalar_FLOAT32_IEEE 0 ADAS_CM_single 0.000000 1.000000 /end CHARACTERISTIC
/begin CHARACTERISTIC IncPredictTime "Increase prediction time for PREDICTION block (PredictTime = Ts + IncPredictTime), s" VALUE 0x0000 /* @ECU_Address@IncPredictTime@ */ Scalar_FLOAT32_IEEE 0 ADAS_CM_single 0.000000 1.000000 /end CHARACTERISTIC
/begin CHARACTERISTIC LccBlockWarnTime "The time during which sending LCC warning signal is blocked after falling edge of LCC warning signal" VALUE 0x0000 /* @ECU_Address@LccBlockWarnTime@ */ Scalar_FLOAT32_IEEE 0 ADAS_CM_single_s 0.000000 10.000000 /end CHARACTERISTIC
/begin CHARACTERISTIC LccDelayTimeOnFallEdge "Time delay on falling edge of warning from BSW or CVW. At this time, the notification continues to be requested, but BSW and CVW do not have warning." VALUE 0x0000 /* @ECU_Address@LccDelayTimeOnFallEdge@ */ Scalar_FLOAT32_IEEE 0 ADAS_CM_single_s 0.000000 2.000000 /end CHARACTERISTIC
/begin CHARACTERISTIC LccDelayTimeOnRisingEdge "Time delay on rising edge of warning from BSW or CVW. At this time, the notification does not request, but BSW or CVW do have warning." VALUE 0x0000 /* @ECU_Address@LccDelayTimeOnRisingEdge@ */ Scalar_FLOAT32_IEEE 0 ADAS_CM_single_s 0.000000 2.000000 /end CHARACTERISTIC
/begin CHARACTERISTIC LccMinProblty "The minimum probability that an object exists for LCC and DOW" VALUE 0x0000 /* @ECU_Address@LccMinProblty@ */ Scalar_UBYTE 0 ADAS_CM_uint8_percent_ 0.000000 100.000000 /end CHARACTERISTIC
/begin CHARACTERISTIC LccMinSpd "The minimum vehicle speed at which LCC active" VALUE 0x0000 /* @ECU_Address@LccMinSpd@ */ Scalar_UBYTE 0 ADAS_CM_uint8_km_per_h 0.000000 255.000000 /end CHARACTERISTIC
/begin CHARACTERISTIC LccMinWarnTime "Minimum LCC warning signal time" VALUE 0x0000 /* @ECU_Address@LccMinWarnTime@ */ Scalar_FLOAT32_IEEE 0 ADAS_CM_single_s 0.000000 10.000000 /end CHARACTERISTIC
/begin CHARACTERISTIC LdwDelayOppBlockWarnTime "Delay of prohibition of opposite warning, s" VALUE 0x0000 /* @ECU_Address@LdwDelayOppBlockWarnTime@ */ Scalar_FLOAT32_IEEE 0 ADAS_CM_single 0.100000 10.000000 /end CHARACTERISTIC
/begin CHARACTERISTIC LdwMaDiffResetFilter "SxFA difference Moving average filter reset, %" VALUE 0x0000 /* @ECU_Address@LdwMaDiffResetFilter@ */ Scalar_FLOAT32_IEEE 0 ADAS_CM_single 0.000000 10.000000 /end CHARACTERISTIC
/begin CHARACTERISTIC LdwMaFilterAvail "Moving average filter available: 0-off, 1-avail" VALUE 0x0000 /* @ECU_Address@LdwMaFilterAvail@ */ Scalar_UBYTE 0 ADAS_CM_uint8 0.000000 1.000000 /end CHARACTERISTIC
/begin CHARACTERISTIC LdwMaWindowSize "Moving average filter window size (for SxFA point)" VALUE 0x0000 /* @ECU_Address@LdwMaWindowSize@ */ Scalar_FLOAT32_IEEE 0 ADAS_CM_single 1.000000 1000.000000 /end CHARACTERISTIC
/begin CHARACTERISTIC LidarAvail "Lidar installed" VALUE 0x0000 /* @ECU_Address@LidarAvail@ */ Scalar_UBYTE 0 ADAS_CM_uint8 0.000000 1.000000 /end CHARACTERISTIC
/begin CHARACTERISTIC LightAmbientBorder "BCM_LightAmbient_Val border to switch to DAY" VALUE 0x0000 /* @ECU_Address@LightAmbientBorder@ */ Scalar_FLOAT32_IEEE 0 ADAS_CM_single 0.000000 2000.000000 /end CHARACTERISTIC
/begin CHARACTERISTIC LightFrontBorder "BCM_LightFront_Val border to switch to DAY" VALUE 0x0000 /* @ECU_Address@LightFrontBorder@ */ Scalar_FLOAT32_IEEE 0 ADAS_CM_single 0.000000 2000.000000 /end CHARACTERISTIC
/begin CHARACTERISTIC Lim_ratAccPed "Response corridor width" VALUE 0x0000 /* @ECU_Address@Lim_ratAccPed@ */ Scalar_FLOAT32_IEEE 0 ADAS_CM_single 0.000000 100.000000 /end CHARACTERISTIC
/begin CHARACTERISTIC MaxBlinkCount "Number of blinks to go to BlinkDetect State (Standby)" VALUE 0x0000 /* @ECU_Address@MaxBlinkCount@ */ Scalar_FLOAT32_IEEE 0 ADAS_CM_single 0.000000 20.000000 /end CHARACTERISTIC
/begin CHARACTERISTIC MaxLineDist "Maximum distance between line and outer side of the front axle tire for IN_LANE_POSITION, m" VALUE 0x0000 /* @ECU_Address@MaxLineDist@ */ Scalar_FLOAT32_IEEE 0 ADAS_CM_single 0.000000 3.000000 /end CHARACTERISTIC
/begin CHARACTERISTIC MaxWarnDist "Maximum distance between line and outer side of the front axle tire at which warning is available, m. (FOR FUNC CALIBRATION)" VALUE 0x0000 /* @ECU_Address@MaxWarnDist@ */ Scalar_FLOAT32_IEEE 0 ADAS_CM_single 0.000000 1.500000 /end CHARACTERISTIC
/begin CHARACTERISTIC MinDinamGab "Minimum Dinamic gab" VALUE 0x0000 /* @ECU_Address@MinDinamGab@ */ Scalar_FLOAT32_IEEE 0 ADAS_CM_single 0.000000 2.000000 /end CHARACTERISTIC
/begin CHARACTERISTIC MinTLC_Avoid "TTLC at which warning is activated (Before crossing mode + AVOID), s" VALUE 0x0000 /* @ECU_Address@MinTLC_Avoid@ */ Scalar_FLOAT32_IEEE 0 ADAS_CM_single 0.010000 2.000000 /end CHARACTERISTIC
/begin CHARACTERISTIC MinTLC_BeforeCross "TTLC at which warning is activated (Before crossing mode), s" VALUE 0x0000 /* @ECU_Address@MinTLC_BeforeCross@ */ Scalar_FLOAT32_IEEE 0 ADAS_CM_single 0.001000 2.000000 /end CHARACTERISTIC
/begin CHARACTERISTIC MinTLC_WhileCross "TTLC at which warning is activated (While crossing mode), s" VALUE 0x0000 /* @ECU_Address@MinTLC_WhileCross@ */ Scalar_FLOAT32_IEEE 0 ADAS_CM_single 0.001000 2.000000 /end CHARACTERISTIC
/begin CHARACTERISTIC MinTimeWarn "Minimal Time Warning" VALUE 0x0000 /* @ECU_Address@MinTimeWarn@ */ Scalar_FLOAT32_IEEE 0 ADAS_CM_single 0.000000 10.000000 /end CHARACTERISTIC
/begin CHARACTERISTIC MinTimeWarnRctc "Time Minimum warning " VALUE 0x0000 /* @ECU_Address@MinTimeWarnRctc@ */ Scalar_FLOAT32_IEEE 0 ADAS_CM_single 0.000000 3.500000 /end CHARACTERISTIC
/begin CHARACTERISTIC MinWarnTime "Warning duration, s" VALUE 0x0000 /* @ECU_Address@MinWarnTime@ */ Scalar_FLOAT32_IEEE 0 ADAS_CM_single 0.100000 4.000000 /end CHARACTERISTIC
/begin CHARACTERISTIC MinimumDecelFull "Response corridor width" VALUE 0x0000 /* @ECU_Address@MinimumDecelFull@ */ Scalar_FLOAT32_IEEE 0 ADAS_CM_single 0.000000 10.000000 /end CHARACTERISTIC
/begin CHARACTERISTIC NarrCoef "Contraction ratio for ADB_Bord_array_Modif" VALUE 0x0000 /* @ECU_Address@NarrCoef@ */ Scalar_FLOAT32_IEEE 0 ADAS_CM_single 0.000000 1.000000 /end CHARACTERISTIC
/begin CHARACTERISTIC ObjLifetime_OFF "Object dietime (time before stop solver for object), sec" VALUE 0x0000 /* @ECU_Address@ObjLifetime_OFF@ */ Scalar_FLOAT32_IEEE 0 ADAS_CM_single 0.000000 20.000000 /end CHARACTERISTIC
/begin CHARACTERISTIC ObjLifetime_ON "Object lifetime (time before start solver for object), sec" VALUE 0x0000 /* @ECU_Address@ObjLifetime_ON@ */ Scalar_FLOAT32_IEEE 0 ADAS_CM_single 0.000000 20.000000 /end CHARACTERISTIC
/begin CHARACTERISTIC Obj_Filter_avail "Objects (object angles) filter availability" VALUE 0x0000 /* @ECU_Address@Obj_Filter_avail@ */ Scalar_FLOAT32_IEEE 0 ADAS_CM_single 0.000000 1.000000 /end CHARACTERISTIC
/begin CHARACTERISTIC ParamProbal "parameter probability perception" VALUE 0x0000 /* @ECU_Address@ParamProbal@ */ Scalar_UBYTE 0 ADAS_CM_uint8 0.000000 100.000000 /end CHARACTERISTIC
/begin CHARACTERISTIC PercStartFrontOncomObj "Start FrontOncomObj Perception" VALUE 0x0000 /* @ECU_Address@PercStartFrontOncomObj@ */ Scalar_UBYTE 0 ADAS_CM_uint8 0.000000 1.000000 /end CHARACTERISTIC
/begin CHARACTERISTIC PercStartFrontPasObj "Start FrontPasObj Perception" VALUE 0x0000 /* @ECU_Address@PercStartFrontPasObj@ */ Scalar_UBYTE 0 ADAS_CM_uint8 0.000000 1.000000 /end CHARACTERISTIC
/begin CHARACTERISTIC PercStartLane "Start Lane Perception" VALUE 0x0000 /* @ECU_Address@PercStartLane@ */ Scalar_UBYTE 0 ADAS_CM_uint8 0.000000 1.000000 /end CHARACTERISTIC
/begin CHARACTERISTIC PercStartMlia "Start MLIA Perception" VALUE 0x0000 /* @ECU_Address@PercStartMlia@ */ Scalar_UBYTE 0 ADAS_CM_uint8 0.000000 1.000000 /end CHARACTERISTIC
/begin CHARACTERISTIC PercStartMlia_Mode "Mode of start MLIA Perception: 0 - always=1, 1 - by XCP (PercStartMlia), 2 - by MliaStartReq+RLS, 3 - by RLS only" VALUE 0x0000 /* @ECU_Address@PercStartMlia_Mode@ */ Scalar_UBYTE 0 ADAS_CM_uint8 0.000000 3.000000 /end CHARACTERISTIC
/begin CHARACTERISTIC PercStartRearObj "Start RearObj Perception" VALUE 0x0000 /* @ECU_Address@PercStartRearObj@ */ Scalar_UBYTE 0 ADAS_CM_uint8 0.000000 1.000000 /end CHARACTERISTIC
/begin CHARACTERISTIC PercStartSign "Start Sign Perception" VALUE 0x0000 /* @ECU_Address@PercStartSign@ */ Scalar_UBYTE 0 ADAS_CM_uint8 0.000000 1.000000 /end CHARACTERISTIC
/begin CHARACTERISTIC Poly_YawRateRadSLim "Response corridor width" VALUE 0x0000 /* @ECU_Address@Poly_YawRateRadSLim@ */ Scalar_FLOAT32_IEEE 0 ADAS_CM_single 0.000000 1.000000 /end CHARACTERISTIC
/begin CHARACTERISTIC PredictZone "Zone offset inside the lane for the prediction block, m" VALUE 0x0000 /* @ECU_Address@PredictZone@ */ Scalar_FLOAT32_IEEE 0 ADAS_CM_single -0.500000 0.500000 /end CHARACTERISTIC
/begin CHARACTERISTIC PredictionAvail "Availability of PREDICTION block: 0-off, 1-avail" VALUE 0x0000 /* @ECU_Address@PredictionAvail@ */ Scalar_UBYTE 0 ADAS_CM_uint8 0.000000 1.000000 /end CHARACTERISTIC
/begin CHARACTERISTIC ProbabilLim "Response corridor width" VALUE 0x0000 /* @ECU_Address@ProbabilLim@ */ Scalar_UBYTE 0 ADAS_CM_uint8 0.000000 100.000000 /end CHARACTERISTIC
/begin CHARACTERISTIC ProbabilOnOff "Response corridor width" VALUE 0x0000 /* @ECU_Address@ProbabilOnOff@ */ Scalar_UBYTE 0 ADAS_CM_uint8 0.000000 1.000000 /end CHARACTERISTIC
/begin CHARACTERISTIC Proj_bright "Projection Brightness Control Signal (0-off, 1-10%, 2-25%, 3-40%, 4-60%, 5-85%, 6-100%" VALUE 0x0000 /* @ECU_Address@Proj_bright@ */ Scalar_UBYTE 0 ADAS_CM_uint8 0.000000 6.000000 /end CHARACTERISTIC
/begin CHARACTERISTIC R48_Filter_avail "Сorrespondence of mLED zones to ADB diodes availability" VALUE 0x0000 /* @ECU_Address@R48_Filter_avail@ */ Scalar_FLOAT32_IEEE 0 ADAS_CM_single 0.000000 1.000000 /end CHARACTERISTIC
/begin CHARACTERISTIC RCTCMu "Coefficient of Adhesion" VALUE 0x0000 /* @ECU_Address@RCTCMu@ */ Scalar_FLOAT32_IEEE 0 ADAS_CM_single 0.000000 1.000000 /end CHARACTERISTIC
/begin CHARACTERISTIC RCWCarGab "Car Gab" VALUE 0x0000 /* @ECU_Address@RCWCarGab@ */ Scalar_FLOAT32_IEEE 0 ADAS_CM_single 0.000000 2.000000 /end CHARACTERISTIC
/begin CHARACTERISTIC RCWMu "Coefficient of Adhesion" VALUE 0x0000 /* @ECU_Address@RCWMu@ */ Scalar_FLOAT32_IEEE 0 ADAS_CM_single 0.000000 1.000000 /end CHARACTERISTIC
/begin CHARACTERISTIC RCWWsteer "Driver reaction angular velocity" VALUE 0x0000 /* @ECU_Address@RCWWsteer@ */ Scalar_FLOAT32_IEEE 0 ADAS_CM_single 0.100000 1.500000 /end CHARACTERISTIC
/begin CHARACTERISTIC RCW_12_14_Stat "Enable RCW Off or On 12 and 14 object" VALUE 0x0000 /* @ECU_Address@RCW_12_14_Stat@ */ Scalar_UBYTE 0 ADAS_CM_uint8 0.000000 1.000000 /end CHARACTERISTIC
/begin CHARACTERISTIC RCW_Stat "Enable RCW Off or On" VALUE 0x0000 /* @ECU_Address@RCW_Stat@ */ Scalar_UBYTE 0 ADAS_CM_uint8 0.000000 1.000000 /end CHARACTERISTIC
/begin CHARACTERISTIC RctcCarGab_length "Car Gab length" VALUE 0x0000 /* @ECU_Address@RctcCarGab_length@ */ Scalar_FLOAT32_IEEE 0 ADAS_CM_single 0.000000 2.000000 /end CHARACTERISTIC
/begin CHARACTERISTIC RctcCarGab_wigth "Car Gab wigth" VALUE 0x0000 /* @ECU_Address@RctcCarGab_wigth@ */ Scalar_FLOAT32_IEEE 0 ADAS_CM_single 0.000000 2.000000 /end CHARACTERISTIC
/begin CHARACTERISTIC RctcParamProbal "parameter probability perception" VALUE 0x0000 /* @ECU_Address@RctcParamProbal@ */ Scalar_UBYTE 0 ADAS_CM_uint8 0.000000 100.000000 /end CHARACTERISTIC
/begin CHARACTERISTIC RctcTimePhonk "Minimal Time Warning " VALUE 0x0000 /* @ECU_Address@RctcTimePhonk@ */ Scalar_FLOAT32_IEEE 0 ADAS_CM_single 0.000000 0.500000 /end CHARACTERISTIC
/begin CHARACTERISTIC RctcTimeRes "time before collision" VALUE 0x0000 /* @ECU_Address@RctcTimeRes@ */ Scalar_FLOAT32_IEEE 0 ADAS_CM_single 0.000000 1.500000 /end CHARACTERISTIC
/begin CHARACTERISTIC RearRadarAvail "MRRx installed" VALUE 0x0000 /* @ECU_Address@RearRadarAvail@ */ Scalar_UBYTE 0 ADAS_CM_uint8 0.000000 1.000000 /end CHARACTERISTIC
/begin CHARACTERISTIC ReserveAcceler "Response corridor width" VALUE 0x0000 /* @ECU_Address@ReserveAcceler@ */ Scalar_FLOAT32_IEEE 0 ADAS_CM_single 0.000000 10.000000 /end CHARACTERISTIC
/begin CHARACTERISTIC RtctTimeReactDriver "Time Reaction Driver" VALUE 0x0000 /* @ECU_Address@RtctTimeReactDriver@ */ Scalar_FLOAT32_IEEE 0 ADAS_CM_single 0.000000 1.500000 /end CHARACTERISTIC
/begin CHARACTERISTIC SasSpdMax "Maximum steering wheel rotation speed at which warning is available, deg/s" VALUE 0x0000 /* @ECU_Address@SasSpdMax@ */ Scalar_FLOAT32_IEEE 0 ADAS_CM_single 1.000000 300.000000 /end CHARACTERISTIC
/begin CHARACTERISTIC Satur_Exp_mled_1 "Lower limit for zone expansion saturation (1)" VALUE 0x0000 /* @ECU_Address@Satur_Exp_mled_1@ */ Scalar_FLOAT32_IEEE 0 ADAS_CM_single 0.000000 300.000000 /end CHARACTERISTIC
/begin CHARACTERISTIC Satur_Exp_mled_2 "Upper limit for zone expansion saturation (500)" VALUE 0x0000 /* @ECU_Address@Satur_Exp_mled_2@ */ Scalar_FLOAT32_IEEE 0 ADAS_CM_single 0.000000 1000.000000 /end CHARACTERISTIC
/begin CHARACTERISTIC Satur_Exp_obj_1 "Lower limit for zone expansion saturation (1)" VALUE 0x0000 /* @ECU_Address@Satur_Exp_obj_1@ */ Scalar_FLOAT32_IEEE 0 ADAS_CM_single 0.000000 300.000000 /end CHARACTERISTIC
/begin CHARACTERISTIC Satur_Exp_obj_2 "Upper limit for zone expansion saturation (500)" VALUE 0x0000 /* @ECU_Address@Satur_Exp_obj_2@ */ Scalar_FLOAT32_IEEE 0 ADAS_CM_single 0.000000 1000.000000 /end CHARACTERISTIC
/begin CHARACTERISTIC Satur_Nar_mled_1 "Lower limit for zone narrowing saturation (1)" VALUE 0x0000 /* @ECU_Address@Satur_Nar_mled_1@ */ Scalar_FLOAT32_IEEE 0 ADAS_CM_single 0.000000 300.000000 /end CHARACTERISTIC
/begin CHARACTERISTIC Satur_Nar_mled_2 "Upper limit for zone narrowing saturation (500)" VALUE 0x0000 /* @ECU_Address@Satur_Nar_mled_2@ */ Scalar_FLOAT32_IEEE 0 ADAS_CM_single 0.000000 1000.000000 /end CHARACTERISTIC
/begin CHARACTERISTIC Satur_Nar_obj_1 "Lower limit for zone narrowing saturation (1)" VALUE 0x0000 /* @ECU_Address@Satur_Nar_obj_1@ */ Scalar_FLOAT32_IEEE 0 ADAS_CM_single 0.000000 300.000000 /end CHARACTERISTIC
/begin CHARACTERISTIC Satur_Nar_obj_2 "Upper limit for zone narrowing saturation (500)" VALUE 0x0000 /* @ECU_Address@Satur_Nar_obj_2@ */ Scalar_FLOAT32_IEEE 0 ADAS_CM_single 0.000000 1000.000000 /end CHARACTERISTIC
/begin CHARACTERISTIC SignDuration "Duration of sign display, s" VALUE 0x0000 /* @ECU_Address@SignDuration@ */ Scalar_FLOAT32_IEEE 0 ADAS_CM_single 0.000000 10.000000 /end CHARACTERISTIC
/begin CHARACTERISTIC SpeedActiveLdw_off "Speed at which LDW state changes to standby, kmh" VALUE 0x0000 /* @ECU_Address@SpeedActiveLdw_off@ */ Scalar_FLOAT32_IEEE 0 ADAS_CM_single 0.000000 75.000000 /end CHARACTERISTIC
/begin CHARACTERISTIC SpeedActiveLdw_on "Speed at which LDW state changes to active, kmh" VALUE 0x0000 /* @ECU_Address@SpeedActiveLdw_on@ */ Scalar_FLOAT32_IEEE 0 ADAS_CM_single 0.000000 80.000000 /end CHARACTERISTIC
/begin CHARACTERISTIC SpeedActiveMlia_off "Speed at which the HB turns off, kmh" VALUE 0x0000 /* @ECU_Address@SpeedActiveMlia_off@ */ Scalar_FLOAT32_IEEE 0 ADAS_CM_single 0.000000 45.000000 /end CHARACTERISTIC
/begin CHARACTERISTIC SpeedActiveMlia_on "Speed at which the HB turns on, kmh" VALUE 0x0000 /* @ECU_Address@SpeedActiveMlia_on@ */ Scalar_FLOAT32_IEEE 0 ADAS_CM_single 0.000000 50.000000 /end CHARACTERISTIC
/begin CHARACTERISTIC SpeedMliaBoost_off "Speed at which the HB_boost turns off, kmh" VALUE 0x0000 /* @ECU_Address@SpeedMliaBoost_off@ */ Scalar_FLOAT32_IEEE 0 ADAS_CM_single 60.000000 110.000000 /end CHARACTERISTIC
/begin CHARACTERISTIC SpeedMliaBoost_on "Speed at which the HB_boost turns on, kmh" VALUE 0x0000 /* @ECU_Address@SpeedMliaBoost_on@ */ Scalar_FLOAT32_IEEE 0 ADAS_CM_single 90.000000 250.000000 /end CHARACTERISTIC
/begin CHARACTERISTIC SpeedMliaDark_off "Obj Speed at which MLIA doesn`t blur vehicle with off-headlamps, kmh" VALUE 0x0000 /* @ECU_Address@SpeedMliaDark_off@ */ Scalar_FLOAT32_IEEE 0 ADAS_CM_single 0.000000 100.000000 /end CHARACTERISTIC
/begin CHARACTERISTIC SpeedMliaDark_on "Obj Speed at which MLIA blurs vehicle with off-headlamps, kmh" VALUE 0x0000 /* @ECU_Address@SpeedMliaDark_on@ */ Scalar_FLOAT32_IEEE 0 ADAS_CM_single 0.000000 100.000000 /end CHARACTERISTIC
/begin CHARACTERISTIC Table_Exp_mled "Expansion Lookup Table 0-60-320-pixels step difference (mled)" CURVE 0x0000 /* @ECU_Address@Table_Exp_mled@ */ FixLookup_FLOAT32_IEEE 0 ADAS_CM_single -3.4E+38 3.4E+38
 /begin AXIS_DESCR FIX_AXIS NO_INPUT_QUANTITY ADAS_CM_single 3 0.000000 320.000000 /begin FIX_AXIS_PAR_LIST 0 60 320 /end FIX_AXIS_PAR_LIST /end AXIS_DESCR
/end CHARACTERISTIC
/begin CHARACTERISTIC Table_Exp_obj "Expansion Lookup Table 0-30-angles step difference (obj)" CURVE 0x0000 /* @ECU_Address@Table_Exp_obj@ */ FixLookup_FLOAT32_IEEE 0 ADAS_CM_single -3.4E+38 3.4E+38
 /begin AXIS_DESCR FIX_AXIS NO_INPUT_QUANTITY ADAS_CM_single 2 0.000000 30.000000 FIX_AXIS_PAR_DIST 0 30 2 /end AXIS_DESCR
/end CHARACTERISTIC
/begin CHARACTERISTIC Table_Nar_mled "Narrow Lookup Table 0-60-320-pixels step difference (mled)" CURVE 0x0000 /* @ECU_Address@Table_Nar_mled@ */ FixLookup_FLOAT32_IEEE 0 ADAS_CM_single -3.4E+38 3.4E+38
 /begin AXIS_DESCR FIX_AXIS NO_INPUT_QUANTITY ADAS_CM_single 3 0.000000 320.000000 /begin FIX_AXIS_PAR_LIST 0 60 320 /end FIX_AXIS_PAR_LIST /end AXIS_DESCR
/end CHARACTERISTIC
/begin CHARACTERISTIC Table_Nar_obj "Narrow Lookup Table 0-30-angles step difference (obj)" CURVE 0x0000 /* @ECU_Address@Table_Nar_obj@ */ FixLookup_FLOAT32_IEEE 0 ADAS_CM_single -3.4E+38 3.4E+38
 /begin AXIS_DESCR FIX_AXIS NO_INPUT_QUANTITY ADAS_CM_single 2 0.000000 30.000000 FIX_AXIS_PAR_DIST 0 30 2 /end AXIS_DESCR
/end CHARACTERISTIC
/begin CHARACTERISTIC TargetAccelerFS "Response corridor width" VALUE 0x0000 /* @ECU_Address@TargetAccelerFS@ */ Scalar_FLOAT32_IEEE 0 ADAS_CM_single 0.000000 10.000000 /end CHARACTERISTIC
/begin CHARACTERISTIC TargetAccelerFull "Response corridor width" VALUE 0x0000 /* @ECU_Address@TargetAccelerFull@ */ Scalar_FLOAT32_IEEE 0 ADAS_CM_single 0.000000 10.000000 /end CHARACTERISTIC
/begin CHARACTERISTIC ThermalCameraAvail "TICU installed" VALUE 0x0000 /* @ECU_Address@ThermalCameraAvail@ */ Scalar_UBYTE 0 ADAS_CM_uint8 0.000000 1.000000 /end CHARACTERISTIC
/begin CHARACTERISTIC TiToSafe "Time to stop blink counter (Total time = TiToSafe + Filter_delay_OFF(ON)), sec" VALUE 0x0000 /* @ECU_Address@TiToSafe@ */ Scalar_FLOAT32_IEEE 0 ADAS_CM_single 0.000000 20.000000 /end CHARACTERISTIC
/begin CHARACTERISTIC TiWarn "Response corridor width" VALUE 0x0000 /* @ECU_Address@TiWarn@ */ Scalar_FLOAT32_IEEE 0 ADAS_CM_single 0.000000 2.000000 /end CHARACTERISTIC
/begin CHARACTERISTIC TimeBrake "Time Brakes" VALUE 0x0000 /* @ECU_Address@TimeBrake@ */ Scalar_FLOAT32_IEEE 0 ADAS_CM_single 0.000000 1.500000 /end CHARACTERISTIC
/begin CHARACTERISTIC TimeFixRCTC " Fix predict time" VALUE 0x0000 /* @ECU_Address@TimeFixRCTC@ */ Scalar_UBYTE 0 ADAS_CM_uint8 0.000000 1.000000 /end CHARACTERISTIC
/begin CHARACTERISTIC TimeOverTbData "Time Over Table Data" CURVE 0x0000 /* @ECU_Address@TimeOverTbData@ */ Lookup1D_FLOAT32_IEEE 0 ADAS_CM_single 0.000000 3.000000
 /begin AXIS_DESCR COM_AXIS NO_INPUT_QUANTITY ADAS_CM_single 21 0.000000 300.000000 AXIS_PTS_REF TimeOverBkPoint /end AXIS_DESCR
/end CHARACTERISTIC
/begin CHARACTERISTIC TimeReactDriver "Time Reaction Driver" VALUE 0x0000 /* @ECU_Address@TimeReactDriver@ */ Scalar_FLOAT32_IEEE 0 ADAS_CM_single 0.000000 1.500000 /end CHARACTERISTIC
/begin CHARACTERISTIC TimeReq12 "time before collision 12 object" VALUE 0x0000 /* @ECU_Address@TimeReq12@ */ Scalar_FLOAT32_IEEE 0 ADAS_CM_single 0.000000 4.500000 /end CHARACTERISTIC
/begin CHARACTERISTIC TimeReq13 "time before collision 13 object" VALUE 0x0000 /* @ECU_Address@TimeReq13@ */ Scalar_FLOAT32_IEEE 0 ADAS_CM_single 0.000000 4.500000 /end CHARACTERISTIC
/begin CHARACTERISTIC TimeReq14 "time before collision 14 object" VALUE 0x0000 /* @ECU_Address@TimeReq14@ */ Scalar_FLOAT32_IEEE 0 ADAS_CM_single 0.000000 4.500000 /end CHARACTERISTIC
/begin CHARACTERISTIC TsrLeftPotTime "Time for holding the speed sign when vehicle speed more, sec" VALUE 0x0000 /* @ECU_Address@TsrLeftPotTime@ */ Scalar_FLOAT32_IEEE 0 ADAS_CM_single -3.4E+38 3.4E+38 /end CHARACTERISTIC
/begin CHARACTERISTIC TsrLowLimit "Lower limit for speed offset of start timer TsrLeftPotTime on speed sign keeping" VALUE 0x0000 /* @ECU_Address@TsrLowLimit@ */ Scalar_FLOAT32_IEEE 0 ADAS_CM_single 20.000000 50.000000 /end CHARACTERISTIC
/begin CHARACTERISTIC TsrRightPotTime "Time for display all signs except for OverTakeTaboo in right pot, sec" VALUE 0x0000 /* @ECU_Address@TsrRightPotTime@ */ Scalar_FLOAT32_IEEE 0 ADAS_CM_single 2.000000 8.000000 /end CHARACTERISTIC
/begin CHARACTERISTIC TsrUpLimit "Upper limit for speed offset on speed sign dumping" VALUE 0x0000 /* @ECU_Address@TsrUpLimit@ */ Scalar_FLOAT32_IEEE 0 ADAS_CM_single 20.000000 50.000000 /end CHARACTERISTIC
/begin CHARACTERISTIC TurnExtWarnLine "Offset of the warning line to the inside of the turn (correction), m" VALUE 0x0000 /* @ECU_Address@TurnExtWarnLine@ */ Scalar_FLOAT32_IEEE 0 ADAS_CM_single -0.200000 0.500000 /end CHARACTERISTIC
/begin CHARACTERISTIC TurnSigTime "Delay after turn signal off (for TURN_SIGNAL_MANAGER), s" VALUE 0x0000 /* @ECU_Address@TurnSigTime@ */ Scalar_FLOAT32_IEEE 0 ADAS_CM_single 0.100000 2.000000 /end CHARACTERISTIC
/begin CHARACTERISTIC TurningRadius "Turning radius for correction, m" VALUE 0x0000 /* @ECU_Address@TurningRadius@ */ Scalar_FLOAT32_IEEE 0 ADAS_CM_single 0.000000 1000.000000 /end CHARACTERISTIC
/begin CHARACTERISTIC Vangle_avail "Vertical angle accounting in mLED-module in MLIA: 0-off, 1-active" VALUE 0x0000 /* @ECU_Address@Vangle_avail@ */ Scalar_FLOAT32_IEEE 0 ADAS_CM_single 0.000000 1.000000 /end CHARACTERISTIC
/begin CHARACTERISTIC VdepartMax "Maximum lateral departure speed at which warning is available, m/s" VALUE 0x0000 /* @ECU_Address@VdepartMax@ */ Scalar_FLOAT32_IEEE 0 ADAS_CM_single 0.100000 1000.000000 /end CHARACTERISTIC
/begin CHARACTERISTIC VisActReq "Signal imitate from message IC_ADAS_REST of signal VisualActReq" VALUE 0x0000 /* @ECU_Address@VisActReq@ */ Scalar_UBYTE 0 ADAS_CM_uint8 0 255 /end CHARACTERISTIC
/begin CHARACTERISTIC VisCarWidth "Meters" VALUE 0x0000 /* @ECU_Address@VisCarWidth@ */ Scalar_FLOAT32_IEEE 0 ADAS_CM_single -3.4E+38 3.4E+38 /end CHARACTERISTIC
/begin CHARACTERISTIC VisEdgeZones "Number of microzones for traffic zones in the center of the marking line" VALUE 0x0000 /* @ECU_Address@VisEdgeZones@ */ Scalar_FLOAT32_IEEE 0 ADAS_CM_single -3.4E+38 3.4E+38 /end CHARACTERISTIC
/begin CHARACTERISTIC VisMinObjProb "Minimal value of objects probability" VALUE 0x0000 /* @ECU_Address@VisMinObjProb@ */ Scalar_UBYTE 0 ADAS_CM_uint8 0 255 /end CHARACTERISTIC
/begin CHARACTERISTIC VisNumMicroZone "Number of microzones in one traffic lane, only an even number!!!" VALUE 0x0000 /* @ECU_Address@VisNumMicroZone@ */ Scalar_FLOAT32_IEEE 0 ADAS_CM_single -3.4E+38 3.4E+38 /end CHARACTERISTIC
/begin CHARACTERISTIC VisObjHyster "Hysteresis for object" VALUE 0x0000 /* @ECU_Address@VisObjHyster@ */ Scalar_FLOAT32_IEEE 0 ADAS_CM_single 0.000000 4.000000 /end CHARACTERISTIC
/begin CHARACTERISTIC VisOffsetZones "Number of microzones for offset traffic areas" VALUE 0x0000 /* @ECU_Address@VisOffsetZones@ */ Scalar_FLOAT32_IEEE 0 ADAS_CM_single -3.4E+38 3.4E+38 /end CHARACTERISTIC
/begin CHARACTERISTIC VisPedWidth "Meters" VALUE 0x0000 /* @ECU_Address@VisPedWidth@ */ Scalar_FLOAT32_IEEE 0 ADAS_CM_single -3.4E+38 3.4E+38 /end CHARACTERISTIC
/begin CHARACTERISTIC VisTruckWidth "Meters" VALUE 0x0000 /* @ECU_Address@VisTruckWidth@ */ Scalar_FLOAT32_IEEE 0 ADAS_CM_single -3.4E+38 3.4E+38 /end CHARACTERISTIC
/begin CHARACTERISTIC VmaxRCTC "Vmax our car " VALUE 0x0000 /* @ECU_Address@VmaxRCTC@ */ Scalar_FLOAT32_IEEE 0 ADAS_CM_single 0.000000 100.000000 /end CHARACTERISTIC
/begin CHARACTERISTIC VminRCTC "Vmin our car" VALUE 0x0000 /* @ECU_Address@VminRCTC@ */ Scalar_FLOAT32_IEEE 0 ADAS_CM_single 0.000000 100.000000 /end CHARACTERISTIC
/begin CHARACTERISTIC WarnLine_BeforeCross "First warning line (Before crossing mode), m. (! WarnLine_X < DeltaPos !)" VALUE 0x0000 /* @ECU_Address@WarnLine_BeforeCross@ */ Scalar_FLOAT32_IEEE 0 ADAS_CM_single -0.200000 0.500000 /end CHARACTERISTIC
/begin CHARACTERISTIC WarnLine_WhileCross "First warning line (While crossing mode), m. (! WarnLine_X < DeltaPos !)" VALUE 0x0000 /* @ECU_Address@WarnLine_WhileCross@ */ Scalar_FLOAT32_IEEE 0 ADAS_CM_single -0.200000 0.500000 /end CHARACTERISTIC
/begin CHARACTERISTIC WelcomeTi "Turning on HB animation time, s" VALUE 0x0000 /* @ECU_Address@WelcomeTi@ */ Scalar_FLOAT32_IEEE 0 ADAS_CM_single 0.000000 10.000000 /end CHARACTERISTIC
/begin CHARACTERISTIC WfsWaitTime "sec for waiting after washing" VALUE 0x0000 /* @ECU_Address@WfsWaitTime@ */ Scalar_FLOAT32_IEEE 0 ADAS_CM_single -3.4E+38 3.4E+38 /end CHARACTERISTIC
/begin CHARACTERISTIC WfsWashCntLim "limiter of washing counter for blocking the system" VALUE 0x0000 /* @ECU_Address@WfsWashCntLim@ */ Scalar_UBYTE 0 ADAS_CM_uint8 0 255 /end CHARACTERISTIC
/begin CHARACTERISTIC WheelBaseLimo "Wheel base of the Limousine" VALUE 0x0000 /* @ECU_Address@WheelBaseLimo@ */ Scalar_FLOAT32_IEEE 0 ADAS_CM_single_m 0.000000 10.000000 /end CHARACTERISTIC
/begin CHARACTERISTIC WheelBaseSedan "Wheel base of the Sedan" VALUE 0x0000 /* @ECU_Address@WheelBaseSedan@ */ Scalar_FLOAT32_IEEE 0 ADAS_CM_single_m 0.000000 10.000000 /end CHARACTERISTIC
/begin CHARACTERISTIC Wheelbase "Distance between front and rear axles, m" VALUE 0x0000 /* @ECU_Address@Wheelbase@ */ Scalar_FLOAT32_IEEE 0 ADAS_CM_single 3.000000 5.000000 /end CHARACTERISTIC
/begin CHARACTERISTIC Width "Response corridor width" VALUE 0x0000 /* @ECU_Address@Width@ */ Scalar_FLOAT32_IEEE 0 ADAS_CM_single 0.000000 5.000000 /end CHARACTERISTIC
/begin CHARACTERISTIC X_HL_Limo "X-Distance between rear axle and HL ((X_ADB+X_mLED)/2), limousine, m" VALUE 0x0000 /* @ECU_Address@X_HL_Limo@ */ Scalar_FLOAT32_IEEE 0 ADAS_CM_single 0.000000 10.000000 /end CHARACTERISTIC
/begin CHARACTERISTIC X_HL_Sedan "X-Distance between rear axle and HL ((X_ADB+X_mLED)/2), sedan, m" VALUE 0x0000 /* @ECU_Address@X_HL_Sedan@ */ Scalar_FLOAT32_IEEE 0 ADAS_CM_single 0.000000 10.000000 /end CHARACTERISTIC
/begin CHARACTERISTIC X_HL_SedanLong "X-Distance between rear axle and HL ((X_ADB+X_mLED)/2), sedan long, m" VALUE 0x0000 /* @ECU_Address@X_HL_SedanLong@ */ Scalar_FLOAT32_IEEE 0 ADAS_CM_single 0.000000 10.000000 /end CHARACTERISTIC
/begin CHARACTERISTIC X_MarkLineRear "x coordinates array of marking line" VAL_BLK 0x0000 /* @ECU_Address@X_MarkLineRear@ */ Scalar_FLOAT32_IEEE 0 ADAS_CM_single_m -3.4E+38 3.4E+38 MATRIX_DIM 7 1 /end CHARACTERISTIC
/begin CHARACTERISTIC X_dark_off "Distance at which MLIA doesn`t blur vehicle with off-headlamps, m" VALUE 0x0000 /* @ECU_Address@X_dark_off@ */ Scalar_FLOAT32_IEEE 0 ADAS_CM_single 0.000000 400.000000 /end CHARACTERISTIC
/begin CHARACTERISTIC X_dark_on "Distance at which MLIA blurs vehicle with off-headlamps, m" VALUE 0x0000 /* @ECU_Address@X_dark_on@ */ Scalar_FLOAT32_IEEE 0 ADAS_CM_single 0.000000 400.000000 /end CHARACTERISTIC
/begin CHARACTERISTIC Y_HL "Y-Distance between longitudinal axis and HL ((Y_ADB+Y_mLED)/2), m" VALUE 0x0000 /* @ECU_Address@Y_HL@ */ Scalar_FLOAT32_IEEE 0 ADAS_CM_single 0.500000 1.500000 /end CHARACTERISTIC
/begin CHARACTERISTIC Y_ext_25 "Object zone expansion from each side at distance <=25 m, m" VALUE 0x0000 /* @ECU_Address@Y_ext_25@ */ Scalar_FLOAT32_IEEE 0 ADAS_CM_single 0.000000 20.000000 /end CHARACTERISTIC
/begin CHARACTERISTIC Y_ext_500 "Object zone expansion from each side at distance >=500 m, m" VALUE 0x0000 /* @ECU_Address@Y_ext_500@ */ Scalar_FLOAT32_IEEE 0 ADAS_CM_single 0.000000 20.000000 /end CHARACTERISTIC
/begin CHARACTERISTIC YawRatePredict_avail "YawRate predict availability" VALUE 0x0000 /* @ECU_Address@YawRatePredict_avail@ */ Scalar_FLOAT32_IEEE 0 ADAS_CM_single 0.000000 1.000000 /end CHARACTERISTIC
/begin CHARACTERISTIC YawRatePredict_coef "YawRate predict coefficient" VALUE 0x0000 /* @ECU_Address@YawRatePredict_coef@ */ Scalar_FLOAT32_IEEE 0 ADAS_CM_single -1000.000000 1000.000000 /end CHARACTERISTIC
/begin CHARACTERISTIC YawRate_dtMin_Avoid "Minimum rate of change of YawRate at which MinTLC = MinTLC_BeforeCross (if YawRate_dt < YawRate_dtMin_Avoid => MinTLC = MinTLC_Avoid), deg/s^2" VALUE 0x0000 /* @ECU_Address@YawRate_dtMin_Avoid@ */ Scalar_FLOAT32_IEEE 0 ADAS_CM_single -10.000000 0.000000 /end CHARACTERISTIC
/begin CHARACTERISTIC Z_HL "Z-Distance between rear axle and HL, m" VALUE 0x0000 /* @ECU_Address@Z_HL@ */ Scalar_FLOAT32_IEEE 0 ADAS_CM_single 0.000000 2.000000 /end CHARACTERISTIC
/begin CHARACTERISTIC kI "Response corridor width" VALUE 0x0000 /* @ECU_Address@kI@ */ Scalar_FLOAT32_IEEE 0 ADAS_CM_single 0.000000 100.000000 /end CHARACTERISTIC
/begin CHARACTERISTIC kP "Response corridor width" VALUE 0x0000 /* @ECU_Address@kP@ */ Scalar_FLOAT32_IEEE 0 ADAS_CM_single 0.000000 100.000000 /end CHARACTERISTIC
/begin CHARACTERISTIC mLED_Filter_avail "mLED-zones filter availability" VALUE 0x0000 /* @ECU_Address@mLED_Filter_avail@ */ Scalar_FLOAT32_IEEE 0 ADAS_CM_single 0.000000 1.000000 /end CHARACTERISTIC
/begin CHARACTERISTIC mLED_avail "Functioning mLED-module in MLIA: 0-off, 1-active" VALUE 0x0000 /* @ECU_Address@mLED_avail@ */ Scalar_FLOAT32_IEEE 0 ADAS_CM_single 0.000000 1.000000 /end CHARACTERISTIC
/begin CHARACTERISTIC mLedHorAngleCoef "Coefficient for converting horizontal angles to pixels (mLedHorAngle/mLedHorPix = 30/320)" VALUE 0x0000 /* @ECU_Address@mLedHorAngleCoef@ */ Scalar_FLOAT32_IEEE 0 ADAS_CM_single 0.080000 1.200000 /end CHARACTERISTIC
/begin CHARACTERISTIC mLedHorBordAngle "Horizontal lighting range between V-V and left/right border of mLED module (mLedHorAngle/2), deg" VALUE 0x0000 /* @ECU_Address@mLedHorBordAngle@ */ Scalar_FLOAT32_IEEE 0 ADAS_CM_single 10.000000 20.000000 /end CHARACTERISTIC
/begin CHARACTERISTIC mLedHorPix "Number of pixels on the mLED module, horizontally" VALUE 0x0000 /* @ECU_Address@mLedHorPix@ */ Scalar_FLOAT32_IEEE 0 ADAS_CM_single 319.000000 320.000000 /end CHARACTERISTIC
/begin CHARACTERISTIC mLedLowBeamPix "Pixel number corresponding to LowBeam on the mLED module, vertically" VALUE 0x0000 /* @ECU_Address@mLedLowBeamPix@ */ Scalar_FLOAT32_IEEE 0 ADAS_CM_single 0.000000 80.000000 /end CHARACTERISTIC
/begin CHARACTERISTIC mLedVerAngleCoef "Coefficient for converting vertical angles to pixels (mLedVerAngle/mLedVerPix = 7.5/80)" VALUE 0x0000 /* @ECU_Address@mLedVerAngleCoef@ */ Scalar_FLOAT32_IEEE 0 ADAS_CM_single 0.080000 1.200000 /end CHARACTERISTIC
/begin CHARACTERISTIC mLedVerLowAngle "Vertical lighting range between H-H and bottom border of mLED module, deg" VALUE 0x0000 /* @ECU_Address@mLedVerLowAngle@ */ Scalar_FLOAT32_IEEE 0 ADAS_CM_single 2.000000 7.000000 /end CHARACTERISTIC
/begin CHARACTERISTIC mLedVerUpAngle "Vertical lighting range between H-H and upper border of mLED module, deg" VALUE 0x0000 /* @ECU_Address@mLedVerUpAngle@ */ Scalar_FLOAT32_IEEE 0 ADAS_CM_single 1.000000 7.000000 /end CHARACTERISTIC
/begin CHARACTERISTIC markLineNotExistValue "Marking line y coordinate value which means marking line not found. If LCC get this value +- 0.1, LCC assumes that the marking line has not been detected at concrete distance." VALUE 0x0000 /* @ECU_Address@markLineNotExistValue@ */ Scalar_FLOAT32_IEEE 0 ADAS_CM_single_m 0.000000 209.000000 /end CHARACTERISTIC
/begin CHARACTERISTIC timeMaxRCTC "Time Maximum predict" VALUE 0x0000 /* @ECU_Address@timeMaxRCTC@ */ Scalar_FLOAT32_IEEE 0 ADAS_CM_single 0.000000 3.500000 /end CHARACTERISTIC
/begin CHARACTERISTIC timeMinRCTC "Time Minimum predict " VALUE 0x0000 /* @ECU_Address@timeMinRCTC@ */ Scalar_FLOAT32_IEEE 0 ADAS_CM_single 0.000000 3.500000 /end CHARACTERISTIC
/begin CHARACTERISTIC x_Sgrp_Limo "The x coordinate of the point SgRP on the Limousine" VALUE 0x0000 /* @ECU_Address@x_Sgrp_Limo@ */ Scalar_FLOAT32_IEEE 0 ADAS_CM_single_m -100.000000 100.000000 /end CHARACTERISTIC
/begin CHARACTERISTIC x_Sgrp_Sedan "The x coordinate of the point SgRP on the Sedan" VALUE 0x0000 /* @ECU_Address@x_Sgrp_Sedan@ */ Scalar_FLOAT32_IEEE 0 ADAS_CM_single_m -100.000000 100.000000 /end CHARACTERISTIC
/begin CHARACTERISTIC x_TrailEdge "The x coordinate of the trailing edge of the car" VALUE 0x0000 /* @ECU_Address@x_TrailEdge@ */ Scalar_FLOAT32_IEEE 0 ADAS_CM_single_m -100.000000 100.000000 /end CHARACTERISTIC
/begin MEASUREMENT AccActive "" UBYTE ADAS_CM_uint8 0 0 0.000000 3.000000 ECU_ADDRESS 0x0000 /* @ECU_Address@AccActive@ */ /end MEASUREMENT
/begin MEASUREMENT AccelReq "" FLOAT32_IEEE ADAS_CM_single 0 0 -5.000000 4.000000 ECU_ADDRESS 0x0000 /* @ECU_Address@AccelReq@ */ /end MEASUREMENT
/begin MEASUREMENT AdasAvailMode "" UBYTE ADAS_CM_uint8 0 0 0.000000 2.000000 ECU_ADDRESS 0x0000 /* @ECU_Address@AdasAvailMode@ */ /end MEASUREMENT
/begin MEASUREMENT CruiseControlType "" UBYTE ADAS_CM_uint8 0 0 0.000000 4.000000 ECU_ADDRESS 0x0000 /* @ECU_Address@CruiseControlType@ */ /end MEASUREMENT
/begin MEASUREMENT DriveOffReq "" UBYTE ADAS_CM_uint8 0 0 0.000000 1.000000 ECU_ADDRESS 0x0000 /* @ECU_Address@DriveOffReq@ */ /end MEASUREMENT
/begin MEASUREMENT DtDiagVerDateModelVisual "" FLOAT32_IEEE ADAS_CM_single 0 0 0.000000 320000.000000 ECU_ADDRESS 0x0000 /* @ECU_Address@DtDiagVerDateModelVisual@ */ /end MEASUREMENT
/begin MEASUREMENT DtDiagVerNumModelVISUAL "" UBYTE ADAS_CM_uint8 0 0 0.000000 255.000000 ECU_ADDRESS 0x0000 /* @ECU_Address@DtDiagVerNumModelVISUAL@ */ /end MEASUREMENT
/begin MEASUREMENT DtLogVisualErrCode "" UBYTE ADAS_CM_uint8 0 0 0.000000 255.000000 ECU_ADDRESS 0x0000 /* @ECU_Address@DtLogVisualErrCode@ */ /end MEASUREMENT
/begin MEASUREMENT DtLogVisualErrFlag "" UBYTE ADAS_CM_uint8 0 0 0.000000 255.000000 ECU_ADDRESS 0x0000 /* @ECU_Address@DtLogVisualErrFlag@ */ /end MEASUREMENT
/begin MEASUREMENT DtLogVisualLogicTrans "" UBYTE ADAS_CM_uint8 0 0 0.000000 255.000000 ECU_ADDRESS 0x0000 /* @ECU_Address@DtLogVisualLogicTrans@ */ /end MEASUREMENT
/begin MEASUREMENT DtLogVisualSolverTrans "" UBYTE ADAS_CM_uint8 0 0 0.000000 255.000000 ECU_ADDRESS 0x0000 /* @ECU_Address@DtLogVisualSolverTrans@ */ /end MEASUREMENT
/begin MEASUREMENT SensSteerWhLvl "" UBYTE ADAS_CM_uint8 0 0 0.000000 63.000000 ECU_ADDRESS 0x0000 /* @ECU_Address@SensSteerWhLvl@ */ /end MEASUREMENT
/begin MEASUREMENT SensSteerWhVibrReq "" UBYTE ADAS_CM_uint8 0 0 0.000000 1.000000 ECU_ADDRESS 0x0000 /* @ECU_Address@SensSteerWhVibrReq@ */ /end MEASUREMENT
/begin MEASUREMENT SpeedTarget "" FLOAT32_IEEE ADAS_CM_single 0 0 0.000000 250.000000 ECU_ADDRESS 0x0000 /* @ECU_Address@SpeedTarget@ */ /end MEASUREMENT
/begin MEASUREMENT StandStillReq "" UBYTE ADAS_CM_uint8 0 0 0.000000 1.000000 ECU_ADDRESS 0x0000 /* @ECU_Address@StandStillReq@ */ /end MEASUREMENT
/begin MEASUREMENT VisAccSetDist "" UBYTE ADAS_CM_uint8 0 0 0.000000 3.000000 ECU_ADDRESS 0x0000 /* @ECU_Address@VisAccSetDist@ */ /end MEASUREMENT
/begin MEASUREMENT VisAccTargetObj "" UBYTE ADAS_CM_uint8 0 0 0.000000 20.000000 ECU_ADDRESS 0x0000 /* @ECU_Address@VisAccTargetObj@ */ /end MEASUREMENT
/begin MEASUREMENT VisAebTargetObj "" UBYTE ADAS_CM_uint8 0 0 0.000000 20.000000 ECU_ADDRESS 0x0000 /* @ECU_Address@VisAebTargetObj@ */ /end MEASUREMENT
/begin MEASUREMENT VisEgoZone "" UBYTE ADAS_CM_uint8 0 0 0.000000 4.000000 ECU_ADDRESS 0x0000 /* @ECU_Address@VisEgoZone@ */ /end MEASUREMENT
/begin MEASUREMENT VisFcwTargetObj "" UBYTE ADAS_CM_uint8 0 0 0.000000 20.000000 ECU_ADDRESS 0x0000 /* @ECU_Address@VisFcwTargetObj@ */ /end MEASUREMENT
/begin MEASUREMENT VisLaneLLType "" UBYTE ADAS_CM_uint8 0 0 0.000000 1.000000 ECU_ADDRESS 0x0000 /* @ECU_Address@VisLaneLLType@ */ /end MEASUREMENT
/begin MEASUREMENT VisLaneLType "" UBYTE ADAS_CM_uint8 0 0 0.000000 4.000000 ECU_ADDRESS 0x0000 /* @ECU_Address@VisLaneLType@ */ /end MEASUREMENT
/begin MEASUREMENT VisLaneRRType "" UBYTE ADAS_CM_uint8 0 0 0.000000 1.000000 ECU_ADDRESS 0x0000 /* @ECU_Address@VisLaneRRType@ */ /end MEASUREMENT
/begin MEASUREMENT VisLaneRType "" UBYTE ADAS_CM_uint8 0 0 0.000000 4.000000 ECU_ADDRESS 0x0000 /* @ECU_Address@VisLaneRType@ */ /end MEASUREMENT
/begin MEASUREMENT VisLccLeftLane "" UBYTE ADAS_CM_uint8 0 0 0.000000 1.000000 ECU_ADDRESS 0x0000 /* @ECU_Address@VisLccLeftLane@ */ /end MEASUREMENT
/begin MEASUREMENT VisLccRightLane "" UBYTE ADAS_CM_uint8 0 0 0.000000 1.000000 ECU_ADDRESS 0x0000 /* @ECU_Address@VisLccRightLane@ */ /end MEASUREMENT
/begin MEASUREMENT VisLdwLeftLine "" UBYTE ADAS_CM_uint8 0 0 0.000000 1.000000 ECU_ADDRESS 0x0000 /* @ECU_Address@VisLdwLeftLine@ */ /end MEASUREMENT
/begin MEASUREMENT VisLdwRightLine "" UBYTE ADAS_CM_uint8 0 0 0.000000 1.000000 ECU_ADDRESS 0x0000 /* @ECU_Address@VisLdwRightLine@ */ /end MEASUREMENT
/begin MEASUREMENT VisLkaAct "" UBYTE ADAS_CM_uint8 0 0 0.000000 1.000000 ECU_ADDRESS 0x0000 /* @ECU_Address@VisLkaAct@ */ /end MEASUREMENT
/begin MEASUREMENT VisObj1DistLong "" FLOAT32_IEEE ADAS_CM_single 0 0 0.000000 100.000000 ECU_ADDRESS 0x0000 /* @ECU_Address@VisObj1DistLong@ */ /end MEASUREMENT
/begin MEASUREMENT VisObj1Orient "" UBYTE ADAS_CM_uint8 0 0 0.000000 3.000000 ECU_ADDRESS 0x0000 /* @ECU_Address@VisObj1Orient@ */ /end MEASUREMENT
/begin MEASUREMENT VisObj1Zone "" UBYTE ADAS_CM_uint8 0 0 0.000000 9.000000 ECU_ADDRESS 0x0000 /* @ECU_Address@VisObj1Zone@ */ /end MEASUREMENT
/begin MEASUREMENT VisObj1_Type "" UBYTE ADAS_CM_uint8 0 0 0.000000 7.000000 ECU_ADDRESS 0x0000 /* @ECU_Address@VisObj1_Type@ */ /end MEASUREMENT
/begin MEASUREMENT VisObj2DistLong "" FLOAT32_IEEE ADAS_CM_single 0 0 0.000000 100.000000 ECU_ADDRESS 0x0000 /* @ECU_Address@VisObj2DistLong@ */ /end MEASUREMENT
/begin MEASUREMENT VisObj2Orient "" UBYTE ADAS_CM_uint8 0 0 0.000000 3.000000 ECU_ADDRESS 0x0000 /* @ECU_Address@VisObj2Orient@ */ /end MEASUREMENT
/begin MEASUREMENT VisObj2Zone "" UBYTE ADAS_CM_uint8 0 0 0.000000 9.000000 ECU_ADDRESS 0x0000 /* @ECU_Address@VisObj2Zone@ */ /end MEASUREMENT
/begin MEASUREMENT VisObj2_Type "" UBYTE ADAS_CM_uint8 0 0 0.000000 7.000000 ECU_ADDRESS 0x0000 /* @ECU_Address@VisObj2_Type@ */ /end MEASUREMENT
/begin MEASUREMENT VisObj3DistLong "" FLOAT32_IEEE ADAS_CM_single 0 0 0.000000 100.000000 ECU_ADDRESS 0x0000 /* @ECU_Address@VisObj3DistLong@ */ /end MEASUREMENT
/begin MEASUREMENT VisObj3Orient "" UBYTE ADAS_CM_uint8 0 0 0.000000 3.000000 ECU_ADDRESS 0x0000 /* @ECU_Address@VisObj3Orient@ */ /end MEASUREMENT
/begin MEASUREMENT VisObj3Zone "" UBYTE ADAS_CM_uint8 0 0 0.000000 9.000000 ECU_ADDRESS 0x0000 /* @ECU_Address@VisObj3Zone@ */ /end MEASUREMENT
/begin MEASUREMENT VisObj3_Type "" UBYTE ADAS_CM_uint8 0 0 0.000000 7.000000 ECU_ADDRESS 0x0000 /* @ECU_Address@VisObj3_Type@ */ /end MEASUREMENT
/begin MEASUREMENT VisObj4DistLong "" FLOAT32_IEEE ADAS_CM_single 0 0 0.000000 100.000000 ECU_ADDRESS 0x0000 /* @ECU_Address@VisObj4DistLong@ */ /end MEASUREMENT
/begin MEASUREMENT VisObj4Orient "" UBYTE ADAS_CM_uint8 0 0 0.000000 3.000000 ECU_ADDRESS 0x0000 /* @ECU_Address@VisObj4Orient@ */ /end MEASUREMENT
/begin MEASUREMENT VisObj4Zone "" UBYTE ADAS_CM_uint8 0 0 0.000000 9.000000 ECU_ADDRESS 0x0000 /* @ECU_Address@VisObj4Zone@ */ /end MEASUREMENT
/begin MEASUREMENT VisObj4_Type "" UBYTE ADAS_CM_uint8 0 0 0.000000 7.000000 ECU_ADDRESS 0x0000 /* @ECU_Address@VisObj4_Type@ */ /end MEASUREMENT
/begin MEASUREMENT VisObj5DistLong "" FLOAT32_IEEE ADAS_CM_single 0 0 0.000000 100.000000 ECU_ADDRESS 0x0000 /* @ECU_Address@VisObj5DistLong@ */ /end MEASUREMENT
/begin MEASUREMENT VisObj5Orient "" UBYTE ADAS_CM_uint8 0 0 0.000000 3.000000 ECU_ADDRESS 0x0000 /* @ECU_Address@VisObj5Orient@ */ /end MEASUREMENT
/begin MEASUREMENT VisObj5Zone "" UBYTE ADAS_CM_uint8 0 0 0.000000 9.000000 ECU_ADDRESS 0x0000 /* @ECU_Address@VisObj5Zone@ */ /end MEASUREMENT
/begin MEASUREMENT VisObj5_Type "" UBYTE ADAS_CM_uint8 0 0 0.000000 7.000000 ECU_ADDRESS 0x0000 /* @ECU_Address@VisObj5_Type@ */ /end MEASUREMENT
/begin MEASUREMENT VisObj6DistLong "" FLOAT32_IEEE ADAS_CM_single 0 0 0.000000 100.000000 ECU_ADDRESS 0x0000 /* @ECU_Address@VisObj6DistLong@ */ /end MEASUREMENT
/begin MEASUREMENT VisObj6Orient "" UBYTE ADAS_CM_uint8 0 0 0.000000 3.000000 ECU_ADDRESS 0x0000 /* @ECU_Address@VisObj6Orient@ */ /end MEASUREMENT
/begin MEASUREMENT VisObj6Zone "" UBYTE ADAS_CM_uint8 0 0 0.000000 9.000000 ECU_ADDRESS 0x0000 /* @ECU_Address@VisObj6Zone@ */ /end MEASUREMENT
/begin MEASUREMENT VisObj6_Type "" UBYTE ADAS_CM_uint8 0 0 0.000000 7.000000 ECU_ADDRESS 0x0000 /* @ECU_Address@VisObj6_Type@ */ /end MEASUREMENT
/begin MEASUREMENT VisObj7DistLong "" FLOAT32_IEEE ADAS_CM_single 0 0 0.000000 100.000000 ECU_ADDRESS 0x0000 /* @ECU_Address@VisObj7DistLong@ */ /end MEASUREMENT
/begin MEASUREMENT VisObj7Orient "" UBYTE ADAS_CM_uint8 0 0 0.000000 3.000000 ECU_ADDRESS 0x0000 /* @ECU_Address@VisObj7Orient@ */ /end MEASUREMENT
/begin MEASUREMENT VisObj7Zone "" UBYTE ADAS_CM_uint8 0 0 0.000000 9.000000 ECU_ADDRESS 0x0000 /* @ECU_Address@VisObj7Zone@ */ /end MEASUREMENT
/begin MEASUREMENT VisObj7_Type "" UBYTE ADAS_CM_uint8 0 0 0.000000 7.000000 ECU_ADDRESS 0x0000 /* @ECU_Address@VisObj7_Type@ */ /end MEASUREMENT
/begin MEASUREMENT VisObj8DistLong "" FLOAT32_IEEE ADAS_CM_single 0 0 0.000000 100.000000 ECU_ADDRESS 0x0000 /* @ECU_Address@VisObj8DistLong@ */ /end MEASUREMENT
/begin MEASUREMENT VisObj8Orient "" UBYTE ADAS_CM_uint8 0 0 0.000000 3.000000 ECU_ADDRESS 0x0000 /* @ECU_Address@VisObj8Orient@ */ /end MEASUREMENT
/begin MEASUREMENT VisObj8Zone "" UBYTE ADAS_CM_uint8 0 0 0.000000 9.000000 ECU_ADDRESS 0x0000 /* @ECU_Address@VisObj8Zone@ */ /end MEASUREMENT
/begin MEASUREMENT VisObj8_Type "" UBYTE ADAS_CM_uint8 0 0 0.000000 7.000000 ECU_ADDRESS 0x0000 /* @ECU_Address@VisObj8_Type@ */ /end MEASUREMENT
/begin MEASUREMENT VisObj9DistLong "" FLOAT32_IEEE ADAS_CM_single 0 0 0.000000 100.000000 ECU_ADDRESS 0x0000 /* @ECU_Address@VisObj9DistLong@ */ /end MEASUREMENT
/begin MEASUREMENT VisObj9Orient "" UBYTE ADAS_CM_uint8 0 0 0.000000 3.000000 ECU_ADDRESS 0x0000 /* @ECU_Address@VisObj9Orient@ */ /end MEASUREMENT
/begin MEASUREMENT VisObj9Zone "" UBYTE ADAS_CM_uint8 0 0 0.000000 9.000000 ECU_ADDRESS 0x0000 /* @ECU_Address@VisObj9Zone@ */ /end MEASUREMENT
/begin MEASUREMENT VisObj9_Type "" UBYTE ADAS_CM_uint8 0 0 0.000000 7.000000 ECU_ADDRESS 0x0000 /* @ECU_Address@VisObj9_Type@ */ /end MEASUREMENT
/begin MEASUREMENT VisObjDynam1ID "" UBYTE ADAS_CM_uint8 0 0 0.000000 20.000000 ECU_ADDRESS 0x0000 /* @ECU_Address@VisObjDynam1ID@ */ /end MEASUREMENT
/begin MEASUREMENT VisObjDynam2ID "" UBYTE ADAS_CM_uint8 0 0 0.000000 20.000000 ECU_ADDRESS 0x0000 /* @ECU_Address@VisObjDynam2ID@ */ /end MEASUREMENT
/begin MEASUREMENT VisObjDynam3ID "" UBYTE ADAS_CM_uint8 0 0 0.000000 20.000000 ECU_ADDRESS 0x0000 /* @ECU_Address@VisObjDynam3ID@ */ /end MEASUREMENT
/begin MEASUREMENT VisObjDynam4ID "" UBYTE ADAS_CM_uint8 0 0 0.000000 20.000000 ECU_ADDRESS 0x0000 /* @ECU_Address@VisObjDynam4ID@ */ /end MEASUREMENT
/begin MEASUREMENT VisObjDynam5ID "" UBYTE ADAS_CM_uint8 0 0 0.000000 20.000000 ECU_ADDRESS 0x0000 /* @ECU_Address@VisObjDynam5ID@ */ /end MEASUREMENT
/begin MEASUREMENT VisObjDynam6ID "" UBYTE ADAS_CM_uint8 0 0 0.000000 20.000000 ECU_ADDRESS 0x0000 /* @ECU_Address@VisObjDynam6ID@ */ /end MEASUREMENT
/begin MEASUREMENT VisObjDynam7ID "" UBYTE ADAS_CM_uint8 0 0 0.000000 20.000000 ECU_ADDRESS 0x0000 /* @ECU_Address@VisObjDynam7ID@ */ /end MEASUREMENT
/begin MEASUREMENT VisObjDynam8ID "" UBYTE ADAS_CM_uint8 0 0 0.000000 20.000000 ECU_ADDRESS 0x0000 /* @ECU_Address@VisObjDynam8ID@ */ /end MEASUREMENT
/begin MEASUREMENT VisObjDynam9ID "" UBYTE ADAS_CM_uint8 0 0 0.000000 20.000000 ECU_ADDRESS 0x0000 /* @ECU_Address@VisObjDynam9ID@ */ /end MEASUREMENT
/begin MEASUREMENT VisRoadAngleLvl "" UBYTE ADAS_CM_uint8 0 0 0.000000 4.000000 ECU_ADDRESS 0x0000 /* @ECU_Address@VisRoadAngleLvl@ */ /end MEASUREMENT
/begin MEASUREMENT VlcActive "" UBYTE ADAS_CM_uint8 0 0 0.000000 1.000000 ECU_ADDRESS 0x0000 /* @ECU_Address@VlcActive@ */ /end MEASUREMENT
/begin MEASUREMENT VlcTrqActive "" UBYTE ADAS_CM_uint8 0 0 0.000000 1.000000 ECU_ADDRESS 0x0000 /* @ECU_Address@VlcTrqActive@ */ /end MEASUREMENT
/begin MEASUREMENT rtDW_ADAS.GTADBtargetLEDs_MODE "" UBYTE ADAS_CM_logical 0 0 0 1 ECU_ADDRESS 0x0000 /* @ECU_Address@rtDW_ADAS.GTADBtargetLEDs_MODE@ */ /end MEASUREMENT
/begin MEASUREMENT rtDW_ADAS.GTAVOIDANCE.GTAVOIDANCE_MODE "" UBYTE ADAS_CM_logical 0 0 0 1 ECU_ADDRESS 0x0000 /* @ECU_Address@rtDW_ADAS.GTAVOIDANCE.GTAVOIDANCE_MODE@ */ /end MEASUREMENT
/begin MEASUREMENT rtDW_ADAS.GTAVOIDANCE.GTUD_DSTATE "" FLOAT32_IEEE ADAS_CM_single 0 0 -3.4E+38 3.4E+38 ECU_ADDRESS 0x0000 /* @ECU_Address@rtDW_ADAS.GTAVOIDANCE.GTUD_DSTATE@ */ /end MEASUREMENT
/begin MEASUREMENT rtDW_ADAS.GTAVOIDANCE_e.GTAVOIDANCE_MODE "" UBYTE ADAS_CM_logical 0 0 0 1 ECU_ADDRESS 0x0000 /* @ECU_Address@rtDW_ADAS.GTAVOIDANCE_e.GTAVOIDANCE_MODE@ */ /end MEASUREMENT
/begin MEASUREMENT rtDW_ADAS.GTAVOIDANCE_e.GTUD_DSTATE "" FLOAT32_IEEE ADAS_CM_single 0 0 -3.4E+38 3.4E+38 ECU_ADDRESS 0x0000 /* @ECU_Address@rtDW_ADAS.GTAVOIDANCE_e.GTUD_DSTATE@ */ /end MEASUREMENT
/begin MEASUREMENT rtDW_ADAS.GTAngleDetect.Angle_obj1.DetectObj "" UBYTE ADAS_CM_uint8 0 0 0 255 ECU_ADDRESS 0x0000 /* @ECU_Address@rtDW_ADAS.GTAngleDetect.Angle_obj1.DetectObj@ */ /end MEASUREMENT
/begin MEASUREMENT rtDW_ADAS.GTAngleDetect.Angle_obj1.NumZone "" UBYTE ADAS_CM_uint8 0 0 0 255 ECU_ADDRESS 0x0000 /* @ECU_Address@rtDW_ADAS.GTAngleDetect.Angle_obj1.NumZone@ */ /end MEASUREMENT
/begin MEASUREMENT rtDW_ADAS.GTAngleDetect.Angle_obj1.VAngle_obj "" FLOAT32_IEEE ADAS_CM_single 0 0 -3.4E+38 3.4E+38 ECU_ADDRESS 0x0000 /* @ECU_Address@rtDW_ADAS.GTAngleDetect.Angle_obj1.VAngle_obj@ */ /end MEASUREMENT
/begin MEASUREMENT rtDW_ADAS.GTAngleDetect.Angle_obj1.alfa_LL_obj "" FLOAT32_IEEE ADAS_CM_single 0 0 -3.4E+38 3.4E+38 ECU_ADDRESS 0x0000 /* @ECU_Address@rtDW_ADAS.GTAngleDetect.Angle_obj1.alfa_LL_obj@ */ /end MEASUREMENT
/begin MEASUREMENT rtDW_ADAS.GTAngleDetect.Angle_obj1.alfa_LR_obj "" FLOAT32_IEEE ADAS_CM_single 0 0 -3.4E+38 3.4E+38 ECU_ADDRESS 0x0000 /* @ECU_Address@rtDW_ADAS.GTAngleDetect.Angle_obj1.alfa_LR_obj@ */ /end MEASUREMENT
/begin MEASUREMENT rtDW_ADAS.GTAngleDetect.Angle_obj1.alfa_RL_obj "" FLOAT32_IEEE ADAS_CM_single 0 0 -3.4E+38 3.4E+38 ECU_ADDRESS 0x0000 /* @ECU_Address@rtDW_ADAS.GTAngleDetect.Angle_obj1.alfa_RL_obj@ */ /end MEASUREMENT
/begin MEASUREMENT rtDW_ADAS.GTAngleDetect.Angle_obj1.alfa_RR_obj "" FLOAT32_IEEE ADAS_CM_single 0 0 -3.4E+38 3.4E+38 ECU_ADDRESS 0x0000 /* @ECU_Address@rtDW_ADAS.GTAngleDetect.Angle_obj1.alfa_RR_obj@ */ /end MEASUREMENT
/begin MEASUREMENT rtDW_ADAS.GTAngleDetect.Angle_obj2.DetectObj "" UBYTE ADAS_CM_uint8 0 0 0 255 ECU_ADDRESS 0x0000 /* @ECU_Address@rtDW_ADAS.GTAngleDetect.Angle_obj2.DetectObj@ */ /end MEASUREMENT
/begin MEASUREMENT rtDW_ADAS.GTAngleDetect.Angle_obj2.NumZone "" UBYTE ADAS_CM_uint8 0 0 0 255 ECU_ADDRESS 0x0000 /* @ECU_Address@rtDW_ADAS.GTAngleDetect.Angle_obj2.NumZone@ */ /end MEASUREMENT
/begin MEASUREMENT rtDW_ADAS.GTAngleDetect.Angle_obj2.VAngle_obj "" FLOAT32_IEEE ADAS_CM_single 0 0 -3.4E+38 3.4E+38 ECU_ADDRESS 0x0000 /* @ECU_Address@rtDW_ADAS.GTAngleDetect.Angle_obj2.VAngle_obj@ */ /end MEASUREMENT
/begin MEASUREMENT rtDW_ADAS.GTAngleDetect.Angle_obj2.alfa_LL_obj "" FLOAT32_IEEE ADAS_CM_single 0 0 -3.4E+38 3.4E+38 ECU_ADDRESS 0x0000 /* @ECU_Address@rtDW_ADAS.GTAngleDetect.Angle_obj2.alfa_LL_obj@ */ /end MEASUREMENT
/begin MEASUREMENT rtDW_ADAS.GTAngleDetect.Angle_obj2.alfa_LR_obj "" FLOAT32_IEEE ADAS_CM_single 0 0 -3.4E+38 3.4E+38 ECU_ADDRESS 0x0000 /* @ECU_Address@rtDW_ADAS.GTAngleDetect.Angle_obj2.alfa_LR_obj@ */ /end MEASUREMENT
/begin MEASUREMENT rtDW_ADAS.GTAngleDetect.Angle_obj2.alfa_RL_obj "" FLOAT32_IEEE ADAS_CM_single 0 0 -3.4E+38 3.4E+38 ECU_ADDRESS 0x0000 /* @ECU_Address@rtDW_ADAS.GTAngleDetect.Angle_obj2.alfa_RL_obj@ */ /end MEASUREMENT
/begin MEASUREMENT rtDW_ADAS.GTAngleDetect.Angle_obj2.alfa_RR_obj "" FLOAT32_IEEE ADAS_CM_single 0 0 -3.4E+38 3.4E+38 ECU_ADDRESS 0x0000 /* @ECU_Address@rtDW_ADAS.GTAngleDetect.Angle_obj2.alfa_RR_obj@ */ /end MEASUREMENT
/begin MEASUREMENT rtDW_ADAS.GTAngleDetect.Angle_obj3.DetectObj "" UBYTE ADAS_CM_uint8 0 0 0 255 ECU_ADDRESS 0x0000 /* @ECU_Address@rtDW_ADAS.GTAngleDetect.Angle_obj3.DetectObj@ */ /end MEASUREMENT
/begin MEASUREMENT rtDW_ADAS.GTAngleDetect.Angle_obj3.NumZone "" UBYTE ADAS_CM_uint8 0 0 0 255 ECU_ADDRESS 0x0000 /* @ECU_Address@rtDW_ADAS.GTAngleDetect.Angle_obj3.NumZone@ */ /end MEASUREMENT
/begin MEASUREMENT rtDW_ADAS.GTAngleDetect.Angle_obj3.VAngle_obj "" FLOAT32_IEEE ADAS_CM_single 0 0 -3.4E+38 3.4E+38 ECU_ADDRESS 0x0000 /* @ECU_Address@rtDW_ADAS.GTAngleDetect.Angle_obj3.VAngle_obj@ */ /end MEASUREMENT
/begin MEASUREMENT rtDW_ADAS.GTAngleDetect.Angle_obj3.alfa_LL_obj "" FLOAT32_IEEE ADAS_CM_single 0 0 -3.4E+38 3.4E+38 ECU_ADDRESS 0x0000 /* @ECU_Address@rtDW_ADAS.GTAngleDetect.Angle_obj3.alfa_LL_obj@ */ /end MEASUREMENT
/begin MEASUREMENT rtDW_ADAS.GTAngleDetect.Angle_obj3.alfa_LR_obj "" FLOAT32_IEEE ADAS_CM_single 0 0 -3.4E+38 3.4E+38 ECU_ADDRESS 0x0000 /* @ECU_Address@rtDW_ADAS.GTAngleDetect.Angle_obj3.alfa_LR_obj@ */ /end MEASUREMENT
/begin MEASUREMENT rtDW_ADAS.GTAngleDetect.Angle_obj3.alfa_RL_obj "" FLOAT32_IEEE ADAS_CM_single 0 0 -3.4E+38 3.4E+38 ECU_ADDRESS 0x0000 /* @ECU_Address@rtDW_ADAS.GTAngleDetect.Angle_obj3.alfa_RL_obj@ */ /end MEASUREMENT
/begin MEASUREMENT rtDW_ADAS.GTAngleDetect.Angle_obj3.alfa_RR_obj "" FLOAT32_IEEE ADAS_CM_single 0 0 -3.4E+38 3.4E+38 ECU_ADDRESS 0x0000 /* @ECU_Address@rtDW_ADAS.GTAngleDetect.Angle_obj3.alfa_RR_obj@ */ /end MEASUREMENT
/begin MEASUREMENT rtDW_ADAS.GTAngleDetect.Angle_obj4.DetectObj "" UBYTE ADAS_CM_uint8 0 0 0 255 ECU_ADDRESS 0x0000 /* @ECU_Address@rtDW_ADAS.GTAngleDetect.Angle_obj4.DetectObj@ */ /end MEASUREMENT
/begin MEASUREMENT rtDW_ADAS.GTAngleDetect.Angle_obj4.NumZone "" UBYTE ADAS_CM_uint8 0 0 0 255 ECU_ADDRESS 0x0000 /* @ECU_Address@rtDW_ADAS.GTAngleDetect.Angle_obj4.NumZone@ */ /end MEASUREMENT
/begin MEASUREMENT rtDW_ADAS.GTAngleDetect.Angle_obj4.VAngle_obj "" FLOAT32_IEEE ADAS_CM_single 0 0 -3.4E+38 3.4E+38 ECU_ADDRESS 0x0000 /* @ECU_Address@rtDW_ADAS.GTAngleDetect.Angle_obj4.VAngle_obj@ */ /end MEASUREMENT
/begin MEASUREMENT rtDW_ADAS.GTAngleDetect.Angle_obj4.alfa_LL_obj "" FLOAT32_IEEE ADAS_CM_single 0 0 -3.4E+38 3.4E+38 ECU_ADDRESS 0x0000 /* @ECU_Address@rtDW_ADAS.GTAngleDetect.Angle_obj4.alfa_LL_obj@ */ /end MEASUREMENT
/begin MEASUREMENT rtDW_ADAS.GTAngleDetect.Angle_obj4.alfa_LR_obj "" FLOAT32_IEEE ADAS_CM_single 0 0 -3.4E+38 3.4E+38 ECU_ADDRESS 0x0000 /* @ECU_Address@rtDW_ADAS.GTAngleDetect.Angle_obj4.alfa_LR_obj@ */ /end MEASUREMENT
/begin MEASUREMENT rtDW_ADAS.GTAngleDetect.Angle_obj4.alfa_RL_obj "" FLOAT32_IEEE ADAS_CM_single 0 0 -3.4E+38 3.4E+38 ECU_ADDRESS 0x0000 /* @ECU_Address@rtDW_ADAS.GTAngleDetect.Angle_obj4.alfa_RL_obj@ */ /end MEASUREMENT
/begin MEASUREMENT rtDW_ADAS.GTAngleDetect.Angle_obj4.alfa_RR_obj "" FLOAT32_IEEE ADAS_CM_single 0 0 -3.4E+38 3.4E+38 ECU_ADDRESS 0x0000 /* @ECU_Address@rtDW_ADAS.GTAngleDetect.Angle_obj4.alfa_RR_obj@ */ /end MEASUREMENT
/begin MEASUREMENT rtDW_ADAS.GTAngleDetect.Angle_obj5.DetectObj "" UBYTE ADAS_CM_uint8 0 0 0 255 ECU_ADDRESS 0x0000 /* @ECU_Address@rtDW_ADAS.GTAngleDetect.Angle_obj5.DetectObj@ */ /end MEASUREMENT
/begin MEASUREMENT rtDW_ADAS.GTAngleDetect.Angle_obj5.NumZone "" UBYTE ADAS_CM_uint8 0 0 0 255 ECU_ADDRESS 0x0000 /* @ECU_Address@rtDW_ADAS.GTAngleDetect.Angle_obj5.NumZone@ */ /end MEASUREMENT
/begin MEASUREMENT rtDW_ADAS.GTAngleDetect.Angle_obj5.VAngle_obj "" FLOAT32_IEEE ADAS_CM_single 0 0 -3.4E+38 3.4E+38 ECU_ADDRESS 0x0000 /* @ECU_Address@rtDW_ADAS.GTAngleDetect.Angle_obj5.VAngle_obj@ */ /end MEASUREMENT
/begin MEASUREMENT rtDW_ADAS.GTAngleDetect.Angle_obj5.alfa_LL_obj "" FLOAT32_IEEE ADAS_CM_single 0 0 -3.4E+38 3.4E+38 ECU_ADDRESS 0x0000 /* @ECU_Address@rtDW_ADAS.GTAngleDetect.Angle_obj5.alfa_LL_obj@ */ /end MEASUREMENT
/begin MEASUREMENT rtDW_ADAS.GTAngleDetect.Angle_obj5.alfa_LR_obj "" FLOAT32_IEEE ADAS_CM_single 0 0 -3.4E+38 3.4E+38 ECU_ADDRESS 0x0000 /* @ECU_Address@rtDW_ADAS.GTAngleDetect.Angle_obj5.alfa_LR_obj@ */ /end MEASUREMENT
/begin MEASUREMENT rtDW_ADAS.GTAngleDetect.Angle_obj5.alfa_RL_obj "" FLOAT32_IEEE ADAS_CM_single 0 0 -3.4E+38 3.4E+38 ECU_ADDRESS 0x0000 /* @ECU_Address@rtDW_ADAS.GTAngleDetect.Angle_obj5.alfa_RL_obj@ */ /end MEASUREMENT
/begin MEASUREMENT rtDW_ADAS.GTAngleDetect.Angle_obj5.alfa_RR_obj "" FLOAT32_IEEE ADAS_CM_single 0 0 -3.4E+38 3.4E+38 ECU_ADDRESS 0x0000 /* @ECU_Address@rtDW_ADAS.GTAngleDetect.Angle_obj5.alfa_RR_obj@ */ /end MEASUREMENT
/begin MEASUREMENT rtDW_ADAS.GTAngleDetect.Angle_obj6.DetectObj "" UBYTE ADAS_CM_uint8 0 0 0 255 ECU_ADDRESS 0x0000 /* @ECU_Address@rtDW_ADAS.GTAngleDetect.Angle_obj6.DetectObj@ */ /end MEASUREMENT
/begin MEASUREMENT rtDW_ADAS.GTAngleDetect.Angle_obj6.NumZone "" UBYTE ADAS_CM_uint8 0 0 0 255 ECU_ADDRESS 0x0000 /* @ECU_Address@rtDW_ADAS.GTAngleDetect.Angle_obj6.NumZone@ */ /end MEASUREMENT
/begin MEASUREMENT rtDW_ADAS.GTAngleDetect.Angle_obj6.VAngle_obj "" FLOAT32_IEEE ADAS_CM_single 0 0 -3.4E+38 3.4E+38 ECU_ADDRESS 0x0000 /* @ECU_Address@rtDW_ADAS.GTAngleDetect.Angle_obj6.VAngle_obj@ */ /end MEASUREMENT
/begin MEASUREMENT rtDW_ADAS.GTAngleDetect.Angle_obj6.alfa_LL_obj "" FLOAT32_IEEE ADAS_CM_single 0 0 -3.4E+38 3.4E+38 ECU_ADDRESS 0x0000 /* @ECU_Address@rtDW_ADAS.GTAngleDetect.Angle_obj6.alfa_LL_obj@ */ /end MEASUREMENT
/begin MEASUREMENT rtDW_ADAS.GTAngleDetect.Angle_obj6.alfa_LR_obj "" FLOAT32_IEEE ADAS_CM_single 0 0 -3.4E+38 3.4E+38 ECU_ADDRESS 0x0000 /* @ECU_Address@rtDW_ADAS.GTAngleDetect.Angle_obj6.alfa_LR_obj@ */ /end MEASUREMENT
/begin MEASUREMENT rtDW_ADAS.GTAngleDetect.Angle_obj6.alfa_RL_obj "" FLOAT32_IEEE ADAS_CM_single 0 0 -3.4E+38 3.4E+38 ECU_ADDRESS 0x0000 /* @ECU_Address@rtDW_ADAS.GTAngleDetect.Angle_obj6.alfa_RL_obj@ */ /end MEASUREMENT
/begin MEASUREMENT rtDW_ADAS.GTAngleDetect.Angle_obj6.alfa_RR_obj "" FLOAT32_IEEE ADAS_CM_single 0 0 -3.4E+38 3.4E+38 ECU_ADDRESS 0x0000 /* @ECU_Address@rtDW_ADAS.GTAngleDetect.Angle_obj6.alfa_RR_obj@ */ /end MEASUREMENT
/begin MEASUREMENT rtDW_ADAS.GTAngleDetect.Angle_obj7.DetectObj "" UBYTE ADAS_CM_uint8 0 0 0 255 ECU_ADDRESS 0x0000 /* @ECU_Address@rtDW_ADAS.GTAngleDetect.Angle_obj7.DetectObj@ */ /end MEASUREMENT
/begin MEASUREMENT rtDW_ADAS.GTAngleDetect.Angle_obj7.NumZone "" UBYTE ADAS_CM_uint8 0 0 0 255 ECU_ADDRESS 0x0000 /* @ECU_Address@rtDW_ADAS.GTAngleDetect.Angle_obj7.NumZone@ */ /end MEASUREMENT
/begin MEASUREMENT rtDW_ADAS.GTAngleDetect.Angle_obj7.VAngle_obj "" FLOAT32_IEEE ADAS_CM_single 0 0 -3.4E+38 3.4E+38 ECU_ADDRESS 0x0000 /* @ECU_Address@rtDW_ADAS.GTAngleDetect.Angle_obj7.VAngle_obj@ */ /end MEASUREMENT
/begin MEASUREMENT rtDW_ADAS.GTAngleDetect.Angle_obj7.alfa_LL_obj "" FLOAT32_IEEE ADAS_CM_single 0 0 -3.4E+38 3.4E+38 ECU_ADDRESS 0x0000 /* @ECU_Address@rtDW_ADAS.GTAngleDetect.Angle_obj7.alfa_LL_obj@ */ /end MEASUREMENT
/begin MEASUREMENT rtDW_ADAS.GTAngleDetect.Angle_obj7.alfa_LR_obj "" FLOAT32_IEEE ADAS_CM_single 0 0 -3.4E+38 3.4E+38 ECU_ADDRESS 0x0000 /* @ECU_Address@rtDW_ADAS.GTAngleDetect.Angle_obj7.alfa_LR_obj@ */ /end MEASUREMENT
/begin MEASUREMENT rtDW_ADAS.GTAngleDetect.Angle_obj7.alfa_RL_obj "" FLOAT32_IEEE ADAS_CM_single 0 0 -3.4E+38 3.4E+38 ECU_ADDRESS 0x0000 /* @ECU_Address@rtDW_ADAS.GTAngleDetect.Angle_obj7.alfa_RL_obj@ */ /end MEASUREMENT
/begin MEASUREMENT rtDW_ADAS.GTAngleDetect.Angle_obj7.alfa_RR_obj "" FLOAT32_IEEE ADAS_CM_single 0 0 -3.4E+38 3.4E+38 ECU_ADDRESS 0x0000 /* @ECU_Address@rtDW_ADAS.GTAngleDetect.Angle_obj7.alfa_RR_obj@ */ /end MEASUREMENT
/begin MEASUREMENT rtDW_ADAS.GTAngleDetect.Angle_obj8.DetectObj "" UBYTE ADAS_CM_uint8 0 0 0 255 ECU_ADDRESS 0x0000 /* @ECU_Address@rtDW_ADAS.GTAngleDetect.Angle_obj8.DetectObj@ */ /end MEASUREMENT
/begin MEASUREMENT rtDW_ADAS.GTAngleDetect.Angle_obj8.NumZone "" UBYTE ADAS_CM_uint8 0 0 0 255 ECU_ADDRESS 0x0000 /* @ECU_Address@rtDW_ADAS.GTAngleDetect.Angle_obj8.NumZone@ */ /end MEASUREMENT
/begin MEASUREMENT rtDW_ADAS.GTAngleDetect.Angle_obj8.VAngle_obj "" FLOAT32_IEEE ADAS_CM_single 0 0 -3.4E+38 3.4E+38 ECU_ADDRESS 0x0000 /* @ECU_Address@rtDW_ADAS.GTAngleDetect.Angle_obj8.VAngle_obj@ */ /end MEASUREMENT
/begin MEASUREMENT rtDW_ADAS.GTAngleDetect.Angle_obj8.alfa_LL_obj "" FLOAT32_IEEE ADAS_CM_single 0 0 -3.4E+38 3.4E+38 ECU_ADDRESS 0x0000 /* @ECU_Address@rtDW_ADAS.GTAngleDetect.Angle_obj8.alfa_LL_obj@ */ /end MEASUREMENT
/begin MEASUREMENT rtDW_ADAS.GTAngleDetect.Angle_obj8.alfa_LR_obj "" FLOAT32_IEEE ADAS_CM_single 0 0 -3.4E+38 3.4E+38 ECU_ADDRESS 0x0000 /* @ECU_Address@rtDW_ADAS.GTAngleDetect.Angle_obj8.alfa_LR_obj@ */ /end MEASUREMENT
/begin MEASUREMENT rtDW_ADAS.GTAngleDetect.Angle_obj8.alfa_RL_obj "" FLOAT32_IEEE ADAS_CM_single 0 0 -3.4E+38 3.4E+38 ECU_ADDRESS 0x0000 /* @ECU_Address@rtDW_ADAS.GTAngleDetect.Angle_obj8.alfa_RL_obj@ */ /end MEASUREMENT
/begin MEASUREMENT rtDW_ADAS.GTAngleDetect.Angle_obj8.alfa_RR_obj "" FLOAT32_IEEE ADAS_CM_single 0 0 -3.4E+38 3.4E+38 ECU_ADDRESS 0x0000 /* @ECU_Address@rtDW_ADAS.GTAngleDetect.Angle_obj8.alfa_RR_obj@ */ /end MEASUREMENT
/begin MEASUREMENT rtDW_ADAS.GTAngleobj1.GTAngleobj1_MODE "" UBYTE ADAS_CM_logical 0 0 0 1 ECU_ADDRESS 0x0000 /* @ECU_Address@rtDW_ADAS.GTAngleobj1.GTAngleobj1_MODE@ */ /end MEASUREMENT
/begin MEASUREMENT rtDW_ADAS.GTAngleobj1.GTDelay1_DSTATE "" FLOAT32_IEEE ADAS_CM_single 0 0 -3.4E+38 3.4E+38 ECU_ADDRESS 0x0000 /* @ECU_Address@rtDW_ADAS.GTAngleobj1.GTDelay1_DSTATE@ */ /end MEASUREMENT
/begin MEASUREMENT rtDW_ADAS.GTAngleobj1.GTDelay2_DSTATE "" FLOAT32_IEEE ADAS_CM_single 0 0 -3.4E+38 3.4E+38 ECU_ADDRESS 0x0000 /* @ECU_Address@rtDW_ADAS.GTAngleobj1.GTDelay2_DSTATE@ */ /end MEASUREMENT
/begin MEASUREMENT rtDW_ADAS.GTAngleobj1.GTDelay3_DSTATE "" FLOAT32_IEEE ADAS_CM_single 0 0 -3.4E+38 3.4E+38 ECU_ADDRESS 0x0000 /* @ECU_Address@rtDW_ADAS.GTAngleobj1.GTDelay3_DSTATE@ */ /end MEASUREMENT
/begin MEASUREMENT rtDW_ADAS.GTAngleobj1.GTDelay6_DSTATE "" FLOAT32_IEEE ADAS_CM_single 0 0 -3.4E+38 3.4E+38 ECU_ADDRESS 0x0000 /* @ECU_Address@rtDW_ADAS.GTAngleobj1.GTDelay6_DSTATE@ */ /end MEASUREMENT
/begin MEASUREMENT rtDW_ADAS.GTAngleobj1.GTDelay8_DSTATE "" FLOAT32_IEEE ADAS_CM_single 0 0 -3.4E+38 3.4E+38 ECU_ADDRESS 0x0000 /* @ECU_Address@rtDW_ADAS.GTAngleobj1.GTDelay8_DSTATE@ */ /end MEASUREMENT
/begin MEASUREMENT rtDW_ADAS.GTAngleobj1.GTDelayInput2_DSTATE "" FLOAT32_IEEE ADAS_CM_single 0 0 -3.4E+38 3.4E+38 ECU_ADDRESS 0x0000 /* @ECU_Address@rtDW_ADAS.GTAngleobj1.GTDelayInput2_DSTATE@ */ /end MEASUREMENT
/begin MEASUREMENT rtDW_ADAS.GTAngleobj1.GTDelayInput2_DSTATE_h "" FLOAT32_IEEE ADAS_CM_single 0 0 -3.4E+38 3.4E+38 ECU_ADDRESS 0x0000 /* @ECU_Address@rtDW_ADAS.GTAngleobj1.GTDelayInput2_DSTATE_h@ */ /end MEASUREMENT
/begin MEASUREMENT rtDW_ADAS.GTAngleobj1.GTDelayInput2_DSTATE_m "" FLOAT32_IEEE ADAS_CM_single 0 0 -3.4E+38 3.4E+38 ECU_ADDRESS 0x0000 /* @ECU_Address@rtDW_ADAS.GTAngleobj1.GTDelayInput2_DSTATE_m@ */ /end MEASUREMENT
/begin MEASUREMENT rtDW_ADAS.GTAngleobj1.GTDelayInput2_DSTATE_p "" FLOAT32_IEEE ADAS_CM_single 0 0 -3.4E+38 3.4E+38 ECU_ADDRESS 0x0000 /* @ECU_Address@rtDW_ADAS.GTAngleobj1.GTDelayInput2_DSTATE_p@ */ /end MEASUREMENT
/begin MEASUREMENT rtDW_ADAS.GTAngleobj1.GTis_active_c349_ADAS "" UBYTE ADAS_CM_uint8 0 0 0 255 ECU_ADDRESS 0x0000 /* @ECU_Address@rtDW_ADAS.GTAngleobj1.GTis_active_c349_ADAS@ */ /end MEASUREMENT
/begin MEASUREMENT rtDW_ADAS.GTAngleobj1.GTis_active_c354_ADAS "" UBYTE ADAS_CM_uint8 0 0 0 255 ECU_ADDRESS 0x0000 /* @ECU_Address@rtDW_ADAS.GTAngleobj1.GTis_active_c354_ADAS@ */ /end MEASUREMENT
/begin MEASUREMENT rtDW_ADAS.GTAngleobj1.GTis_c349_ADAS "" UBYTE ADAS_CM_uint8 0 0 0 255 ECU_ADDRESS 0x0000 /* @ECU_Address@rtDW_ADAS.GTAngleobj1.GTis_c349_ADAS@ */ /end MEASUREMENT
/begin MEASUREMENT rtDW_ADAS.GTAngleobj1.GTis_c354_ADAS "" UBYTE ADAS_CM_uint8 0 0 0 255 ECU_ADDRESS 0x0000 /* @ECU_Address@rtDW_ADAS.GTAngleobj1.GTis_c354_ADAS@ */ /end MEASUREMENT
/begin MEASUREMENT rtDW_ADAS.GTAngleobj1.GTtemporalCounter_i1 "" ULONG ADAS_CM_uint32 0 0 0 4294967295 ECU_ADDRESS 0x0000 /* @ECU_Address@rtDW_ADAS.GTAngleobj1.GTtemporalCounter_i1@ */ /end MEASUREMENT
/begin MEASUREMENT rtDW_ADAS.GTAngleobj10.GTAngleobj1_MODE "" UBYTE ADAS_CM_logical 0 0 0 1 ECU_ADDRESS 0x0000 /* @ECU_Address@rtDW_ADAS.GTAngleobj10.GTAngleobj1_MODE@ */ /end MEASUREMENT
/begin MEASUREMENT rtDW_ADAS.GTAngleobj10.GTDelay1_DSTATE "" FLOAT32_IEEE ADAS_CM_single 0 0 -3.4E+38 3.4E+38 ECU_ADDRESS 0x0000 /* @ECU_Address@rtDW_ADAS.GTAngleobj10.GTDelay1_DSTATE@ */ /end MEASUREMENT
/begin MEASUREMENT rtDW_ADAS.GTAngleobj10.GTDelay2_DSTATE "" FLOAT32_IEEE ADAS_CM_single 0 0 -3.4E+38 3.4E+38 ECU_ADDRESS 0x0000 /* @ECU_Address@rtDW_ADAS.GTAngleobj10.GTDelay2_DSTATE@ */ /end MEASUREMENT
/begin MEASUREMENT rtDW_ADAS.GTAngleobj10.GTDelay3_DSTATE "" FLOAT32_IEEE ADAS_CM_single 0 0 -3.4E+38 3.4E+38 ECU_ADDRESS 0x0000 /* @ECU_Address@rtDW_ADAS.GTAngleobj10.GTDelay3_DSTATE@ */ /end MEASUREMENT
/begin MEASUREMENT rtDW_ADAS.GTAngleobj10.GTDelay6_DSTATE "" FLOAT32_IEEE ADAS_CM_single 0 0 -3.4E+38 3.4E+38 ECU_ADDRESS 0x0000 /* @ECU_Address@rtDW_ADAS.GTAngleobj10.GTDelay6_DSTATE@ */ /end MEASUREMENT
/begin MEASUREMENT rtDW_ADAS.GTAngleobj10.GTDelay8_DSTATE "" FLOAT32_IEEE ADAS_CM_single 0 0 -3.4E+38 3.4E+38 ECU_ADDRESS 0x0000 /* @ECU_Address@rtDW_ADAS.GTAngleobj10.GTDelay8_DSTATE@ */ /end MEASUREMENT
/begin MEASUREMENT rtDW_ADAS.GTAngleobj10.GTDelayInput2_DSTATE "" FLOAT32_IEEE ADAS_CM_single 0 0 -3.4E+38 3.4E+38 ECU_ADDRESS 0x0000 /* @ECU_Address@rtDW_ADAS.GTAngleobj10.GTDelayInput2_DSTATE@ */ /end MEASUREMENT
/begin MEASUREMENT rtDW_ADAS.GTAngleobj10.GTDelayInput2_DSTATE_h "" FLOAT32_IEEE ADAS_CM_single 0 0 -3.4E+38 3.4E+38 ECU_ADDRESS 0x0000 /* @ECU_Address@rtDW_ADAS.GTAngleobj10.GTDelayInput2_DSTATE_h@ */ /end MEASUREMENT
/begin MEASUREMENT rtDW_ADAS.GTAngleobj10.GTDelayInput2_DSTATE_m "" FLOAT32_IEEE ADAS_CM_single 0 0 -3.4E+38 3.4E+38 ECU_ADDRESS 0x0000 /* @ECU_Address@rtDW_ADAS.GTAngleobj10.GTDelayInput2_DSTATE_m@ */ /end MEASUREMENT
/begin MEASUREMENT rtDW_ADAS.GTAngleobj10.GTDelayInput2_DSTATE_p "" FLOAT32_IEEE ADAS_CM_single 0 0 -3.4E+38 3.4E+38 ECU_ADDRESS 0x0000 /* @ECU_Address@rtDW_ADAS.GTAngleobj10.GTDelayInput2_DSTATE_p@ */ /end MEASUREMENT
/begin MEASUREMENT rtDW_ADAS.GTAngleobj10.GTis_active_c349_ADAS "" UBYTE ADAS_CM_uint8 0 0 0 255 ECU_ADDRESS 0x0000 /* @ECU_Address@rtDW_ADAS.GTAngleobj10.GTis_active_c349_ADAS@ */ /end MEASUREMENT
/begin MEASUREMENT rtDW_ADAS.GTAngleobj10.GTis_active_c354_ADAS "" UBYTE ADAS_CM_uint8 0 0 0 255 ECU_ADDRESS 0x0000 /* @ECU_Address@rtDW_ADAS.GTAngleobj10.GTis_active_c354_ADAS@ */ /end MEASUREMENT
/begin MEASUREMENT rtDW_ADAS.GTAngleobj10.GTis_c349_ADAS "" UBYTE ADAS_CM_uint8 0 0 0 255 ECU_ADDRESS 0x0000 /* @ECU_Address@rtDW_ADAS.GTAngleobj10.GTis_c349_ADAS@ */ /end MEASUREMENT
/begin MEASUREMENT rtDW_ADAS.GTAngleobj10.GTis_c354_ADAS "" UBYTE ADAS_CM_uint8 0 0 0 255 ECU_ADDRESS 0x0000 /* @ECU_Address@rtDW_ADAS.GTAngleobj10.GTis_c354_ADAS@ */ /end MEASUREMENT
/begin MEASUREMENT rtDW_ADAS.GTAngleobj10.GTtemporalCounter_i1 "" ULONG ADAS_CM_uint32 0 0 0 4294967295 ECU_ADDRESS 0x0000 /* @ECU_Address@rtDW_ADAS.GTAngleobj10.GTtemporalCounter_i1@ */ /end MEASUREMENT
/begin MEASUREMENT rtDW_ADAS.GTAngleobj11.GTAngleobj1_MODE "" UBYTE ADAS_CM_logical 0 0 0 1 ECU_ADDRESS 0x0000 /* @ECU_Address@rtDW_ADAS.GTAngleobj11.GTAngleobj1_MODE@ */ /end MEASUREMENT
/begin MEASUREMENT rtDW_ADAS.GTAngleobj11.GTDelay1_DSTATE "" FLOAT32_IEEE ADAS_CM_single 0 0 -3.4E+38 3.4E+38 ECU_ADDRESS 0x0000 /* @ECU_Address@rtDW_ADAS.GTAngleobj11.GTDelay1_DSTATE@ */ /end MEASUREMENT
/begin MEASUREMENT rtDW_ADAS.GTAngleobj11.GTDelay2_DSTATE "" FLOAT32_IEEE ADAS_CM_single 0 0 -3.4E+38 3.4E+38 ECU_ADDRESS 0x0000 /* @ECU_Address@rtDW_ADAS.GTAngleobj11.GTDelay2_DSTATE@ */ /end MEASUREMENT
/begin MEASUREMENT rtDW_ADAS.GTAngleobj11.GTDelay3_DSTATE "" FLOAT32_IEEE ADAS_CM_single 0 0 -3.4E+38 3.4E+38 ECU_ADDRESS 0x0000 /* @ECU_Address@rtDW_ADAS.GTAngleobj11.GTDelay3_DSTATE@ */ /end MEASUREMENT
/begin MEASUREMENT rtDW_ADAS.GTAngleobj11.GTDelay6_DSTATE "" FLOAT32_IEEE ADAS_CM_single 0 0 -3.4E+38 3.4E+38 ECU_ADDRESS 0x0000 /* @ECU_Address@rtDW_ADAS.GTAngleobj11.GTDelay6_DSTATE@ */ /end MEASUREMENT
/begin MEASUREMENT rtDW_ADAS.GTAngleobj11.GTDelay8_DSTATE "" FLOAT32_IEEE ADAS_CM_single 0 0 -3.4E+38 3.4E+38 ECU_ADDRESS 0x0000 /* @ECU_Address@rtDW_ADAS.GTAngleobj11.GTDelay8_DSTATE@ */ /end MEASUREMENT
/begin MEASUREMENT rtDW_ADAS.GTAngleobj11.GTDelayInput2_DSTATE "" FLOAT32_IEEE ADAS_CM_single 0 0 -3.4E+38 3.4E+38 ECU_ADDRESS 0x0000 /* @ECU_Address@rtDW_ADAS.GTAngleobj11.GTDelayInput2_DSTATE@ */ /end MEASUREMENT
/begin MEASUREMENT rtDW_ADAS.GTAngleobj11.GTDelayInput2_DSTATE_h "" FLOAT32_IEEE ADAS_CM_single 0 0 -3.4E+38 3.4E+38 ECU_ADDRESS 0x0000 /* @ECU_Address@rtDW_ADAS.GTAngleobj11.GTDelayInput2_DSTATE_h@ */ /end MEASUREMENT
/begin MEASUREMENT rtDW_ADAS.GTAngleobj11.GTDelayInput2_DSTATE_m "" FLOAT32_IEEE ADAS_CM_single 0 0 -3.4E+38 3.4E+38 ECU_ADDRESS 0x0000 /* @ECU_Address@rtDW_ADAS.GTAngleobj11.GTDelayInput2_DSTATE_m@ */ /end MEASUREMENT
/begin MEASUREMENT rtDW_ADAS.GTAngleobj11.GTDelayInput2_DSTATE_p "" FLOAT32_IEEE ADAS_CM_single 0 0 -3.4E+38 3.4E+38 ECU_ADDRESS 0x0000 /* @ECU_Address@rtDW_ADAS.GTAngleobj11.GTDelayInput2_DSTATE_p@ */ /end MEASUREMENT
/begin MEASUREMENT rtDW_ADAS.GTAngleobj11.GTis_active_c349_ADAS "" UBYTE ADAS_CM_uint8 0 0 0 255 ECU_ADDRESS 0x0000 /* @ECU_Address@rtDW_ADAS.GTAngleobj11.GTis_active_c349_ADAS@ */ /end MEASUREMENT
/begin MEASUREMENT rtDW_ADAS.GTAngleobj11.GTis_active_c354_ADAS "" UBYTE ADAS_CM_uint8 0 0 0 255 ECU_ADDRESS 0x0000 /* @ECU_Address@rtDW_ADAS.GTAngleobj11.GTis_active_c354_ADAS@ */ /end MEASUREMENT
/begin MEASUREMENT rtDW_ADAS.GTAngleobj11.GTis_c349_ADAS "" UBYTE ADAS_CM_uint8 0 0 0 255 ECU_ADDRESS 0x0000 /* @ECU_Address@rtDW_ADAS.GTAngleobj11.GTis_c349_ADAS@ */ /end MEASUREMENT
/begin MEASUREMENT rtDW_ADAS.GTAngleobj11.GTis_c354_ADAS "" UBYTE ADAS_CM_uint8 0 0 0 255 ECU_ADDRESS 0x0000 /* @ECU_Address@rtDW_ADAS.GTAngleobj11.GTis_c354_ADAS@ */ /end MEASUREMENT
/begin MEASUREMENT rtDW_ADAS.GTAngleobj11.GTtemporalCounter_i1 "" ULONG ADAS_CM_uint32 0 0 0 4294967295 ECU_ADDRESS 0x0000 /* @ECU_Address@rtDW_ADAS.GTAngleobj11.GTtemporalCounter_i1@ */ /end MEASUREMENT
/begin MEASUREMENT rtDW_ADAS.GTAngleobj12.GTAngleobj1_MODE "" UBYTE ADAS_CM_logical 0 0 0 1 ECU_ADDRESS 0x0000 /* @ECU_Address@rtDW_ADAS.GTAngleobj12.GTAngleobj1_MODE@ */ /end MEASUREMENT
/begin MEASUREMENT rtDW_ADAS.GTAngleobj12.GTDelay1_DSTATE "" FLOAT32_IEEE ADAS_CM_single 0 0 -3.4E+38 3.4E+38 ECU_ADDRESS 0x0000 /* @ECU_Address@rtDW_ADAS.GTAngleobj12.GTDelay1_DSTATE@ */ /end MEASUREMENT
/begin MEASUREMENT rtDW_ADAS.GTAngleobj12.GTDelay2_DSTATE "" FLOAT32_IEEE ADAS_CM_single 0 0 -3.4E+38 3.4E+38 ECU_ADDRESS 0x0000 /* @ECU_Address@rtDW_ADAS.GTAngleobj12.GTDelay2_DSTATE@ */ /end MEASUREMENT
/begin MEASUREMENT rtDW_ADAS.GTAngleobj12.GTDelay3_DSTATE "" FLOAT32_IEEE ADAS_CM_single 0 0 -3.4E+38 3.4E+38 ECU_ADDRESS 0x0000 /* @ECU_Address@rtDW_ADAS.GTAngleobj12.GTDelay3_DSTATE@ */ /end MEASUREMENT
/begin MEASUREMENT rtDW_ADAS.GTAngleobj12.GTDelay6_DSTATE "" FLOAT32_IEEE ADAS_CM_single 0 0 -3.4E+38 3.4E+38 ECU_ADDRESS 0x0000 /* @ECU_Address@rtDW_ADAS.GTAngleobj12.GTDelay6_DSTATE@ */ /end MEASUREMENT
/begin MEASUREMENT rtDW_ADAS.GTAngleobj12.GTDelay8_DSTATE "" FLOAT32_IEEE ADAS_CM_single 0 0 -3.4E+38 3.4E+38 ECU_ADDRESS 0x0000 /* @ECU_Address@rtDW_ADAS.GTAngleobj12.GTDelay8_DSTATE@ */ /end MEASUREMENT
/begin MEASUREMENT rtDW_ADAS.GTAngleobj12.GTDelayInput2_DSTATE "" FLOAT32_IEEE ADAS_CM_single 0 0 -3.4E+38 3.4E+38 ECU_ADDRESS 0x0000 /* @ECU_Address@rtDW_ADAS.GTAngleobj12.GTDelayInput2_DSTATE@ */ /end MEASUREMENT
/begin MEASUREMENT rtDW_ADAS.GTAngleobj12.GTDelayInput2_DSTATE_h "" FLOAT32_IEEE ADAS_CM_single 0 0 -3.4E+38 3.4E+38 ECU_ADDRESS 0x0000 /* @ECU_Address@rtDW_ADAS.GTAngleobj12.GTDelayInput2_DSTATE_h@ */ /end MEASUREMENT
/begin MEASUREMENT rtDW_ADAS.GTAngleobj12.GTDelayInput2_DSTATE_m "" FLOAT32_IEEE ADAS_CM_single 0 0 -3.4E+38 3.4E+38 ECU_ADDRESS 0x0000 /* @ECU_Address@rtDW_ADAS.GTAngleobj12.GTDelayInput2_DSTATE_m@ */ /end MEASUREMENT
/begin MEASUREMENT rtDW_ADAS.GTAngleobj12.GTDelayInput2_DSTATE_p "" FLOAT32_IEEE ADAS_CM_single 0 0 -3.4E+38 3.4E+38 ECU_ADDRESS 0x0000 /* @ECU_Address@rtDW_ADAS.GTAngleobj12.GTDelayInput2_DSTATE_p@ */ /end MEASUREMENT
/begin MEASUREMENT rtDW_ADAS.GTAngleobj12.GTis_active_c349_ADAS "" UBYTE ADAS_CM_uint8 0 0 0 255 ECU_ADDRESS 0x0000 /* @ECU_Address@rtDW_ADAS.GTAngleobj12.GTis_active_c349_ADAS@ */ /end MEASUREMENT
/begin MEASUREMENT rtDW_ADAS.GTAngleobj12.GTis_active_c354_ADAS "" UBYTE ADAS_CM_uint8 0 0 0 255 ECU_ADDRESS 0x0000 /* @ECU_Address@rtDW_ADAS.GTAngleobj12.GTis_active_c354_ADAS@ */ /end MEASUREMENT
/begin MEASUREMENT rtDW_ADAS.GTAngleobj12.GTis_c349_ADAS "" UBYTE ADAS_CM_uint8 0 0 0 255 ECU_ADDRESS 0x0000 /* @ECU_Address@rtDW_ADAS.GTAngleobj12.GTis_c349_ADAS@ */ /end MEASUREMENT
/begin MEASUREMENT rtDW_ADAS.GTAngleobj12.GTis_c354_ADAS "" UBYTE ADAS_CM_uint8 0 0 0 255 ECU_ADDRESS 0x0000 /* @ECU_Address@rtDW_ADAS.GTAngleobj12.GTis_c354_ADAS@ */ /end MEASUREMENT
/begin MEASUREMENT rtDW_ADAS.GTAngleobj12.GTtemporalCounter_i1 "" ULONG ADAS_CM_uint32 0 0 0 4294967295 ECU_ADDRESS 0x0000 /* @ECU_Address@rtDW_ADAS.GTAngleobj12.GTtemporalCounter_i1@ */ /end MEASUREMENT
/begin MEASUREMENT rtDW_ADAS.GTAngleobj13.GTAngleobj1_MODE "" UBYTE ADAS_CM_logical 0 0 0 1 ECU_ADDRESS 0x0000 /* @ECU_Address@rtDW_ADAS.GTAngleobj13.GTAngleobj1_MODE@ */ /end MEASUREMENT
/begin MEASUREMENT rtDW_ADAS.GTAngleobj13.GTDelay1_DSTATE "" FLOAT32_IEEE ADAS_CM_single 0 0 -3.4E+38 3.4E+38 ECU_ADDRESS 0x0000 /* @ECU_Address@rtDW_ADAS.GTAngleobj13.GTDelay1_DSTATE@ */ /end MEASUREMENT
/begin MEASUREMENT rtDW_ADAS.GTAngleobj13.GTDelay2_DSTATE "" FLOAT32_IEEE ADAS_CM_single 0 0 -3.4E+38 3.4E+38 ECU_ADDRESS 0x0000 /* @ECU_Address@rtDW_ADAS.GTAngleobj13.GTDelay2_DSTATE@ */ /end MEASUREMENT
/begin MEASUREMENT rtDW_ADAS.GTAngleobj13.GTDelay3_DSTATE "" FLOAT32_IEEE ADAS_CM_single 0 0 -3.4E+38 3.4E+38 ECU_ADDRESS 0x0000 /* @ECU_Address@rtDW_ADAS.GTAngleobj13.GTDelay3_DSTATE@ */ /end MEASUREMENT
/begin MEASUREMENT rtDW_ADAS.GTAngleobj13.GTDelay6_DSTATE "" FLOAT32_IEEE ADAS_CM_single 0 0 -3.4E+38 3.4E+38 ECU_ADDRESS 0x0000 /* @ECU_Address@rtDW_ADAS.GTAngleobj13.GTDelay6_DSTATE@ */ /end MEASUREMENT
/begin MEASUREMENT rtDW_ADAS.GTAngleobj13.GTDelay8_DSTATE "" FLOAT32_IEEE ADAS_CM_single 0 0 -3.4E+38 3.4E+38 ECU_ADDRESS 0x0000 /* @ECU_Address@rtDW_ADAS.GTAngleobj13.GTDelay8_DSTATE@ */ /end MEASUREMENT
/begin MEASUREMENT rtDW_ADAS.GTAngleobj13.GTDelayInput2_DSTATE "" FLOAT32_IEEE ADAS_CM_single 0 0 -3.4E+38 3.4E+38 ECU_ADDRESS 0x0000 /* @ECU_Address@rtDW_ADAS.GTAngleobj13.GTDelayInput2_DSTATE@ */ /end MEASUREMENT
/begin MEASUREMENT rtDW_ADAS.GTAngleobj13.GTDelayInput2_DSTATE_h "" FLOAT32_IEEE ADAS_CM_single 0 0 -3.4E+38 3.4E+38 ECU_ADDRESS 0x0000 /* @ECU_Address@rtDW_ADAS.GTAngleobj13.GTDelayInput2_DSTATE_h@ */ /end MEASUREMENT
/begin MEASUREMENT rtDW_ADAS.GTAngleobj13.GTDelayInput2_DSTATE_m "" FLOAT32_IEEE ADAS_CM_single 0 0 -3.4E+38 3.4E+38 ECU_ADDRESS 0x0000 /* @ECU_Address@rtDW_ADAS.GTAngleobj13.GTDelayInput2_DSTATE_m@ */ /end MEASUREMENT
/begin MEASUREMENT rtDW_ADAS.GTAngleobj13.GTDelayInput2_DSTATE_p "" FLOAT32_IEEE ADAS_CM_single 0 0 -3.4E+38 3.4E+38 ECU_ADDRESS 0x0000 /* @ECU_Address@rtDW_ADAS.GTAngleobj13.GTDelayInput2_DSTATE_p@ */ /end MEASUREMENT
/begin MEASUREMENT rtDW_ADAS.GTAngleobj13.GTis_active_c349_ADAS "" UBYTE ADAS_CM_uint8 0 0 0 255 ECU_ADDRESS 0x0000 /* @ECU_Address@rtDW_ADAS.GTAngleobj13.GTis_active_c349_ADAS@ */ /end MEASUREMENT
/begin MEASUREMENT rtDW_ADAS.GTAngleobj13.GTis_active_c354_ADAS "" UBYTE ADAS_CM_uint8 0 0 0 255 ECU_ADDRESS 0x0000 /* @ECU_Address@rtDW_ADAS.GTAngleobj13.GTis_active_c354_ADAS@ */ /end MEASUREMENT
/begin MEASUREMENT rtDW_ADAS.GTAngleobj13.GTis_c349_ADAS "" UBYTE ADAS_CM_uint8 0 0 0 255 ECU_ADDRESS 0x0000 /* @ECU_Address@rtDW_ADAS.GTAngleobj13.GTis_c349_ADAS@ */ /end MEASUREMENT
/begin MEASUREMENT rtDW_ADAS.GTAngleobj13.GTis_c354_ADAS "" UBYTE ADAS_CM_uint8 0 0 0 255 ECU_ADDRESS 0x0000 /* @ECU_Address@rtDW_ADAS.GTAngleobj13.GTis_c354_ADAS@ */ /end MEASUREMENT
/begin MEASUREMENT rtDW_ADAS.GTAngleobj13.GTtemporalCounter_i1 "" ULONG ADAS_CM_uint32 0 0 0 4294967295 ECU_ADDRESS 0x0000 /* @ECU_Address@rtDW_ADAS.GTAngleobj13.GTtemporalCounter_i1@ */ /end MEASUREMENT
/begin MEASUREMENT rtDW_ADAS.GTAngleobj14.GTAngleobj1_MODE "" UBYTE ADAS_CM_logical 0 0 0 1 ECU_ADDRESS 0x0000 /* @ECU_Address@rtDW_ADAS.GTAngleobj14.GTAngleobj1_MODE@ */ /end MEASUREMENT
/begin MEASUREMENT rtDW_ADAS.GTAngleobj14.GTDelay1_DSTATE "" FLOAT32_IEEE ADAS_CM_single 0 0 -3.4E+38 3.4E+38 ECU_ADDRESS 0x0000 /* @ECU_Address@rtDW_ADAS.GTAngleobj14.GTDelay1_DSTATE@ */ /end MEASUREMENT
/begin MEASUREMENT rtDW_ADAS.GTAngleobj14.GTDelay2_DSTATE "" FLOAT32_IEEE ADAS_CM_single 0 0 -3.4E+38 3.4E+38 ECU_ADDRESS 0x0000 /* @ECU_Address@rtDW_ADAS.GTAngleobj14.GTDelay2_DSTATE@ */ /end MEASUREMENT
/begin MEASUREMENT rtDW_ADAS.GTAngleobj14.GTDelay3_DSTATE "" FLOAT32_IEEE ADAS_CM_single 0 0 -3.4E+38 3.4E+38 ECU_ADDRESS 0x0000 /* @ECU_Address@rtDW_ADAS.GTAngleobj14.GTDelay3_DSTATE@ */ /end MEASUREMENT
/begin MEASUREMENT rtDW_ADAS.GTAngleobj14.GTDelay6_DSTATE "" FLOAT32_IEEE ADAS_CM_single 0 0 -3.4E+38 3.4E+38 ECU_ADDRESS 0x0000 /* @ECU_Address@rtDW_ADAS.GTAngleobj14.GTDelay6_DSTATE@ */ /end MEASUREMENT
/begin MEASUREMENT rtDW_ADAS.GTAngleobj14.GTDelay8_DSTATE "" FLOAT32_IEEE ADAS_CM_single 0 0 -3.4E+38 3.4E+38 ECU_ADDRESS 0x0000 /* @ECU_Address@rtDW_ADAS.GTAngleobj14.GTDelay8_DSTATE@ */ /end MEASUREMENT
/begin MEASUREMENT rtDW_ADAS.GTAngleobj14.GTDelayInput2_DSTATE "" FLOAT32_IEEE ADAS_CM_single 0 0 -3.4E+38 3.4E+38 ECU_ADDRESS 0x0000 /* @ECU_Address@rtDW_ADAS.GTAngleobj14.GTDelayInput2_DSTATE@ */ /end MEASUREMENT
/begin MEASUREMENT rtDW_ADAS.GTAngleobj14.GTDelayInput2_DSTATE_h "" FLOAT32_IEEE ADAS_CM_single 0 0 -3.4E+38 3.4E+38 ECU_ADDRESS 0x0000 /* @ECU_Address@rtDW_ADAS.GTAngleobj14.GTDelayInput2_DSTATE_h@ */ /end MEASUREMENT
/begin MEASUREMENT rtDW_ADAS.GTAngleobj14.GTDelayInput2_DSTATE_m "" FLOAT32_IEEE ADAS_CM_single 0 0 -3.4E+38 3.4E+38 ECU_ADDRESS 0x0000 /* @ECU_Address@rtDW_ADAS.GTAngleobj14.GTDelayInput2_DSTATE_m@ */ /end MEASUREMENT
/begin MEASUREMENT rtDW_ADAS.GTAngleobj14.GTDelayInput2_DSTATE_p "" FLOAT32_IEEE ADAS_CM_single 0 0 -3.4E+38 3.4E+38 ECU_ADDRESS 0x0000 /* @ECU_Address@rtDW_ADAS.GTAngleobj14.GTDelayInput2_DSTATE_p@ */ /end MEASUREMENT
/begin MEASUREMENT rtDW_ADAS.GTAngleobj14.GTis_active_c349_ADAS "" UBYTE ADAS_CM_uint8 0 0 0 255 ECU_ADDRESS 0x0000 /* @ECU_Address@rtDW_ADAS.GTAngleobj14.GTis_active_c349_ADAS@ */ /end MEASUREMENT
/begin MEASUREMENT rtDW_ADAS.GTAngleobj14.GTis_active_c354_ADAS "" UBYTE ADAS_CM_uint8 0 0 0 255 ECU_ADDRESS 0x0000 /* @ECU_Address@rtDW_ADAS.GTAngleobj14.GTis_active_c354_ADAS@ */ /end MEASUREMENT
/begin MEASUREMENT rtDW_ADAS.GTAngleobj14.GTis_c349_ADAS "" UBYTE ADAS_CM_uint8 0 0 0 255 ECU_ADDRESS 0x0000 /* @ECU_Address@rtDW_ADAS.GTAngleobj14.GTis_c349_ADAS@ */ /end MEASUREMENT
/begin MEASUREMENT rtDW_ADAS.GTAngleobj14.GTis_c354_ADAS "" UBYTE ADAS_CM_uint8 0 0 0 255 ECU_ADDRESS 0x0000 /* @ECU_Address@rtDW_ADAS.GTAngleobj14.GTis_c354_ADAS@ */ /end MEASUREMENT
/begin MEASUREMENT rtDW_ADAS.GTAngleobj14.GTtemporalCounter_i1 "" ULONG ADAS_CM_uint32 0 0 0 4294967295 ECU_ADDRESS 0x0000 /* @ECU_Address@rtDW_ADAS.GTAngleobj14.GTtemporalCounter_i1@ */ /end MEASUREMENT
/begin MEASUREMENT rtDW_ADAS.GTAngleobj15.GTAngleobj1_MODE "" UBYTE ADAS_CM_logical 0 0 0 1 ECU_ADDRESS 0x0000 /* @ECU_Address@rtDW_ADAS.GTAngleobj15.GTAngleobj1_MODE@ */ /end MEASUREMENT
/begin MEASUREMENT rtDW_ADAS.GTAngleobj15.GTDelay1_DSTATE "" FLOAT32_IEEE ADAS_CM_single 0 0 -3.4E+38 3.4E+38 ECU_ADDRESS 0x0000 /* @ECU_Address@rtDW_ADAS.GTAngleobj15.GTDelay1_DSTATE@ */ /end MEASUREMENT
/begin MEASUREMENT rtDW_ADAS.GTAngleobj15.GTDelay2_DSTATE "" FLOAT32_IEEE ADAS_CM_single 0 0 -3.4E+38 3.4E+38 ECU_ADDRESS 0x0000 /* @ECU_Address@rtDW_ADAS.GTAngleobj15.GTDelay2_DSTATE@ */ /end MEASUREMENT
/begin MEASUREMENT rtDW_ADAS.GTAngleobj15.GTDelay3_DSTATE "" FLOAT32_IEEE ADAS_CM_single 0 0 -3.4E+38 3.4E+38 ECU_ADDRESS 0x0000 /* @ECU_Address@rtDW_ADAS.GTAngleobj15.GTDelay3_DSTATE@ */ /end MEASUREMENT
/begin MEASUREMENT rtDW_ADAS.GTAngleobj15.GTDelay6_DSTATE "" FLOAT32_IEEE ADAS_CM_single 0 0 -3.4E+38 3.4E+38 ECU_ADDRESS 0x0000 /* @ECU_Address@rtDW_ADAS.GTAngleobj15.GTDelay6_DSTATE@ */ /end MEASUREMENT
/begin MEASUREMENT rtDW_ADAS.GTAngleobj15.GTDelay8_DSTATE "" FLOAT32_IEEE ADAS_CM_single 0 0 -3.4E+38 3.4E+38 ECU_ADDRESS 0x0000 /* @ECU_Address@rtDW_ADAS.GTAngleobj15.GTDelay8_DSTATE@ */ /end MEASUREMENT
/begin MEASUREMENT rtDW_ADAS.GTAngleobj15.GTDelayInput2_DSTATE "" FLOAT32_IEEE ADAS_CM_single 0 0 -3.4E+38 3.4E+38 ECU_ADDRESS 0x0000 /* @ECU_Address@rtDW_ADAS.GTAngleobj15.GTDelayInput2_DSTATE@ */ /end MEASUREMENT
/begin MEASUREMENT rtDW_ADAS.GTAngleobj15.GTDelayInput2_DSTATE_h "" FLOAT32_IEEE ADAS_CM_single 0 0 -3.4E+38 3.4E+38 ECU_ADDRESS 0x0000 /* @ECU_Address@rtDW_ADAS.GTAngleobj15.GTDelayInput2_DSTATE_h@ */ /end MEASUREMENT
/begin MEASUREMENT rtDW_ADAS.GTAngleobj15.GTDelayInput2_DSTATE_m "" FLOAT32_IEEE ADAS_CM_single 0 0 -3.4E+38 3.4E+38 ECU_ADDRESS 0x0000 /* @ECU_Address@rtDW_ADAS.GTAngleobj15.GTDelayInput2_DSTATE_m@ */ /end MEASUREMENT
/begin MEASUREMENT rtDW_ADAS.GTAngleobj15.GTDelayInput2_DSTATE_p "" FLOAT32_IEEE ADAS_CM_single 0 0 -3.4E+38 3.4E+38 ECU_ADDRESS 0x0000 /* @ECU_Address@rtDW_ADAS.GTAngleobj15.GTDelayInput2_DSTATE_p@ */ /end MEASUREMENT
/begin MEASUREMENT rtDW_ADAS.GTAngleobj15.GTis_active_c349_ADAS "" UBYTE ADAS_CM_uint8 0 0 0 255 ECU_ADDRESS 0x0000 /* @ECU_Address@rtDW_ADAS.GTAngleobj15.GTis_active_c349_ADAS@ */ /end MEASUREMENT
/begin MEASUREMENT rtDW_ADAS.GTAngleobj15.GTis_active_c354_ADAS "" UBYTE ADAS_CM_uint8 0 0 0 255 ECU_ADDRESS 0x0000 /* @ECU_Address@rtDW_ADAS.GTAngleobj15.GTis_active_c354_ADAS@ */ /end MEASUREMENT
/begin MEASUREMENT rtDW_ADAS.GTAngleobj15.GTis_c349_ADAS "" UBYTE ADAS_CM_uint8 0 0 0 255 ECU_ADDRESS 0x0000 /* @ECU_Address@rtDW_ADAS.GTAngleobj15.GTis_c349_ADAS@ */ /end MEASUREMENT
/begin MEASUREMENT rtDW_ADAS.GTAngleobj15.GTis_c354_ADAS "" UBYTE ADAS_CM_uint8 0 0 0 255 ECU_ADDRESS 0x0000 /* @ECU_Address@rtDW_ADAS.GTAngleobj15.GTis_c354_ADAS@ */ /end MEASUREMENT
/begin MEASUREMENT rtDW_ADAS.GTAngleobj15.GTtemporalCounter_i1 "" ULONG ADAS_CM_uint32 0 0 0 4294967295 ECU_ADDRESS 0x0000 /* @ECU_Address@rtDW_ADAS.GTAngleobj15.GTtemporalCounter_i1@ */ /end MEASUREMENT
/begin MEASUREMENT rtDW_ADAS.GTAngleobj16.GTAngleobj1_MODE "" UBYTE ADAS_CM_logical 0 0 0 1 ECU_ADDRESS 0x0000 /* @ECU_Address@rtDW_ADAS.GTAngleobj16.GTAngleobj1_MODE@ */ /end MEASUREMENT
/begin MEASUREMENT rtDW_ADAS.GTAngleobj16.GTDelay1_DSTATE "" FLOAT32_IEEE ADAS_CM_single 0 0 -3.4E+38 3.4E+38 ECU_ADDRESS 0x0000 /* @ECU_Address@rtDW_ADAS.GTAngleobj16.GTDelay1_DSTATE@ */ /end MEASUREMENT
/begin MEASUREMENT rtDW_ADAS.GTAngleobj16.GTDelay2_DSTATE "" FLOAT32_IEEE ADAS_CM_single 0 0 -3.4E+38 3.4E+38 ECU_ADDRESS 0x0000 /* @ECU_Address@rtDW_ADAS.GTAngleobj16.GTDelay2_DSTATE@ */ /end MEASUREMENT
/begin MEASUREMENT rtDW_ADAS.GTAngleobj16.GTDelay3_DSTATE "" FLOAT32_IEEE ADAS_CM_single 0 0 -3.4E+38 3.4E+38 ECU_ADDRESS 0x0000 /* @ECU_Address@rtDW_ADAS.GTAngleobj16.GTDelay3_DSTATE@ */ /end MEASUREMENT
/begin MEASUREMENT rtDW_ADAS.GTAngleobj16.GTDelay6_DSTATE "" FLOAT32_IEEE ADAS_CM_single 0 0 -3.4E+38 3.4E+38 ECU_ADDRESS 0x0000 /* @ECU_Address@rtDW_ADAS.GTAngleobj16.GTDelay6_DSTATE@ */ /end MEASUREMENT
/begin MEASUREMENT rtDW_ADAS.GTAngleobj16.GTDelay8_DSTATE "" FLOAT32_IEEE ADAS_CM_single 0 0 -3.4E+38 3.4E+38 ECU_ADDRESS 0x0000 /* @ECU_Address@rtDW_ADAS.GTAngleobj16.GTDelay8_DSTATE@ */ /end MEASUREMENT
/begin MEASUREMENT rtDW_ADAS.GTAngleobj16.GTDelayInput2_DSTATE "" FLOAT32_IEEE ADAS_CM_single 0 0 -3.4E+38 3.4E+38 ECU_ADDRESS 0x0000 /* @ECU_Address@rtDW_ADAS.GTAngleobj16.GTDelayInput2_DSTATE@ */ /end MEASUREMENT
/begin MEASUREMENT rtDW_ADAS.GTAngleobj16.GTDelayInput2_DSTATE_h "" FLOAT32_IEEE ADAS_CM_single 0 0 -3.4E+38 3.4E+38 ECU_ADDRESS 0x0000 /* @ECU_Address@rtDW_ADAS.GTAngleobj16.GTDelayInput2_DSTATE_h@ */ /end MEASUREMENT
/begin MEASUREMENT rtDW_ADAS.GTAngleobj16.GTDelayInput2_DSTATE_m "" FLOAT32_IEEE ADAS_CM_single 0 0 -3.4E+38 3.4E+38 ECU_ADDRESS 0x0000 /* @ECU_Address@rtDW_ADAS.GTAngleobj16.GTDelayInput2_DSTATE_m@ */ /end MEASUREMENT
/begin MEASUREMENT rtDW_ADAS.GTAngleobj16.GTDelayInput2_DSTATE_p "" FLOAT32_IEEE ADAS_CM_single 0 0 -3.4E+38 3.4E+38 ECU_ADDRESS 0x0000 /* @ECU_Address@rtDW_ADAS.GTAngleobj16.GTDelayInput2_DSTATE_p@ */ /end MEASUREMENT
/begin MEASUREMENT rtDW_ADAS.GTAngleobj16.GTis_active_c349_ADAS "" UBYTE ADAS_CM_uint8 0 0 0 255 ECU_ADDRESS 0x0000 /* @ECU_Address@rtDW_ADAS.GTAngleobj16.GTis_active_c349_ADAS@ */ /end MEASUREMENT
/begin MEASUREMENT rtDW_ADAS.GTAngleobj16.GTis_active_c354_ADAS "" UBYTE ADAS_CM_uint8 0 0 0 255 ECU_ADDRESS 0x0000 /* @ECU_Address@rtDW_ADAS.GTAngleobj16.GTis_active_c354_ADAS@ */ /end MEASUREMENT
/begin MEASUREMENT rtDW_ADAS.GTAngleobj16.GTis_c349_ADAS "" UBYTE ADAS_CM_uint8 0 0 0 255 ECU_ADDRESS 0x0000 /* @ECU_Address@rtDW_ADAS.GTAngleobj16.GTis_c349_ADAS@ */ /end MEASUREMENT
/begin MEASUREMENT rtDW_ADAS.GTAngleobj16.GTis_c354_ADAS "" UBYTE ADAS_CM_uint8 0 0 0 255 ECU_ADDRESS 0x0000 /* @ECU_Address@rtDW_ADAS.GTAngleobj16.GTis_c354_ADAS@ */ /end MEASUREMENT
/begin MEASUREMENT rtDW_ADAS.GTAngleobj16.GTtemporalCounter_i1 "" ULONG ADAS_CM_uint32 0 0 0 4294967295 ECU_ADDRESS 0x0000 /* @ECU_Address@rtDW_ADAS.GTAngleobj16.GTtemporalCounter_i1@ */ /end MEASUREMENT
/begin MEASUREMENT rtDW_ADAS.GTAngleobj17.GTAngleobj1_MODE "" UBYTE ADAS_CM_logical 0 0 0 1 ECU_ADDRESS 0x0000 /* @ECU_Address@rtDW_ADAS.GTAngleobj17.GTAngleobj1_MODE@ */ /end MEASUREMENT
/begin MEASUREMENT rtDW_ADAS.GTAngleobj17.GTDelay1_DSTATE "" FLOAT32_IEEE ADAS_CM_single 0 0 -3.4E+38 3.4E+38 ECU_ADDRESS 0x0000 /* @ECU_Address@rtDW_ADAS.GTAngleobj17.GTDelay1_DSTATE@ */ /end MEASUREMENT
/begin MEASUREMENT rtDW_ADAS.GTAngleobj17.GTDelay2_DSTATE "" FLOAT32_IEEE ADAS_CM_single 0 0 -3.4E+38 3.4E+38 ECU_ADDRESS 0x0000 /* @ECU_Address@rtDW_ADAS.GTAngleobj17.GTDelay2_DSTATE@ */ /end MEASUREMENT
/begin MEASUREMENT rtDW_ADAS.GTAngleobj17.GTDelay3_DSTATE "" FLOAT32_IEEE ADAS_CM_single 0 0 -3.4E+38 3.4E+38 ECU_ADDRESS 0x0000 /* @ECU_Address@rtDW_ADAS.GTAngleobj17.GTDelay3_DSTATE@ */ /end MEASUREMENT
/begin MEASUREMENT rtDW_ADAS.GTAngleobj17.GTDelay6_DSTATE "" FLOAT32_IEEE ADAS_CM_single 0 0 -3.4E+38 3.4E+38 ECU_ADDRESS 0x0000 /* @ECU_Address@rtDW_ADAS.GTAngleobj17.GTDelay6_DSTATE@ */ /end MEASUREMENT
/begin MEASUREMENT rtDW_ADAS.GTAngleobj17.GTDelay8_DSTATE "" FLOAT32_IEEE ADAS_CM_single 0 0 -3.4E+38 3.4E+38 ECU_ADDRESS 0x0000 /* @ECU_Address@rtDW_ADAS.GTAngleobj17.GTDelay8_DSTATE@ */ /end MEASUREMENT
/begin MEASUREMENT rtDW_ADAS.GTAngleobj17.GTDelayInput2_DSTATE "" FLOAT32_IEEE ADAS_CM_single 0 0 -3.4E+38 3.4E+38 ECU_ADDRESS 0x0000 /* @ECU_Address@rtDW_ADAS.GTAngleobj17.GTDelayInput2_DSTATE@ */ /end MEASUREMENT
/begin MEASUREMENT rtDW_ADAS.GTAngleobj17.GTDelayInput2_DSTATE_h "" FLOAT32_IEEE ADAS_CM_single 0 0 -3.4E+38 3.4E+38 ECU_ADDRESS 0x0000 /* @ECU_Address@rtDW_ADAS.GTAngleobj17.GTDelayInput2_DSTATE_h@ */ /end MEASUREMENT
/begin MEASUREMENT rtDW_ADAS.GTAngleobj17.GTDelayInput2_DSTATE_m "" FLOAT32_IEEE ADAS_CM_single 0 0 -3.4E+38 3.4E+38 ECU_ADDRESS 0x0000 /* @ECU_Address@rtDW_ADAS.GTAngleobj17.GTDelayInput2_DSTATE_m@ */ /end MEASUREMENT
/begin MEASUREMENT rtDW_ADAS.GTBlkCnt "" UBYTE ADAS_CM_uint8 0 0 0 255 ECU_ADDRESS 0x0000 /* @ECU_Address@rtDW_ADAS.GTBlkCnt@ */ /end MEASUREMENT
/begin MEASUREMENT rtDW_ADAS.GTBlkCnt_c "" UBYTE ADAS_CM_uint8 0 0 0 255 ECU_ADDRESS 0x0000 /* @ECU_Address@rtDW_ADAS.GTBlkCnt_c@ */ /end MEASUREMENT
/begin MEASUREMENT rtDW_ADAS.GTBlkCnt_k "" UBYTE ADAS_CM_uint8 0 0 0 255 ECU_ADDRESS 0x0000 /* @ECU_Address@rtDW_ADAS.GTBlkCnt_k@ */ /end MEASUREMENT
/begin MEASUREMENT rtDW_ADAS.GTCntHeat "" UBYTE ADAS_CM_uint8 0 0 0 255 ECU_ADDRESS 0x0000 /* @ECU_Address@rtDW_ADAS.GTCntHeat@ */ /end MEASUREMENT
/begin MEASUREMENT rtDW_ADAS.GTHLLAdbTargetLed.MliaLADBLED1 "" UBYTE ADAS_CM_uint8 0 0 0 255 ECU_ADDRESS 0x0000 /* @ECU_Address@rtDW_ADAS.GTHLLAdbTargetLed.MliaLADBLED1@ */ /end MEASUREMENT
/begin MEASUREMENT rtDW_ADAS.GTHLLAdbTargetLed.MliaLADBLED10 "" UBYTE ADAS_CM_uint8 0 0 0 255 ECU_ADDRESS 0x0000 /* @ECU_Address@rtDW_ADAS.GTHLLAdbTargetLed.MliaLADBLED10@ */ /end MEASUREMENT
/begin MEASUREMENT rtDW_ADAS.GTHLLAdbTargetLed.MliaLADBLED11 "" UBYTE ADAS_CM_uint8 0 0 0 255 ECU_ADDRESS 0x0000 /* @ECU_Address@rtDW_ADAS.GTHLLAdbTargetLed.MliaLADBLED11@ */ /end MEASUREMENT
/begin MEASUREMENT rtDW_ADAS.GTHLLAdbTargetLed.MliaLADBLED12 "" UBYTE ADAS_CM_uint8 0 0 0 255 ECU_ADDRESS 0x0000 /* @ECU_Address@rtDW_ADAS.GTHLLAdbTargetLed.MliaLADBLED12@ */ /end MEASUREMENT
/begin MEASUREMENT rtDW_ADAS.GTHLLAdbTargetLed.MliaLADBLED13 "" UBYTE ADAS_CM_uint8 0 0 0 255 ECU_ADDRESS 0x0000 /* @ECU_Address@rtDW_ADAS.GTHLLAdbTargetLed.MliaLADBLED13@ */ /end MEASUREMENT
/begin MEASUREMENT rtDW_ADAS.GTHLLAdbTargetLed.MliaLADBLED14 "" UBYTE ADAS_CM_uint8 0 0 0 255 ECU_ADDRESS 0x0000 /* @ECU_Address@rtDW_ADAS.GTHLLAdbTargetLed.MliaLADBLED14@ */ /end MEASUREMENT
/begin MEASUREMENT rtDW_ADAS.GTHLLAdbTargetLed.MliaLADBLED15 "" UBYTE ADAS_CM_uint8 0 0 0 255 ECU_ADDRESS 0x0000 /* @ECU_Address@rtDW_ADAS.GTHLLAdbTargetLed.MliaLADBLED15@ */ /end MEASUREMENT
/begin MEASUREMENT rtDW_ADAS.GTHLLAdbTargetLed.MliaLADBLED16 "" UBYTE ADAS_CM_uint8 0 0 0 255 ECU_ADDRESS 0x0000 /* @ECU_Address@rtDW_ADAS.GTHLLAdbTargetLed.MliaLADBLED16@ */ /end MEASUREMENT
/begin MEASUREMENT rtDW_ADAS.GTHLLAdbTargetLed.MliaLADBLED17 "" UBYTE ADAS_CM_uint8 0 0 0 255 ECU_ADDRESS 0x0000 /* @ECU_Address@rtDW_ADAS.GTHLLAdbTargetLed.MliaLADBLED17@ */ /end MEASUREMENT
/begin MEASUREMENT rtDW_ADAS.GTHLLAdbTargetLed.MliaLADBLED18 "" UBYTE ADAS_CM_uint8 0 0 0 255 ECU_ADDRESS 0x0000 /* @ECU_Address@rtDW_ADAS.GTHLLAdbTargetLed.MliaLADBLED18@ */ /end MEASUREMENT
/begin MEASUREMENT rtDW_ADAS.GTHLLAdbTargetLed.MliaLADBLED2 "" UBYTE ADAS_CM_uint8 0 0 0 255 ECU_ADDRESS 0x0000 /* @ECU_Address@rtDW_ADAS.GTHLLAdbTargetLed.MliaLADBLED2@ */ /end MEASUREMENT
/begin MEASUREMENT rtDW_ADAS.GTHLLAdbTargetLed.MliaLADBLED3 "" UBYTE ADAS_CM_uint8 0 0 0 255 ECU_ADDRESS 0x0000 /* @ECU_Address@rtDW_ADAS.GTHLLAdbTargetLed.MliaLADBLED3@ */ /end MEASUREMENT
/begin MEASUREMENT rtDW_ADAS.GTHLLAdbTargetLed.MliaLADBLED4 "" UBYTE ADAS_CM_uint8 0 0 0 255 ECU_ADDRESS 0x0000 /* @ECU_Address@rtDW_ADAS.GTHLLAdbTargetLed.MliaLADBLED4@ */ /end MEASUREMENT
/begin MEASUREMENT rtDW_ADAS.GTHLLAdbTargetLed.MliaLADBLED5 "" UBYTE ADAS_CM_uint8 0 0 0 255 ECU_ADDRESS 0x0000 /* @ECU_Address@rtDW_ADAS.GTHLLAdbTargetLed.MliaLADBLED5@ */ /end MEASUREMENT
/begin MEASUREMENT rtDW_ADAS.GTHLLAdbTargetLed.MliaLADBLED6 "" UBYTE ADAS_CM_uint8 0 0 0 255 ECU_ADDRESS 0x0000 /* @ECU_Address@rtDW_ADAS.GTHLLAdbTargetLed.MliaLADBLED6@ */ /end MEASUREMENT
/begin MEASUREMENT rtDW_ADAS.GTHLLAdbTargetLed.MliaLADBLED7 "" UBYTE ADAS_CM_uint8 0 0 0 255 ECU_ADDRESS 0x0000 /* @ECU_Address@rtDW_ADAS.GTHLLAdbTargetLed.MliaLADBLED7@ */ /end MEASUREMENT
/begin MEASUREMENT rtDW_ADAS.GTHLLAdbTargetLed.MliaLADBLED8 "" UBYTE ADAS_CM_uint8 0 0 0 255 ECU_ADDRESS 0x0000 /* @ECU_Address@rtDW_ADAS.GTHLLAdbTargetLed.MliaLADBLED8@ */ /end MEASUREMENT
/begin MEASUREMENT rtDW_ADAS.GTHLLAdbTargetLed.MliaLADBLED9 "" UBYTE ADAS_CM_uint8 0 0 0 255 ECU_ADDRESS 0x0000 /* @ECU_Address@rtDW_ADAS.GTHLLAdbTargetLed.MliaLADBLED9@ */ /end MEASUREMENT
/begin MEASUREMENT rtDW_ADAS.GTHLLAdbTargetLed_g.MliaLADBLED1 "" UBYTE ADAS_CM_uint8 0 0 0 255 ECU_ADDRESS 0x0000 /* @ECU_Address@rtDW_ADAS.GTHLLAdbTargetLed_g.MliaLADBLED1@ */ /end MEASUREMENT
/begin MEASUREMENT rtDW_ADAS.GTHLLAdbTargetLed_g.MliaLADBLED10 "" UBYTE ADAS_CM_uint8 0 0 0 255 ECU_ADDRESS 0x0000 /* @ECU_Address@rtDW_ADAS.GTHLLAdbTargetLed_g.MliaLADBLED10@ */ /end MEASUREMENT
/begin MEASUREMENT rtDW_ADAS.GTHLLAdbTargetLed_g.MliaLADBLED11 "" UBYTE ADAS_CM_uint8 0 0 0 255 ECU_ADDRESS 0x0000 /* @ECU_Address@rtDW_ADAS.GTHLLAdbTargetLed_g.MliaLADBLED11@ */ /end MEASUREMENT
/begin MEASUREMENT rtDW_ADAS.GTHLLAdbTargetLed_g.MliaLADBLED12 "" UBYTE ADAS_CM_uint8 0 0 0 255 ECU_ADDRESS 0x0000 /* @ECU_Address@rtDW_ADAS.GTHLLAdbTargetLed_g.MliaLADBLED12@ */ /end MEASUREMENT
/begin MEASUREMENT rtDW_ADAS.GTHLLAdbTargetLed_g.MliaLADBLED13 "" UBYTE ADAS_CM_uint8 0 0 0 255 ECU_ADDRESS 0x0000 /* @ECU_Address@rtDW_ADAS.GTHLLAdbTargetLed_g.MliaLADBLED13@ */ /end MEASUREMENT
/begin MEASUREMENT rtDW_ADAS.GTHLLAdbTargetLed_g.MliaLADBLED14 "" UBYTE ADAS_CM_uint8 0 0 0 255 ECU_ADDRESS 0x0000 /* @ECU_Address@rtDW_ADAS.GTHLLAdbTargetLed_g.MliaLADBLED14@ */ /end MEASUREMENT
/begin MEASUREMENT rtDW_ADAS.GTHLLAdbTargetLed_g.MliaLADBLED15 "" UBYTE ADAS_CM_uint8 0 0 0 255 ECU_ADDRESS 0x0000 /* @ECU_Address@rtDW_ADAS.GTHLLAdbTargetLed_g.MliaLADBLED15@ */ /end MEASUREMENT
/begin MEASUREMENT rtDW_ADAS.GTHLLAdbTargetLed_g.MliaLADBLED16 "" UBYTE ADAS_CM_uint8 0 0 0 255 ECU_ADDRESS 0x0000 /* @ECU_Address@rtDW_ADAS.GTHLLAdbTargetLed_g.MliaLADBLED16@ */ /end MEASUREMENT
/begin MEASUREMENT rtDW_ADAS.GTHLLAdbTargetLed_g.MliaLADBLED17 "" UBYTE ADAS_CM_uint8 0 0 0 255 ECU_ADDRESS 0x0000 /* @ECU_Address@rtDW_ADAS.GTHLLAdbTargetLed_g.MliaLADBLED17@ */ /end MEASUREMENT
/begin MEASUREMENT rtDW_ADAS.GTHLLAdbTargetLed_g.MliaLADBLED18 "" UBYTE ADAS_CM_uint8 0 0 0 255 ECU_ADDRESS 0x0000 /* @ECU_Address@rtDW_ADAS.GTHLLAdbTargetLed_g.MliaLADBLED18@ */ /end MEASUREMENT
/begin MEASUREMENT rtDW_ADAS.GTHLLAdbTargetLed_g.MliaLADBLED2 "" UBYTE ADAS_CM_uint8 0 0 0 255 ECU_ADDRESS 0x0000 /* @ECU_Address@rtDW_ADAS.GTHLLAdbTargetLed_g.MliaLADBLED2@ */ /end MEASUREMENT
/begin MEASUREMENT rtDW_ADAS.GTHLLAdbTargetLed_g.MliaLADBLED3 "" UBYTE ADAS_CM_uint8 0 0 0 255 ECU_ADDRESS 0x0000 /* @ECU_Address@rtDW_ADAS.GTHLLAdbTargetLed_g.MliaLADBLED3@ */ /end MEASUREMENT
/begin MEASUREMENT rtDW_ADAS.GTHLLAdbTargetLed_g.MliaLADBLED4 "" UBYTE ADAS_CM_uint8 0 0 0 255 ECU_ADDRESS 0x0000 /* @ECU_Address@rtDW_ADAS.GTHLLAdbTargetLed_g.MliaLADBLED4@ */ /end MEASUREMENT
/begin MEASUREMENT rtDW_ADAS.GTHLLAdbTargetLed_g.MliaLADBLED5 "" UBYTE ADAS_CM_uint8 0 0 0 255 ECU_ADDRESS 0x0000 /* @ECU_Address@rtDW_ADAS.GTHLLAdbTargetLed_g.MliaLADBLED5@ */ /end MEASUREMENT
/begin MEASUREMENT rtDW_ADAS.GTHLLAdbTargetLed_g.MliaLADBLED6 "" UBYTE ADAS_CM_uint8 0 0 0 255 ECU_ADDRESS 0x0000 /* @ECU_Address@rtDW_ADAS.GTHLLAdbTargetLed_g.MliaLADBLED6@ */ /end MEASUREMENT
/begin MEASUREMENT rtDW_ADAS.GTHLLAdbTargetLed_g.MliaLADBLED7 "" UBYTE ADAS_CM_uint8 0 0 0 255 ECU_ADDRESS 0x0000 /* @ECU_Address@rtDW_ADAS.GTHLLAdbTargetLed_g.MliaLADBLED7@ */ /end MEASUREMENT
/begin MEASUREMENT rtDW_ADAS.GTHLLAdbTargetLed_g.MliaLADBLED8 "" UBYTE ADAS_CM_uint8 0 0 0 255 ECU_ADDRESS 0x0000 /* @ECU_Address@rtDW_ADAS.GTHLLAdbTargetLed_g.MliaLADBLED8@ */ /end MEASUREMENT
/begin MEASUREMENT rtDW_ADAS.GTHLLAdbTargetLed_g.MliaLADBLED9 "" UBYTE ADAS_CM_uint8 0 0 0 255 ECU_ADDRESS 0x0000 /* @ECU_Address@rtDW_ADAS.GTHLLAdbTargetLed_g.MliaLADBLED9@ */ /end MEASUREMENT
/begin MEASUREMENT rtDW_ADAS.GTHLLAdbTargetLed_gz.MliaLADBLED1 "" UBYTE ADAS_CM_uint8 0 0 0 255 ECU_ADDRESS 0x0000 /* @ECU_Address@rtDW_ADAS.GTHLLAdbTargetLed_gz.MliaLADBLED1@ */ /end MEASUREMENT
/begin MEASUREMENT rtDW_ADAS.GTHLLAdbTargetLed_gz.MliaLADBLED10 "" UBYTE ADAS_CM_uint8 0 0 0 255 ECU_ADDRESS 0x0000 /* @ECU_Address@rtDW_ADAS.GTHLLAdbTargetLed_gz.MliaLADBLED10@ */ /end MEASUREMENT
/begin MEASUREMENT rtDW_ADAS.GTHLLAdbTargetLed_gz.MliaLADBLED11 "" UBYTE ADAS_CM_uint8 0 0 0 255 ECU_ADDRESS 0x0000 /* @ECU_Address@rtDW_ADAS.GTHLLAdbTargetLed_gz.MliaLADBLED11@ */ /end MEASUREMENT
/begin MEASUREMENT rtDW_ADAS.GTHLLAdbTargetLed_gz.MliaLADBLED12 "" UBYTE ADAS_CM_uint8 0 0 0 255 ECU_ADDRESS 0x0000 /* @ECU_Address@rtDW_ADAS.GTHLLAdbTargetLed_gz.MliaLADBLED12@ */ /end MEASUREMENT
/begin MEASUREMENT rtDW_ADAS.GTHLLAdbTargetLed_gz.MliaLADBLED13 "" UBYTE ADAS_CM_uint8 0 0 0 255 ECU_ADDRESS 0x0000 /* @ECU_Address@rtDW_ADAS.GTHLLAdbTargetLed_gz.MliaLADBLED13@ */ /end MEASUREMENT
/begin MEASUREMENT rtDW_ADAS.GTHLLAdbTargetLed_gz.MliaLADBLED14 "" UBYTE ADAS_CM_uint8 0 0 0 255 ECU_ADDRESS 0x0000 /* @ECU_Address@rtDW_ADAS.GTHLLAdbTargetLed_gz.MliaLADBLED14@ */ /end MEASUREMENT
/begin MEASUREMENT rtDW_ADAS.GTHLLAdbTargetLed_gz.MliaLADBLED15 "" UBYTE ADAS_CM_uint8 0 0 0 255 ECU_ADDRESS 0x0000 /* @ECU_Address@rtDW_ADAS.GTHLLAdbTargetLed_gz.MliaLADBLED15@ */ /end MEASUREMENT
/begin MEASUREMENT rtDW_ADAS.GTHLLAdbTargetLed_gz.MliaLADBLED16 "" UBYTE ADAS_CM_uint8 0 0 0 255 ECU_ADDRESS 0x0000 /* @ECU_Address@rtDW_ADAS.GTHLLAdbTargetLed_gz.MliaLADBLED16@ */ /end MEASUREMENT
/begin MEASUREMENT rtDW_ADAS.GTHLLAdbTargetLed_gz.MliaLADBLED17 "" UBYTE ADAS_CM_uint8 0 0 0 255 ECU_ADDRESS 0x0000 /* @ECU_Address@rtDW_ADAS.GTHLLAdbTargetLed_gz.MliaLADBLED17@ */ /end MEASUREMENT
/begin MEASUREMENT rtDW_ADAS.GTHLLAdbTargetLed_gz.MliaLADBLED18 "" UBYTE ADAS_CM_uint8 0 0 0 255 ECU_ADDRESS 0x0000 /* @ECU_Address@rtDW_ADAS.GTHLLAdbTargetLed_gz.MliaLADBLED18@ */ /end MEASUREMENT
/begin MEASUREMENT rtDW_ADAS.GTHLLAdbTargetLed_gz.MliaLADBLED2 "" UBYTE ADAS_CM_uint8 0 0 0 255 ECU_ADDRESS 0x0000 /* @ECU_Address@rtDW_ADAS.GTHLLAdbTargetLed_gz.MliaLADBLED2@ */ /end MEASUREMENT
/begin MEASUREMENT rtDW_ADAS.GTHLLAdbTargetLed_gz.MliaLADBLED3 "" UBYTE ADAS_CM_uint8 0 0 0 255 ECU_ADDRESS 0x0000 /* @ECU_Address@rtDW_ADAS.GTHLLAdbTargetLed_gz.MliaLADBLED3@ */ /end MEASUREMENT
/begin MEASUREMENT rtDW_ADAS.GTHLLAdbTargetLed_gz.MliaLADBLED4 "" UBYTE ADAS_CM_uint8 0 0 0 255 ECU_ADDRESS 0x0000 /* @ECU_Address@rtDW_ADAS.GTHLLAdbTargetLed_gz.MliaLADBLED4@ */ /end MEASUREMENT
/begin MEASUREMENT rtDW_ADAS.GTHLLAdbTargetLed_gz.MliaLADBLED5 "" UBYTE ADAS_CM_uint8 0 0 0 255 ECU_ADDRESS 0x0000 /* @ECU_Address@rtDW_ADAS.GTHLLAdbTargetLed_gz.MliaLADBLED5@ */ /end MEASUREMENT
/begin MEASUREMENT rtDW_ADAS.GTHLLAdbTargetLed_gz.MliaLADBLED6 "" UBYTE ADAS_CM_uint8 0 0 0 255 ECU_ADDRESS 0x0000 /* @ECU_Address@rtDW_ADAS.GTHLLAdbTargetLed_gz.MliaLADBLED6@ */ /end MEASUREMENT
/begin MEASUREMENT rtDW_ADAS.GTHLLAdbTargetLed_gz.MliaLADBLED7 "" UBYTE ADAS_CM_uint8 0 0 0 255 ECU_ADDRESS 0x0000 /* @ECU_Address@rtDW_ADAS.GTHLLAdbTargetLed_gz.MliaLADBLED7@ */ /end MEASUREMENT
/begin MEASUREMENT rtDW_ADAS.GTHLLAdbTargetLed_gz.MliaLADBLED8 "" UBYTE ADAS_CM_uint8 0 0 0 255 ECU_ADDRESS 0x0000 /* @ECU_Address@rtDW_ADAS.GTHLLAdbTargetLed_gz.MliaLADBLED8@ */ /end MEASUREMENT
/begin MEASUREMENT rtDW_ADAS.GTHLLAdbTargetLed_gz.MliaLADBLED9 "" UBYTE ADAS_CM_uint8 0 0 0 255 ECU_ADDRESS 0x0000 /* @ECU_Address@rtDW_ADAS.GTHLLAdbTargetLed_gz.MliaLADBLED9@ */ /end MEASUREMENT
/begin MEASUREMENT rtDW_ADAS.GTHLRAdbTargetLed.MliaRADBLED1 "" UBYTE ADAS_CM_uint8 0 0 0 255 ECU_ADDRESS 0x0000 /* @ECU_Address@rtDW_ADAS.GTHLRAdbTargetLed.MliaRADBLED1@ */ /end MEASUREMENT
/begin MEASUREMENT rtDW_ADAS.GTHLRAdbTargetLed.MliaRADBLED10 "" UBYTE ADAS_CM_uint8 0 0 0 255 ECU_ADDRESS 0x0000 /* @ECU_Address@rtDW_ADAS.GTHLRAdbTargetLed.MliaRADBLED10@ */ /end MEASUREMENT
/begin MEASUREMENT rtDW_ADAS.GTHLRAdbTargetLed.MliaRADBLED11 "" UBYTE ADAS_CM_uint8 0 0 0 255 ECU_ADDRESS 0x0000 /* @ECU_Address@rtDW_ADAS.GTHLRAdbTargetLed.MliaRADBLED11@ */ /end MEASUREMENT
/begin MEASUREMENT rtDW_ADAS.GTHLRAdbTargetLed.MliaRADBLED12 "" UBYTE ADAS_CM_uint8 0 0 0 255 ECU_ADDRESS 0x0000 /* @ECU_Address@rtDW_ADAS.GTHLRAdbTargetLed.MliaRADBLED12@ */ /end MEASUREMENT
/begin MEASUREMENT rtDW_ADAS.GTHLRAdbTargetLed.MliaRADBLED13 "" UBYTE ADAS_CM_uint8 0 0 0 255 ECU_ADDRESS 0x0000 /* @ECU_Address@rtDW_ADAS.GTHLRAdbTargetLed.MliaRADBLED13@ */ /end MEASUREMENT
/begin MEASUREMENT rtDW_ADAS.GTHLRAdbTargetLed.MliaRADBLED14 "" UBYTE ADAS_CM_uint8 0 0 0 255 ECU_ADDRESS 0x0000 /* @ECU_Address@rtDW_ADAS.GTHLRAdbTargetLed.MliaRADBLED14@ */ /end MEASUREMENT
/begin MEASUREMENT rtDW_ADAS.GTHLRAdbTargetLed.MliaRADBLED15 "" UBYTE ADAS_CM_uint8 0 0 0 255 ECU_ADDRESS 0x0000 /* @ECU_Address@rtDW_ADAS.GTHLRAdbTargetLed.MliaRADBLED15@ */ /end MEASUREMENT
/begin MEASUREMENT rtDW_ADAS.GTHLRAdbTargetLed.MliaRADBLED16 "" UBYTE ADAS_CM_uint8 0 0 0 255 ECU_ADDRESS 0x0000 /* @ECU_Address@rtDW_ADAS.GTHLRAdbTargetLed.MliaRADBLED16@ */ /end MEASUREMENT
/begin MEASUREMENT rtDW_ADAS.GTHLRAdbTargetLed.MliaRADBLED17 "" UBYTE ADAS_CM_uint8 0 0 0 255 ECU_ADDRESS 0x0000 /* @ECU_Address@rtDW_ADAS.GTHLRAdbTargetLed.MliaRADBLED17@ */ /end MEASUREMENT
/begin MEASUREMENT rtDW_ADAS.GTHLRAdbTargetLed.MliaRADBLED18 "" UBYTE ADAS_CM_uint8 0 0 0 255 ECU_ADDRESS 0x0000 /* @ECU_Address@rtDW_ADAS.GTHLRAdbTargetLed.MliaRADBLED18@ */ /end MEASUREMENT
/begin MEASUREMENT rtDW_ADAS.GTHLRAdbTargetLed.MliaRADBLED2 "" UBYTE ADAS_CM_uint8 0 0 0 255 ECU_ADDRESS 0x0000 /* @ECU_Address@rtDW_ADAS.GTHLRAdbTargetLed.MliaRADBLED2@ */ /end MEASUREMENT
/begin MEASUREMENT rtDW_ADAS.GTHLRAdbTargetLed.MliaRADBLED3 "" UBYTE ADAS_CM_uint8 0 0 0 255 ECU_ADDRESS 0x0000 /* @ECU_Address@rtDW_ADAS.GTHLRAdbTargetLed.MliaRADBLED3@ */ /end MEASUREMENT
/begin MEASUREMENT rtDW_ADAS.GTHLRAdbTargetLed.MliaRADBLED4 "" UBYTE ADAS_CM_uint8 0 0 0 255 ECU_ADDRESS 0x0000 /* @ECU_Address@rtDW_ADAS.GTHLRAdbTargetLed.MliaRADBLED4@ */ /end MEASUREMENT
/begin MEASUREMENT rtDW_ADAS.GTHLRAdbTargetLed.MliaRADBLED5 "" UBYTE ADAS_CM_uint8 0 0 0 255 ECU_ADDRESS 0x0000 /* @ECU_Address@rtDW_ADAS.GTHLRAdbTargetLed.MliaRADBLED5@ */ /end MEASUREMENT
/begin MEASUREMENT rtDW_ADAS.GTHLRAdbTargetLed.MliaRADBLED6 "" UBYTE ADAS_CM_uint8 0 0 0 255 ECU_ADDRESS 0x0000 /* @ECU_Address@rtDW_ADAS.GTHLRAdbTargetLed.MliaRADBLED6@ */ /end MEASUREMENT
/begin MEASUREMENT rtDW_ADAS.GTHLRAdbTargetLed.MliaRADBLED7 "" UBYTE ADAS_CM_uint8 0 0 0 255 ECU_ADDRESS 0x0000 /* @ECU_Address@rtDW_ADAS.GTHLRAdbTargetLed.MliaRADBLED7@ */ /end MEASUREMENT
/begin MEASUREMENT rtDW_ADAS.GTHLRAdbTargetLed.MliaRADBLED8 "" UBYTE ADAS_CM_uint8 0 0 0 255 ECU_ADDRESS 0x0000 /* @ECU_Address@rtDW_ADAS.GTHLRAdbTargetLed.MliaRADBLED8@ */ /end MEASUREMENT
/begin MEASUREMENT rtDW_ADAS.GTHLRAdbTargetLed.MliaRADBLED9 "" UBYTE ADAS_CM_uint8 0 0 0 255 ECU_ADDRESS 0x0000 /* @ECU_Address@rtDW_ADAS.GTHLRAdbTargetLed.MliaRADBLED9@ */ /end MEASUREMENT
/begin MEASUREMENT rtDW_ADAS.GTHLRAdbTargetLed_i.MliaRADBLED1 "" UBYTE ADAS_CM_uint8 0 0 0 255 ECU_ADDRESS 0x0000 /* @ECU_Address@rtDW_ADAS.GTHLRAdbTargetLed_i.MliaRADBLED1@ */ /end MEASUREMENT
/begin MEASUREMENT rtDW_ADAS.GTHLRAdbTargetLed_i.MliaRADBLED10 "" UBYTE ADAS_CM_uint8 0 0 0 255 ECU_ADDRESS 0x0000 /* @ECU_Address@rtDW_ADAS.GTHLRAdbTargetLed_i.MliaRADBLED10@ */ /end MEASUREMENT
/begin MEASUREMENT rtDW_ADAS.GTHLRAdbTargetLed_i.MliaRADBLED11 "" UBYTE ADAS_CM_uint8 0 0 0 255 ECU_ADDRESS 0x0000 /* @ECU_Address@rtDW_ADAS.GTHLRAdbTargetLed_i.MliaRADBLED11@ */ /end MEASUREMENT
/begin MEASUREMENT rtDW_ADAS.GTHLRAdbTargetLed_i.MliaRADBLED12 "" UBYTE ADAS_CM_uint8 0 0 0 255 ECU_ADDRESS 0x0000 /* @ECU_Address@rtDW_ADAS.GTHLRAdbTargetLed_i.MliaRADBLED12@ */ /end MEASUREMENT
/begin MEASUREMENT rtDW_ADAS.GTHLRAdbTargetLed_i.MliaRADBLED13 "" UBYTE ADAS_CM_uint8 0 0 0 255 ECU_ADDRESS 0x0000 /* @ECU_Address@rtDW_ADAS.GTHLRAdbTargetLed_i.MliaRADBLED13@ */ /end MEASUREMENT
/begin MEASUREMENT rtDW_ADAS.GTHLRAdbTargetLed_i.MliaRADBLED14 "" UBYTE ADAS_CM_uint8 0 0 0 255 ECU_ADDRESS 0x0000 /* @ECU_Address@rtDW_ADAS.GTHLRAdbTargetLed_i.MliaRADBLED14@ */ /end MEASUREMENT
/begin MEASUREMENT rtDW_ADAS.GTHLRAdbTargetLed_i.MliaRADBLED15 "" UBYTE ADAS_CM_uint8 0 0 0 255 ECU_ADDRESS 0x0000 /* @ECU_Address@rtDW_ADAS.GTHLRAdbTargetLed_i.MliaRADBLED15@ */ /end MEASUREMENT
/begin MEASUREMENT rtDW_ADAS.GTHLRAdbTargetLed_i.MliaRADBLED16 "" UBYTE ADAS_CM_uint8 0 0 0 255 ECU_ADDRESS 0x0000 /* @ECU_Address@rtDW_ADAS.GTHLRAdbTargetLed_i.MliaRADBLED16@ */ /end MEASUREMENT
/begin MEASUREMENT rtDW_ADAS.GTHLRAdbTargetLed_i.MliaRADBLED17 "" UBYTE ADAS_CM_uint8 0 0 0 255 ECU_ADDRESS 0x0000 /* @ECU_Address@rtDW_ADAS.GTHLRAdbTargetLed_i.MliaRADBLED17@ */ /end MEASUREMENT
/begin MEASUREMENT rtDW_ADAS.GTHLRAdbTargetLed_i.MliaRADBLED18 "" UBYTE ADAS_CM_uint8 0 0 0 255 ECU_ADDRESS 0x0000 /* @ECU_Address@rtDW_ADAS.GTHLRAdbTargetLed_i.MliaRADBLED18@ */ /end MEASUREMENT
/begin MEASUREMENT rtDW_ADAS.GTHLRAdbTargetLed_i.MliaRADBLED2 "" UBYTE ADAS_CM_uint8 0 0 0 255 ECU_ADDRESS 0x0000 /* @ECU_Address@rtDW_ADAS.GTHLRAdbTargetLed_i.MliaRADBLED2@ */ /end MEASUREMENT
/begin MEASUREMENT rtDW_ADAS.GTHLRAdbTargetLed_i.MliaRADBLED3 "" UBYTE ADAS_CM_uint8 0 0 0 255 ECU_ADDRESS 0x0000 /* @ECU_Address@rtDW_ADAS.GTHLRAdbTargetLed_i.MliaRADBLED3@ */ /end MEASUREMENT
/begin MEASUREMENT rtDW_ADAS.GTHLRAdbTargetLed_i.MliaRADBLED4 "" UBYTE ADAS_CM_uint8 0 0 0 255 ECU_ADDRESS 0x0000 /* @ECU_Address@rtDW_ADAS.GTHLRAdbTargetLed_i.MliaRADBLED4@ */ /end MEASUREMENT
/begin MEASUREMENT rtDW_ADAS.GTHLRAdbTargetLed_i.MliaRADBLED5 "" UBYTE ADAS_CM_uint8 0 0 0 255 ECU_ADDRESS 0x0000 /* @ECU_Address@rtDW_ADAS.GTHLRAdbTargetLed_i.MliaRADBLED5@ */ /end MEASUREMENT
/begin MEASUREMENT rtDW_ADAS.GTHLRAdbTargetLed_i.MliaRADBLED6 "" UBYTE ADAS_CM_uint8 0 0 0 255 ECU_ADDRESS 0x0000 /* @ECU_Address@rtDW_ADAS.GTHLRAdbTargetLed_i.MliaRADBLED6@ */ /end MEASUREMENT
/begin MEASUREMENT rtDW_ADAS.GTHLRAdbTargetLed_i.MliaRADBLED7 "" UBYTE ADAS_CM_uint8 0 0 0 255 ECU_ADDRESS 0x0000 /* @ECU_Address@rtDW_ADAS.GTHLRAdbTargetLed_i.MliaRADBLED7@ */ /end MEASUREMENT
/begin MEASUREMENT rtDW_ADAS.GTHLRAdbTargetLed_i.MliaRADBLED8 "" UBYTE ADAS_CM_uint8 0 0 0 255 ECU_ADDRESS 0x0000 /* @ECU_Address@rtDW_ADAS.GTHLRAdbTargetLed_i.MliaRADBLED8@ */ /end MEASUREMENT
/begin MEASUREMENT rtDW_ADAS.GTHLRAdbTargetLed_i.MliaRADBLED9 "" UBYTE ADAS_CM_uint8 0 0 0 255 ECU_ADDRESS 0x0000 /* @ECU_Address@rtDW_ADAS.GTHLRAdbTargetLed_i.MliaRADBLED9@ */ /end MEASUREMENT
/begin MEASUREMENT rtDW_ADAS.GTHLRAdbTargetLed_i5.MliaRADBLED1 "" UBYTE ADAS_CM_uint8 0 0 0 255 ECU_ADDRESS 0x0000 /* @ECU_Address@rtDW_ADAS.GTHLRAdbTargetLed_i5.MliaRADBLED1@ */ /end MEASUREMENT
/begin MEASUREMENT rtDW_ADAS.GTHLRAdbTargetLed_i5.MliaRADBLED10 "" UBYTE ADAS_CM_uint8 0 0 0 255 ECU_ADDRESS 0x0000 /* @ECU_Address@rtDW_ADAS.GTHLRAdbTargetLed_i5.MliaRADBLED10@ */ /end MEASUREMENT
/begin MEASUREMENT rtDW_ADAS.GTHLRAdbTargetLed_i5.MliaRADBLED11 "" UBYTE ADAS_CM_uint8 0 0 0 255 ECU_ADDRESS 0x0000 /* @ECU_Address@rtDW_ADAS.GTHLRAdbTargetLed_i5.MliaRADBLED11@ */ /end MEASUREMENT
/begin MEASUREMENT rtDW_ADAS.GTHLRAdbTargetLed_i5.MliaRADBLED12 "" UBYTE ADAS_CM_uint8 0 0 0 255 ECU_ADDRESS 0x0000 /* @ECU_Address@rtDW_ADAS.GTHLRAdbTargetLed_i5.MliaRADBLED12@ */ /end MEASUREMENT
/begin MEASUREMENT rtDW_ADAS.GTHLRAdbTargetLed_i5.MliaRADBLED13 "" UBYTE ADAS_CM_uint8 0 0 0 255 ECU_ADDRESS 0x0000 /* @ECU_Address@rtDW_ADAS.GTHLRAdbTargetLed_i5.MliaRADBLED13@ */ /end MEASUREMENT
/begin MEASUREMENT rtDW_ADAS.GTHLRAdbTargetLed_i5.MliaRADBLED14 "" UBYTE ADAS_CM_uint8 0 0 0 255 ECU_ADDRESS 0x0000 /* @ECU_Address@rtDW_ADAS.GTHLRAdbTargetLed_i5.MliaRADBLED14@ */ /end MEASUREMENT
/begin MEASUREMENT rtDW_ADAS.GTHLRAdbTargetLed_i5.MliaRADBLED15 "" UBYTE ADAS_CM_uint8 0 0 0 255 ECU_ADDRESS 0x0000 /* @ECU_Address@rtDW_ADAS.GTHLRAdbTargetLed_i5.MliaRADBLED15@ */ /end MEASUREMENT
/begin MEASUREMENT rtDW_ADAS.GTHLRAdbTargetLed_i5.MliaRADBLED16 "" UBYTE ADAS_CM_uint8 0 0 0 255 ECU_ADDRESS 0x0000 /* @ECU_Address@rtDW_ADAS.GTHLRAdbTargetLed_i5.MliaRADBLED16@ */ /end MEASUREMENT
/begin MEASUREMENT rtDW_ADAS.GTHLRAdbTargetLed_i5.MliaRADBLED17 "" UBYTE ADAS_CM_uint8 0 0 0 255 ECU_ADDRESS 0x0000 /* @ECU_Address@rtDW_ADAS.GTHLRAdbTargetLed_i5.MliaRADBLED17@ */ /end MEASUREMENT
/begin MEASUREMENT rtDW_ADAS.GTHLRAdbTargetLed_i5.MliaRADBLED18 "" UBYTE ADAS_CM_uint8 0 0 0 255 ECU_ADDRESS 0x0000 /* @ECU_Address@rtDW_ADAS.GTHLRAdbTargetLed_i5.MliaRADBLED18@ */ /end MEASUREMENT
/begin MEASUREMENT rtDW_ADAS.GTHLRAdbTargetLed_i5.MliaRADBLED2 "" UBYTE ADAS_CM_uint8 0 0 0 255 ECU_ADDRESS 0x0000 /* @ECU_Address@rtDW_ADAS.GTHLRAdbTargetLed_i5.MliaRADBLED2@ */ /end MEASUREMENT
/begin MEASUREMENT rtDW_ADAS.GTHLRAdbTargetLed_i5.MliaRADBLED3 "" UBYTE ADAS_CM_uint8 0 0 0 255 ECU_ADDRESS 0x0000 /* @ECU_Address@rtDW_ADAS.GTHLRAdbTargetLed_i5.MliaRADBLED3@ */ /end MEASUREMENT
/begin MEASUREMENT rtDW_ADAS.GTHLRAdbTargetLed_i5.MliaRADBLED4 "" UBYTE ADAS_CM_uint8 0 0 0 255 ECU_ADDRESS 0x0000 /* @ECU_Address@rtDW_ADAS.GTHLRAdbTargetLed_i5.MliaRADBLED4@ */ /end MEASUREMENT
/begin MEASUREMENT rtDW_ADAS.GTHLRAdbTargetLed_i5.MliaRADBLED5 "" UBYTE ADAS_CM_uint8 0 0 0 255 ECU_ADDRESS 0x0000 /* @ECU_Address@rtDW_ADAS.GTHLRAdbTargetLed_i5.MliaRADBLED5@ */ /end MEASUREMENT
/begin MEASUREMENT rtDW_ADAS.GTHLRAdbTargetLed_i5.MliaRADBLED6 "" UBYTE ADAS_CM_uint8 0 0 0 255 ECU_ADDRESS 0x0000 /* @ECU_Address@rtDW_ADAS.GTHLRAdbTargetLed_i5.MliaRADBLED6@ */ /end MEASUREMENT
/begin MEASUREMENT rtDW_ADAS.GTHLRAdbTargetLed_i5.MliaRADBLED7 "" UBYTE ADAS_CM_uint8 0 0 0 255 ECU_ADDRESS 0x0000 /* @ECU_Address@rtDW_ADAS.GTHLRAdbTargetLed_i5.MliaRADBLED7@ */ /end MEASUREMENT
/begin MEASUREMENT rtDW_ADAS.GTHLRAdbTargetLed_i5.MliaRADBLED8 "" UBYTE ADAS_CM_uint8 0 0 0 255 ECU_ADDRESS 0x0000 /* @ECU_Address@rtDW_ADAS.GTHLRAdbTargetLed_i5.MliaRADBLED8@ */ /end MEASUREMENT
/begin MEASUREMENT rtDW_ADAS.GTHLRAdbTargetLed_i5.MliaRADBLED9 "" UBYTE ADAS_CM_uint8 0 0 0 255 ECU_ADDRESS 0x0000 /* @ECU_Address@rtDW_ADAS.GTHLRAdbTargetLed_i5.MliaRADBLED9@ */ /end MEASUREMENT
/begin MEASUREMENT rtDW_ADAS.GTMemory4_PreviousInput_j "" UBYTE ADAS_CM_uint8 0 0 0 255 ECU_ADDRESS 0x0000 /* @ECU_Address@rtDW_ADAS.GTMemory4_PreviousInput_j@ */ /end MEASUREMENT
/begin MEASUREMENT rtDW_ADAS.GTMemory5_PreviousInput_i "" UBYTE ADAS_CM_uint8 0 0 0 255 ECU_ADDRESS 0x0000 /* @ECU_Address@rtDW_ADAS.GTMemory5_PreviousInput_i@ */ /end MEASUREMENT
/begin MEASUREMENT rtDW_ADAS.GTMemory_PreviousInput_j "" UBYTE ADAS_CM_uint8 0 0 0 255 ECU_ADDRESS 0x0000 /* @ECU_Address@rtDW_ADAS.GTMemory_PreviousInput_j@ */ /end MEASUREMENT
/begin MEASUREMENT rtDW_ADAS.GTNvLog "" UBYTE ADAS_CM_uint8 0 0 0 255 ECU_ADDRESS 0x0000 /* @ECU_Address@rtDW_ADAS.GTNvLog@ */ /end MEASUREMENT
/begin MEASUREMENT rtDW_ADAS.GTRD "" UBYTE ADAS_CM_uint8 0 0 0 255 ECU_ADDRESS 0x0000 /* @ECU_Address@rtDW_ADAS.GTRD@ */ /end MEASUREMENT
/begin MEASUREMENT rtDW_ADAS.GTRelay_Mode_a "" UBYTE ADAS_CM_logical 0 0 0 1 ECU_ADDRESS 0x0000 /* @ECU_Address@rtDW_ADAS.GTRelay_Mode_a@ */ /end MEASUREMENT
/begin MEASUREMENT rtDW_ADAS.GTTd "" FLOAT32_IEEE ADAS_CM_single 0 0 -3.4E+38 3.4E+38 ECU_ADDRESS 0x0000 /* @ECU_Address@rtDW_ADAS.GTTd@ */ /end MEASUREMENT
/begin MEASUREMENT rtDW_ADAS.GTVisEgoZone "" UBYTE ADAS_CM_uint8 0 0 0 255 ECU_ADDRESS 0x0000 /* @ECU_Address@rtDW_ADAS.GTVisEgoZone@ */ /end MEASUREMENT
/begin MEASUREMENT rtDW_ADAS.GTVisLaneLType "" UBYTE ADAS_CM_uint8 0 0 0 255 ECU_ADDRESS 0x0000 /* @ECU_Address@rtDW_ADAS.GTVisLaneLType@ */ /end MEASUREMENT
/begin MEASUREMENT rtDW_ADAS.GTVisLaneRType "" UBYTE ADAS_CM_uint8 0 0 0 255 ECU_ADDRESS 0x0000 /* @ECU_Address@rtDW_ADAS.GTVisLaneRType@ */ /end MEASUREMENT
/begin MEASUREMENT rtDW_ADAS.GTVisObj1DistLong "" FLOAT32_IEEE ADAS_CM_single_m 0 0 -3.4E+38 3.4E+38 MATRIX_DIM 1 1 ECU_ADDRESS 0x0000 /* @ECU_Address@rtDW_ADAS.GTVisObj1DistLong@ */ /end MEASUREMENT
/begin MEASUREMENT rtDW_ADAS.GTVisObj1Orient "" UBYTE ADAS_CM_uint8 0 0 0 255 MATRIX_DIM 1 1 ECU_ADDRESS 0x0000 /* @ECU_Address@rtDW_ADAS.GTVisObj1Orient@ */ /end MEASUREMENT
/begin MEASUREMENT rtDW_ADAS.GTVisObj1Zone "" UBYTE ADAS_CM_uint8 0 0 0 255 ECU_ADDRESS 0x0000 /* @ECU_Address@rtDW_ADAS.GTVisObj1Zone@ */ /end MEASUREMENT
/begin MEASUREMENT rtDW_ADAS.GTVisObj1_Type "" UBYTE ADAS_CM_uint8 0 0 0 255 MATRIX_DIM 1 1 ECU_ADDRESS 0x0000 /* @ECU_Address@rtDW_ADAS.GTVisObj1_Type@ */ /end MEASUREMENT
/begin MEASUREMENT rtDW_ADAS.GTVisObj2DistLong "" FLOAT32_IEEE ADAS_CM_single_m 0 0 -3.4E+38 3.4E+38 MATRIX_DIM 1 1 ECU_ADDRESS 0x0000 /* @ECU_Address@rtDW_ADAS.GTVisObj2DistLong@ */ /end MEASUREMENT
/begin MEASUREMENT rtDW_ADAS.GTVisObj2Orient "" UBYTE ADAS_CM_uint8 0 0 0 255 MATRIX_DIM 1 1 ECU_ADDRESS 0x0000 /* @ECU_Address@rtDW_ADAS.GTVisObj2Orient@ */ /end MEASUREMENT
/begin MEASUREMENT rtDW_ADAS.GTVisObj2Zone "" UBYTE ADAS_CM_uint8 0 0 0 255 ECU_ADDRESS 0x0000 /* @ECU_Address@rtDW_ADAS.GTVisObj2Zone@ */ /end MEASUREMENT
/begin MEASUREMENT rtDW_ADAS.GTVisObj2_Type "" UBYTE ADAS_CM_uint8 0 0 0 255 MATRIX_DIM 1 1 ECU_ADDRESS 0x0000 /* @ECU_Address@rtDW_ADAS.GTVisObj2_Type@ */ /end MEASUREMENT
/begin MEASUREMENT rtDW_ADAS.GTVisObj3DistLong "" FLOAT32_IEEE ADAS_CM_single_m 0 0 -3.4E+38 3.4E+38 MATRIX_DIM 1 1 ECU_ADDRESS 0x0000 /* @ECU_Address@rtDW_ADAS.GTVisObj3DistLong@ */ /end MEASUREMENT
/begin MEASUREMENT rtDW_ADAS.GTVisObj3Orient "" UBYTE ADAS_CM_uint8 0 0 0 255 MATRIX_DIM 1 1 ECU_ADDRESS 0x0000 /* @ECU_Address@rtDW_ADAS.GTVisObj3Orient@ */ /end MEASUREMENT
/begin MEASUREMENT rtDW_ADAS.GTVisObj3Zone "" UBYTE ADAS_CM_uint8 0 0 0 255 ECU_ADDRESS 0x0000 /* @ECU_Address@rtDW_ADAS.GTVisObj3Zone@ */ /end MEASUREMENT
/begin MEASUREMENT rtDW_ADAS.GTVisObj3_Type "" UBYTE ADAS_CM_uint8 0 0 0 255 MATRIX_DIM 1 1 ECU_ADDRESS 0x0000 /* @ECU_Address@rtDW_ADAS.GTVisObj3_Type@ */ /end MEASUREMENT
/begin MEASUREMENT rtDW_ADAS.GTVisObj4DistLong "" FLOAT32_IEEE ADAS_CM_single_m 0 0 -3.4E+38 3.4E+38 MATRIX_DIM 1 1 ECU_ADDRESS 0x0000 /* @ECU_Address@rtDW_ADAS.GTVisObj4DistLong@ */ /end MEASUREMENT
/begin MEASUREMENT rtDW_ADAS.GTVisObj4Orient "" UBYTE ADAS_CM_uint8 0 0 0 255 MATRIX_DIM 1 1 ECU_ADDRESS 0x0000 /* @ECU_Address@rtDW_ADAS.GTVisObj4Orient@ */ /end MEASUREMENT
/begin MEASUREMENT rtDW_ADAS.GTVisObj4Zone "" UBYTE ADAS_CM_uint8 0 0 0 255 ECU_ADDRESS 0x0000 /* @ECU_Address@rtDW_ADAS.GTVisObj4Zone@ */ /end MEASUREMENT
/begin MEASUREMENT rtDW_ADAS.GTVisObj4_Type "" UBYTE ADAS_CM_uint8 0 0 0 255 MATRIX_DIM 1 1 ECU_ADDRESS 0x0000 /* @ECU_Address@rtDW_ADAS.GTVisObj4_Type@ */ /end MEASUREMENT
/begin MEASUREMENT rtDW_ADAS.GTVisObj5DistLong "" FLOAT32_IEEE ADAS_CM_single_m 0 0 -3.4E+38 3.4E+38 MATRIX_DIM 1 1 ECU_ADDRESS 0x0000 /* @ECU_Address@rtDW_ADAS.GTVisObj5DistLong@ */ /end MEASUREMENT
/begin MEASUREMENT rtDW_ADAS.GTVisObj5Orient "" UBYTE ADAS_CM_uint8 0 0 0 255 MATRIX_DIM 1 1 ECU_ADDRESS 0x0000 /* @ECU_Address@rtDW_ADAS.GTVisObj5Orient@ */ /end MEASUREMENT
/begin MEASUREMENT rtDW_ADAS.GTVisObj5Zone "" UBYTE ADAS_CM_uint8 0 0 0 255 ECU_ADDRESS 0x0000 /* @ECU_Address@rtDW_ADAS.GTVisObj5Zone@ */ /end MEASUREMENT
/begin MEASUREMENT rtDW_ADAS.GTVisObj5_Type "" UBYTE ADAS_CM_uint8 0 0 0 255 MATRIX_DIM 1 1 ECU_ADDRESS 0x0000 /* @ECU_Address@rtDW_ADAS.GTVisObj5_Type@ */ /end MEASUREMENT
/begin MEASUREMENT rtDW_ADAS.GTVisObj6DistLong "" FLOAT32_IEEE ADAS_CM_single_m 0 0 -3.4E+38 3.4E+38 MATRIX_DIM 1 1 ECU_ADDRESS 0x0000 /* @ECU_Address@rtDW_ADAS.GTVisObj6DistLong@ */ /end MEASUREMENT
/begin MEASUREMENT rtDW_ADAS.GTVisObj6Orient "" UBYTE ADAS_CM_uint8 0 0 0 255 MATRIX_DIM 1 1 ECU_ADDRESS 0x0000 /* @ECU_Address@rtDW_ADAS.GTVisObj6Orient@ */ /end MEASUREMENT
/begin MEASUREMENT rtDW_ADAS.GTVisObj6Zone "" UBYTE ADAS_CM_uint8 0 0 0 255 ECU_ADDRESS 0x0000 /* @ECU_Address@rtDW_ADAS.GTVisObj6Zone@ */ /end MEASUREMENT
/begin MEASUREMENT rtDW_ADAS.GTVisObj6_Type "" UBYTE ADAS_CM_uint8 0 0 0 255 MATRIX_DIM 1 1 ECU_ADDRESS 0x0000 /* @ECU_Address@rtDW_ADAS.GTVisObj6_Type@ */ /end MEASUREMENT
/begin MEASUREMENT rtDW_ADAS.GTVisObj7DistLong "" FLOAT32_IEEE ADAS_CM_single_m 0 0 -3.4E+38 3.4E+38 MATRIX_DIM 1 1 ECU_ADDRESS 0x0000 /* @ECU_Address@rtDW_ADAS.GTVisObj7DistLong@ */ /end MEASUREMENT
/begin MEASUREMENT rtDW_ADAS.GTVisObj7Orient "" UBYTE ADAS_CM_uint8 0 0 0 255 MATRIX_DIM 1 1 ECU_ADDRESS 0x0000 /* @ECU_Address@rtDW_ADAS.GTVisObj7Orient@ */ /end MEASUREMENT
/begin MEASUREMENT rtDW_ADAS.GTVisObj7Zone "" UBYTE ADAS_CM_uint8 0 0 0 255 ECU_ADDRESS 0x0000 /* @ECU_Address@rtDW_ADAS.GTVisObj7Zone@ */ /end MEASUREMENT
/begin MEASUREMENT rtDW_ADAS.GTVisObj7_Type "" UBYTE ADAS_CM_uint8 0 0 0 255 MATRIX_DIM 1 1 ECU_ADDRESS 0x0000 /* @ECU_Address@rtDW_ADAS.GTVisObj7_Type@ */ /end MEASUREMENT
/begin MEASUREMENT rtDW_ADAS.GTVisObj8DistLong "" FLOAT32_IEEE ADAS_CM_single_m 0 0 -3.4E+38 3.4E+38 MATRIX_DIM 1 1 ECU_ADDRESS 0x0000 /* @ECU_Address@rtDW_ADAS.GTVisObj8DistLong@ */ /end MEASUREMENT
/begin MEASUREMENT rtDW_ADAS.GTVisObj8Orient "" UBYTE ADAS_CM_uint8 0 0 0 255 MATRIX_DIM 1 1 ECU_ADDRESS 0x0000 /* @ECU_Address@rtDW_ADAS.GTVisObj8Orient@ */ /end MEASUREMENT
/begin MEASUREMENT rtDW_ADAS.GTVisObj8Zone "" UBYTE ADAS_CM_uint8 0 0 0 255 ECU_ADDRESS 0x0000 /* @ECU_Address@rtDW_ADAS.GTVisObj8Zone@ */ /end MEASUREMENT
/begin MEASUREMENT rtDW_ADAS.GTVisObj8_Type "" UBYTE ADAS_CM_uint8 0 0 0 255 MATRIX_DIM 1 1 ECU_ADDRESS 0x0000 /* @ECU_Address@rtDW_ADAS.GTVisObj8_Type@ */ /end MEASUREMENT
/begin MEASUREMENT rtDW_ADAS.GTVisObj9DistLong "" FLOAT32_IEEE ADAS_CM_single_m 0 0 -3.4E+38 3.4E+38 MATRIX_DIM 1 1 ECU_ADDRESS 0x0000 /* @ECU_Address@rtDW_ADAS.GTVisObj9DistLong@ */ /end MEASUREMENT
/begin MEASUREMENT rtDW_ADAS.GTVisObj9Orient "" UBYTE ADAS_CM_uint8 0 0 0 255 MATRIX_DIM 1 1 ECU_ADDRESS 0x0000 /* @ECU_Address@rtDW_ADAS.GTVisObj9Orient@ */ /end MEASUREMENT
/begin MEASUREMENT rtDW_ADAS.GTVisObj9Zone "" UBYTE ADAS_CM_uint8 0 0 0 255 ECU_ADDRESS 0x0000 /* @ECU_Address@rtDW_ADAS.GTVisObj9Zone@ */ /end MEASUREMENT
/begin MEASUREMENT rtDW_ADAS.GTVisObj9_Type "" UBYTE ADAS_CM_uint8 0 0 0 255 MATRIX_DIM 1 1 ECU_ADDRESS 0x0000 /* @ECU_Address@rtDW_ADAS.GTVisObj9_Type@ */ /end MEASUREMENT
/begin MEASUREMENT rtDW_ADAS.GTVisObjDynam1ID "" UBYTE ADAS_CM_uint8 0 0 0 255 ECU_ADDRESS 0x0000 /* @ECU_Address@rtDW_ADAS.GTVisObjDynam1ID@ */ /end MEASUREMENT
/begin MEASUREMENT rtDW_ADAS.GTVisObjDynam2ID "" UBYTE ADAS_CM_uint8 0 0 0 255 ECU_ADDRESS 0x0000 /* @ECU_Address@rtDW_ADAS.GTVisObjDynam2ID@ */ /end MEASUREMENT
/begin MEASUREMENT rtDW_ADAS.GTVisObjDynam3ID "" UBYTE ADAS_CM_uint8 0 0 0 255 ECU_ADDRESS 0x0000 /* @ECU_Address@rtDW_ADAS.GTVisObjDynam3ID@ */ /end MEASUREMENT
/begin MEASUREMENT rtDW_ADAS.GTVisObjDynam4ID "" UBYTE ADAS_CM_uint8 0 0 0 255 ECU_ADDRESS 0x0000 /* @ECU_Address@rtDW_ADAS.GTVisObjDynam4ID@ */ /end MEASUREMENT
/begin MEASUREMENT rtDW_ADAS.GTVisObjDynam5ID "" UBYTE ADAS_CM_uint8 0 0 0 255 ECU_ADDRESS 0x0000 /* @ECU_Address@rtDW_ADAS.GTVisObjDynam5ID@ */ /end MEASUREMENT
/begin MEASUREMENT rtDW_ADAS.GTVisObjDynam6ID "" UBYTE ADAS_CM_uint8 0 0 0 255 ECU_ADDRESS 0x0000 /* @ECU_Address@rtDW_ADAS.GTVisObjDynam6ID@ */ /end MEASUREMENT
/begin MEASUREMENT rtDW_ADAS.GTVisObjDynam7ID "" UBYTE ADAS_CM_uint8 0 0 0 255 ECU_ADDRESS 0x0000 /* @ECU_Address@rtDW_ADAS.GTVisObjDynam7ID@ */ /end MEASUREMENT
/begin MEASUREMENT rtDW_ADAS.GTVisObjDynam8ID "" UBYTE ADAS_CM_uint8 0 0 0 255 ECU_ADDRESS 0x0000 /* @ECU_Address@rtDW_ADAS.GTVisObjDynam8ID@ */ /end MEASUREMENT
/begin MEASUREMENT rtDW_ADAS.GTVisObjDynam9ID "" UBYTE ADAS_CM_uint8 0 0 0 255 ECU_ADDRESS 0x0000 /* @ECU_Address@rtDW_ADAS.GTVisObjDynam9ID@ */ /end MEASUREMENT
/begin MEASUREMENT rtDW_ADAS.GTVisRoadAngleLvl "" UBYTE ADAS_CM_uint8 0 0 0 255 ECU_ADDRESS 0x0000 /* @ECU_Address@rtDW_ADAS.GTVisRoadAngleLvl@ */ /end MEASUREMENT
/begin MEASUREMENT rtDW_ADAS.GTWaitTime "" FLOAT64_IEEE ADAS_CM_double 0 0 -1.7E+308 1.7E+308 ECU_ADDRESS 0x0000 /* @ECU_Address@rtDW_ADAS.GTWaitTime@ */ /end MEASUREMENT
/begin MEASUREMENT rtDW_ADAS.GTWashCntF "" UBYTE ADAS_CM_uint8 0 0 0 255 ECU_ADDRESS 0x0000 /* @ECU_Address@rtDW_ADAS.GTWashCntF@ */ /end MEASUREMENT
/begin MEASUREMENT rtDW_ADAS.GTWashCntL "" UBYTE ADAS_CM_uint8 0 0 0 255 ECU_ADDRESS 0x0000 /* @ECU_Address@rtDW_ADAS.GTWashCntL@ */ /end MEASUREMENT
/begin MEASUREMENT rtDW_ADAS.GTWashCntT "" UBYTE ADAS_CM_uint8 0 0 0 255 ECU_ADDRESS 0x0000 /* @ECU_Address@rtDW_ADAS.GTWashCntT@ */ /end MEASUREMENT
/begin MEASUREMENT rtDW_ADAS.GTWsH "" UBYTE ADAS_CM_uint8 0 0 0 255 ECU_ADDRESS 0x0000 /* @ECU_Address@rtDW_ADAS.GTWsH@ */ /end MEASUREMENT
/begin MEASUREMENT rtDW_ADAS.GTis_Active "" UBYTE ADAS_CM_uint8 0 0 0 255 ECU_ADDRESS 0x0000 /* @ECU_Address@rtDW_ADAS.GTis_Active@ */ /end MEASUREMENT
/begin MEASUREMENT rtDW_ADAS.GTis_Active_Warning "" UBYTE ADAS_CM_uint8 0 0 0 255 ECU_ADDRESS 0x0000 /* @ECU_Address@rtDW_ADAS.GTis_Active_Warning@ */ /end MEASUREMENT
/begin MEASUREMENT rtDW_ADAS.GTis_Auto "" UBYTE ADAS_CM_uint8 0 0 0 255 ECU_ADDRESS 0x0000 /* @ECU_Address@rtDW_ADAS.GTis_Auto@ */ /end MEASUREMENT
/begin MEASUREMENT rtDW_ADAS.GTis_Dense "" UBYTE ADAS_CM_uint8 0 0 0 255 ECU_ADDRESS 0x0000 /* @ECU_Address@rtDW_ADAS.GTis_Dense@ */ /end MEASUREMENT
/begin MEASUREMENT rtDW_ADAS.GTis_Normal "" UBYTE ADAS_CM_uint8 0 0 0 255 ECU_ADDRESS 0x0000 /* @ECU_Address@rtDW_ADAS.GTis_Normal@ */ /end MEASUREMENT
/begin MEASUREMENT rtDW_ADAS.GTis_active_c100_ADAS "" UBYTE ADAS_CM_uint8 0 0 0 255 ECU_ADDRESS 0x0000 /* @ECU_Address@rtDW_ADAS.GTis_active_c100_ADAS@ */ /end MEASUREMENT
/begin MEASUREMENT rtDW_ADAS.GTis_active_c101_ADAS "" UBYTE ADAS_CM_uint8 0 0 0 255 ECU_ADDRESS 0x0000 /* @ECU_Address@rtDW_ADAS.GTis_active_c101_ADAS@ */ /end MEASUREMENT
/begin MEASUREMENT rtDW_ADAS.GTis_active_c102_ADAS "" UBYTE ADAS_CM_uint8 0 0 0 255 ECU_ADDRESS 0x0000 /* @ECU_Address@rtDW_ADAS.GTis_active_c102_ADAS@ */ /end MEASUREMENT
/begin MEASUREMENT rtDW_ADAS.GTis_active_c633_ADAS "" UBYTE ADAS_CM_uint8 0 0 0 255 ECU_ADDRESS 0x0000 /* @ECU_Address@rtDW_ADAS.GTis_active_c633_ADAS@ */ /end MEASUREMENT
/begin MEASUREMENT rtDW_ADAS.GTis_active_c90_ADAS "" UBYTE ADAS_CM_uint8 0 0 0 255 ECU_ADDRESS 0x0000 /* @ECU_Address@rtDW_ADAS.GTis_active_c90_ADAS@ */ /end MEASUREMENT
/begin MEASUREMENT rtDW_ADAS.GTis_active_c94_ADAS "" UBYTE ADAS_CM_uint8 0 0 0 255 ECU_ADDRESS 0x0000 /* @ECU_Address@rtDW_ADAS.GTis_active_c94_ADAS@ */ /end MEASUREMENT
/begin MEASUREMENT rtDW_ADAS.GTis_active_c95_ADAS "" UBYTE ADAS_CM_uint8 0 0 0 255 ECU_ADDRESS 0x0000 /* @ECU_Address@rtDW_ADAS.GTis_active_c95_ADAS@ */ /end MEASUREMENT
/begin MEASUREMENT rtDW_ADAS.GTis_active_c96_ADAS "" UBYTE ADAS_CM_uint8 0 0 0 255 ECU_ADDRESS 0x0000 /* @ECU_Address@rtDW_ADAS.GTis_active_c96_ADAS@ */ /end MEASUREMENT
/begin MEASUREMENT rtDW_ADAS.GTis_active_c98_ADAS "" UBYTE ADAS_CM_uint8 0 0 0 255 ECU_ADDRESS 0x0000 /* @ECU_Address@rtDW_ADAS.GTis_active_c98_ADAS@ */ /end MEASUREMENT
/begin MEASUREMENT rtDW_ADAS.GTis_active_c99_ADAS "" UBYTE ADAS_CM_uint8 0 0 0 255 ECU_ADDRESS 0x0000 /* @ECU_Address@rtDW_ADAS.GTis_active_c99_ADAS@ */ /end MEASUREMENT
/begin MEASUREMENT rtDW_ADAS.GTis_c100_ADAS "" UBYTE ADAS_CM_uint8 0 0 0 255 ECU_ADDRESS 0x0000 /* @ECU_Address@rtDW_ADAS.GTis_c100_ADAS@ */ /end MEASUREMENT
/begin MEASUREMENT rtDW_ADAS.GTis_c101_ADAS "" UBYTE ADAS_CM_uint8 0 0 0 255 ECU_ADDRESS 0x0000 /* @ECU_Address@rtDW_ADAS.GTis_c101_ADAS@ */ /end MEASUREMENT
/begin MEASUREMENT rtDW_ADAS.GTis_c102_ADAS "" UBYTE ADAS_CM_uint8 0 0 0 255 ECU_ADDRESS 0x0000 /* @ECU_Address@rtDW_ADAS.GTis_c102_ADAS@ */ /end MEASUREMENT
/begin MEASUREMENT rtDW_ADAS.GTis_c633_ADAS "" UBYTE ADAS_CM_uint8 0 0 0 255 ECU_ADDRESS 0x0000 /* @ECU_Address@rtDW_ADAS.GTis_c633_ADAS@ */ /end MEASUREMENT
/begin MEASUREMENT rtDW_ADAS.GTis_c90_ADAS "" UBYTE ADAS_CM_uint8 0 0 0 255 ECU_ADDRESS 0x0000 /* @ECU_Address@rtDW_ADAS.GTis_c90_ADAS@ */ /end MEASUREMENT
/begin MEASUREMENT rtDW_ADAS.GTis_c94_ADAS "" UBYTE ADAS_CM_uint8 0 0 0 255 ECU_ADDRESS 0x0000 /* @ECU_Address@rtDW_ADAS.GTis_c94_ADAS@ */ /end MEASUREMENT
/begin MEASUREMENT rtDW_ADAS.GTis_c95_ADAS "" UBYTE ADAS_CM_uint8 0 0 0 255 ECU_ADDRESS 0x0000 /* @ECU_Address@rtDW_ADAS.GTis_c95_ADAS@ */ /end MEASUREMENT
/begin MEASUREMENT rtDW_ADAS.GTis_c96_ADAS "" UBYTE ADAS_CM_uint8 0 0 0 255 ECU_ADDRESS 0x0000 /* @ECU_Address@rtDW_ADAS.GTis_c96_ADAS@ */ /end MEASUREMENT
/begin MEASUREMENT rtDW_ADAS.GTis_c98_ADAS "" UBYTE ADAS_CM_uint8 0 0 0 255 ECU_ADDRESS 0x0000 /* @ECU_Address@rtDW_ADAS.GTis_c98_ADAS@ */ /end MEASUREMENT
/begin MEASUREMENT rtDW_ADAS.GTis_c99_ADAS "" UBYTE ADAS_CM_uint8 0 0 0 255 ECU_ADDRESS 0x0000 /* @ECU_Address@rtDW_ADAS.GTis_c99_ADAS@ */ /end MEASUREMENT
/begin MEASUREMENT rtDW_ADAS.GTmLEDTargetLed.MliaRADBLED1 "" UBYTE ADAS_CM_uint8 0 0 0 255 ECU_ADDRESS 0x0000 /* @ECU_Address@rtDW_ADAS.GTmLEDTargetLed.MliaRADBLED1@ */ /end MEASUREMENT
/begin MEASUREMENT rtDW_ADAS.GTmLEDTargetLed.MliaRADBLED10 "" UBYTE ADAS_CM_uint8 0 0 0 255 ECU_ADDRESS 0x0000 /* @ECU_Address@rtDW_ADAS.GTmLEDTargetLed.MliaRADBLED10@ */ /end MEASUREMENT
/begin MEASUREMENT rtDW_ADAS.GTmLEDTargetLed.MliaRADBLED11 "" UBYTE ADAS_CM_uint8 0 0 0 255 ECU_ADDRESS 0x0000 /* @ECU_Address@rtDW_ADAS.GTmLEDTargetLed.MliaRADBLED11@ */ /end MEASUREMENT
/begin MEASUREMENT rtDW_ADAS.GTmLEDTargetLed.MliaRADBLED12 "" UBYTE ADAS_CM_uint8 0 0 0 255 ECU_ADDRESS 0x0000 /* @ECU_Address@rtDW_ADAS.GTmLEDTargetLed.MliaRADBLED12@ */ /end MEASUREMENT
/begin MEASUREMENT rtDW_ADAS.GTmLEDTargetLed.MliaRADBLED13 "" UBYTE ADAS_CM_uint8 0 0 0 255 ECU_ADDRESS 0x0000 /* @ECU_Address@rtDW_ADAS.GTmLEDTargetLed.MliaRADBLED13@ */ /end MEASUREMENT
/begin MEASUREMENT rtDW_ADAS.GTmLEDTargetLed.MliaRADBLED14 "" UBYTE ADAS_CM_uint8 0 0 0 255 ECU_ADDRESS 0x0000 /* @ECU_Address@rtDW_ADAS.GTmLEDTargetLed.MliaRADBLED14@ */ /end MEASUREMENT
/begin MEASUREMENT rtDW_ADAS.GTmLEDTargetLed.MliaRADBLED15 "" UBYTE ADAS_CM_uint8 0 0 0 255 ECU_ADDRESS 0x0000 /* @ECU_Address@rtDW_ADAS.GTmLEDTargetLed.MliaRADBLED15@ */ /end MEASUREMENT
/begin MEASUREMENT rtDW_ADAS.GTmLEDTargetLed.MliaRADBLED16 "" UBYTE ADAS_CM_uint8 0 0 0 255 ECU_ADDRESS 0x0000 /* @ECU_Address@rtDW_ADAS.GTmLEDTargetLed.MliaRADBLED16@ */ /end MEASUREMENT
/begin MEASUREMENT rtDW_ADAS.GTmLEDTargetLed.MliaRADBLED17 "" UBYTE ADAS_CM_uint8 0 0 0 255 ECU_ADDRESS 0x0000 /* @ECU_Address@rtDW_ADAS.GTmLEDTargetLed.MliaRADBLED17@ */ /end MEASUREMENT
/begin MEASUREMENT rtDW_ADAS.GTmLEDTargetLed.MliaRADBLED18 "" UBYTE ADAS_CM_uint8 0 0 0 255 ECU_ADDRESS 0x0000 /* @ECU_Address@rtDW_ADAS.GTmLEDTargetLed.MliaRADBLED18@ */ /end MEASUREMENT
/begin MEASUREMENT rtDW_ADAS.GTmLEDTargetLed.MliaRADBLED2 "" UBYTE ADAS_CM_uint8 0 0 0 255 ECU_ADDRESS 0x0000 /* @ECU_Address@rtDW_ADAS.GTmLEDTargetLed.MliaRADBLED2@ */ /end MEASUREMENT
/begin MEASUREMENT rtDW_ADAS.GTmLEDTargetLed.MliaRADBLED3 "" UBYTE ADAS_CM_uint8 0 0 0 255 ECU_ADDRESS 0x0000 /* @ECU_Address@rtDW_ADAS.GTmLEDTargetLed.MliaRADBLED3@ */ /end MEASUREMENT
/begin MEASUREMENT rtDW_ADAS.GTmLEDTargetLed.MliaRADBLED4 "" UBYTE ADAS_CM_uint8 0 0 0 255 ECU_ADDRESS 0x0000 /* @ECU_Address@rtDW_ADAS.GTmLEDTargetLed.MliaRADBLED4@ */ /end MEASUREMENT
/begin MEASUREMENT rtDW_ADAS.GTmLEDTargetLed.MliaRADBLED5 "" UBYTE ADAS_CM_uint8 0 0 0 255 ECU_ADDRESS 0x0000 /* @ECU_Address@rtDW_ADAS.GTmLEDTargetLed.MliaRADBLED5@ */ /end MEASUREMENT
/begin MEASUREMENT rtDW_ADAS.GTmLEDTargetLed.MliaRADBLED6 "" UBYTE ADAS_CM_uint8 0 0 0 255 ECU_ADDRESS 0x0000 /* @ECU_Address@rtDW_ADAS.GTmLEDTargetLed.MliaRADBLED6@ */ /end MEASUREMENT
/begin MEASUREMENT rtDW_ADAS.GTmLEDTargetLed.MliaRADBLED7 "" UBYTE ADAS_CM_uint8 0 0 0 255 ECU_ADDRESS 0x0000 /* @ECU_Address@rtDW_ADAS.GTmLEDTargetLed.MliaRADBLED7@ */ /end MEASUREMENT
/begin MEASUREMENT rtDW_ADAS.GTmLEDTargetLed.MliaRADBLED8 "" UBYTE ADAS_CM_uint8 0 0 0 255 ECU_ADDRESS 0x0000 /* @ECU_Address@rtDW_ADAS.GTmLEDTargetLed.MliaRADBLED8@ */ /end MEASUREMENT
/begin MEASUREMENT rtDW_ADAS.GTmLEDTargetLed.MliaRADBLED9 "" UBYTE ADAS_CM_uint8 0 0 0 255 ECU_ADDRESS 0x0000 /* @ECU_Address@rtDW_ADAS.GTmLEDTargetLed.MliaRADBLED9@ */ /end MEASUREMENT
/begin MEASUREMENT rtDW_ADAS.GTmLEDTargetLed_a.MliaLADBLED1 "" UBYTE ADAS_CM_uint8 0 0 0 255 ECU_ADDRESS 0x0000 /* @ECU_Address@rtDW_ADAS.GTmLEDTargetLed_a.MliaLADBLED1@ */ /end MEASUREMENT
/begin MEASUREMENT rtDW_ADAS.GTmLEDTargetLed_a.MliaLADBLED10 "" UBYTE ADAS_CM_uint8 0 0 0 255 ECU_ADDRESS 0x0000 /* @ECU_Address@rtDW_ADAS.GTmLEDTargetLed_a.MliaLADBLED10@ */ /end MEASUREMENT
/begin MEASUREMENT rtDW_ADAS.GTmLEDTargetLed_a.MliaLADBLED11 "" UBYTE ADAS_CM_uint8 0 0 0 255 ECU_ADDRESS 0x0000 /* @ECU_Address@rtDW_ADAS.GTmLEDTargetLed_a.MliaLADBLED11@ */ /end MEASUREMENT
/begin MEASUREMENT rtDW_ADAS.GTmLEDTargetLed_a.MliaLADBLED12 "" UBYTE ADAS_CM_uint8 0 0 0 255 ECU_ADDRESS 0x0000 /* @ECU_Address@rtDW_ADAS.GTmLEDTargetLed_a.MliaLADBLED12@ */ /end MEASUREMENT
/begin MEASUREMENT rtDW_ADAS.GTmLEDTargetLed_a.MliaLADBLED13 "" UBYTE ADAS_CM_uint8 0 0 0 255 ECU_ADDRESS 0x0000 /* @ECU_Address@rtDW_ADAS.GTmLEDTargetLed_a.MliaLADBLED13@ */ /end MEASUREMENT
/begin MEASUREMENT rtDW_ADAS.GTmLEDTargetLed_a.MliaLADBLED14 "" UBYTE ADAS_CM_uint8 0 0 0 255 ECU_ADDRESS 0x0000 /* @ECU_Address@rtDW_ADAS.GTmLEDTargetLed_a.MliaLADBLED14@ */ /end MEASUREMENT
/begin MEASUREMENT rtDW_ADAS.GTmLEDTargetLed_a.MliaLADBLED15 "" UBYTE ADAS_CM_uint8 0 0 0 255 ECU_ADDRESS 0x0000 /* @ECU_Address@rtDW_ADAS.GTmLEDTargetLed_a.MliaLADBLED15@ */ /end MEASUREMENT
/begin MEASUREMENT rtDW_ADAS.GTmLEDTargetLed_a.MliaLADBLED16 "" UBYTE ADAS_CM_uint8 0 0 0 255 ECU_ADDRESS 0x0000 /* @ECU_Address@rtDW_ADAS.GTmLEDTargetLed_a.MliaLADBLED16@ */ /end MEASUREMENT
/begin MEASUREMENT rtDW_ADAS.GTmLEDTargetLed_a.MliaLADBLED17 "" UBYTE ADAS_CM_uint8 0 0 0 255 ECU_ADDRESS 0x0000 /* @ECU_Address@rtDW_ADAS.GTmLEDTargetLed_a.MliaLADBLED17@ */ /end MEASUREMENT
/begin MEASUREMENT rtDW_ADAS.GTmLEDTargetLed_a.MliaLADBLED18 "" UBYTE ADAS_CM_uint8 0 0 0 255 ECU_ADDRESS 0x0000 /* @ECU_Address@rtDW_ADAS.GTmLEDTargetLed_a.MliaLADBLED18@ */ /end MEASUREMENT
/begin MEASUREMENT rtDW_ADAS.GTmLEDTargetLed_a.MliaLADBLED2 "" UBYTE ADAS_CM_uint8 0 0 0 255 ECU_ADDRESS 0x0000 /* @ECU_Address@rtDW_ADAS.GTmLEDTargetLed_a.MliaLADBLED2@ */ /end MEASUREMENT
/begin MEASUREMENT rtDW_ADAS.GTmLEDTargetLed_a.MliaLADBLED3 "" UBYTE ADAS_CM_uint8 0 0 0 255 ECU_ADDRESS 0x0000 /* @ECU_Address@rtDW_ADAS.GTmLEDTargetLed_a.MliaLADBLED3@ */ /end MEASUREMENT
/begin MEASUREMENT rtDW_ADAS.GTmLEDTargetLed_a.MliaLADBLED4 "" UBYTE ADAS_CM_uint8 0 0 0 255 ECU_ADDRESS 0x0000 /* @ECU_Address@rtDW_ADAS.GTmLEDTargetLed_a.MliaLADBLED4@ */ /end MEASUREMENT
/begin MEASUREMENT rtDW_ADAS.GTmLEDTargetLed_a.MliaLADBLED5 "" UBYTE ADAS_CM_uint8 0 0 0 255 ECU_ADDRESS 0x0000 /* @ECU_Address@rtDW_ADAS.GTmLEDTargetLed_a.MliaLADBLED5@ */ /end MEASUREMENT
/begin MEASUREMENT rtDW_ADAS.GTmLEDTargetLed_a.MliaLADBLED6 "" UBYTE ADAS_CM_uint8 0 0 0 255 ECU_ADDRESS 0x0000 /* @ECU_Address@rtDW_ADAS.GTmLEDTargetLed_a.MliaLADBLED6@ */ /end MEASUREMENT
/begin MEASUREMENT rtDW_ADAS.GTmLEDTargetLed_a.MliaLADBLED7 "" UBYTE ADAS_CM_uint8 0 0 0 255 ECU_ADDRESS 0x0000 /* @ECU_Address@rtDW_ADAS.GTmLEDTargetLed_a.MliaLADBLED7@ */ /end MEASUREMENT
/begin MEASUREMENT rtDW_ADAS.GTmLEDTargetLed_a.MliaLADBLED8 "" UBYTE ADAS_CM_uint8 0 0 0 255 ECU_ADDRESS 0x0000 /* @ECU_Address@rtDW_ADAS.GTmLEDTargetLed_a.MliaLADBLED8@ */ /end MEASUREMENT
/begin MEASUREMENT rtDW_ADAS.GTmLEDTargetLed_a.MliaLADBLED9 "" UBYTE ADAS_CM_uint8 0 0 0 255 ECU_ADDRESS 0x0000 /* @ECU_Address@rtDW_ADAS.GTmLEDTargetLed_a.MliaLADBLED9@ */ /end MEASUREMENT
/begin MEASUREMENT rtDW_ADAS.GTtemporalCounter_i1 "" ULONG ADAS_CM_uint32 0 0 0 4294967295 ECU_ADDRESS 0x0000 /* @ECU_Address@rtDW_ADAS.GTtemporalCounter_i1@ */ /end MEASUREMENT
/begin MEASUREMENT rtDW_ADAS.GTtemporalCounter_i1_a "" ULONG ADAS_CM_uint32 0 0 0 4294967295 ECU_ADDRESS 0x0000 /* @ECU_Address@rtDW_ADAS.GTtemporalCounter_i1_a@ */ /end MEASUREMENT
/begin MEASUREMENT rtDW_ADAS.GTtemporalCounter_i1_ag "" UWORD ADAS_CM_uint16 0 0 0 65535 ECU_ADDRESS 0x0000 /* @ECU_Address@rtDW_ADAS.GTtemporalCounter_i1_ag@ */ /end MEASUREMENT
/begin MEASUREMENT rtDW_ADAS.GTtemporalCounter_i1_dd "" UBYTE ADAS_CM_uint8 0 0 0 255 ECU_ADDRESS 0x0000 /* @ECU_Address@rtDW_ADAS.GTtemporalCounter_i1_dd@ */ /end MEASUREMENT
/begin MEASUREMENT rtDW_ADAS.GTtemporalCounter_i1_dr "" UBYTE ADAS_CM_uint8 0 0 0 255 ECU_ADDRESS 0x0000 /* @ECU_Address@rtDW_ADAS.GTtemporalCounter_i1_dr@ */ /end MEASUREMENT
/begin MEASUREMENT rtDW_ADAS.GTtemporalCounter_i1_hp "" UBYTE ADAS_CM_uint8 0 0 0 255 ECU_ADDRESS 0x0000 /* @ECU_Address@rtDW_ADAS.GTtemporalCounter_i1_hp@ */ /end MEASUREMENT
/begin MEASUREMENT rtDW_ADAS.GTtemporalCounter_i1_ly "" UBYTE ADAS_CM_uint8 0 0 0 255 ECU_ADDRESS 0x0000 /* @ECU_Address@rtDW_ADAS.GTtemporalCounter_i1_ly@ */ /end MEASUREMENT
/begin MEASUREMENT rtDW_ADAS.GTtemporalCounter_i1_o "" ULONG ADAS_CM_uint32 0 0 0 4294967295 ECU_ADDRESS 0x0000 /* @ECU_Address@rtDW_ADAS.GTtemporalCounter_i1_o@ */ /end MEASUREMENT
/begin AXIS_PTS TimeOverBkPoint "Time Over Break Point" 0x0000 /* @ECU_Address@TimeOverBkPoint@ */ NO_INPUT_QUANTITY Axis_FLOAT32_IEEE 0 ADAS_CM_single 21 0.000000 300.000000 /end AXIS_PTS
/begin COMPU_METHOD ADAS_CM_double "" IDENTICAL "%15.10" "" /end COMPU_METHOD
/begin COMPU_METHOD ADAS_CM_logical "" IDENTICAL "%1.0" "" /end COMPU_METHOD
/begin COMPU_METHOD ADAS_CM_single "" IDENTICAL "%8.6" "" /end COMPU_METHOD
/begin COMPU_METHOD ADAS_CM_single_km_per_h "" IDENTICAL "%8.6" "km/h" /end COMPU_METHOD
/begin COMPU_METHOD ADAS_CM_single_m "" IDENTICAL "%8.6" "m" /end COMPU_METHOD
/begin COMPU_METHOD ADAS_CM_single_m_per_s "" IDENTICAL "%8.6" "m/s" /end COMPU_METHOD
/begin COMPU_METHOD ADAS_CM_single_s "" IDENTICAL "%8.6" "s" /end COMPU_METHOD
/begin COMPU_METHOD ADAS_CM_uint16 "" IDENTICAL "%5.0" "" /end COMPU_METHOD
/begin COMPU_METHOD ADAS_CM_uint32 "" IDENTICAL "%10.0" "" /end COMPU_METHOD
/begin COMPU_METHOD ADAS_CM_uint8 "" IDENTICAL "%3.0" "" /end COMPU_METHOD
/begin COMPU_METHOD ADAS_CM_uint8_km_per_h "" IDENTICAL "%3.0" "km/h" /end COMPU_METHOD
/begin COMPU_METHOD ADAS_CM_uint8_percent_ "" IDENTICAL "%3.0" "%" /end COMPU_METHOD
/begin RECORD_LAYOUT FixLookup_FLOAT32_IEEE FNC_VALUES 1 FLOAT32_IEEE COLUMN_DIR DIRECT /end RECORD_LAYOUT
/begin RECORD_LAYOUT Lookup1D_FLOAT32_IEEE FNC_VALUES 1 FLOAT32_IEEE COLUMN_DIR DIRECT /end RECORD_LAYOUT
/begin RECORD_LAYOUT Scalar_BOOLEAN FNC_VALUES 1 UBYTE COLUMN_DIR DIRECT /end RECORD_LAYOUT
/begin RECORD_LAYOUT Scalar_FLOAT32_IEEE FNC_VALUES 1 FLOAT32_IEEE COLUMN_DIR DIRECT /end RECORD_LAYOUT
/begin RECORD_LAYOUT Scalar_UBYTE FNC_VALUES 1 UBYTE COLUMN_DIR DIRECT /end RECORD_LAYOUT
/begin RECORD_LAYOUT Axis_FLOAT32_IEEE AXIS_PTS_X 1 FLOAT32_IEEE INDEX_INCR DIRECT /end RECORD_LAYOUT
/begin GROUP ADAS_Output_new_VISUAL "ADAS/Output_new/VISUAL"
 /begin REF_MEASUREMENT DtDiagVerDateModelVisual DtDiagVerNumModelVISUAL DtLogVisualErrCode DtLogVisualErrFlag DtLogVisualLogicTrans DtLogVisualSolverTrans VisAccSetDist VisAccTargetObj VisAebTargetObj VisEgoZone VisFcwTargetObj VisLaneLLType VisLaneLType VisLaneRRType VisLaneRType VisLccLeftLane VisLccRightLane VisLdwLeftLine VisLdwRightLine VisLkaAct VisObj1DistLong VisObj1Orient VisObj1Zone VisObj1_Type VisObj2DistLong VisObj2Orient VisObj2Zone VisObj2_Type VisObj3DistLong VisObj3Orient VisObj3Zone VisObj3_Type VisObj4DistLong VisObj4Orient VisObj4Zone VisObj4_Type VisObj5DistLong VisObj5Orient VisObj5Zone VisObj5_Type VisObj6DistLong VisObj6Orient VisObj6Zone VisObj6_Type VisObj7DistLong VisObj7Orient VisObj7Zone VisObj7_Type VisObj8DistLong VisObj8Orient VisObj8Zone VisObj8_Type VisObj9DistLong VisObj9Orient VisObj9Zone VisObj9_Type VisObjDynam1ID VisObjDynam2ID VisObjDynam3ID VisObjDynam4ID VisObjDynam5ID VisObjDynam6ID VisObjDynam7ID VisObjDynam8ID VisObjDynam9ID VisRoadAngleLvl rtDW_ADAS.GTVisEgoZone rtDW_ADAS.GTVisLaneLType rtDW_ADAS.GTVisLaneRType rtDW_ADAS.GTVisObj1DistLong rtDW_ADAS.GTVisObj1Orient rtDW_ADAS.GTVisObj1Zone rtDW_ADAS.GTVisObj1_Type rtDW_ADAS.GTVisObj2DistLong rtDW_ADAS.GTVisObj2Orient rtDW_ADAS.GTVisObj2Zone rtDW_ADAS.GTVisObj2_Type rtDW_ADAS.GTVisObj3DistLong rtDW_ADAS.GTVisObj3Orient rtDW_ADAS.GTVisObj3Zone rtDW_ADAS.GTVisObj3_Type rtDW_ADAS.GTVisObj4DistLong rtDW_ADAS.GTVisObj4Orient rtDW_ADAS.GTVisObj4Zone rtDW_ADAS.GTVisObj4_Type rtDW_ADAS.GTVisObj5DistLong rtDW_ADAS.GTVisObj5Orient rtDW_ADAS.GTVisObj5Zone rtDW_ADAS.GTVisObj5_Type rtDW_ADAS.GTVisObj6DistLong rtDW_ADAS.GTVisObj6Orient rtDW_ADAS.GTVisObj6Zone rtDW_ADAS.GTVisObj6_Type rtDW_ADAS.GTVisObj7DistLong rtDW_ADAS.GTVisObj7Orient rtDW_ADAS.GTVisObj7Zone rtDW_ADAS.GTVisObj7_Type rtDW_ADAS.GTVisObj8DistLong rtDW_ADAS.GTVisObj8Orient rtDW_ADAS.GTVisObj8Zone rtDW_ADAS.GTVisObj8_Type rtDW_ADAS.GTVisObj9DistLong rtDW_ADAS.GTVisObj9Orient rtDW_ADAS.GTVisObj9Zone rtDW_ADAS.GTVisObj9_Type rtDW_ADAS.GTVisObjDynam1ID rtDW_ADAS.GTVisObjDynam2ID rtDW_ADAS.GTVisObjDynam3ID rtDW_ADAS.GTVisObjDynam4ID rtDW_ADAS.GTVisObjDynam5ID rtDW_ADAS.GTVisObjDynam6ID rtDW_ADAS.GTVisObjDynam7ID rtDW_ADAS.GTVisObjDynam8ID rtDW_ADAS.GTVisObjDynam9ID rtDW_ADAS.GTVisRoadAngleLvl /end REF_MEASUREMENT
/end GROUP
/begin GROUP ADAS_Output_new_VLC_OUT "ADAS/Output_new/VLC_OUT"
 /begin REF_MEASUREMENT AccActive AccelReq CruiseControlType DriveOffReq SpeedTarget StandStillReq VlcActive VlcTrqActive /end REF_MEASUREMENT
/end GROUP
/begin GROUP ADAS_Output_new_Vibration_Manager "ADAS/Output_new/Vibration
Manager" /begin REF_MEASUREMENT AdasAvailMode SensSteerWhLvl SensSteerWhVibrReq /end REF_MEASUREMENT /end GROUP
/begin GROUP ADAS_ServiceManager "ADAS/ServiceManager"
 /begin SUB_GROUP ADAS_ServiceManager_Neural_PowerManager ADAS_ServiceManager_SensManager /end SUB_GROUP
/end GROUP
/begin GROUP ADAS_ServiceManager_Neural_PowerManager "ADAS/ServiceManager/Neural+PowerManager" /begin REF_MEASUREMENT rtDW_ADAS.GTis_active_c633_ADAS rtDW_ADAS.GTis_c633_ADAS /end REF_MEASUREMENT /end GROUP
/begin GROUP ADAS_ServiceManager_SensManager "ADAS/ServiceManager/SensManager" /begin SUB_GROUP ADAS_ServiceManager_SensManager_Sens_08_05_24 /end SUB_GROUP /end GROUP
/begin GROUP ADAS_ServiceManager_SensManager_Sens_08_05_24 "ADAS/ServiceManager/SensManager/Sens_08.05.24"
 /begin SUB_GROUP ADAS_ServiceManager_SensManager_Sens_08_05_24_HCS_02_05_24 ADAS_ServiceManager_SensManager_Sens_08_05_24_USSM_06_05_24 ADAS_ServiceManager_SensManager_Sens_08_05_24_WFS_08_05_24 /end SUB_GROUP
/end GROUP
/begin GROUP ADAS_ServiceManager_SensManager_Sens_08_05_24_HCS_02_05_24 "ADAS/ServiceManager/SensManager/Sens_08.05.24/HCS_02.05.24"
 /begin SUB_GROUP ADAS_ServiceManager_SensManager_Sens_08_05_24_HCS_02_05_24_Subsystem ADAS_ServiceManager_SensManager_Sens_08_05_24_HCS_02_05_24_Subsystem1 /end SUB_GROUP
 /begin REF_MEASUREMENT rtDW_ADAS.GTCntHeat rtDW_ADAS.GTRD rtDW_ADAS.GTWaitTime rtDW_ADAS.GTWsH rtDW_ADAS.GTis_Active_Warning rtDW_ADAS.GTis_Auto rtDW_ADAS.GTis_active_c90_ADAS rtDW_ADAS.GTis_active_c94_ADAS rtDW_ADAS.GTis_c90_ADAS rtDW_ADAS.GTis_c94_ADAS rtDW_ADAS.GTtemporalCounter_i1_a rtDW_ADAS.GTtemporalCounter_i1_o /end REF_MEASUREMENT
/end GROUP
/begin GROUP ADAS_ServiceManager_SensManager_Sens_08_05_24_HCS_02_05_24_Subsystem "ADAS/ServiceManager/SensManager/Sens_08.05.24/HCS_02.05.24/Subsystem"
 /begin REF_MEASUREMENT rtDW_ADAS.GTRD rtDW_ADAS.GTis_active_c95_ADAS rtDW_ADAS.GTis_c95_ADAS rtDW_ADAS.GTtemporalCounter_i1_ag /end REF_MEASUREMENT
/end GROUP
/begin GROUP ADAS_ServiceManager_SensManager_Sens_08_05_24_HCS_02_05_24_Subsystem1 "ADAS/ServiceManager/SensManager/Sens_08.05.24/HCS_02.05.24/Subsystem1"
 /begin REF_MEASUREMENT rtDW_ADAS.GTTd rtDW_ADAS.GTis_active_c96_ADAS rtDW_ADAS.GTis_c96_ADAS /end REF_MEASUREMENT
/end GROUP
/begin GROUP ADAS_ServiceManager_SensManager_Sens_08_05_24_USSM_06_05_24 "ADAS/ServiceManager/SensManager/Sens_08.05.24/USSM_06.05.24"
 /begin SUB_GROUP ADAS_ServiceManager_SensManager_Sens_08_05_24_USSM_06_05_24_Compare_To_Constant ADAS_ServiceManager_SensManager_Sens_08_05_24_USSM_06_05_24_Compare_To_Constant1 ADAS_ServiceManager_SensManager_Sens_08_05_24_USSM_06_05_24_Compare_To_Constant2 ADAS_ServiceManager_SensManager_Sens_08_05_24_USSM_06_05_24_Compare_To_Constant3 ADAS_ServiceManager_SensManager_Sens_08_05_24_USSM_06_05_24_Compare_To_Constant4 ADAS_ServiceManager_SensManager_Sens_08_05_24_USSM_06_05_24_Compare_To_Constant5 /end SUB_GROUP
 /begin REF_MEASUREMENT rtConstB_ADAS.GTCompare_c rtConstB_ADAS.GTCompare_k rtConstB_ADAS.GTCompare_l rtConstB_ADAS.GTCompare_p rtConstB_ADAS.GTLogicalOperator1 rtConstB_ADAS.GTLogicalOperator3 rtConstB_ADAS.GTLogicalOperator5 rtDW_ADAS.GTRelay_Mode_a /end REF_MEASUREMENT
/end GROUP
/begin GROUP ADAS_ServiceManager_SensManager_Sens_08_05_24_USSM_06_05_24_Compare_To_Constant "ADAS/ServiceManager/SensManager/Sens_08.05.24/USSM_06.05.24/Compare
To Constant" /begin REF_MEASUREMENT rtConstB_ADAS.GTCompare_c /end REF_MEASUREMENT /end GROUP
/begin GROUP ADAS_ServiceManager_SensManager_Sens_08_05_24_USSM_06_05_24_Compare_To_Constant2 "ADAS/ServiceManager/SensManager/Sens_08.05.24/USSM_06.05.24/Compare
To Constant2" /begin REF_MEASUREMENT rtConstB_ADAS.GTCompare_l /end REF_MEASUREMENT /end GROUP
/begin GROUP ADAS_ServiceManager_SensManager_Sens_08_05_24_USSM_06_05_24_Compare_To_Constant4 "ADAS/ServiceManager/SensManager/Sens_08.05.24/USSM_06.05.24/Compare
To Constant4" /begin REF_MEASUREMENT rtConstB_ADAS.GTCompare_k /end REF_MEASUREMENT /end GROUP
/begin GROUP ADAS_ServiceManager_SensManager_Sens_08_05_24_USSM_06_05_24_Compare_To_Constant5 "ADAS/ServiceManager/SensManager/Sens_08.05.24/USSM_06.05.24/Compare
To Constant5" /begin REF_MEASUREMENT rtConstB_ADAS.GTCompare_p /end REF_MEASUREMENT /end GROUP
/begin GROUP ADAS_ServiceManager_SensManager_Sens_08_05_24_WFS_08_05_24 "ADAS/ServiceManager/SensManager/Sens_08.05.24/WFS_08.05.24"
 /begin SUB_GROUP ADAS_ServiceManager_SensManager_Sens_08_05_24_WFS_08_05_24_Wash_Degradation_23_10_24 /end SUB_GROUP
 /begin REF_MEASUREMENT rtDW_ADAS.GTNvLog rtDW_ADAS.GTWashCntF rtDW_ADAS.GTWashCntL rtDW_ADAS.GTWashCntT rtDW_ADAS.GTis_Active rtDW_ADAS.GTis_Dense rtDW_ADAS.GTis_Normal rtDW_ADAS.GTis_active_c98_ADAS rtDW_ADAS.GTis_active_c99_ADAS rtDW_ADAS.GTis_c98_ADAS rtDW_ADAS.GTis_c99_ADAS rtDW_ADAS.GTtemporalCounter_i1 rtDW_ADAS.GTtemporalCounter_i1_dd /end REF_MEASUREMENT
/end GROUP
/begin GROUP ADAS_ServiceManager_SensManager_Sens_08_05_24_WFS_08_05_24_Wash_Degradation_23_10_24 "ADAS/ServiceManager/SensManager/Sens_08.05.24/WFS_08.05.24/Wash Degradation_23.10.24"
 /begin REF_MEASUREMENT rtDW_ADAS.GTBlkCnt rtDW_ADAS.GTBlkCnt_c rtDW_ADAS.GTBlkCnt_k rtDW_ADAS.GTMemory4_PreviousInput_j rtDW_ADAS.GTMemory5_PreviousInput_i rtDW_ADAS.GTMemory_PreviousInput_j rtDW_ADAS.GTWashCntF rtDW_ADAS.GTWashCntL rtDW_ADAS.GTWashCntT rtDW_ADAS.GTis_active_c100_ADAS rtDW_ADAS.GTis_active_c101_ADAS rtDW_ADAS.GTis_active_c102_ADAS rtDW_ADAS.GTis_c100_ADAS rtDW_ADAS.GTis_c101_ADAS rtDW_ADAS.GTis_c102_ADAS rtDW_ADAS.GTtemporalCounter_i1_dr rtDW_ADAS.GTtemporalCounter_i1_hp rtDW_ADAS.GTtemporalCounter_i1_ly /end REF_MEASUREMENT
/end GROUP
/begin GROUP rtDW_ADAS.GTAngleDetect ""
 /begin SUB_GROUP rtDW_ADAS.GTAngleDetect.Angle_obj1 rtDW_ADAS.GTAngleDetect.Angle_obj2 rtDW_ADAS.GTAngleDetect.Angle_obj3 rtDW_ADAS.GTAngleDetect.Angle_obj4 rtDW_ADAS.GTAngleDetect.Angle_obj5 rtDW_ADAS.GTAngleDetect.Angle_obj6 rtDW_ADAS.GTAngleDetect.Angle_obj7 rtDW_ADAS.GTAngleDetect.Angle_obj8 /end SUB_GROUP
/end GROUP
/begin GROUP rtDW_ADAS.GTAngleDetect.Angle_obj1 ""
 /begin REF_MEASUREMENT rtDW_ADAS.GTAngleDetect.Angle_obj1.DetectObj rtDW_ADAS.GTAngleDetect.Angle_obj1.alfa_LL_obj rtDW_ADAS.GTAngleDetect.Angle_obj1.alfa_LR_obj rtDW_ADAS.GTAngleDetect.Angle_obj1.alfa_RL_obj rtDW_ADAS.GTAngleDetect.Angle_obj1.alfa_RR_obj rtDW_ADAS.GTAngleDetect.Angle_obj1.VAngle_obj rtDW_ADAS.GTAngleDetect.Angle_obj1.NumZone /end REF_MEASUREMENT
/end GROUP
/begin GROUP rtDW_ADAS.GTAngleDetect.Angle_obj2 ""
 /begin REF_MEASUREMENT rtDW_ADAS.GTAngleDetect.Angle_obj2.DetectObj rtDW_ADAS.GTAngleDetect.Angle_obj2.alfa_LL_obj rtDW_ADAS.GTAngleDetect.Angle_obj2.alfa_LR_obj rtDW_ADAS.GTAngleDetect.Angle_obj2.alfa_RL_obj rtDW_ADAS.GTAngleDetect.Angle_obj2.alfa_RR_obj rtDW_ADAS.GTAngleDetect.Angle_obj2.VAngle_obj rtDW_ADAS.GTAngleDetect.Angle_obj2.NumZone /end REF_MEASUREMENT
/end GROUP
/begin GROUP rtDW_ADAS.GTAngleDetect.Angle_obj3 ""
 /begin REF_MEASUREMENT rtDW_ADAS.GTAngleDetect.Angle_obj3.DetectObj rtDW_ADAS.GTAngleDetect.Angle_obj3.alfa_LL_obj rtDW_ADAS.GTAngleDetect.Angle_obj3.alfa_LR_obj rtDW_ADAS.GTAngleDetect.Angle_obj3.alfa_RL_obj rtDW_ADAS.GTAngleDetect.Angle_obj3.alfa_RR_obj rtDW_ADAS.GTAngleDetect.Angle_obj3.VAngle_obj rtDW_ADAS.GTAngleDetect.Angle_obj3.NumZone /end REF_MEASUREMENT
/end GROUP
/begin GROUP rtDW_ADAS.GTAngleDetect.Angle_obj4 ""
 /begin REF_MEASUREMENT rtDW_ADAS.GTAngleDetect.Angle_obj4.DetectObj rtDW_ADAS.GTAngleDetect.Angle_obj4.alfa_LL_obj rtDW_ADAS.GTAngleDetect.Angle_obj4.alfa_LR_obj rtDW_ADAS.GTAngleDetect.Angle_obj4.alfa_RL_obj rtDW_ADAS.GTAngleDetect.Angle_obj4.alfa_RR_obj rtDW_ADAS.GTAngleDetect.Angle_obj4.VAngle_obj rtDW_ADAS.GTAngleDetect.Angle_obj4.NumZone /end REF_MEASUREMENT
/end GROUP
/begin GROUP rtDW_ADAS.GTAngleDetect.Angle_obj5 ""
 /begin REF_MEASUREMENT rtDW_ADAS.GTAngleDetect.Angle_obj5.DetectObj rtDW_ADAS.GTAngleDetect.Angle_obj5.alfa_LL_obj rtDW_ADAS.GTAngleDetect.Angle_obj5.alfa_LR_obj rtDW_ADAS.GTAngleDetect.Angle_obj5.alfa_RL_obj rtDW_ADAS.GTAngleDetect.Angle_obj5.alfa_RR_obj rtDW_ADAS.GTAngleDetect.Angle_obj5.VAngle_obj rtDW_ADAS.GTAngleDetect.Angle_obj5.NumZone /end REF_MEASUREMENT
/end GROUP
/begin GROUP rtDW_ADAS.GTAngleDetect.Angle_obj6 ""
 /begin REF_MEASUREMENT rtDW_ADAS.GTAngleDetect.Angle_obj6.DetectObj rtDW_ADAS.GTAngleDetect.Angle_obj6.alfa_LL_obj rtDW_ADAS.GTAngleDetect.Angle_obj6.alfa_LR_obj rtDW_ADAS.GTAngleDetect.Angle_obj6.alfa_RL_obj rtDW_ADAS.GTAngleDetect.Angle_obj6.alfa_RR_obj rtDW_ADAS.GTAngleDetect.Angle_obj6.VAngle_obj rtDW_ADAS.GTAngleDetect.Angle_obj6.NumZone /end REF_MEASUREMENT
/end GROUP
/begin GROUP rtDW_ADAS.GTAngleDetect.Angle_obj7 ""
 /begin REF_MEASUREMENT rtDW_ADAS.GTAngleDetect.Angle_obj7.DetectObj rtDW_ADAS.GTAngleDetect.Angle_obj7.alfa_LL_obj rtDW_ADAS.GTAngleDetect.Angle_obj7.alfa_LR_obj rtDW_ADAS.GTAngleDetect.Angle_obj7.alfa_RL_obj rtDW_ADAS.GTAngleDetect.Angle_obj7.alfa_RR_obj rtDW_ADAS.GTAngleDetect.Angle_obj7.VAngle_obj rtDW_ADAS.GTAngleDetect.Angle_obj7.NumZone /end REF_MEASUREMENT
/end GROUP
/begin GROUP rtDW_ADAS.GTAngleDetect.Angle_obj8 ""
 /begin REF_MEASUREMENT rtDW_ADAS.GTAngleDetect.Angle_obj8.DetectObj rtDW_ADAS.GTAngleDetect.Angle_obj8.alfa_LL_obj rtDW_ADAS.GTAngleDetect.Angle_obj8.alfa_LR_obj rtDW_ADAS.GTAngleDetect.Angle_obj8.alfa_RL_obj rtDW_ADAS.GTAngleDetect.Angle_obj8.alfa_RR_obj rtDW_ADAS.GTAngleDetect.Angle_obj8.VAngle_obj rtDW_ADAS.GTAngleDetect.Angle_obj8.NumZone /end REF_MEASUREMENT
/end GROUP
/begin GROUP rtDW_ADAS.GTHLLAdbTargetLed ""
 /begin REF_MEASUREMENT rtDW_ADAS.GTHLLAdbTargetLed.MliaLADBLED1 rtDW_ADAS.GTHLLAdbTargetLed.MliaLADBLED2 rtDW_ADAS.GTHLLAdbTargetLed.MliaLADBLED3 rtDW_ADAS.GTHLLAdbTargetLed.MliaLADBLED4 rtDW_ADAS.GTHLLAdbTargetLed.MliaLADBLED5 rtDW_ADAS.GTHLLAdbTargetLed.MliaLADBLED6 rtDW_ADAS.GTHLLAdbTargetLed.MliaLADBLED7 rtDW_ADAS.GTHLLAdbTargetLed.MliaLADBLED8 rtDW_ADAS.GTHLLAdbTargetLed.MliaLADBLED9 rtDW_ADAS.GTHLLAdbTargetLed.MliaLADBLED10 rtDW_ADAS.GTHLLAdbTargetLed.MliaLADBLED11 rtDW_ADAS.GTHLLAdbTargetLed.MliaLADBLED12 rtDW_ADAS.GTHLLAdbTargetLed.MliaLADBLED13 rtDW_ADAS.GTHLLAdbTargetLed.MliaLADBLED14 rtDW_ADAS.GTHLLAdbTargetLed.MliaLADBLED15 rtDW_ADAS.GTHLLAdbTargetLed.MliaLADBLED16 rtDW_ADAS.GTHLLAdbTargetLed.MliaLADBLED17 rtDW_ADAS.GTHLLAdbTargetLed.MliaLADBLED18 /end REF_MEASUREMENT
/end GROUP
/begin GROUP rtDW_ADAS.GTHLLAdbTargetLed_g ""
 /begin REF_MEASUREMENT rtDW_ADAS.GTHLLAdbTargetLed_g.MliaLADBLED1 rtDW_ADAS.GTHLLAdbTargetLed_g.MliaLADBLED2 rtDW_ADAS.GTHLLAdbTargetLed_g.MliaLADBLED3 rtDW_ADAS.GTHLLAdbTargetLed_g.MliaLADBLED4 rtDW_ADAS.GTHLLAdbTargetLed_g.MliaLADBLED5 rtDW_ADAS.GTHLLAdbTargetLed_g.MliaLADBLED6 rtDW_ADAS.GTHLLAdbTargetLed_g.MliaLADBLED7 rtDW_ADAS.GTHLLAdbTargetLed_g.MliaLADBLED8 rtDW_ADAS.GTHLLAdbTargetLed_g.MliaLADBLED9 rtDW_ADAS.GTHLLAdbTargetLed_g.MliaLADBLED10 rtDW_ADAS.GTHLLAdbTargetLed_g.MliaLADBLED11 rtDW_ADAS.GTHLLAdbTargetLed_g.MliaLADBLED12 rtDW_ADAS.GTHLLAdbTargetLed_g.MliaLADBLED13 rtDW_ADAS.GTHLLAdbTargetLed_g.MliaLADBLED14 rtDW_ADAS.GTHLLAdbTargetLed_g.MliaLADBLED15 rtDW_ADAS.GTHLLAdbTargetLed_g.MliaLADBLED16 rtDW_ADAS.GTHLLAdbTargetLed_g.MliaLADBLED17 rtDW_ADAS.GTHLLAdbTargetLed_g.MliaLADBLED18 /end REF_MEASUREMENT
/end GROUP
/begin GROUP rtDW_ADAS.GTHLLAdbTargetLed_gz ""
 /begin REF_MEASUREMENT rtDW_ADAS.GTHLLAdbTargetLed_gz.MliaLADBLED1 rtDW_ADAS.GTHLLAdbTargetLed_gz.MliaLADBLED2 rtDW_ADAS.GTHLLAdbTargetLed_gz.MliaLADBLED3 rtDW_ADAS.GTHLLAdbTargetLed_gz.MliaLADBLED4 rtDW_ADAS.GTHLLAdbTargetLed_gz.MliaLADBLED5 rtDW_ADAS.GTHLLAdbTargetLed_gz.MliaLADBLED6 rtDW_ADAS.GTHLLAdbTargetLed_gz.MliaLADBLED7 rtDW_ADAS.GTHLLAdbTargetLed_gz.MliaLADBLED8 rtDW_ADAS.GTHLLAdbTargetLed_gz.MliaLADBLED9 rtDW_ADAS.GTHLLAdbTargetLed_gz.MliaLADBLED10 rtDW_ADAS.GTHLLAdbTargetLed_gz.MliaLADBLED11 rtDW_ADAS.GTHLLAdbTargetLed_gz.MliaLADBLED12 rtDW_ADAS.GTHLLAdbTargetLed_gz.MliaLADBLED13 rtDW_ADAS.GTHLLAdbTargetLed_gz.MliaLADBLED14 rtDW_ADAS.GTHLLAdbTargetLed_gz.MliaLADBLED15 rtDW_ADAS.GTHLLAdbTargetLed_gz.MliaLADBLED16 rtDW_ADAS.GTHLLAdbTargetLed_gz.MliaLADBLED17 rtDW_ADAS.GTHLLAdbTargetLed_gz.MliaLADBLED18 /end REF_MEASUREMENT
/end GROUP
/begin GROUP rtDW_ADAS.GTHLRAdbTargetLed ""
 /begin REF_MEASUREMENT rtDW_ADAS.GTHLRAdbTargetLed.MliaRADBLED1 rtDW_ADAS.GTHLRAdbTargetLed.MliaRADBLED2 rtDW_ADAS.GTHLRAdbTargetLed.MliaRADBLED3 rtDW_ADAS.GTHLRAdbTargetLed.MliaRADBLED4 rtDW_ADAS.GTHLRAdbTargetLed.MliaRADBLED5 rtDW_ADAS.GTHLRAdbTargetLed.MliaRADBLED6 rtDW_ADAS.GTHLRAdbTargetLed.MliaRADBLED7 rtDW_ADAS.GTHLRAdbTargetLed.MliaRADBLED8 rtDW_ADAS.GTHLRAdbTargetLed.MliaRADBLED9 rtDW_ADAS.GTHLRAdbTargetLed.MliaRADBLED10 rtDW_ADAS.GTHLRAdbTargetLed.MliaRADBLED11 rtDW_ADAS.GTHLRAdbTargetLed.MliaRADBLED12 rtDW_ADAS.GTHLRAdbTargetLed.MliaRADBLED13 rtDW_ADAS.GTHLRAdbTargetLed.MliaRADBLED14 rtDW_ADAS.GTHLRAdbTargetLed.MliaRADBLED15 rtDW_ADAS.GTHLRAdbTargetLed.MliaRADBLED16 rtDW_ADAS.GTHLRAdbTargetLed.MliaRADBLED17 rtDW_ADAS.GTHLRAdbTargetLed.MliaRADBLED18 /end REF_MEASUREMENT
/end GROUP
/begin GROUP rtDW_ADAS.GTHLRAdbTargetLed_i ""
 /begin REF_MEASUREMENT rtDW_ADAS.GTHLRAdbTargetLed_i.MliaRADBLED1 rtDW_ADAS.GTHLRAdbTargetLed_i.MliaRADBLED2 rtDW_ADAS.GTHLRAdbTargetLed_i.MliaRADBLED3 rtDW_ADAS.GTHLRAdbTargetLed_i.MliaRADBLED4 rtDW_ADAS.GTHLRAdbTargetLed_i.MliaRADBLED5 rtDW_ADAS.GTHLRAdbTargetLed_i.MliaRADBLED6 rtDW_ADAS.GTHLRAdbTargetLed_i.MliaRADBLED7 rtDW_ADAS.GTHLRAdbTargetLed_i.MliaRADBLED8 rtDW_ADAS.GTHLRAdbTargetLed_i.MliaRADBLED9 rtDW_ADAS.GTHLRAdbTargetLed_i.MliaRADBLED10 rtDW_ADAS.GTHLRAdbTargetLed_i.MliaRADBLED11 rtDW_ADAS.GTHLRAdbTargetLed_i.MliaRADBLED12 rtDW_ADAS.GTHLRAdbTargetLed_i.MliaRADBLED13 rtDW_ADAS.GTHLRAdbTargetLed_i.MliaRADBLED14 rtDW_ADAS.GTHLRAdbTargetLed_i.MliaRADBLED15 rtDW_ADAS.GTHLRAdbTargetLed_i.MliaRADBLED16 rtDW_ADAS.GTHLRAdbTargetLed_i.MliaRADBLED17 rtDW_ADAS.GTHLRAdbTargetLed_i.MliaRADBLED18 /end REF_MEASUREMENT
/end GROUP
/begin GROUP rtDW_ADAS.GTHLRAdbTargetLed_i5 ""
 /begin REF_MEASUREMENT rtDW_ADAS.GTHLRAdbTargetLed_i5.MliaRADBLED1 rtDW_ADAS.GTHLRAdbTargetLed_i5.MliaRADBLED2 rtDW_ADAS.GTHLRAdbTargetLed_i5.MliaRADBLED3 rtDW_ADAS.GTHLRAdbTargetLed_i5.MliaRADBLED4 rtDW_ADAS.GTHLRAdbTargetLed_i5.MliaRADBLED5 rtDW_ADAS.GTHLRAdbTargetLed_i5.MliaRADBLED6 rtDW_ADAS.GTHLRAdbTargetLed_i5.MliaRADBLED7 rtDW_ADAS.GTHLRAdbTargetLed_i5.MliaRADBLED8 rtDW_ADAS.GTHLRAdbTargetLed_i5.MliaRADBLED9 rtDW_ADAS.GTHLRAdbTargetLed_i5.MliaRADBLED10 rtDW_ADAS.GTHLRAdbTargetLed_i5.MliaRADBLED11 rtDW_ADAS.GTHLRAdbTargetLed_i5.MliaRADBLED12 rtDW_ADAS.GTHLRAdbTargetLed_i5.MliaRADBLED13 rtDW_ADAS.GTHLRAdbTargetLed_i5.MliaRADBLED14 rtDW_ADAS.GTHLRAdbTargetLed_i5.MliaRADBLED15 rtDW_ADAS.GTHLRAdbTargetLed_i5.MliaRADBLED16 rtDW_ADAS.GTHLRAdbTargetLed_i5.MliaRADBLED17 rtDW_ADAS.GTHLRAdbTargetLed_i5.MliaRADBLED18 /end REF_MEASUREMENT
/end GROUP
/begin GROUP rtDW_ADAS.GTmLEDTargetLed ""
 /begin REF_MEASUREMENT rtDW_ADAS.GTmLEDTargetLed.MliaRADBLED1 rtDW_ADAS.GTmLEDTargetLed.MliaRADBLED2 rtDW_ADAS.GTmLEDTargetLed.MliaRADBLED3 rtDW_ADAS.GTmLEDTargetLed.MliaRADBLED4 rtDW_ADAS.GTmLEDTargetLed.MliaRADBLED5 rtDW_ADAS.GTmLEDTargetLed.MliaRADBLED6 rtDW_ADAS.GTmLEDTargetLed.MliaRADBLED7 rtDW_ADAS.GTmLEDTargetLed.MliaRADBLED8 rtDW_ADAS.GTmLEDTargetLed.MliaRADBLED9 rtDW_ADAS.GTmLEDTargetLed.MliaRADBLED10 rtDW_ADAS.GTmLEDTargetLed.MliaRADBLED11 rtDW_ADAS.GTmLEDTargetLed.MliaRADBLED12 rtDW_ADAS.GTmLEDTargetLed.MliaRADBLED13 rtDW_ADAS.GTmLEDTargetLed.MliaRADBLED14 rtDW_ADAS.GTmLEDTargetLed.MliaRADBLED15 rtDW_ADAS.GTmLEDTargetLed.MliaRADBLED16 rtDW_ADAS.GTmLEDTargetLed.MliaRADBLED17 rtDW_ADAS.GTmLEDTargetLed.MliaRADBLED18 /end REF_MEASUREMENT
/end GROUP
/begin GROUP rtDW_ADAS.GTmLEDTargetLed_a ""
 /begin REF_MEASUREMENT rtDW_ADAS.GTmLEDTargetLed_a.MliaLADBLED1 rtDW_ADAS.GTmLEDTargetLed_a.MliaLADBLED2 rtDW_ADAS.GTmLEDTargetLed_a.MliaLADBLED3 rtDW_ADAS.GTmLEDTargetLed_a.MliaLADBLED4 rtDW_ADAS.GTmLEDTargetLed_a.MliaLADBLED5 rtDW_ADAS.GTmLEDTargetLed_a.MliaLADBLED6 rtDW_ADAS.GTmLEDTargetLed_a.MliaLADBLED7 rtDW_ADAS.GTmLEDTargetLed_a.MliaLADBLED8 rtDW_ADAS.GTmLEDTargetLed_a.MliaLADBLED9 rtDW_ADAS.GTmLEDTargetLed_a.MliaLADBLED10 rtDW_ADAS.GTmLEDTargetLed_a.MliaLADBLED11 rtDW_ADAS.GTmLEDTargetLed_a.MliaLADBLED12 rtDW_ADAS.GTmLEDTargetLed_a.MliaLADBLED13 rtDW_ADAS.GTmLEDTargetLed_a.MliaLADBLED14 rtDW_ADAS.GTmLEDTargetLed_a.MliaLADBLED15 rtDW_ADAS.GTmLEDTargetLed_a.MliaLADBLED16 rtDW_ADAS.GTmLEDTargetLed_a.MliaLADBLED17 rtDW_ADAS.GTmLEDTargetLed_a.MliaLADBLED18 /end REF_MEASUREMENT
/end GROUP
/end MODULE
/end PROJECT
